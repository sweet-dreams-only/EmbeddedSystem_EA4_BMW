AUTOSAR XML (schema 4-0-3)
package /ComponentTypes
  complex device driver sw component type CDD_DataAndAdrPar
    behavior CDD_DataAndAdrPar_InternalBehavior
      timing event CDD_DataAndAdrPar_InitEvent: start-on-event=CDD_DataAndAdrPar_Init2, period=0
      runnable CDD_DataAndAdrPar_Init2
  swc implementation CDD_DataAndAdrPar_Implementation: behavior=CDD_DataAndAdrPar_InternalBehavior
    code-descriptors:
      code Default: artifact-descriptors=autosar-engineering-object={short-label=Default, category=SWSRC}
