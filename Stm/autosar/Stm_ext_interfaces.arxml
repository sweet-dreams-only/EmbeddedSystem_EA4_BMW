AUTOSAR XML (schema 4-3-0)
# \copyright BMW AG 2017
package /BMW/Platform/Stm/Dem/PortInterfaces
  client server interface EnableCondition: is-service=true
    operation SetEnableCondition: possible-error=[E_OK, E_NOT_OK]
      arg ConditionFulfilled: type=boolean, direction=IN
    error E_OK: error-code=0
    error E_NOT_OK: error-code=1
