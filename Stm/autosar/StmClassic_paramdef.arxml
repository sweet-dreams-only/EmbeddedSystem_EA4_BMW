AUTOSAR XML (schema 4-3-0)
# \copyright BMW AG 2017
package /BMW_DEF
  module definition StmClassic [0..1]: variants pre-compile/post-build  # Configuration of the Stm module
    container CommonPublishedInformation  # Common Container
      integer SwMajorVersion: origin=BMW, set at published-information, default-value=5  # Sw Major Version
      integer SwMinorVersion: origin=BMW, set at published-information, default-value=2  # Sw Minor Version
      integer SwPatchVersion: origin=BMW, set at published-information, default-value=0  # Sw Patch Version
    container StmGeneral
      float StmInitialCentralErrorLockTimeout: 0.01..32.0, origin=BMW, set at pre-compile, default-value=6.0  # Initial (level 1) timeout of the CENTRAL_ERROR_LOCK supervision in seconds for StmComVariant STM_COM_FIELDS. Note: For StmComVariant STM_COM_CYCLIC_DATAELEMENTS this parameter is just for documentation purpose, since currently the AUTOSAR SWCD SWS does not support different aliveTimeout attributes in a NonQueuedReceiverComSpec, while Com does support this.
      float StmCentralErrorLockTimeout: 1.0..32.0, origin=BMW, set at pre-compile, default-value=21.0  # Normal (level 2) timeout in seconds of the CENTRAL_ERROR_LOCK supervision. Note: This value will be used for the attribute aliveTimeout of the corresponding NonQueuedReceiverComSpec.
      float StmEnergyStateTimeout: 1.0..32.0, origin=BMW, set at pre-compile, default-value=21.0  # Timeout in seconds of the ENERGY_STATE supervision. Note: This value will be used for the attribute aliveTimeout of the NonQueuedReceiverComSpec of the corresponding data element.
      float StmVehicleStateTimeout: 0.1..32.0, origin=BMW, set at pre-compile, default-value=0.5  # Timeout in seconds of the VEHICLE_STATE supervision. Note: This value will be used for the attribute aliveTimeout of the NonQueuedReceiverComSpec of the corresponding data element.
      enumeration StmComVariant: {STM_COM_CYCLIC_DATAELEMENTS, STM_COM_FIELDS}, origin=BMW, set at pre-compile, default-value=STM_COM_CYCLIC_DATAELEMENTS  # Switch to indicate, whether STM is deployed in a bordnet, where the CEL signal is transmitted cyclically so that the AUTOSAR Com module can be used for timeout detection or in an field/on-change-event based bordnet (Ethernet), where STM has to simulate timeout detection via field getter.
    container StmFeatureActivation [1..*]: multiple-configuration-container=true
      boolean StmCentralErrorLockEnabled: origin=BMW, set at pre-compile in variant pre-compile / post-build in variant post-build, default-value=true  # Switch indicating whether the StmErrorLock Feature (supervision of error lock signal and Dem interaction) shall be enabled or not.
      boolean StmEnergyStateEnabled: origin=BMW, set at pre-compile in variant pre-compile / post-build in variant post-build, default-value=true  # Switch indicating whether the StmEnergyState Feature (supervision of energy state signal) shall be enabled or not.
      boolean StmVehicleStateEnabled: origin=BMW, set at pre-compile in variant pre-compile / post-build in variant post-build, default-value=false  # Switch indicating whether the StmVehicleState Feature (supervision of vehicle state) shall be enabled or not.
    container StmEventSupervision [0..1]  # This container contains the configuration for timeout supervision in case STM is deployed on on-change-event based network without cyclical messages. Note: This container is only used when StmComVarian is set to STM_COM_FIELDS.
      float StmEventSupervisionCycle: 0.1..1, origin=BMW, set at pre-compile, default-value=0.1  # Set the call cycle time for timeout supervision
      float StmEventFieldGetResponseTime: 0.1..1, origin=BMW, set at pre-compile, default-value=0.1  # This is the maximum runtime/timespan the STM module waits for a return of a remote field-getter C/S call to return the value.
