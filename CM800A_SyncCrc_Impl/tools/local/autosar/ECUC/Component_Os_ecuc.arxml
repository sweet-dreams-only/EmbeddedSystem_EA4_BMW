AUTOSAR XML (schema 4-0-3)
package /ActiveEcuC
  module config Os: implementation-config-variant=VARIANT-PRE-COMPILE, module-description=Os_Impl
    OsOS:
      OsStackMonitoring = false
      OsOSStackUsageMeasurement = AUTO
      OsStatus = EXTENDED
      OsUseGetServiceId = false
      OsUseParameterAccess = false
      OsUseResScheduler = false
      OsOSCallISRHooks = false
      OsOSMemoryProtection = true
      OsOSCheckIntAPIStatus = true
      OsOSSupportFPU = false
      OsOSEnumeratedUnhandledISRs = false
      OsOSORTIDebugSupport = true
      OsOSTypeHeaderInclude = true
      OsOSUserConfigurationVersion = 1
      OsOSSystemStackSize = 200
      OsOSTimingProtectionTimerClock = 0
      OsOSOSInternalChecks = Additional
      OsOSCompiler = GHS
      OsOSORTIDebugLevel = ORTI_22_Additional
      OsOSTimingHooks = 
      OsOSSCHEDULE
        AUTO
      OsOSCC
        AUTO
      OsOSProtectionHookReaction
        Selected: OsOSSHUTDOWN=true
      OsOSPreAlarmHook
        FALSE
      OsOSTimingMeasurement
        TRUE: OsOSGlobalConfig=AsSelected
      OsOSUseSemaphores
        FALSE
      OsHooks: OsErrorHook=false, OsPostTaskHook=false, OsPreTaskHook=false, OsShutdownHook=false, OsStartupHook=false
    VectorCommonData: BswmdVersion=2.05.03
    OsImplementationInformation: OsVectorOilVersion=4.1, OsVectorImplementationName=RH850_P1M.i41, OsBswmdStyleVersion=2
    OSDEFAULTAPPMODE (OsAppMode)
    Appl10 (OsApplication): OsTrusted=false, OsAppGenerateStub=false, OsApplicationASID=1023
      OsApplicationHooks: OsAppStartupHook=false, OsAppShutdownHook=false, OsAppErrorHook=false
