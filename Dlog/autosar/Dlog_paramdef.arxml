AUTOSAR XML (schema 4-3-0)
package /BMW_DEF
  module definition Dlog: category=VENDOR_SPECIFIC_MODULE_DEFINITION, variants pre-compile
    container CommonPublishedInformation  # Common container, aggregated by all modules. It contains published information about vendor and versions.
      integer SwMajorVersion: origin=BMW, set at published-information, default-value=5  # Major version number of the vendor specific implementation of the module.
      integer SwMinorVersion: origin=BMW, set at published-information, default-value=1  # Minor version number of the vendor specific implementation of the module.
      integer SwPatchVersion: origin=BMW, set at published-information, default-value=1  # Patch version number of the vendor specific implementation of the module.
    container Features
      boolean EnableEcu: origin=BMW, set at pre-compile, default-value=true  # Enables the diagonstic service for reading the ECU manufacturing data, the ECU serial number and the VIN. Should be enabled in Bootloader and Application only.
      boolean EnableSvkCurrent: origin=BMW, set at pre-compile, default-value=true  # Enables the diagnostic services for reading the current SVK. Should be enabled in Bootloader and Application only.
      boolean EnableSvkHistory: origin=BMW, set at pre-compile, default-value=false  # Enables the diagnostic services for reading and writing an SVK history entry. Should be enabled in Application only.
      container SvkHistory [0..1]: multiplicity set at pre-compile  # Enables the diagnostic services for reading and writing an SVK history entry. Should be enabled in Application only.
        integer MaxNumberOfHistorySgbmIds: 3..255, origin=BMW, set at pre-compile, default-value=3  # This should be the maximum number of SWEs and HWEs that can possibly be in one configuration set and thererfore be written to the SVK history memory.
        integer NumberOfSvkBackups: 0..31, origin=BMW, set at pre-compile, default-value=3  # The parameter defines the number of SVK backup entries beside the system supplier and plant SVK history.
    container General
      boolean DevErrorDetect: origin=BMW, set at pre-compile, default-value=false  # This parameter determines whether development error tracing is enabled or disabled.
      integer MaxNumberOfSweGroups: 1..255, origin=BMW, set at pre-compile, default-value=8
