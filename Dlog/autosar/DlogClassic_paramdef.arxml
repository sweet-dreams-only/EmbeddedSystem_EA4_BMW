AUTOSAR XML (schema 4-3-0)
# \copyright BMW AG 2015 - 2016
package /BMW_DEF
  module definition DlogClassic: category=VENDOR_SPECIFIC_MODULE_DEFINITION, variants pre-compile  # Configuration of the Dlog module.
    container CommonPublishedInformation  # Common container, aggregated by all modules. It contains published information about vendor and versions.
      integer SwMajorVersion: origin=BMW, set at published-information, default-value=5  # Major version number of the vendor specific implementation of the module.
      integer SwMinorVersion: origin=BMW, set at published-information, default-value=3  # Minor version number of the vendor specific implementation of the module.
      integer SwPatchVersion: origin=BMW, set at published-information, default-value=1  # Patch version number of the vendor specific implementation of the module.
    container Dlog_Features  # This container is for switching specific features of the Dlog module on or off, according to where the module is used (Bootmanger, Bootloader or Application).
      boolean EnableEcuWriteVin: origin=BMW, set at pre-compile, default-value=false  # Enables the diagnostic service for writing the VIN. For non-SWT ECUs it should be enabled in Bootloader only. For SWT enabled ECUs it should be enabled in Application and Bootloader.
      boolean EnableMemSegTableRead: origin=BMW, set at pre-compile, default-value=true  # Enables the diagnostic services for reading Memory Segmentation Table as well as some API functions for accessing the Memory Segmentation Table.
      boolean EnableNvMemory: origin=BMW, set at pre-compile, default-value=true  # Enables the handling of NV Memory Blocks. Should be enabled in Bootloader and Application only.
      boolean EnableRte: origin=BMW, set at pre-compile, default-value=true  # Enables the use of the RTE for communication from and to other modules.
      boolean EnableSweGet: origin=BMW, set at pre-compile, default-value=false  # Should be enabled in Bootmanager and Bootloader only. When using optional SWFKs, this should be enabled in Application, too.
      boolean EnableSweInit: origin=BMW, set at pre-compile, default-value=false  # Should be enabled in Bootmanager only
      boolean EnableTimingParameters: origin=BMW, set at pre-compile, default-value=true  # Enables the diagnostic service for reading the flash timing parameters. Should be enabled in Bootloader and Application only.
      boolean ExceptionHandlerHandleSWEErrors: origin=BMW, set at pre-compile, default-value=false  # Enables the handling of ECC errors in SWEs. Should be enabled in Bootmanager only. If you are using a Hardware, where ECC errors are thrown for blank flash memory, this should be enabled also in Bootloader.
        ecuc-cond condition-formula=GetHandleEccRom:
          ecuc query GetHandleEccRom: ecuc-query-expression=value( refvalue( /BMW_DEF/DlogShared/DlogSharedPlatform/HandleEccRom ) )
      integer MemIfDeviceId: origin=BMW, set at pre-compile, default-value=0  # Sets the device id which should be used for the MemIf interface. Applys only if NvmInterface is set to DLOG_NVM_INTERFACE_MEMIF.
        ecuc-cond condition-formula=[MemIfDeviceId/GetNvMemEnabled, GetMemIfSelected]:
          ecuc query GetNvMemEnabled: ecuc-query-expression=value( refvalue( /BMW_DEF/DlogClassic/Dlog_Features/EnableNvMemory ) )
          ecuc query GetMemIfSelected: ecuc-query-expression=value( refvalue( /BMW_DEF/DlogClassic/Dlog_Features/NvmInterface ) )
      enumeration NvmInterface: origin=BMW, set at pre-compile, default-value=DLOG_NVM_INTERFACE_NVM  # Selects which interface should be used for accessing the NV Memory.
        DLOG_NVM_INTERFACE_MEMIF  # Use the Memory Abstraction Interface for accessing the NV Memory.
        DLOG_NVM_INTERFACE_NVM  # Use the NVRAM Manager for accessing the NV Memory.
        ecuc-cond condition-formula=NvmInterface/GetNvMemEnabled:
          ecuc query GetNvMemEnabled: ecuc-query-expression=value( refvalue( /BMW_DEF/DlogClassic/Dlog_Features/EnableNvMemory ) )
      integer RteCodingSvkArraySize: 8..65535, origin=BMW, set at pre-compile  # Sets the RTE array size (the maximum size) for variable sized Coding SVK array.
      integer RteSvkArrayMaxSize: 17.., origin=BMW, set at pre-compile, default-value=100  # Sets the RTE array size (the maximum size) for variable sized SVK array.
        ecuc-cond condition-formula=RteSvkArrayMaxSize/GetRteEnabled:
          ecuc query GetRteEnabled: ecuc-query-expression=value( refvalue( /BMW_DEF/DlogClassic/Dlog_Features/EnableRte ) )
      integer RteUserSvkArrayMaxSize: 0.., origin=BMW, set at pre-compile, default-value=100  # Sets the RTE array size (the maximum size) for variable sized User SVK array.
        ecuc-cond condition-formula=RteUserSvkArrayMaxSize/GetRteEnabled:
          ecuc query GetRteEnabled: ecuc-query-expression=value( refvalue( /BMW_DEF/DlogClassic/Dlog_Features/EnableRte ) )
      boolean SweGetDirectBootAndAppl1Swe: origin=BMW, set at pre-compile, default-value=false  # Directly access Boot- and Appl1-SWE. Should be enabled in Bootmanager only.
        ecuc-cond condition-formula=SweGetDirectBootAndAppl1Swe/GetSweGetEnabled:
          ecuc query GetSweGetEnabled: ecuc-query-expression=value( refvalue( /BMW_DEF/DlogClassic/Dlog_Features/EnableSweGet ) )
      boolean SweGetPerformErrorCheck: origin=BMW, set at pre-compile, default-value=false  # Should be enabled in Bootmanager only
        ecuc-cond condition-formula=SweGetPerformErrorCheck/GetSweGetEnabled:
          ecuc query GetSweGetEnabled: ecuc-query-expression=value( refvalue( /BMW_DEF/DlogClassic/Dlog_Features/EnableSweGet ) )
      boolean SweGetValidFlagBlankCheck: origin=BMW, set at pre-compile, default-value=false  # Should be enabled in Bootloader only. If your hardware throws ECC errors for blank flash memory, this can be disabled. In this case, enable ExceptionHandlerHandleSWEErrors instead.
        ecuc-cond condition-formula=SweGetValidFlagBlankCheck/GetSweGetEnabled:
          ecuc query GetSweGetEnabled: ecuc-query-expression=value( refvalue( /BMW_DEF/DlogClassic/Dlog_Features/EnableSweGet ) )
      boolean SweGetVerifyCrcChecksum: origin=BMW, set at pre-compile, default-value=true  # Defines whether or not to perform a CRC check in SweGet. Requires the Autosar CRC Library.
        ecuc-cond condition-formula=SweGetVerifyCrcChecksum/GetSweGetEnabled:
          ecuc query GetSweGetEnabled: ecuc-query-expression=value( refvalue( /BMW_DEF/DlogClassic/Dlog_Features/EnableSweGet ) )
    container Dlog_General  # General configuration parameters.
      boolean DlogUseCoding: origin=BMW, set at pre-compile, default-value=false  # This parameter defines whether the Coding module should be used to obtain the CAF IDs. Note that this requires the feature EnableRte to be set.
      string DlogWatchdogInclude [0..1]: multiplicity set at pre-compile, origin=BMW, set at pre-compile, default-value=WdgIf.h  # File to be included for the watchdog triggering operation. Normally it should be WdgIf.h (see default value). | This is needed only, if the features EnableSweGet and SweGetPerformErrorCheck are enabled.
      string DlogWatchdogTrigger: origin=BMW, set at pre-compile, default-value=WdgIf_SetTriggerCondition(0,100)  # Code to be executed for triggering the watchdog. Normally it should call WdgIf_SetTriggerCondition with the desired device index and timeout (see default value). | This is used only, if the features EnableSweGet and SweGetPerformErrorCheck are enabled.
    container Dlog_User
      string RomAccessExceptionHandler: origin=BMW, set at pre-compile, default-value=0  # The parameter defines the user defined rom access exception handler function. It must be an expression that evaluates to 0 or 1, where 0 means no reset and 1 means reset. | The expression may use the parameters uint32 codeAddress and uint32 dataAddress
      string RomAccessExceptionHandlerInclude [0..1]: multiplicity set at pre-compile, origin=BMW, set at pre-compile  # The file that must be #included for the RomAccessExceptionHandler.
