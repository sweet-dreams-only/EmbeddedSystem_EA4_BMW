AUTOSAR XML (schema 4-0-3)
package /Nxtr
  module definition MotCtrlMgr [0..1]: variants pre-compile  # Configuration of the Motor Control Manager.
    container MotCtrlMgrConfigSet  # This is the container for the Motor Control Manager Configuration
      container SignalManagement  # This container all of the signals that MotCtrlMgr manages
        string IncludeHeaders [0..255]: origin=NXTR  # Please type in all includes that may be needed for initial values (e.g. MyHeader.h)
        container NonRteEnum [0..255]  # This container contains the details of enum definitions required outside of the RTE. The short name should be the enumeration name.
          enumeration EnumImplementationDataType: {uint32, uint16, uint8}, origin=NXTR  # Implementation Data Type of enumeration
          container EnumElement [1..65535]  # This container contains the details of the enum element. The short name should be the enumeration element name.
            integer Value: 0..4294967295, origin=NXTR  # Value of enumeration value
        container Signal [0..255]  # This container contains the details of the signal. The short name should match the base signal name (excluding MotCtrl prefix)
          boolean WrittenInMotCtrlRunnable: origin=NXTR  # Set to true if signal is written in motor control runnable
          boolean ReadInMotCtrlRunnable: origin=NXTR  # Set to true if signal is read in motor control runnable
          boolean WrittenIn2msRunnable: origin=NXTR  # Set to true if signal is written in motor control runnable
          boolean ReadIn2msRunnable: origin=NXTR  # Set to true if signal is read in motor control runnable
          enumeration ImplementationDataType: {float32, uint32, sint32, uint16, sint16, uint8, sint8, boolean}, origin=NXTR  # Implementation Data Type of signal
          integer Size: 1..255, origin=NXTR  # Size of signal (set to 1 unless signal is an array)
          string InitialValue: origin=NXTR  # Initial Value, for arrays this should be a comma separated list (e.g. you would enter: 10,20,30,40)
          string Min: origin=NXTR  # Minimum Value as indicated by m file
          string Max: origin=NXTR  # Maximum Value as indicated by m file
          string Units: origin=NXTR  # Units as indicated by m file
          symbolic name reference EnumerationNameReference [0..1]: origin=NXTR, destination=NonRteEnum  # Enumeration Name Reference | Selection of Enumeration if applicable (only select if the signal is an enumeration type)
        container SignalMapping [0..255]  # This container contains the configuration for mapping differently named signals to each other. This is required for the standard sensor interface strategy for example.
          string OutputSignalName: origin=NXTR  # Output Signal Name
          string InputSignalName [1..255]: origin=NXTR  # Input Signal Name
      container RunnableManagement  # This container all of the runnables that MotCtrlMgr manages
        string IncludeHeaders [0..255]: origin=NXTR  # Please type in all includes that provide runnable prototypes (e.g. MyHeader.h)
        container Runnable [0..255]  # This container contains the details of the runnable. The short name should match the runnable name
          enumeration RunnableRate: {MotorControl, MotorControlx2}, origin=NXTR  # Rate of Runnable
          integer SequenceOrder: 1..255, origin=NXTR  # Sequence of Runnables (Lower number is executed first). Please note that there will be inefficiencies if all MotorControlx2 runnables are not grouped together.
