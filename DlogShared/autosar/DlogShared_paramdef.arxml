AUTOSAR XML (schema 4-3-0)
# \copyright BMW AG 2012 - 2017
package /BMW_DEF
  module definition DlogShared: category=VENDOR_SPECIFIC_MODULE_DEFINITION, variants pre-compile/post-build  # Shared part of the Dlog module
    container CommonPublishedInformation  # Common container, aggregated by all modules. It contains published information about vendor and versions.
      integer SwMajorVersion: origin=BMW, set at published-information, default-value=5  # Major version number of the vendor specific implementation of the module.
      integer SwMinorVersion: origin=BMW, set at published-information, default-value=0  # Minor version number of the vendor specific implementation of the module.
      integer SwPatchVersion: origin=BMW, set at published-information, default-value=3  # Patch version number of the vendor specific implementation of the module.
    container DlogSharedGeneral  # Common configuration parameters that are shared between Bootmanager, Bootloader and Application.
      container Logistic  # Describes the logistic data.
        string DlogEcuManufactoringDateDefault: origin=BMW, set at pre-compile, default-value=0x00,0x00,0x00, max-length=16, min-length=5  # The parameter defines the manufacturing date as 3 comma separated byte values (uint8 array).
        string DlogEcuSerialNumberDefault: origin=BMW, set at pre-compile, default-value=1234567890123456  # The parameter defines the default value for the serial number.
        integer DlogEcuSerialNumberLength: 1..255, origin=BMW, set at pre-compile, default-value=16  # The parameter defines the length of the serial number.
        integer DlogHweDevelopmentInfoLength: 0..255, origin=BMW, set at pre-compile, default-value=10  # Length of the HWE development info field: The HardwareDevelopmentInfo CAN NOT be overwritten by the SWE-Generator tool. The length that is configured here will be reserved in a protected ROM space (in the BootManager). It is not designated that the size can be increased during ECU livetime.
        boolean DlogHweTableInitFromRom: origin=BMW, set at pre-compile, default-value=true  # If enabled, initializes the HWE table from ROM. If disabled, HWE table must be initialized by integration code.
        integer DlogNumberOfSvkBackups: 0..61, origin=BMW, set at pre-compile, default-value=3  # The parameter defines the number of SVK backup entries beside the system supplier and plant SVK history.
        integer DlogProgrammingCounterMaxValue: 1..65535, origin=BMW, set at pre-compile, default-value=10  # Maximum number of programming cycles supported by the ECU.
        integer DlogSweDevelopmentInfoLength: 0..255, origin=BMW, set at pre-compile, default-value=10  # Length of the SWE development info field: To disable the SWE development info functionality, set to 0.
        container ConfigSet [1..255]
          container HweData [0..255]  # Describes a HWE entry.
            string DevelopmentInfo: origin=BMW, set at pre-compile  # Content of the development info field of the XWE.
            integer Id: 0..4294967295, origin=BMW, set at pre-compile, default-value=0  # The 32 bit id of the XWE.
            enumeration ProcessClass: {DLOG_PROCESSCLASS_HWEL, DLOG_PROCESSCLASS_HWAP, DLOG_PROCESSCLASS_HWFR, DLOG_PROCESSCLASS_CAFD, DLOG_PROCESSCLASS_BTLD, DLOG_PROCESSCLASS_FLSL, DLOG_PROCESSCLASS_SWFL, DLOG_PROCESSCLASS_SWFF, DLOG_PROCESSCLASS_SWPF, DLOG_PROCESSCLASS_ONPS, DLOG_PROCESSCLASS_IBAD, DLOG_PROCESSCLASS_FAFP, DLOG_PROCESSCLASS_FCFA, DLOG_PROCESSCLASS_TLRT, DLOG_PROCESSCLASS_TPRG, DLOG_PROCESSCLASS_ENTD, DLOG_PROCESSCLASS_NAVD, DLOG_PROCESSCLASS_FCFN}, origin=BMW, set at pre-compile  # The process class of the XWE.
            integer VersionMajor: 0..255, origin=BMW, set at pre-compile, default-value=1  # The major version of the XWE.
            integer VersionMinor: 0..255, origin=BMW, set at pre-compile, default-value=0  # The minor version of the XWE.
            integer VersionPatch: 0..255, origin=BMW, set at pre-compile, default-value=0  # The patch version of the XWE.
        container HWModificationIndex
          enumeration HWModel: {DLOG_HWM_A_MUSTER, DLOG_HWM_B_MUSTER, DLOG_HWM_C_MUSTER, DLOG_HWM_SERIAL}, origin=BMW, set at pre-compile, default-value=DLOG_HWM_A_MUSTER
          integer HWModificationIndex: 0..254, origin=BMW, set at pre-compile, default-value=0  # Index of the hardware modification
          integer SupplierInfoFied: 0..63, origin=BMW, set at pre-compile, default-value=0
      container MemorySegmentation  # Configures the memory segmentation table
        container Entry [1..255]  # This container contains an entry in the memory segmentation table. It consists of the start address, the size and the number of contiguous same sized flash segments. The multiplicity value of this container depends on the number of blocks of same sized flash segments of the target CPU.
          integer NumberOfSegments: 1..65535, origin=BMW, set at pre-compile  # The number of memory segments in this sequence
          integer SegmentSize: 0..4294967295, origin=BMW, set at pre-compile  # The size of each memory segment in this sequence in bytes
          integer StartAddress: 0..4294967295, origin=BMW, set at pre-compile  # The start address of the first memory segment in this sequence
      container Swe  # This container contains the configuration of the SWEs. The first entry must be the Bootloader SWE. Subsequent entries describe the Application SWEs.
        integer BluSweId: 1..255, origin=BMW, set at pre-compile, default-value=1  # Swe Id where the BLU should be stored in case of a Bootloader update.
        integer CrcSkipSize: 0..65535, origin=BMW, set at pre-compile, default-value=255  # Number of Bytes to skip after processing one byte during CRC calculation. Set this value to 0 to include all bytes in CRC calculation. A value of 255 processes every 256'th byte.
        integer MaxNumberOfSwes: 2..256, origin=BMW, set at pre-compile, default-value=16  # Maximum number of supported SWEs by the bootmanager. This value is stored in the bootmanager and accessed by bootloader and application. Therefore it must not be changed on software/bootloader updates.
        integer SignatureLength: 1..1024, origin=BMW, set at pre-compile, default-value=132  # Sets the length (in bytes) of the signature field for each SWE.
        container SweConfiguration [1..255]  # Configures an SWE.
          integer CpuId: 0..254, origin=BMW, set at pre-compile, default-value=0  # Describes the CPU, this SWE is on. Use 0 for master and 1..254 for internal slave CPUs. SWEs on external slaves are NOT configured here.
          integer SweDescriptionTableAddress: 0..18446744073709551615, origin=BMW, set at pre-compile  # Defines the address of the Swe Description table. This configuration parameter is not used by the Dlog module, but it may be used to generate appropriate linker files.
          integer SweId: 0..255, origin=BMW, set at pre-compile, default-value=0  # The number of the SWE. Use 0 for the Boot-SWE and 1..n for the n Application SWEs.
          integer SweSignatureAddress: 0..18446744073709551615, origin=BMW, set at pre-compile  # Defines the address of the Swe Signature. This configuration parameter is not used by the Dlog module, but it may be used to generate appropriate linker files.
          reference SweGroup: origin=BMW, set at pre-compile, destination=SweGroupConfiguration  # Group the SWE belongs to.
          container LogisticData  # The logistic data of the SWE.
            string DevelopmentInfo: origin=BMW, set at pre-compile  # Content of the development info field of the SWE.
            enumeration ProcessClass: {DLOG_PROCESSCLASS_CAFD, DLOG_PROCESSCLASS_BTLD, DLOG_PROCESSCLASS_FLSL, DLOG_PROCESSCLASS_SWFL, DLOG_PROCESSCLASS_SWFF, DLOG_PROCESSCLASS_SWPF, DLOG_PROCESSCLASS_ONPS, DLOG_PROCESSCLASS_IBAD, DLOG_PROCESSCLASS_SWFK, DLOG_PROCESSCLASS_FAFP, DLOG_PROCESSCLASS_FCFA, DLOG_PROCESSCLASS_TLRT, DLOG_PROCESSCLASS_TPRG, DLOG_PROCESSCLASS_ENTD, DLOG_PROCESSCLASS_NAVD, DLOG_PROCESSCLASS_FCFN}, origin=BMW, set at pre-compile  # The process class of the SWE.
          container SignatureBlock [1..255]  # Describes a block in the SWE that is included in the signature check.
            integer Size: 0..18446744073709551615, origin=BMW, set at pre-compile  # The size of the block in bytes.
            integer StartAddress: 0..18446744073709551615, origin=BMW, set at pre-compile  # The start address of the block.
          container SweBlock [1..255]  # Defines a memory block that belongs to this SWE.
            integer BlockSize: 0..4294967295, origin=BMW, set at pre-compile, default-value=0  # The size of the block in bytes.
            integer BlockStartAddress: 0..4294967295, origin=BMW, set at pre-compile, default-value=0  # The start address of the block.
        container SweGroupConfiguration [1..255]
          enumeration GroupType: {ALLOBLIGATORY, ONEOBLIGATORY, OPTIONAL}, origin=BMW, set at pre-compile, default-value=ALLOBLIGATORY
      container TimingParameter  # This container contains all timing parameters for the flash and diagnostic process.
        integer AuthentificationTime: 10..65535, origin=BMW, set at pre-compile, default-value=10  # The parameter defines the maximum authentification time in seconds.
        integer BootloaderInstallTime: 1..65535, origin=BMW, set at pre-compile, default-value=40  # The parameter defines the maximum bootloader install time in seconds.
        integer CheckMemoryTime: 10..65535, origin=BMW, set at pre-compile, default-value=10  # The parameter defines the maximum check memory time in seconds.
        integer EraseMemoryTime: 10..65535, origin=BMW, set at pre-compile, default-value=60  # The parameter defines the maximum erase memory time in seconds.
        integer ResetTime: 1..65535, origin=BMW, set at pre-compile, default-value=10  # The parameter defines the maximum reset time in seconds.
        integer TransferDataTime: 10..65535, origin=BMW, set at pre-compile, default-value=10  # The parameter defines the maximum transfer data time in seconds.
    container DlogSharedPlatform  # Platform specific configuration
      string ConvertExtAddress2IntPointer: origin=BMW, set at pre-compile, default-value=((uint32)extAddress)  # Expression, that converts a logical block number sent by the tester (e.g. a pointer to a SWE table) to an internal (far) pointer. On 32 bit platforms, a simple typecast is sufficient (see default value). | Input parameter is extAddress.
      string ConvertIntPointer2ExtAddress: origin=BMW, set at pre-compile, default-value=((uint32)intPointer)  # Expression, that converts an internal (far) pointer to a logical block number. On 32 bit platforms, a simple typecast is sufficient (see default value). | Input parameter is intPointer.
      enumeration EccErrorState: {INVALID, UNCHECKED}, origin=BMW, set at pre-compile, default-value=INVALID  # The SWE and Programming Dependencies State that shall be returned by the corresponding GetState functions. Use UNCHECKED, if your hardware cannot distinguish between unwritten and erroneous flash memory.
      integer FlashErasedByte: 0..255, origin=BMW, set at pre-compile, default-value=255  # Defines the value which indicates erased flash memory. This is usually 0xFF, however on Tricore it is 0x00.
      integer FlashPageSize: 1..65536, origin=BMW, set at pre-compile, default-value=8  # Size of minimum writable flash data in Bytes.
      boolean HandleEccRom: origin=BMW, set at pre-compile, default-value=false  # Defines whether ROM ECC errors are handled
      boolean MultiCpuEnable: origin=BMW, set at pre-compile, default-value=false  # Selects, whether this ECU is a multi CPU ECU. If enabled, additional user defined functions are required to handle communication with slave CPUs.
    container Dlog_MultiConfig  # Multiple Configuration Container
      integer EcuId: 0..255, origin=BMW, set at pre-compile in variant pre-compile / post-build in variant post-build, default-value=126  # The ECU Id.
      reference ConfigSet: origin=BMW, set at pre-compile in variant pre-compile / post-build in variant post-build, destination=ConfigSet
