AUTOSAR XML (schema 4-2-1)
package /MICROSAR
  module config Os_Rec: definition=Os
    OsMemoryProtection
      6 x OsMemoryRegion, all with OsMemoryRegionAccessRights=SR, OsMemoryRegionAccessRights=UR:
        MemoryRegion_Core0_ROM: OsMemoryRegionStartAddress=0x0, OsMemoryRegionEndAddress=0x009FFFFF, OsMemoryRegionAccessRights=SX, OsMemoryRegionAccessRights=UX, OsMemoryRegionProtectionUnit=MPU_CORE0
        MemoryRegion_Core0_RAM_Stacks: OsMemoryRegionStartAddress=0xFE9C0000, OsMemoryRegionEndAddress=0xFEDFFFFF, OsMemoryRegionProtectionUnit=MPU_CORE0
        MemoryRegion_Core0_RAM_IO: OsMemoryRegionStartAddress=0xFEEF4000, OsMemoryRegionEndAddress=0xFFFFFFFF, OsMemoryRegionAccessRights=SW, OsMemoryRegionProtectionUnit=MPU_CORE0
        MemoryRegion_Core1_ROM: OsMemoryRegionStartAddress=0x0, OsMemoryRegionEndAddress=0x009FFFFF, OsMemoryRegionAccessRights=SX, OsMemoryRegionAccessRights=UX, OsMemoryRegionProtectionUnit=MPU_CORE1
        MemoryRegion_Core1_RAM_Stacks: OsMemoryRegionStartAddress=0xFE9C0000, OsMemoryRegionEndAddress=0xFEDFFFFF, OsMemoryRegionProtectionUnit=MPU_CORE1
        MemoryRegion_Core1_RAM_IO: OsMemoryRegionStartAddress=0xFEEF4000, OsMemoryRegionEndAddress=0xFFFFFFFF, OsMemoryRegionAccessRights=SW, OsMemoryRegionProtectionUnit=MPU_CORE1
