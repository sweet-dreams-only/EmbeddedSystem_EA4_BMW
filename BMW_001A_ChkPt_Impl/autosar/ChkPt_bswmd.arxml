AUTOSAR XML (schema 4-0-3)
package /Nxtr/EcucDefs_ChkPt
  ecuc definition collection NxtrParameterDefinition_ChkPt: module=ChkPt
  module definition ChkPt [0..1]: variants pre-compile  # Configuration of the ChkPt module.
  bsw implementation ChkPt_Impl: programming-language=C, used-code-generator=EXTERNAL, behavior=ChkPtBehavior, vendor-specific-module-def=ChkPt
