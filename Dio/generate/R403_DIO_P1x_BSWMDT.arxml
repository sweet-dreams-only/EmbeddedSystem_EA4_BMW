AUTOSAR XML (schema 4-0-3)
# COPYRIGHT
# Copyright(c) 2013 - 2017 Renesas Electronics Corporation
package /Renesas/EcucDefs_Dio
  bsw implementation Dio_Impl: programming-language=C, sw-version=1.0.12, vendor-id=59, ar-release-version=4.0.3, behavior=BswInternalBehavior_0, vendor-api-infix=Renesas, vendor-specific-module-def=Dio
  bsw module description Dio: module-id=120
    bsw internal behavior BswInternalBehavior_0
      exclusive area DIO_REGISTER_PROTECTION
      10 x bsw called entity:
        BswCalledEntity_0: implemented-entry=Dio_ReadChannel
        BswCalledEntity_1: can-enter-exclusive-area=DIO_REGISTER_PROTECTION, implemented-entry=Dio_WriteChannel
        BswCalledEntity_2: implemented-entry=Dio_ReadPort
        BswCalledEntity_3: can-enter-exclusive-area=DIO_REGISTER_PROTECTION, implemented-entry=Dio_WritePort
        BswCalledEntity_4: implemented-entry=Dio_ReadChannelGroup
        BswCalledEntity_5: can-enter-exclusive-area=DIO_REGISTER_PROTECTION, implemented-entry=Dio_WriteChannelGroup
        BswCalledEntity_6: implemented-entry=Dio_Init
        BswCalledEntity_7: implemented-entry=Dio_GetVersionInfo
        BswCalledEntity_8: can-enter-exclusive-area=DIO_REGISTER_PROTECTION, implemented-entry=Dio_FlipChannel
        BswCalledEntity_9: can-enter-exclusive-area=DIO_REGISTER_PROTECTION, implemented-entry=Dio_MaskedWritePort
  10 x bsw module entry, all with is-synchronous=true, call-type=REGULAR, execution-context=TASK:
    Dio_ReadChannel: service-id=0
    Dio_WriteChannel: service-id=1
    Dio_ReadPort: service-id=2
    Dio_WritePort: service-id=3
    Dio_ReadChannelGroup: service-id=4
    Dio_WriteChannelGroup: service-id=5
    Dio_GetVersionInfo: service-id=18
    Dio_Init: service-id=16
    Dio_FlipChannel: service-id=17
    Dio_MaskedWritePort: service-id=19
