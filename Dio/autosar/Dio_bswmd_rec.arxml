AUTOSAR XML (schema 4-0-3)
package /Renesas/EcucDefs_Dio
  module config Dio_Rec: definition=Dio
    DioGeneral: DioVersionCheckExternalModules=0
  bsw implementation Dio_Impl: programming-language=C, behavior=DioBehavior, recommended-configuration=Dio_Rec, vendor-specific-module-def=Dio
