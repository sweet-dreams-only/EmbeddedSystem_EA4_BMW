AUTOSAR XML (schema 4-2-2)
package /BMW/Platform/Vin/DataTypeMappingSets
  data type mapping set dtms_VinLifeCycleMode
    mode-request-type-maps:
      implementation-data-type=uint8, mode-group=Vin_ChangeIndicator
      implementation-data-type=Vin_LifeCycleRequestType, mode-group=Vin_LifeCycle
      implementation-data-type=uint8, mode-group=Vin_VinComMode
package /BMW/Platform/Vin/ImplementationDataTypes
  11 x impl type:
    VinArrayType: category=ARRAY
      element idteVinSubArray: array-size=7, array-size-semantics=FIXED-SIZE, implementation-data-type=uint8
    Vin_ChallengeArrayType: category=ARRAY
      element AuxU8_Challenge_ArrayType: array-size=5, array-size-semantics=FIXED-SIZE, implementation-data-type=uint8
    Vin_ChallengeRecordType: category=STRUCTURE
      element SssId: implementation-data-type=uint8
      element SsvId: implementation-data-type=uint8
      element Challenge: implementation-data-type=Vin_ChallengeArrayType
    Vin_ComVinType: category=STRUCTURE
      7 x element, all with category=TYPE_REFERENCE, implementation-data-type=uint8:
        Vin{1..7}
    Vin_CounterBaseArrayType: category=ARRAY
      element CounterBaseSubArray: array-size=3, array-size-semantics=FIXED-SIZE, implementation-data-type=uint8
    Vin_LifeCycleRequestType: compu {0=VIN_INITIALIZED, 1=VIN_RUNNING, 2=VIN_STOPPED, else VIN_STOPPED}, implementation-data-type=uint8
    Vin_QualifierType: compu {0=VIN_QUAL_INIT, 1=VIN_QUAL_RECEIVED, 2=VIN_QUAL_EQ_INTERNAL, 4=VIN_QUAL_SECURE_PENDING, 8=VIN_QUAL_SECURE_FINISHED, 16=VIN_QUAL_SECURE_OK, 28=VIN_QUAL_SECURE_MASK, else VIN_QUAL_INIT}, implementation-data-type=uint8
    Vin_ResponseRecordType: category=STRUCTURE
      element SsvId: implementation-data-type=uint8
      element CounterBase: implementation-data-type=uint32
      element Signature: implementation-data-type=uint32
    Vin_SSVMACArrayType: category=ARRAY
      element SubSSVMACArrayType: array-size=8, array-size-semantics=FIXED-SIZE, implementation-data-type=uint8
    Vin_SSVMACRecordType: category=STRUCTURE
      element Mac: array-size-semantics=FIXED-SIZE, implementation-data-type=Vin_SSVMACArrayType
    Vin_VinType: category=STRUCTURE
      element Vin: implementation-data-type=VinArrayType
      element Qualifier: sw-bit-representation={bit-position=0, number-of-bits=4}, implementation-data-type=Vin_QualifierType
  range dc_584997947: raw 0..15
package /BMW/Platform/Vin/ModeDeclarationGroups
  mode declaration group Vin_ChangeIndicator: category=EXPLICIT_ORDER, initial-mode=VIN_CI_INIT, on-transition-value=5
    mode VIN_CI_INIT: value=0
    mode VIN_CI_NOCHANGE: value=1
    mode VIN_CI_CHANGED: value=2
    mode transition ModeTranstion_0: entered-mode=VIN_CI_NOCHANGE, exited-mode=VIN_CI_INIT
    mode transition ModeTranstion_1: entered-mode=VIN_CI_CHANGED, exited-mode=VIN_CI_INIT
  mode declaration group Vin_LifeCycle: category=EXPLICIT_ORDER, initial-mode=VIN_STOPPED, on-transition-value=3
    mode VIN_INITIALIZED: value=0
    mode VIN_RUNNING: value=1
    mode VIN_STOPPED: value=2
  mode declaration group Vin_VinComMode: category=EXPLICIT_ORDER, initial-mode=VIN_VINCOMOFF, on-transition-value=2
    mode VIN_VINCOMON: value=0
    mode VIN_VINCOMOFF: value=1
package /BMW/Platform/Vin/PortInterfaces
  sender receiver interface Challenge
    data Challenge: sw-impl-policy=QUEUED, type=Vin_ChallengeRecordType
  client server interface ChassisNumberAuthentication
    operation generateAuthenticationCode
      5 x arg, all with server-argument-impl-policy=USE-ARGUMENT-TYPE:
        secureSignalVerifierId: type=uint8, direction=IN
        challenge: type=Vin_ChallengeArrayType, direction=IN
        counterBase: type=Vin_CounterBaseArrayType, direction=OUT
        authCodeCounterBase: type=Vin_CounterBaseArrayType, direction=OUT
        authCodeVIN: type=Vin_SSVMACArrayType, direction=OUT
  sender receiver interface ComVin
    data ComVin: type=Vin_ComVinType
  client server interface FieldGetterSetterChassisNumber
    operation FieldGetterChassisNumber
      arg Getter: type=Vin_ComVinType, direction=OUT, server-argument-impl-policy=USE-ARGUMENT-TYPE
  mode switch interface ILifeCycle: service-kind=BASIC-SOFTWARE-MODE-MANAGER
    mode group Mode: type=Vin_LifeCycle
  sender receiver interface ILifeCycleRequest: is-service=true, service-kind=BASIC-SOFTWARE-MODE-MANAGER
    data requestMode: type=Vin_LifeCycleRequestType
  mode switch interface IVinChangeIndicator
    mode group ChangeIndicator: type=Vin_ChangeIndicator
  sender receiver interface Response
    data Response: type=Vin_ResponseRecordType
  sender receiver interface SSVErrorCode
    data ErrorCode: type=uint8
  client server interface SSVState
    operation Get: possible-error=E_NOT_OK
      arg mac: type=Vin_SSVMACArrayType, direction=OUT
      arg errorCounter: type=uint8, direction=OUT
      arg counterbase: type=uint32, direction=OUT
    error E_NOT_OK: error-code=1
  sender receiver interface SSVVinMac
    data Mac: type=Vin_SSVMACRecordType
  sender receiver interface Vin
    data Vin: type=Vin_VinType
  mode switch interface VinCom: is-service=true
    mode group Mode: type=Vin_VinComMode
  sender receiver interface VinRequest
    data RequestMessageIdentifier: sw-impl-policy=QUEUED, type=uint16
  sender receiver interface Vin_InternalCheckVinTrigger
    data Trigger: type=uint8
