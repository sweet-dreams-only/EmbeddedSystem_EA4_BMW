AUTOSAR XML (schema 4-2-2)
# \copyright BMW AG 2015 - 2017
package /BMW/Platform/Vin/Dem/ImplementationDataTypes
  impl type Dem_EventStatusType: compu {0=DEM_EVENT_STATUS_PASSED, 1=DEM_EVENT_STATUS_FAILED, 2=DEM_EVENT_STATUS_PREPASSED, 3=DEM_EVENT_STATUS_PREFAILED}, range raw 0..3, implementation-data-type=uint8
package /BMW/Platform/Vin/Dem/PortInterfaces
  client server interface Vin_DiagnosticMonitor: is-service=true
    operation SetEventStatus: possible-error=Vin_DiagnosticMonitor/E_NOT_OK
      arg EventStatus: type=Dem_EventStatusType, direction=IN
    error E_NOT_OK: error-code=1
package /BMW/Platform/Vin/Det/PortInterfaces
  client server interface DETService: is-service=true
    operation ReportError: possible-error=DETService/E_NOT_OK
      arg InstanceId: type=uint8, direction=IN
      arg ApiId: type=uint8, direction=IN
      arg ErrorId: type=uint8, direction=IN
    error E_NOT_OK: error-code=1
package /BMW/Platform/Vin/Dlog/ImplementationDataTypes
  impl type Dlog_VinArrayType: category=ARRAY
    element SubVinArrayType: array-size=17, array-size-semantics=FIXED-SIZE, implementation-data-type=uint8
package /BMW/Platform/Vin/Dlog/PortInterfaces
  client server interface EcuInfo
    operation GetEcuId: possible-error=EcuInfo/E_NOT_OK
      arg ecuId: type=uint8, direction=OUT, server-argument-impl-policy=USE-ARGUMENT-TYPE
    operation GetVin: possible-error=EcuInfo/E_NOT_OK
      arg Vin: type=Dlog_VinArrayType, direction=OUT, server-argument-impl-policy=USE-ARGUMENT-TYPE
    error E_NOT_OK: error-code=1
package /BMW/Platform/Vin/Fscsm/ImplementationDataTypes
  impl type Fscsm_MessageArrayType: category=ARRAY
    element AuxU8_Message_ArrayType: array-size=16, array-size-semantics=FIXED-SIZE, implementation-data-type=uint8
package /BMW/Platform/Vin/Fscsm/PortInterfaces
  client server interface FscsmApplSwcInterface
    operation VerifyMessage: possible-error=[FSCSM_E_NOT_OK, FSCSM_E_NOT_VERIFIED, FSCSM_E_MISSING_KEYS]
      4 x arg, all with direction=IN:
        messageToVerify: type=Fscsm_MessageArrayType
        messageLength: type=uint16
        macToVerify: type=Fscsm_MessageArrayType
        macLength: type=uint16
    6 x error:
      FSCSM_E_NOT_OK: error-code=1
      FSCSM_E_MISSING_KEYS: error-code=2
      FSCSM_E_NOT_VERIFIED: error-code=3
      FSCSM_E_DOES_NOT_DECRYPT: error-code=4
      FSCSM_E_DOES_NOT_ENCRYPT: error-code=5
      FSCSM_E_NOT_EXPORTABLE: error-code=6
  client server interface RandomNumberGenerator
    operation GenerateRandomNumber: possible-error=RandomNumberGenerator/E_NOT_OK
      arg buffer: type=Fscsm_MessageArrayType, direction=OUT
      arg length: type=uint32, direction=IN
    error E_NOT_OK: error-code=1
  sender receiver interface VK_Established
    data Flag: type=boolean
package /BMW/Platform/Vin/NvM/ImplementationDataTypes
  impl type NvM_DstPtrType: category=DATA_REFERENCE, sw-pointer-target-props={target-category=VALUE, base-type=void}
  impl type NvM_RequestResultType: compu {0=NVM_REQ_OK, 1=NVM_REQ_NOT_OK, 2=NVM_REQ_PENDING, 3=NVM_REQ_INTEGRITY_FAILED, 4=NVM_REQ_BLOCK_SKIPPED, 5=NVM_REQ_NV_INVALIDATED, 6=NVM_REQ_CANCELED, 7=NVM_REQ_REDUNDANCY_FAILED, 8=NVM_REQ_RESTORED_FROM_ROM}, implementation-data-type=uint8
  impl type NvM_SrcPtrType: category=DATA_REFERENCE, sw-pointer-target-props={target-category=VALUE, base-type=void, sw-impl-policy=CONST}
package /BMW/Platform/Vin/NvM/PortInterfaces
  client server interface Vin_NvMNotifyJobFinished: is-service=true
    operation JobFinished: possible-error=E_OK
      arg ServiceId: type=uint8, direction=IN
      arg JobResult: type=NvM_RequestResultType, direction=IN
    error E_OK: error-code=0
  client server interface Vin_NvMService: is-service=true
    operation GetErrorStatus: possible-error=Vin_NvMService/E_NOT_OK
      arg RequestResultPtr: type=NvM_RequestResultType, direction=OUT
    operation ReadBlock: possible-error=Vin_NvMService/E_NOT_OK
      arg DstPtr: type=NvM_DstPtrType, direction=IN
    operation WriteBlock: possible-error=Vin_NvMService/E_NOT_OK
      arg SrcPtr: type=NvM_SrcPtrType, direction=IN
    error E_NOT_OK: error-code=1
