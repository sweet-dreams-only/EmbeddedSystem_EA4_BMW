AUTOSAR XML (schema 4-2-2)
# \copyright BMW AG 2015 - 2017
package /BMW_DEF
  module definition Vin: variants pre-compile  # Configuration of the Vin module
    container CommonPublishedInformation  # Common container, aggregated by all modules. It contains published information about vendor and versions.
      integer SwMajorVersion: set at published-information, origin=BMW, default-value=3  # Major version number of the vendor specific implementation of the module.
      integer SwMinorVersion: set at published-information, origin=BMW, default-value=5  # Minor version number of the vendor specific implementation of the module. The numbering is vendor specific.
      integer SwPatchVersion: set at published-information, origin=BMW, default-value=0  # Patch level version number of the vendor specific implementation of the module. The numbering is vendor specific.
    container VinGeneral  # This container contains the configuration (parameters) of the Vin module.
      boolean VinDevErrorDetect: set at pre-compile, origin=BMW, default-value=false  # Activate/Deactivate the Development Error Detection and Notification.
      integer VinRequestMessageIdentifier: 0..65535, set at pre-compile, origin=BMW, default-value=32771  # Defines the ID which must use to request the VIN signal.
      float TimeoutInitialVinRequest: 0.0..25.0, set at pre-compile, origin=BMW, default-value=0.3  # Timeout between init an first VIN request in s.
      float TimeoutSubsequentVinRequests: 0.1..25.0, set at pre-compile, origin=BMW, default-value=1.0  # Timeout between a request and the next request in s.
      integer MaxNumberVinRequests: 1..255, set at pre-compile, origin=BMW, default-value=4  # Maximum number of VIN requests.
      boolean EnableSIAdapter: set at pre-compile, origin=BMW, default-value=0  # Enables the Service Interface Adapter. This is needed for Ethernet communication.
    container SecureVin [0..1]
      integer SecureVinRequestMessageIdentifier: 0..65535, set at pre-compile, origin=BMW, default-value=57857  # The parameter defines the ID which the SSV must use to request a signed VIN from its connected SSS.
      float TimeoutMac: 0.1..3, set at pre-compile, origin=BMW, default-value=1.0  # This parameter defines the time span in seconds in which the SSV expects to receive the MAC message for the VIN from the SSS after requesting it.
      float TimeoutCounterbase: 0.1..3, set at pre-compile, origin=BMW, default-value=1.0  # This parameter defines the time span in seconds in which the SSV expects to receive an answer from a SSS after sending a challenge to the SSS.
      integer ErrorlimitCounterbase: 1..10, set at pre-compile, origin=BMW, default-value=3  # This parameter defines the maximum number of times the CounterBase of an SSS can be requested by an SSV. If the SSV could not obtain a valid CounterBase within FscsmSSVChallengeFailedLimit times, the SSV enters an error state.
      integer RemoteSSSId: 0..255, set at pre-compile, origin=BMW, default-value=0  # This parameter defines the ID of the SSS to which this SSV is connected. This information is needed to be able to perform the ChallengeResponse protocol correctly.
    container MultiConfig: multiple-configuration-container=true
      integer SSVId: 0..255, set at post-build, origin=BMW, default-value=0  # The unique ID of the SSV. Only relevant, if SecureVin is configured.
