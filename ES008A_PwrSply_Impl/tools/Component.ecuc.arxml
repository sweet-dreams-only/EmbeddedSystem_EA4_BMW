AUTOSAR XML (schema 4-0-3)
package /ActiveEcuC
  ecuc value collection ActiveEcuC: ecuc-values=Rte
