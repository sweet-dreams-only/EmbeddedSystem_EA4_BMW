AUTOSAR XML (schema 4-0-3)
package /MICROSAR
  module config PduR_Pre: definition=PduR
  module config PduR_Rec: definition=PduR, implementation-config-variant=VARIANT-PRE-COMPILE
