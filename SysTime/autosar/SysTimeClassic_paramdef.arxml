AUTOSAR XML (schema 4-3-0)
# \copyright BMW AG 2015 - 2017
package /BMW_DEF
  module definition SysTimeClassic [0..1]: category=VENDOR_SPECIFIC_MODULE_DEFINITION, variants pre-compile  # Configuration of the SysTime module
    container SysTimeGeneral  # General parameter definitions for the System Time Client
      boolean SysTimeEnableServiceInterface: origin=BMW, set at pre-compile, default-value=false  # Describes whether the system time is received via Service Interface (TRUE) or via a plain signal (FALSE). Needs to be enabled for Ethernet communication.
    container CommonPublishedInformation  # Common container, contains published version information.
      integer SwMajorVersion: origin=BMW, set at published-information, default-value=5  # Major version number of the module.
      integer SwMinorVersion: origin=BMW, set at published-information, default-value=0  # Minor version number of the module.
      integer SwPatchVersion: origin=BMW, set at published-information, default-value=3  # Patch version number of the module.
