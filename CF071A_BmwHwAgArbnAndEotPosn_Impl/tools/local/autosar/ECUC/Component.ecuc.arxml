AUTOSAR XML (schema 4-0-3)
# Copyright 2016 Nxtr
package /ActiveEcuC
  ecuc value collection ActiveEcuC: ecu-extract=SYSTEM, ecuc-values=[BmwHwAgArbnAndEotPosn, Rte]
