AUTOSAR XML (schema 4-0-3)
package /ActiveEcuC
  module config MotAg0Meas: implementation-config-variant=VARIANT-PRE-COMPILE
    MotAg0MeasGeneral: DIQEPIF=false, MOTAG0PRTCLFLTNTCNR=NTCNR_0X083
