AUTOSAR XML (schema 4-3-0)
# \copyright BMW AG 2015 - 2017
package /BMW/Platform/StdDiag/ImplementationDataTypes
  4 x impl type:
    NormalCommunicationModeType: compu {0=DISABLE_RX_AND_TX_NORMAL, 1=DISABLE_RX_ENABLE_TX_NORMAL, 2=ENABLE_RX_AND_TX_NORMAL, 3=ENABLE_RX_DISABLE_TX_NORMAL}, implementation-data-type=uint8
    StdDiag_LifeCycleRequestType: compu {0=STDDIAG_INITIALIZED, 1=STDDIAG_RUNNING, 2=STDDIAG_STOPPED}, implementation-data-type=uint8
    AdtApplicationParameter_ArrayType: category=ARRAY
      element data: array-size=255, array-size-semantics=FIXED-SIZE, implementation-data-type=uint8
    UpDownload_ArrayType: category=ARRAY
      element data: array-size=4096, array-size-semantics=FIXED-SIZE, implementation-data-type=uint8
package /BMW/Platform/StdDiag/ModeDeclarationGroups
  mode declaration group StdDiag_LifeCycle: category=EXPLICIT_ORDER, initial-mode=STDDIAG_STOPPED, on-transition-value=3
    mode STDDIAG_INITIALIZED: value=0
    mode STDDIAG_RUNNING: value=1
    mode STDDIAG_STOPPED: value=2
  mode declaration group StdDiag_NormalCommunicationModeGroup: category=EXPLICIT_ORDER, initial-mode=ENABLE_RX_AND_TX_NORMAL, on-transition-value=4
    4 x mode:
      DISABLE_RX_AND_TX_NORMAL: value=0
      DISABLE_RX_ENABLE_TX_NORMAL: value=1
      ENABLE_RX_AND_TX_NORMAL: value=2
      ENABLE_RX_DISABLE_TX_NORMAL: value=3
  mode declaration group StdDiag_SessionModeGroup: initial-mode=STDDIAG_DEFAULT_SESSION
    mode STDDIAG_DEFAULT_SESSION
    mode STDDIAG_OTHER_SESSION
package /BMW/Platform/StdDiag/DataTypeMappingSets
  data type mapping set StdDiag_DataTypeMappingSet
    mode-request-type-maps:
      implementation-data-type=NormalCommunicationModeType, mode-group=StdDiag_NormalCommunicationModeGroup
      implementation-data-type=uint8, mode-group=StdDiag_SessionModeGroup
      implementation-data-type=StdDiag_LifeCycleRequestType, mode-group=StdDiag_LifeCycle
package /BMW/Platform/StdDiag/PortInterfaces
  client server interface ApplicationDataTransfer
    11 x operation:
      UploadPreprocess: possible-error=[E_RUNNING, ApplicationDataTransfer/E_NOT_OK]
        arg parameter: type=AdtApplicationParameter_ArrayType, direction=IN, server-argument-impl-policy=USE-ARRAY-BASE-TYPE
        arg parameterSize: type=uint16, direction=IN, server-argument-impl-policy=USE-ARGUMENT-TYPE
        arg errorCode: type=Dcm_NegativeResponseCodeType, direction=OUT, server-argument-impl-policy=USE-ARGUMENT-TYPE
      UploadPostprocess: possible-error=[E_RUNNING, ApplicationDataTransfer/E_NOT_OK]
        arg parameter: type=AdtApplicationParameter_ArrayType, direction=IN, server-argument-impl-policy=USE-ARRAY-BASE-TYPE
        arg parameterSize: type=uint16, direction=IN, server-argument-impl-policy=USE-ARGUMENT-TYPE
        arg errorCode: type=Dcm_NegativeResponseCodeType, direction=OUT, server-argument-impl-policy=USE-ARGUMENT-TYPE
      DownloadPreprocess: possible-error=[E_RUNNING, ApplicationDataTransfer/E_NOT_OK]
        arg parameter: type=AdtApplicationParameter_ArrayType, direction=IN, server-argument-impl-policy=USE-ARRAY-BASE-TYPE
        arg parameterSize: type=uint16, direction=IN, server-argument-impl-policy=USE-ARGUMENT-TYPE
        arg errorCode: type=Dcm_NegativeResponseCodeType, direction=OUT, server-argument-impl-policy=USE-ARGUMENT-TYPE
      DownloadPostprocess: possible-error=[E_RUNNING, ApplicationDataTransfer/E_NOT_OK]
        arg parameter: type=AdtApplicationParameter_ArrayType, direction=IN, server-argument-impl-policy=USE-ARRAY-BASE-TYPE
        arg parameterSize: type=uint16, direction=IN, server-argument-impl-policy=USE-ARGUMENT-TYPE
        arg errorCode: type=Dcm_NegativeResponseCodeType, direction=OUT, server-argument-impl-policy=USE-ARGUMENT-TYPE
      Upload: possible-error=[E_RUNNING, ApplicationDataTransfer/E_NOT_OK]
        4 x arg:
          blockSequenceCounter: type=uint8, direction=IN, server-argument-impl-policy=USE-ARGUMENT-TYPE
          data: type=UpDownload_ArrayType, direction=OUT, server-argument-impl-policy=USE-ARRAY-BASE-TYPE
          length: type=uint32, direction=IN, server-argument-impl-policy=USE-ARGUMENT-TYPE
          errorCode: type=Dcm_NegativeResponseCodeType, direction=OUT, server-argument-impl-policy=USE-ARGUMENT-TYPE
      Download: possible-error=[E_RUNNING, ApplicationDataTransfer/E_NOT_OK]
        4 x arg:
          blockSequenceCounter: type=uint8, direction=IN, server-argument-impl-policy=USE-ARGUMENT-TYPE
          data: type=UpDownload_ArrayType, direction=IN, server-argument-impl-policy=USE-ARRAY-BASE-TYPE
          length: type=uint32, direction=IN, server-argument-impl-policy=USE-ARGUMENT-TYPE
          errorCode: type=Dcm_NegativeResponseCodeType, direction=OUT, server-argument-impl-policy=USE-ARGUMENT-TYPE
      RequestUpload: possible-error=[E_RUNNING, ApplicationDataTransfer/E_NOT_OK]
        4 x arg, all with server-argument-impl-policy=USE-ARGUMENT-TYPE:
          dataFormatIdentifier: type=uint8, direction=IN
          size: type=uint32, direction=IN
          maxBlockLength: type=uint32, direction=OUT
          errorCode: type=Dcm_NegativeResponseCodeType, direction=OUT
      RequestDownload: possible-error=[E_RUNNING, ApplicationDataTransfer/E_NOT_OK]
        4 x arg, all with server-argument-impl-policy=USE-ARGUMENT-TYPE:
          dataFormatIdentifier: type=uint8, direction=IN
          size: type=uint32, direction=IN
          maxBlockLength: type=uint32, direction=OUT
          errorCode: type=Dcm_NegativeResponseCodeType, direction=OUT
      RequestDownloadExit: possible-error=ApplicationDataTransfer/E_OK
      RequestUploadExit: possible-error=ApplicationDataTransfer/E_OK
      CancelOperation: possible-error=ApplicationDataTransfer/E_OK
    error E_RUNNING: error-code=10
    error E_NOT_OK: error-code=1
    error E_OK: error-code=0
  client server interface ApplicationDataTransferCbk
    operation OperationFinished: possible-error=ApplicationDataTransferCbk/E_OK
      arg result: type=boolean, direction=IN
    error E_OK: error-code=0
  client server interface UserActiveSessionState
    operation GetActiveSessionState: possible-error=UserActiveSessionState/E_NOT_OK
      arg activeSession: type=Dcm_SesCtrlType, direction=IN
      arg activeSessionState: type=uint8, direction=OUT
    error E_NOT_OK: error-code=1
  sender receiver interface ComControlModeRequestInterface: is-service=true
    data requestedMode: type=NormalCommunicationModeType
  sender receiver interface ILifeCycleRequest: is-service=true
    data requestMode: type=StdDiag_LifeCycleRequestType
  mode switch interface ComControlNormalNotificationInterface: is-service=true
    mode group CommunicationModeDeclarationGroup: type=StdDiag_NormalCommunicationModeGroup
  mode switch interface SessionChangeIndicationInterface: is-service=true
    mode group SessionModeDeclarationGroup: type=StdDiag_SessionModeGroup
  mode switch interface ILifeCycle
    mode group Mode: type=StdDiag_LifeCycle
