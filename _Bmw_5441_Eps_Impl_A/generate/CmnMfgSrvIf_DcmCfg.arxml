AUTOSAR XML (schema 4-2-2)
package /ActiveEcuC
  module config Dcm: implementation-config-variant=VARIANT-PRE-COMPILE, module-description=Dcm_Impl
    DcmConfigSet
      DcmDsp
        DcmDspRoutineInfo_CmnMfgSrv_SrvF000 (DcmDspRoutineInfo)
          DcmDspRoutineAuthorization: DcmDspRoutineSessionRef=DcmDspSessionRow_DEFAULT_SESSION, DcmDspRoutineSessionRef=DcmDspSessionRow_NXTRMFG
        DcmDspRoutine_CmnMfgSrv_SrvF000 (DcmDspRoutine):
          DcmDspRequestResultsRoutineSupported = false
          DcmDspRoutineIdentifier = 61440
          DcmDspRoutineUsePort = false
          DcmDspRoutineUsed = true
          DcmDspStopRoutineSupported = false
          DcmDspRoutineFixedLength = false
          DcmDspStartRoutineFnc = CmnMfgSrvIf_Srv0xF000Strt
          DcmDspRoutineInfoRef = DcmDspRoutineInfo_CmnMfgSrv_SrvF000
        DcmDspRoutineInfo_CmnMfgSrv_SrvF001 (DcmDspRoutineInfo)
          DcmDspRoutineAuthorization: DcmDspRoutineSessionRef=DcmDspSessionRow_DEFAULT_SESSION, DcmDspRoutineSessionRef=DcmDspSessionRow_NXTRMFG
        DcmDspRoutine_CmnMfgSrv_SrvF001 (DcmDspRoutine):
          DcmDspRequestResultsRoutineSupported = false
          DcmDspRoutineIdentifier = 61441
          DcmDspRoutineUsePort = false
          DcmDspRoutineUsed = true
          DcmDspStopRoutineSupported = false
          DcmDspRoutineFixedLength = false
          DcmDspStartRoutineFnc = CmnMfgSrvIf_Srv0xF001Strt
          DcmDspRoutineInfoRef = DcmDspRoutineInfo_CmnMfgSrv_SrvF001
        DcmDspRoutineInfo_CmnMfgSrv_SrvF002 (DcmDspRoutineInfo)
          DcmDspRoutineAuthorization: DcmDspRoutineSessionRef=DcmDspSessionRow_DEFAULT_SESSION, DcmDspRoutineSessionRef=DcmDspSessionRow_NXTRMFG
        DcmDspRoutine_CmnMfgSrv_SrvF002 (DcmDspRoutine):
          DcmDspRequestResultsRoutineSupported = false
          DcmDspRoutineIdentifier = 61442
          DcmDspRoutineUsePort = false
          DcmDspRoutineUsed = true
          DcmDspStopRoutineSupported = false
          DcmDspRoutineFixedLength = false
          DcmDspStartRoutineFnc = CmnMfgSrvIf_Srv0xF002Strt
          DcmDspRoutineInfoRef = DcmDspRoutineInfo_CmnMfgSrv_SrvF002
        DcmDspRoutineInfo_CmnMfgSrv_SrvF100 (DcmDspRoutineInfo)
          DcmDspRoutineAuthorization: DcmDspRoutineSessionRef=DcmDspSessionRow_DEFAULT_SESSION, DcmDspRoutineSessionRef=DcmDspSessionRow_NXTRMFG
          DcmDspRoutineRequestResOut
            DcmDspRoutineRequestResOutSignal: DcmDspRoutineSignalLength=8, DcmDspRoutineSignalPos=0, DcmDspRoutineSignalType=UINT8
        DcmDspRoutine_CmnMfgSrv_SrvF100 (DcmDspRoutine):
          DcmDspRequestResultsRoutineSupported = true
          DcmDspRoutineIdentifier = 61696
          DcmDspRoutineUsePort = false
          DcmDspRoutineUsed = true
          DcmDspStopRoutineSupported = true
          DcmDspRoutineFixedLength = false
          DcmDspStartRoutineFnc = CmnMfgSrvIf_Srv0xF100Strt
          DcmDspStopRoutineFnc = CmnMfgSrvIf_Srv0xF100Stop
          DcmDspRequestResultsRoutineFnc = CmnMfgSrvIf_Srv0xF100Sts
          DcmDspRoutineInfoRef = DcmDspRoutineInfo_CmnMfgSrv_SrvF100
        DcmDspRoutineInfo_CmnMfgSrv_SrvF101 (DcmDspRoutineInfo)
          DcmDspRoutineAuthorization: DcmDspRoutineSessionRef=DcmDspSessionRow_DEFAULT_SESSION, DcmDspRoutineSessionRef=DcmDspSessionRow_NXTRMFG
          DcmDspRoutineRequestResOut
            DcmDspRoutineRequestResOutSignal: DcmDspRoutineSignalLength=8, DcmDspRoutineSignalPos=0, DcmDspRoutineSignalType=UINT8
        DcmDspRoutine_CmnMfgSrv_SrvF101 (DcmDspRoutine):
          DcmDspRequestResultsRoutineSupported = true
          DcmDspRoutineIdentifier = 61697
          DcmDspRoutineUsePort = false
          DcmDspRoutineUsed = true
          DcmDspStopRoutineSupported = true
          DcmDspRoutineFixedLength = false
          DcmDspStartRoutineFnc = CmnMfgSrvIf_Srv0xF101Strt
          DcmDspStopRoutineFnc = CmnMfgSrvIf_Srv0xF101Stop
          DcmDspRequestResultsRoutineFnc = CmnMfgSrvIf_Srv0xF101Sts
          DcmDspRoutineInfoRef = DcmDspRoutineInfo_CmnMfgSrv_SrvF101
        DcmDspRoutineInfo_CmnMfgSrv_SrvF110 (DcmDspRoutineInfo)
          DcmDspRoutineAuthorization: DcmDspRoutineSessionRef=DcmDspSessionRow_DEFAULT_SESSION, DcmDspRoutineSessionRef=DcmDspSessionRow_NXTRMFG
          DcmDspRoutineRequestResOut
            DcmDspRoutineRequestResOutSignal: DcmDspRoutineSignalLength=8, DcmDspRoutineSignalPos=0, DcmDspRoutineSignalType=UINT8
        DcmDspRoutine_CmnMfgSrv_SrvF110 (DcmDspRoutine):
          DcmDspRequestResultsRoutineSupported = true
          DcmDspRoutineIdentifier = 61712
          DcmDspRoutineUsePort = false
          DcmDspRoutineUsed = true
          DcmDspStopRoutineSupported = true
          DcmDspRoutineFixedLength = false
          DcmDspStartRoutineFnc = CmnMfgSrvIf_Srv0xF110Strt
          DcmDspStopRoutineFnc = CmnMfgSrvIf_Srv0xF110Stop
          DcmDspRequestResultsRoutineFnc = CmnMfgSrvIf_Srv0xF110Sts
          DcmDspRoutineInfoRef = DcmDspRoutineInfo_CmnMfgSrv_SrvF110
        DcmDspRoutineInfo_CmnMfgSrv_SrvF111 (DcmDspRoutineInfo)
          DcmDspRoutineAuthorization: DcmDspRoutineSessionRef=DcmDspSessionRow_DEFAULT_SESSION, DcmDspRoutineSessionRef=DcmDspSessionRow_NXTRMFG
          DcmDspRoutineRequestResOut
            DcmDspRoutineRequestResOutSignal: DcmDspRoutineSignalLength=8, DcmDspRoutineSignalPos=0, DcmDspRoutineSignalType=UINT8
        DcmDspRoutine_CmnMfgSrv_SrvF111 (DcmDspRoutine):
          DcmDspRequestResultsRoutineSupported = true
          DcmDspRoutineIdentifier = 61713
          DcmDspRoutineUsePort = false
          DcmDspRoutineUsed = true
          DcmDspStopRoutineSupported = true
          DcmDspRoutineFixedLength = false
          DcmDspStartRoutineFnc = CmnMfgSrvIf_Srv0xF111Strt
          DcmDspStopRoutineFnc = CmnMfgSrvIf_Srv0xF111Stop
          DcmDspRequestResultsRoutineFnc = CmnMfgSrvIf_Srv0xF111Sts
          DcmDspRoutineInfoRef = DcmDspRoutineInfo_CmnMfgSrv_SrvF111
        DcmDspRoutineInfo_CmnMfgSrv_SrvF112 (DcmDspRoutineInfo)
          DcmDspRoutineAuthorization: DcmDspRoutineSessionRef=DcmDspSessionRow_DEFAULT_SESSION, DcmDspRoutineSessionRef=DcmDspSessionRow_NXTRMFG
          DcmDspRoutineRequestResOut
            DcmDspRoutineRequestResOutSignal: DcmDspRoutineSignalLength=8, DcmDspRoutineSignalPos=0, DcmDspRoutineSignalType=UINT8
        DcmDspRoutine_CmnMfgSrv_SrvF112 (DcmDspRoutine):
          DcmDspRequestResultsRoutineSupported = true
          DcmDspRoutineIdentifier = 61714
          DcmDspRoutineUsePort = false
          DcmDspRoutineUsed = true
          DcmDspStopRoutineSupported = true
          DcmDspRoutineFixedLength = false
          DcmDspStartRoutineFnc = CmnMfgSrvIf_Srv0xF112Strt
          DcmDspStopRoutineFnc = CmnMfgSrvIf_Srv0xF112Stop
          DcmDspRequestResultsRoutineFnc = CmnMfgSrvIf_Srv0xF112Sts
          DcmDspRoutineInfoRef = DcmDspRoutineInfo_CmnMfgSrv_SrvF112
        DcmDspRoutineInfo_CmnMfgSrv_SrvF113 (DcmDspRoutineInfo)
          DcmDspRoutineAuthorization: DcmDspRoutineSessionRef=DcmDspSessionRow_DEFAULT_SESSION, DcmDspRoutineSessionRef=DcmDspSessionRow_NXTRMFG
          DcmDspRoutineRequestResOut
            DcmDspRoutineRequestResOutSignal: DcmDspRoutineSignalLength=8, DcmDspRoutineSignalPos=0, DcmDspRoutineSignalType=UINT8
        DcmDspRoutine_CmnMfgSrv_SrvF113 (DcmDspRoutine):
          DcmDspRequestResultsRoutineSupported = true
          DcmDspRoutineIdentifier = 61715
          DcmDspRoutineUsePort = false
          DcmDspRoutineUsed = true
          DcmDspStopRoutineSupported = true
          DcmDspRoutineFixedLength = false
          DcmDspStartRoutineFnc = CmnMfgSrvIf_Srv0xF113Strt
          DcmDspStopRoutineFnc = CmnMfgSrvIf_Srv0xF113Stop
          DcmDspRequestResultsRoutineFnc = CmnMfgSrvIf_Srv0xF113Sts
          DcmDspRoutineInfoRef = DcmDspRoutineInfo_CmnMfgSrv_SrvF113
        DcmDspRoutineInfo_CmnMfgSrv_SrvF114 (DcmDspRoutineInfo)
          DcmDspRoutineAuthorization: DcmDspRoutineSessionRef=DcmDspSessionRow_DEFAULT_SESSION, DcmDspRoutineSessionRef=DcmDspSessionRow_NXTRMFG
          DcmDspRoutineRequestResOut
            DcmDspRoutineRequestResOutSignal: DcmDspRoutineSignalLength=8, DcmDspRoutineSignalPos=0, DcmDspRoutineSignalType=UINT8
        DcmDspRoutine_CmnMfgSrv_SrvF114 (DcmDspRoutine):
          DcmDspRequestResultsRoutineSupported = true
          DcmDspRoutineIdentifier = 61716
          DcmDspRoutineUsePort = false
          DcmDspRoutineUsed = true
          DcmDspStopRoutineSupported = true
          DcmDspRoutineFixedLength = false
          DcmDspStartRoutineFnc = CmnMfgSrvIf_Srv0xF114Strt
          DcmDspStopRoutineFnc = CmnMfgSrvIf_Srv0xF114Stop
          DcmDspRequestResultsRoutineFnc = CmnMfgSrvIf_Srv0xF114Sts
          DcmDspRoutineInfoRef = DcmDspRoutineInfo_CmnMfgSrv_SrvF114
        DcmDspRoutineInfo_CmnMfgSrv_SrvF115 (DcmDspRoutineInfo)
          DcmDspRoutineAuthorization: DcmDspRoutineSessionRef=DcmDspSessionRow_DEFAULT_SESSION, DcmDspRoutineSessionRef=DcmDspSessionRow_NXTRMFG
          DcmDspRoutineRequestResOut
            DcmDspRoutineRequestResOutSignal: DcmDspRoutineSignalLength=8, DcmDspRoutineSignalPos=0, DcmDspRoutineSignalType=UINT8
        DcmDspRoutine_CmnMfgSrv_SrvF115 (DcmDspRoutine):
          DcmDspRequestResultsRoutineSupported = true
          DcmDspRoutineIdentifier = 61717
          DcmDspRoutineUsePort = false
          DcmDspRoutineUsed = true
          DcmDspStopRoutineSupported = true
          DcmDspRoutineFixedLength = false
          DcmDspStartRoutineFnc = CmnMfgSrvIf_Srv0xF115Strt
          DcmDspStopRoutineFnc = CmnMfgSrvIf_Srv0xF115Stop
          DcmDspRequestResultsRoutineFnc = CmnMfgSrvIf_Srv0xF115Sts
          DcmDspRoutineInfoRef = DcmDspRoutineInfo_CmnMfgSrv_SrvF115
        DcmDspRoutineInfo_CmnMfgSrv_SrvF116 (DcmDspRoutineInfo)
          DcmDspRoutineAuthorization: DcmDspRoutineSessionRef=DcmDspSessionRow_DEFAULT_SESSION, DcmDspRoutineSessionRef=DcmDspSessionRow_NXTRMFG
          DcmDspRoutineRequestResOut
            DcmDspRoutineRequestResOutSignal: DcmDspRoutineSignalLength=8, DcmDspRoutineSignalPos=0, DcmDspRoutineSignalType=UINT8
        DcmDspRoutine_CmnMfgSrv_SrvF116 (DcmDspRoutine):
          DcmDspRequestResultsRoutineSupported = true
          DcmDspRoutineIdentifier = 61718
          DcmDspRoutineUsePort = false
          DcmDspRoutineUsed = true
          DcmDspStopRoutineSupported = true
          DcmDspRoutineFixedLength = false
          DcmDspStartRoutineFnc = CmnMfgSrvIf_Srv0xF116Strt
          DcmDspStopRoutineFnc = CmnMfgSrvIf_Srv0xF116Stop
          DcmDspRequestResultsRoutineFnc = CmnMfgSrvIf_Srv0xF116Sts
          DcmDspRoutineInfoRef = DcmDspRoutineInfo_CmnMfgSrv_SrvF116
        DcmDspRoutineInfo_CmnMfgSrv_SrvF117 (DcmDspRoutineInfo)
          DcmDspRoutineAuthorization: DcmDspRoutineSessionRef=DcmDspSessionRow_DEFAULT_SESSION, DcmDspRoutineSessionRef=DcmDspSessionRow_NXTRMFG
          DcmDspRoutineRequestResOut
            DcmDspRoutineRequestResOutSignal: DcmDspRoutineSignalLength=8, DcmDspRoutineSignalPos=0, DcmDspRoutineSignalType=UINT8
        DcmDspRoutine_CmnMfgSrv_SrvF117 (DcmDspRoutine):
          DcmDspRequestResultsRoutineSupported = true
          DcmDspRoutineIdentifier = 61719
          DcmDspRoutineUsePort = false
          DcmDspRoutineUsed = true
          DcmDspStopRoutineSupported = true
          DcmDspRoutineFixedLength = false
          DcmDspStartRoutineFnc = CmnMfgSrvIf_Srv0xF117Strt
          DcmDspStopRoutineFnc = CmnMfgSrvIf_Srv0xF117Stop
          DcmDspRequestResultsRoutineFnc = CmnMfgSrvIf_Srv0xF117Sts
          DcmDspRoutineInfoRef = DcmDspRoutineInfo_CmnMfgSrv_SrvF117
        DcmDspRoutineInfo_CmnMfgSrv_SrvF118 (DcmDspRoutineInfo)
          DcmDspRoutineAuthorization: DcmDspRoutineSessionRef=DcmDspSessionRow_DEFAULT_SESSION, DcmDspRoutineSessionRef=DcmDspSessionRow_NXTRMFG
          DcmDspRoutineRequestResOut
            DcmDspRoutineRequestResOutSignal: DcmDspRoutineSignalLength=8, DcmDspRoutineSignalPos=0, DcmDspRoutineSignalType=UINT8
        DcmDspRoutine_CmnMfgSrv_SrvF118 (DcmDspRoutine):
          DcmDspRequestResultsRoutineSupported = true
          DcmDspRoutineIdentifier = 61720
          DcmDspRoutineUsePort = false
          DcmDspRoutineUsed = true
          DcmDspStopRoutineSupported = true
          DcmDspRoutineFixedLength = false
          DcmDspStartRoutineFnc = CmnMfgSrvIf_Srv0xF118Strt
          DcmDspStopRoutineFnc = CmnMfgSrvIf_Srv0xF118Stop
          DcmDspRequestResultsRoutineFnc = CmnMfgSrvIf_Srv0xF118Sts
          DcmDspRoutineInfoRef = DcmDspRoutineInfo_CmnMfgSrv_SrvF118
        DcmDspRoutineInfo_CmnMfgSrv_SrvF119 (DcmDspRoutineInfo)
          DcmDspRoutineAuthorization: DcmDspRoutineSessionRef=DcmDspSessionRow_DEFAULT_SESSION, DcmDspRoutineSessionRef=DcmDspSessionRow_NXTRMFG
          DcmDspRoutineRequestResOut
            DcmDspRoutineRequestResOutSignal: DcmDspRoutineSignalLength=8, DcmDspRoutineSignalPos=0, DcmDspRoutineSignalType=UINT8
        DcmDspRoutine_CmnMfgSrv_SrvF119 (DcmDspRoutine):
          DcmDspRequestResultsRoutineSupported = true
          DcmDspRoutineIdentifier = 61721
          DcmDspRoutineUsePort = false
          DcmDspRoutineUsed = true
          DcmDspStopRoutineSupported = true
          DcmDspRoutineFixedLength = false
          DcmDspStartRoutineFnc = CmnMfgSrvIf_Srv0xF119Strt
          DcmDspStopRoutineFnc = CmnMfgSrvIf_Srv0xF119Stop
          DcmDspRequestResultsRoutineFnc = CmnMfgSrvIf_Srv0xF119Sts
          DcmDspRoutineInfoRef = DcmDspRoutineInfo_CmnMfgSrv_SrvF119
        DcmDspRoutineInfo_CmnMfgSrv_SrvF11A (DcmDspRoutineInfo)
          DcmDspRoutineAuthorization: DcmDspRoutineSessionRef=DcmDspSessionRow_DEFAULT_SESSION, DcmDspRoutineSessionRef=DcmDspSessionRow_NXTRMFG
          DcmDspRoutineRequestResOut
            DcmDspRoutineRequestResOutSignal: DcmDspRoutineSignalLength=8, DcmDspRoutineSignalPos=0, DcmDspRoutineSignalType=UINT8
        DcmDspRoutine_CmnMfgSrv_SrvF11A (DcmDspRoutine):
          DcmDspRequestResultsRoutineSupported = true
          DcmDspRoutineIdentifier = 61722
          DcmDspRoutineUsePort = false
          DcmDspRoutineUsed = true
          DcmDspStopRoutineSupported = true
          DcmDspRoutineFixedLength = false
          DcmDspStartRoutineFnc = CmnMfgSrvIf_Srv0xF11AStrt
          DcmDspStopRoutineFnc = CmnMfgSrvIf_Srv0xF11AStop
          DcmDspRequestResultsRoutineFnc = CmnMfgSrvIf_Srv0xF11ASts
          DcmDspRoutineInfoRef = DcmDspRoutineInfo_CmnMfgSrv_SrvF11A
        DcmDspRoutineInfo_CmnMfgSrv_SrvF140 (DcmDspRoutineInfo)
          DcmDspRoutineAuthorization: DcmDspRoutineSessionRef=DcmDspSessionRow_DEFAULT_SESSION, DcmDspRoutineSessionRef=DcmDspSessionRow_NXTRMFG
          DcmDspRoutineRequestResOut
            DcmDspRoutineRequestResOutSignal: DcmDspRoutineSignalLength=64, DcmDspRoutineSignalPos=0, DcmDspRoutineSignalType=UINT8
        DcmDspRoutine_CmnMfgSrv_SrvF140 (DcmDspRoutine):
          DcmDspRequestResultsRoutineSupported = true
          DcmDspRoutineIdentifier = 61760
          DcmDspRoutineUsePort = false
          DcmDspRoutineUsed = true
          DcmDspStopRoutineSupported = true
          DcmDspRoutineFixedLength = false
          DcmDspStartRoutineFnc = CmnMfgSrvIf_Srv0xF140Strt
          DcmDspStopRoutineFnc = CmnMfgSrvIf_Srv0xF140Stop
          DcmDspRequestResultsRoutineFnc = CmnMfgSrvIf_Srv0xF140Sts
          DcmDspRoutineInfoRef = DcmDspRoutineInfo_CmnMfgSrv_SrvF140
        DcmDspRoutineInfo_CmnMfgSrv_SrvF141 (DcmDspRoutineInfo)
          DcmDspRoutineAuthorization: DcmDspRoutineSessionRef=DcmDspSessionRow_DEFAULT_SESSION, DcmDspRoutineSessionRef=DcmDspSessionRow_NXTRMFG
          DcmDspRoutineRequestResOut
            DcmDspRoutineRequestResOutSignal: DcmDspRoutineSignalLength=64, DcmDspRoutineSignalPos=0, DcmDspRoutineSignalType=UINT8
        DcmDspRoutine_CmnMfgSrv_SrvF141 (DcmDspRoutine):
          DcmDspRequestResultsRoutineSupported = true
          DcmDspRoutineIdentifier = 61761
          DcmDspRoutineUsePort = false
          DcmDspRoutineUsed = true
          DcmDspStopRoutineSupported = true
          DcmDspRoutineFixedLength = false
          DcmDspStartRoutineFnc = CmnMfgSrvIf_Srv0xF141Strt
          DcmDspStopRoutineFnc = CmnMfgSrvIf_Srv0xF141Stop
          DcmDspRequestResultsRoutineFnc = CmnMfgSrvIf_Srv0xF141Sts
          DcmDspRoutineInfoRef = DcmDspRoutineInfo_CmnMfgSrv_SrvF141
        DcmDspRoutineInfo_CmnMfgSrv_SrvF150 (DcmDspRoutineInfo)
          DcmDspRoutineAuthorization: DcmDspRoutineSessionRef=DcmDspSessionRow_DEFAULT_SESSION, DcmDspRoutineSessionRef=DcmDspSessionRow_NXTRMFG
          DcmDspRoutineRequestResOut
            DcmDspRoutineRequestResOutSignal: DcmDspRoutineSignalLength=8, DcmDspRoutineSignalPos=0, DcmDspRoutineSignalType=UINT8
        DcmDspRoutine_CmnMfgSrv_SrvF150 (DcmDspRoutine):
          DcmDspRequestResultsRoutineSupported = true
          DcmDspRoutineIdentifier = 61776
          DcmDspRoutineUsePort = false
          DcmDspRoutineUsed = true
          DcmDspStopRoutineSupported = true
          DcmDspRoutineFixedLength = false
          DcmDspStartRoutineFnc = CmnMfgSrvIf_Srv0xF150Strt
          DcmDspStopRoutineFnc = CmnMfgSrvIf_Srv0xF150Stop
          DcmDspRequestResultsRoutineFnc = CmnMfgSrvIf_Srv0xF150Sts
          DcmDspRoutineInfoRef = DcmDspRoutineInfo_CmnMfgSrv_SrvF150
        DcmDspRoutineInfo_CmnMfgSrv_SrvF151 (DcmDspRoutineInfo)
          DcmDspRoutineAuthorization: DcmDspRoutineSessionRef=DcmDspSessionRow_DEFAULT_SESSION, DcmDspRoutineSessionRef=DcmDspSessionRow_NXTRMFG
          DcmDspRoutineRequestResOut
            DcmDspRoutineRequestResOutSignal: DcmDspRoutineSignalLength=8, DcmDspRoutineSignalPos=0, DcmDspRoutineSignalType=UINT8
        DcmDspRoutine_CmnMfgSrv_SrvF151 (DcmDspRoutine):
          DcmDspRequestResultsRoutineSupported = true
          DcmDspRoutineIdentifier = 61777
          DcmDspRoutineUsePort = false
          DcmDspRoutineUsed = true
          DcmDspStopRoutineSupported = true
          DcmDspRoutineFixedLength = false
          DcmDspStartRoutineFnc = CmnMfgSrvIf_Srv0xF151Strt
          DcmDspStopRoutineFnc = CmnMfgSrvIf_Srv0xF151Stop
          DcmDspRequestResultsRoutineFnc = CmnMfgSrvIf_Srv0xF151Sts
          DcmDspRoutineInfoRef = DcmDspRoutineInfo_CmnMfgSrv_SrvF151
        DcmDspRoutineInfo_CmnMfgSrv_SrvF200 (DcmDspRoutineInfo)
          DcmDspRoutineAuthorization: DcmDspRoutineSessionRef=DcmDspSessionRow_DEFAULT_SESSION, DcmDspRoutineSessionRef=DcmDspSessionRow_NXTRMFG
          DcmDspStartRoutineIn
            DcmDspStartRoutineInSignal: DcmDspRoutineSignalLength=32, DcmDspRoutineSignalPos=0, DcmDspRoutineSignalType=UINT8
        DcmDspRoutine_CmnMfgSrv_SrvF200 (DcmDspRoutine):
          DcmDspRequestResultsRoutineSupported = false
          DcmDspRoutineIdentifier = 61952
          DcmDspRoutineUsePort = false
          DcmDspRoutineUsed = true
          DcmDspStopRoutineSupported = false
          DcmDspRoutineFixedLength = false
          DcmDspStartRoutineFnc = CmnMfgSrvIf_Srv0xF200Strt
          DcmDspRoutineInfoRef = DcmDspRoutineInfo_CmnMfgSrv_SrvF200
        DcmDspRoutineInfo_CmnMfgSrv_SrvFD68 (DcmDspRoutineInfo)
          DcmDspRoutineAuthorization: DcmDspRoutineSessionRef=DcmDspSessionRow_DEFAULT_SESSION, DcmDspRoutineSessionRef=DcmDspSessionRow_NXTRMFG
          DcmDspStartRoutineIn
            DcmDspStartRoutineInSignal: DcmDspRoutineSignalLength=16, DcmDspRoutineSignalPos=0, DcmDspRoutineSignalType=UINT8
          DcmDspStartRoutineOut
            DcmDspStartRoutineOutSignal: DcmDspRoutineSignalLength=40, DcmDspRoutineSignalPos=0, DcmDspRoutineSignalType=UINT8
        DcmDspRoutine_CmnMfgSrv_SrvFD68 (DcmDspRoutine):
          DcmDspRequestResultsRoutineSupported = false
          DcmDspRoutineIdentifier = 64872
          DcmDspRoutineUsePort = false
          DcmDspRoutineUsed = true
          DcmDspStopRoutineSupported = false
          DcmDspRoutineFixedLength = false
          DcmDspStartRoutineFnc = CmnMfgSrvIf_Srv0xFD68Strt
          DcmDspRoutineInfoRef = DcmDspRoutineInfo_CmnMfgSrv_SrvFD68
        DcmDspRoutineInfo_CmnMfgSrv_SrvFD70 (DcmDspRoutineInfo)
          DcmDspRoutineAuthorization: DcmDspRoutineSessionRef=DcmDspSessionRow_DEFAULT_SESSION, DcmDspRoutineSessionRef=DcmDspSessionRow_NXTRMFG
        DcmDspRoutine_CmnMfgSrv_SrvFD70 (DcmDspRoutine):
          DcmDspRequestResultsRoutineSupported = false
          DcmDspRoutineIdentifier = 64880
          DcmDspRoutineUsePort = false
          DcmDspRoutineUsed = true
          DcmDspStopRoutineSupported = false
          DcmDspRoutineFixedLength = false
          DcmDspStartRoutineFnc = CmnMfgSrvIf_Srv0xFD70Strt
          DcmDspRoutineInfoRef = DcmDspRoutineInfo_CmnMfgSrv_SrvFD70
        DcmDspRoutineInfo_CmnMfgSrv_SrvFD71 (DcmDspRoutineInfo)
          DcmDspRoutineAuthorization: DcmDspRoutineSessionRef=DcmDspSessionRow_DEFAULT_SESSION, DcmDspRoutineSessionRef=DcmDspSessionRow_NXTRMFG
        DcmDspRoutine_CmnMfgSrv_SrvFD71 (DcmDspRoutine):
          DcmDspRequestResultsRoutineSupported = false
          DcmDspRoutineIdentifier = 64881
          DcmDspRoutineUsePort = false
          DcmDspRoutineUsed = true
          DcmDspStopRoutineSupported = false
          DcmDspRoutineFixedLength = false
          DcmDspStartRoutineFnc = CmnMfgSrvIf_Srv0xFD71Strt
          DcmDspRoutineInfoRef = DcmDspRoutineInfo_CmnMfgSrv_SrvFD71
        DcmDspRoutineInfo_CmnMfgSrv_SrvFDA4 (DcmDspRoutineInfo)
          DcmDspRoutineAuthorization: DcmDspRoutineSessionRef=DcmDspSessionRow_DEFAULT_SESSION, DcmDspRoutineSessionRef=DcmDspSessionRow_NXTRMFG
        DcmDspRoutine_CmnMfgSrv_SrvFDA4 (DcmDspRoutine):
          DcmDspRequestResultsRoutineSupported = false
          DcmDspRoutineIdentifier = 64932
          DcmDspRoutineUsePort = false
          DcmDspRoutineUsed = true
          DcmDspStopRoutineSupported = false
          DcmDspRoutineFixedLength = false
          DcmDspStartRoutineFnc = CmnMfgSrvIf_Srv0xFDA4Strt
          DcmDspRoutineInfoRef = DcmDspRoutineInfo_CmnMfgSrv_SrvFDA4
        DcmDspRoutineInfo_CmnMfgSrv_SrvFDA5 (DcmDspRoutineInfo)
          DcmDspRoutineAuthorization: DcmDspRoutineSessionRef=DcmDspSessionRow_DEFAULT_SESSION, DcmDspRoutineSessionRef=DcmDspSessionRow_NXTRMFG
        DcmDspRoutine_CmnMfgSrv_SrvFDA5 (DcmDspRoutine):
          DcmDspRequestResultsRoutineSupported = false
          DcmDspRoutineIdentifier = 64933
          DcmDspRoutineUsePort = false
          DcmDspRoutineUsed = true
          DcmDspStopRoutineSupported = false
          DcmDspRoutineFixedLength = false
          DcmDspStartRoutineFnc = CmnMfgSrvIf_Srv0xFDA5Strt
          DcmDspRoutineInfoRef = DcmDspRoutineInfo_CmnMfgSrv_SrvFDA5
        DcmDspRoutineInfo_CmnMfgSrv_SrvFDAC (DcmDspRoutineInfo)
          DcmDspRoutineAuthorization: DcmDspRoutineSessionRef=DcmDspSessionRow_DEFAULT_SESSION, DcmDspRoutineSessionRef=DcmDspSessionRow_NXTRMFG
        DcmDspRoutine_CmnMfgSrv_SrvFDAC (DcmDspRoutine):
          DcmDspRequestResultsRoutineSupported = false
          DcmDspRoutineIdentifier = 64940
          DcmDspRoutineUsePort = false
          DcmDspRoutineUsed = true
          DcmDspStopRoutineSupported = false
          DcmDspRoutineFixedLength = false
          DcmDspStartRoutineFnc = CmnMfgSrvIf_Srv0xFDACStrt
          DcmDspRoutineInfoRef = DcmDspRoutineInfo_CmnMfgSrv_SrvFDAC
        DcmDspRoutineInfo_CmnMfgSrv_SrvFDAD (DcmDspRoutineInfo)
          DcmDspRoutineAuthorization: DcmDspRoutineSessionRef=DcmDspSessionRow_DEFAULT_SESSION, DcmDspRoutineSessionRef=DcmDspSessionRow_NXTRMFG
        DcmDspRoutine_CmnMfgSrv_SrvFDAD (DcmDspRoutine):
          DcmDspRequestResultsRoutineSupported = false
          DcmDspRoutineIdentifier = 64941
          DcmDspRoutineUsePort = false
          DcmDspRoutineUsed = true
          DcmDspStopRoutineSupported = false
          DcmDspRoutineFixedLength = false
          DcmDspStartRoutineFnc = CmnMfgSrvIf_Srv0xFDADStrt
          DcmDspRoutineInfoRef = DcmDspRoutineInfo_CmnMfgSrv_SrvFDAD
        DcmDspRoutineInfo_CmnMfgSrv_SrvFDAE (DcmDspRoutineInfo)
          DcmDspRoutineAuthorization: DcmDspRoutineSessionRef=DcmDspSessionRow_DEFAULT_SESSION, DcmDspRoutineSessionRef=DcmDspSessionRow_NXTRMFG
        DcmDspRoutine_CmnMfgSrv_SrvFDAE (DcmDspRoutine):
          DcmDspRequestResultsRoutineSupported = false
          DcmDspRoutineIdentifier = 64942
          DcmDspRoutineUsePort = false
          DcmDspRoutineUsed = true
          DcmDspStopRoutineSupported = false
          DcmDspRoutineFixedLength = false
          DcmDspStartRoutineFnc = CmnMfgSrvIf_Srv0xFDAEStrt
          DcmDspRoutineInfoRef = DcmDspRoutineInfo_CmnMfgSrv_SrvFDAE
        DcmDspRoutineInfo_CmnMfgSrv_SrvFDAF (DcmDspRoutineInfo)
          DcmDspRoutineAuthorization: DcmDspRoutineSessionRef=DcmDspSessionRow_DEFAULT_SESSION, DcmDspRoutineSessionRef=DcmDspSessionRow_NXTRMFG
        DcmDspRoutine_CmnMfgSrv_SrvFDAF (DcmDspRoutine):
          DcmDspRequestResultsRoutineSupported = false
          DcmDspRoutineIdentifier = 64943
          DcmDspRoutineUsePort = false
          DcmDspRoutineUsed = true
          DcmDspStopRoutineSupported = false
          DcmDspRoutineFixedLength = false
          DcmDspStartRoutineFnc = CmnMfgSrvIf_Srv0xFDAFStrt
          DcmDspRoutineInfoRef = DcmDspRoutineInfo_CmnMfgSrv_SrvFDAF
        DcmDspRoutineInfo_CmnMfgSrv_SrvFDF0 (DcmDspRoutineInfo)
          DcmDspRoutineAuthorization: DcmDspRoutineSessionRef=DcmDspSessionRow_DEFAULT_SESSION, DcmDspRoutineSessionRef=DcmDspSessionRow_NXTRMFG
          DcmDspRoutineRequestResOut
            DcmDspRoutineRequestResOutSignal: DcmDspRoutineSignalLength=8, DcmDspRoutineSignalPos=0, DcmDspRoutineSignalType=UINT8
        DcmDspRoutine_CmnMfgSrv_SrvFDF0 (DcmDspRoutine):
          DcmDspRequestResultsRoutineSupported = true
          DcmDspRoutineIdentifier = 65008
          DcmDspRoutineUsePort = false
          DcmDspRoutineUsed = true
          DcmDspStopRoutineSupported = false
          DcmDspRoutineFixedLength = false
          DcmDspStartRoutineFnc = CmnMfgSrvIf_Srv0xFDF0Strt
          DcmDspRequestResultsRoutineFnc = CmnMfgSrvIf_Srv0xFDF0Sts
          DcmDspRoutineInfoRef = DcmDspRoutineInfo_CmnMfgSrv_SrvFDF0
        DcmDspRoutineInfo_CmnMfgSrv_SrvFDF1 (DcmDspRoutineInfo)
          DcmDspRoutineAuthorization: DcmDspRoutineSessionRef=DcmDspSessionRow_DEFAULT_SESSION, DcmDspRoutineSessionRef=DcmDspSessionRow_NXTRMFG
          DcmDspRoutineRequestResOut
            DcmDspRoutineRequestResOutSignal: DcmDspRoutineSignalLength=8, DcmDspRoutineSignalPos=0, DcmDspRoutineSignalType=UINT8
        DcmDspRoutine_CmnMfgSrv_SrvFDF1 (DcmDspRoutine):
          DcmDspRequestResultsRoutineSupported = true
          DcmDspRoutineIdentifier = 65009
          DcmDspRoutineUsePort = false
          DcmDspRoutineUsed = true
          DcmDspStopRoutineSupported = false
          DcmDspRoutineFixedLength = false
          DcmDspStartRoutineFnc = CmnMfgSrvIf_Srv0xFDF1Strt
          DcmDspRequestResultsRoutineFnc = CmnMfgSrvIf_Srv0xFDF1Sts
          DcmDspRoutineInfoRef = DcmDspRoutineInfo_CmnMfgSrv_SrvFDF1
        DcmDspRoutineInfo_CmnMfgSrv_SrvFE20 (DcmDspRoutineInfo)
          DcmDspRoutineAuthorization: DcmDspRoutineSessionRef=DcmDspSessionRow_DEFAULT_SESSION, DcmDspRoutineSessionRef=DcmDspSessionRow_NXTRMFG
          DcmDspStartRoutineIn
            DcmDspStartRoutineInSignal: DcmDspRoutineSignalLength=64, DcmDspRoutineSignalPos=0, DcmDspRoutineSignalType=UINT8
          DcmDspRoutineStopIn
            DcmDspRoutineStopInSignal: DcmDspRoutineSignalLength=32, DcmDspRoutineSignalPos=0, DcmDspRoutineSignalType=UINT8
        DcmDspRoutine_CmnMfgSrv_SrvFE20 (DcmDspRoutine):
          DcmDspRequestResultsRoutineSupported = false
          DcmDspRoutineIdentifier = 65056
          DcmDspRoutineUsePort = false
          DcmDspRoutineUsed = true
          DcmDspStopRoutineSupported = true
          DcmDspRoutineFixedLength = false
          DcmDspStartRoutineFnc = CmnMfgSrvIf_Srv0xFE20Strt
          DcmDspStopRoutineFnc = CmnMfgSrvIf_Srv0xFE20Stop
          DcmDspRoutineInfoRef = DcmDspRoutineInfo_CmnMfgSrv_SrvFE20
        DcmDspRoutineInfo_CmnMfgSrv_SrvFE80 (DcmDspRoutineInfo)
          DcmDspRoutineAuthorization: DcmDspRoutineSessionRef=DcmDspSessionRow_DEFAULT_SESSION, DcmDspRoutineSessionRef=DcmDspSessionRow_NXTRMFG
        DcmDspRoutine_CmnMfgSrv_SrvFE80 (DcmDspRoutine):
          DcmDspRequestResultsRoutineSupported = false
          DcmDspRoutineIdentifier = 65152
          DcmDspRoutineUsePort = false
          DcmDspRoutineUsed = true
          DcmDspStopRoutineSupported = false
          DcmDspRoutineFixedLength = false
          DcmDspStartRoutineFnc = CmnMfgSrvIf_Srv0xFE80Strt
          DcmDspRoutineInfoRef = DcmDspRoutineInfo_CmnMfgSrv_SrvFE80
        DcmDspRoutineInfo_CmnMfgSrv_SrvFE88 (DcmDspRoutineInfo)
          DcmDspRoutineAuthorization: DcmDspRoutineSessionRef=DcmDspSessionRow_DEFAULT_SESSION, DcmDspRoutineSessionRef=DcmDspSessionRow_NXTRMFG
        DcmDspRoutine_CmnMfgSrv_SrvFE88 (DcmDspRoutine):
          DcmDspRequestResultsRoutineSupported = false
          DcmDspRoutineIdentifier = 65160
          DcmDspRoutineUsePort = false
          DcmDspRoutineUsed = true
          DcmDspStopRoutineSupported = false
          DcmDspRoutineFixedLength = false
          DcmDspStartRoutineFnc = CmnMfgSrvIf_Srv0xFE88Strt
          DcmDspRoutineInfoRef = DcmDspRoutineInfo_CmnMfgSrv_SrvFE88
        DcmDspRoutineInfo_CmnMfgSrv_SrvFE89 (DcmDspRoutineInfo)
          DcmDspRoutineAuthorization: DcmDspRoutineSessionRef=DcmDspSessionRow_DEFAULT_SESSION, DcmDspRoutineSessionRef=DcmDspSessionRow_NXTRMFG
        DcmDspRoutine_CmnMfgSrv_SrvFE89 (DcmDspRoutine):
          DcmDspRequestResultsRoutineSupported = false
          DcmDspRoutineIdentifier = 65161
          DcmDspRoutineUsePort = false
          DcmDspRoutineUsed = true
          DcmDspStopRoutineSupported = false
          DcmDspRoutineFixedLength = false
          DcmDspStartRoutineFnc = CmnMfgSrvIf_Srv0xFE89Strt
          DcmDspRoutineInfoRef = DcmDspRoutineInfo_CmnMfgSrv_SrvFE89
        DcmDspRoutineInfo_CmnMfgSrv_SrvFEA1 (DcmDspRoutineInfo)
          DcmDspRoutineAuthorization: DcmDspRoutineSessionRef=DcmDspSessionRow_DEFAULT_SESSION, DcmDspRoutineSessionRef=DcmDspSessionRow_NXTRMFG
        DcmDspRoutine_CmnMfgSrv_SrvFEA1 (DcmDspRoutine):
          DcmDspRequestResultsRoutineSupported = false
          DcmDspRoutineIdentifier = 65185
          DcmDspRoutineUsePort = false
          DcmDspRoutineUsed = true
          DcmDspStopRoutineSupported = false
          DcmDspRoutineFixedLength = false
          DcmDspStartRoutineFnc = CmnMfgSrvIf_Srv0xFEA1Strt
          DcmDspRoutineInfoRef = DcmDspRoutineInfo_CmnMfgSrv_SrvFEA1
        DcmDspDataInfo_CmnMfgSrv_SrvF194 (DcmDspDataInfo): DcmDspDataFixedLength=true
        DcmDspData_CmnMfgSrv_SrvF194 (DcmDspData):
          DcmDspDataSize = 128
          DcmDspDataUsePort = USE_DATA_ASYNCH_FNC
          DcmDspDataType = UINT8
          DcmDspDataConditionCheckReadFncUsed = false
          DcmDspDataReadFnc = CmnMfgSrvIf_Srv0xF194Rd
          DcmDspDataInfoRef = DcmDspDataInfo_CmnMfgSrv_SrvF194
        DcmDspDidInfo_CmnMfgSrv_SrvF194 (DcmDspDidInfo): DcmDspDidDynamicallyDefined=false
          DcmDspDidAccess
            DcmDspDidRead: DcmDspDidReadSessionRef=DcmDspSessionRow_NXTRMFG
        DcmDspDid_CmnMfgSrv_SrvF194 (DcmDspDid):
          DcmDspDidIdentifier = 61844
          DcmDspDidUsed = true
          DcmDspDidUsePort = USE_DATA_ELEMENT_SPECIFIC_INTERFACES
          DcmDspDidInfoRef = DcmDspDidInfo_CmnMfgSrv_SrvF194
          DcmDspDidSignal: DcmDspDidDataPos=0, DcmDspDidDataRef=DcmDspData_CmnMfgSrv_SrvF194
        DcmDspDataInfo_CmnMfgSrv_SrvF195 (DcmDspDataInfo): DcmDspDataFixedLength=true
        DcmDspData_CmnMfgSrv_SrvF195 (DcmDspData):
          DcmDspDataSize = 128
          DcmDspDataUsePort = USE_DATA_ASYNCH_FNC
          DcmDspDataType = UINT8
          DcmDspDataConditionCheckReadFncUsed = false
          DcmDspDataReadFnc = CmnMfgSrvIf_Srv0xF195Rd
          DcmDspDataInfoRef = DcmDspDataInfo_CmnMfgSrv_SrvF195
        DcmDspDidInfo_CmnMfgSrv_SrvF195 (DcmDspDidInfo): DcmDspDidDynamicallyDefined=false
          DcmDspDidAccess
            DcmDspDidRead: DcmDspDidReadSessionRef=DcmDspSessionRow_NXTRMFG
        DcmDspDid_CmnMfgSrv_SrvF195 (DcmDspDid):
          DcmDspDidIdentifier = 61845
          DcmDspDidUsed = true
          DcmDspDidUsePort = USE_DATA_ELEMENT_SPECIFIC_INTERFACES
          DcmDspDidInfoRef = DcmDspDidInfo_CmnMfgSrv_SrvF195
          DcmDspDidSignal: DcmDspDidDataPos=0, DcmDspDidDataRef=DcmDspData_CmnMfgSrv_SrvF195
        DcmDspDataInfo_CmnMfgSrv_SrvF1F2 (DcmDspDataInfo): DcmDspDataFixedLength=true
        DcmDspData_CmnMfgSrv_SrvF1F2 (DcmDspData):
          DcmDspDataSize = 40
          DcmDspDataUsePort = USE_DATA_ASYNCH_FNC
          DcmDspDataType = UINT8
          DcmDspDataConditionCheckReadFncUsed = false
          DcmDspDataReadFnc = CmnMfgSrvIf_Srv0xF1F2Rd
          DcmDspDataInfoRef = DcmDspDataInfo_CmnMfgSrv_SrvF1F2
        DcmDspDidInfo_CmnMfgSrv_SrvF1F2 (DcmDspDidInfo): DcmDspDidDynamicallyDefined=false
          DcmDspDidAccess
            DcmDspDidRead: DcmDspDidReadSessionRef=DcmDspSessionRow_NXTRMFG
        DcmDspDid_CmnMfgSrv_SrvF1F2 (DcmDspDid):
          DcmDspDidIdentifier = 61938
          DcmDspDidUsed = true
          DcmDspDidUsePort = USE_DATA_ELEMENT_SPECIFIC_INTERFACES
          DcmDspDidInfoRef = DcmDspDidInfo_CmnMfgSrv_SrvF1F2
          DcmDspDidSignal: DcmDspDidDataPos=0, DcmDspDidDataRef=DcmDspData_CmnMfgSrv_SrvF1F2
        DcmDspDataInfo_CmnMfgSrv_SrvF1F3 (DcmDspDataInfo): DcmDspDataFixedLength=true
        DcmDspData_CmnMfgSrv_SrvF1F3 (DcmDspData):
          DcmDspDataSize = 40
          DcmDspDataUsePort = USE_DATA_ASYNCH_FNC
          DcmDspDataType = UINT8
          DcmDspDataConditionCheckReadFncUsed = false
          DcmDspDataReadFnc = CmnMfgSrvIf_Srv0xF1F3Rd
          DcmDspDataInfoRef = DcmDspDataInfo_CmnMfgSrv_SrvF1F3
        DcmDspDidInfo_CmnMfgSrv_SrvF1F3 (DcmDspDidInfo): DcmDspDidDynamicallyDefined=false
          DcmDspDidAccess
            DcmDspDidRead: DcmDspDidReadSessionRef=DcmDspSessionRow_NXTRMFG
        DcmDspDid_CmnMfgSrv_SrvF1F3 (DcmDspDid):
          DcmDspDidIdentifier = 61939
          DcmDspDidUsed = true
          DcmDspDidUsePort = USE_DATA_ELEMENT_SPECIFIC_INTERFACES
          DcmDspDidInfoRef = DcmDspDidInfo_CmnMfgSrv_SrvF1F3
          DcmDspDidSignal: DcmDspDidDataPos=0, DcmDspDidDataRef=DcmDspData_CmnMfgSrv_SrvF1F3
        DcmDspDataInfo_CmnMfgSrv_SrvF1F4 (DcmDspDataInfo): DcmDspDataFixedLength=true
        DcmDspData_CmnMfgSrv_SrvF1F4 (DcmDspData):
          DcmDspDataSize = 40
          DcmDspDataUsePort = USE_DATA_ASYNCH_FNC
          DcmDspDataType = UINT8
          DcmDspDataConditionCheckReadFncUsed = false
          DcmDspDataReadFnc = CmnMfgSrvIf_Srv0xF1F4Rd
          DcmDspDataInfoRef = DcmDspDataInfo_CmnMfgSrv_SrvF1F4
        DcmDspDidInfo_CmnMfgSrv_SrvF1F4 (DcmDspDidInfo): DcmDspDidDynamicallyDefined=false
          DcmDspDidAccess
            DcmDspDidRead: DcmDspDidReadSessionRef=DcmDspSessionRow_NXTRMFG
        DcmDspDid_CmnMfgSrv_SrvF1F4 (DcmDspDid):
          DcmDspDidIdentifier = 61940
          DcmDspDidUsed = true
          DcmDspDidUsePort = USE_DATA_ELEMENT_SPECIFIC_INTERFACES
          DcmDspDidInfoRef = DcmDspDidInfo_CmnMfgSrv_SrvF1F4
          DcmDspDidSignal: DcmDspDidDataPos=0, DcmDspDidDataRef=DcmDspData_CmnMfgSrv_SrvF1F4
        DcmDspDataInfo_CmnMfgSrv_SrvF1F7 (DcmDspDataInfo): DcmDspDataFixedLength=true
        DcmDspData_CmnMfgSrv_SrvF1F7 (DcmDspData):
          DcmDspDataSize = 472
          DcmDspDataUsePort = USE_DATA_ASYNCH_FNC
          DcmDspDataType = UINT8
          DcmDspDataConditionCheckReadFncUsed = false
          DcmDspDataReadFnc = CmnMfgSrvIf_Srv0xF1F7Rd
          DcmDspDataInfoRef = DcmDspDataInfo_CmnMfgSrv_SrvF1F7
        DcmDspDidInfo_CmnMfgSrv_SrvF1F7 (DcmDspDidInfo): DcmDspDidDynamicallyDefined=false
          DcmDspDidAccess
            DcmDspDidRead: DcmDspDidReadSessionRef=DcmDspSessionRow_NXTRMFG
        DcmDspDid_CmnMfgSrv_SrvF1F7 (DcmDspDid):
          DcmDspDidIdentifier = 61943
          DcmDspDidUsed = true
          DcmDspDidUsePort = USE_DATA_ELEMENT_SPECIFIC_INTERFACES
          DcmDspDidInfoRef = DcmDspDidInfo_CmnMfgSrv_SrvF1F7
          DcmDspDidSignal: DcmDspDidDataPos=0, DcmDspDidDataRef=DcmDspData_CmnMfgSrv_SrvF1F7
        DcmDspDataInfo_CmnMfgSrv_SrvF1F8 (DcmDspDataInfo): DcmDspDataFixedLength=true
        DcmDspData_CmnMfgSrv_SrvF1F8 (DcmDspData):
          DcmDspDataSize = 472
          DcmDspDataUsePort = USE_DATA_ASYNCH_FNC
          DcmDspDataType = UINT8
          DcmDspDataConditionCheckReadFncUsed = false
          DcmDspDataReadFnc = CmnMfgSrvIf_Srv0xF1F8Rd
          DcmDspDataInfoRef = DcmDspDataInfo_CmnMfgSrv_SrvF1F8
        DcmDspDidInfo_CmnMfgSrv_SrvF1F8 (DcmDspDidInfo): DcmDspDidDynamicallyDefined=false
          DcmDspDidAccess
            DcmDspDidRead: DcmDspDidReadSessionRef=DcmDspSessionRow_NXTRMFG
        DcmDspDid_CmnMfgSrv_SrvF1F8 (DcmDspDid):
          DcmDspDidIdentifier = 61944
          DcmDspDidUsed = true
          DcmDspDidUsePort = USE_DATA_ELEMENT_SPECIFIC_INTERFACES
          DcmDspDidInfoRef = DcmDspDidInfo_CmnMfgSrv_SrvF1F8
          DcmDspDidSignal: DcmDspDidDataPos=0, DcmDspDidDataRef=DcmDspData_CmnMfgSrv_SrvF1F8
        DcmDspDataInfo_CmnMfgSrv_SrvF1F9 (DcmDspDataInfo): DcmDspDataFixedLength=true
        DcmDspData_CmnMfgSrv_SrvF1F9 (DcmDspData):
          DcmDspDataSize = 472
          DcmDspDataUsePort = USE_DATA_ASYNCH_FNC
          DcmDspDataType = UINT8
          DcmDspDataConditionCheckReadFncUsed = false
          DcmDspDataReadFnc = CmnMfgSrvIf_Srv0xF1F9Rd
          DcmDspDataInfoRef = DcmDspDataInfo_CmnMfgSrv_SrvF1F9
        DcmDspDidInfo_CmnMfgSrv_SrvF1F9 (DcmDspDidInfo): DcmDspDidDynamicallyDefined=false
          DcmDspDidAccess
            DcmDspDidRead: DcmDspDidReadSessionRef=DcmDspSessionRow_NXTRMFG
        DcmDspDid_CmnMfgSrv_SrvF1F9 (DcmDspDid):
          DcmDspDidIdentifier = 61945
          DcmDspDidUsed = true
          DcmDspDidUsePort = USE_DATA_ELEMENT_SPECIFIC_INTERFACES
          DcmDspDidInfoRef = DcmDspDidInfo_CmnMfgSrv_SrvF1F9
          DcmDspDidSignal: DcmDspDidDataPos=0, DcmDspDidDataRef=DcmDspData_CmnMfgSrv_SrvF1F9
        DcmDspDataInfo_CmnMfgSrv_SrvF1FD (DcmDspDataInfo): DcmDspDataFixedLength=true
        DcmDspData_CmnMfgSrv_SrvF1FD (DcmDspData):
          DcmDspDataSize = 72
          DcmDspDataUsePort = USE_DATA_ASYNCH_FNC
          DcmDspDataType = UINT8
          DcmDspDataConditionCheckReadFncUsed = false
          DcmDspDataReadFnc = CmnMfgSrvIf_Srv0xF1FDRd
          DcmDspDataInfoRef = DcmDspDataInfo_CmnMfgSrv_SrvF1FD
        DcmDspDidInfo_CmnMfgSrv_SrvF1FD (DcmDspDidInfo): DcmDspDidDynamicallyDefined=false
          DcmDspDidAccess
            DcmDspDidRead: DcmDspDidReadSessionRef=DcmDspSessionRow_NXTRMFG
        DcmDspDid_CmnMfgSrv_SrvF1FD (DcmDspDid):
          DcmDspDidIdentifier = 61949
          DcmDspDidUsed = true
          DcmDspDidUsePort = USE_DATA_ELEMENT_SPECIFIC_INTERFACES
          DcmDspDidInfoRef = DcmDspDidInfo_CmnMfgSrv_SrvF1FD
          DcmDspDidSignal: DcmDspDidDataPos=0, DcmDspDidDataRef=DcmDspData_CmnMfgSrv_SrvF1FD
        DcmDspDataInfo_CmnMfgSrv_SrvF1FE (DcmDspDataInfo): DcmDspDataFixedLength=true
        DcmDspData_CmnMfgSrv_SrvF1FE (DcmDspData):
          DcmDspDataSize = 40
          DcmDspDataUsePort = USE_DATA_ASYNCH_FNC
          DcmDspDataType = UINT8
          DcmDspDataConditionCheckReadFncUsed = false
          DcmDspDataReadFnc = CmnMfgSrvIf_Srv0xF1FERd
          DcmDspDataInfoRef = DcmDspDataInfo_CmnMfgSrv_SrvF1FE
        DcmDspDidInfo_CmnMfgSrv_SrvF1FE (DcmDspDidInfo): DcmDspDidDynamicallyDefined=false
          DcmDspDidAccess
            DcmDspDidRead: DcmDspDidReadSessionRef=DcmDspSessionRow_NXTRMFG
        DcmDspDid_CmnMfgSrv_SrvF1FE (DcmDspDid):
          DcmDspDidIdentifier = 61950
          DcmDspDidUsed = true
          DcmDspDidUsePort = USE_DATA_ELEMENT_SPECIFIC_INTERFACES
          DcmDspDidInfoRef = DcmDspDidInfo_CmnMfgSrv_SrvF1FE
          DcmDspDidSignal: DcmDspDidDataPos=0, DcmDspDidDataRef=DcmDspData_CmnMfgSrv_SrvF1FE
        DcmDspDataInfo_CmnMfgSrv_SrvF1FF (DcmDspDataInfo): DcmDspDataFixedLength=true
        DcmDspData_CmnMfgSrv_SrvF1FF (DcmDspData):
          DcmDspDataSize = 160
          DcmDspDataUsePort = USE_DATA_ASYNCH_FNC
          DcmDspDataType = UINT8
          DcmDspDataConditionCheckReadFncUsed = false
          DcmDspDataReadFnc = CmnMfgSrvIf_Srv0xF1FFRd
          DcmDspDataInfoRef = DcmDspDataInfo_CmnMfgSrv_SrvF1FF
        DcmDspDidInfo_CmnMfgSrv_SrvF1FF (DcmDspDidInfo): DcmDspDidDynamicallyDefined=false
          DcmDspDidAccess
            DcmDspDidRead: DcmDspDidReadSessionRef=DcmDspSessionRow_NXTRMFG
        DcmDspDid_CmnMfgSrv_SrvF1FF (DcmDspDid):
          DcmDspDidIdentifier = 61951
          DcmDspDidUsed = true
          DcmDspDidUsePort = USE_DATA_ELEMENT_SPECIFIC_INTERFACES
          DcmDspDidInfoRef = DcmDspDidInfo_CmnMfgSrv_SrvF1FF
          DcmDspDidSignal: DcmDspDidDataPos=0, DcmDspDidDataRef=DcmDspData_CmnMfgSrv_SrvF1FF
        DcmDspDataInfo_CmnMfgSrv_SrvFD00 (DcmDspDataInfo): DcmDspDataFixedLength=true
        DcmDspData_CmnMfgSrv_SrvFD00 (DcmDspData):
          DcmDspDataSize = 8
          DcmDspDataUsePort = USE_DATA_ASYNCH_FNC
          DcmDspDataType = UINT8
          DcmDspDataConditionCheckReadFncUsed = false
          DcmDspDataReadFnc = CmnMfgSrvIf_Srv0xFD00Rd
          DcmDspDataInfoRef = DcmDspDataInfo_CmnMfgSrv_SrvFD00
        DcmDspDidInfo_CmnMfgSrv_SrvFD00 (DcmDspDidInfo): DcmDspDidDynamicallyDefined=false
          DcmDspDidAccess
            DcmDspDidRead: DcmDspDidReadSessionRef=DcmDspSessionRow_NXTRMFG
        DcmDspDid_CmnMfgSrv_SrvFD00 (DcmDspDid):
          DcmDspDidIdentifier = 64768
          DcmDspDidUsed = true
          DcmDspDidUsePort = USE_DATA_ELEMENT_SPECIFIC_INTERFACES
          DcmDspDidInfoRef = DcmDspDidInfo_CmnMfgSrv_SrvFD00
          DcmDspDidSignal: DcmDspDidDataPos=0, DcmDspDidDataRef=DcmDspData_CmnMfgSrv_SrvFD00
        DcmDspDataInfo_CmnMfgSrv_SrvFD01 (DcmDspDataInfo): DcmDspDataFixedLength=true
        DcmDspData_CmnMfgSrv_SrvFD01 (DcmDspData):
          DcmDspDataSize = 32
          DcmDspDataUsePort = USE_DATA_ASYNCH_FNC
          DcmDspDataType = UINT8
          DcmDspDataConditionCheckReadFncUsed = false
          DcmDspDataReadFnc = CmnMfgSrvIf_Srv0xFD01Rd
          DcmDspDataInfoRef = DcmDspDataInfo_CmnMfgSrv_SrvFD01
        DcmDspDidInfo_CmnMfgSrv_SrvFD01 (DcmDspDidInfo): DcmDspDidDynamicallyDefined=false
          DcmDspDidAccess
            DcmDspDidRead: DcmDspDidReadSessionRef=DcmDspSessionRow_NXTRMFG
        DcmDspDid_CmnMfgSrv_SrvFD01 (DcmDspDid):
          DcmDspDidIdentifier = 64769
          DcmDspDidUsed = true
          DcmDspDidUsePort = USE_DATA_ELEMENT_SPECIFIC_INTERFACES
          DcmDspDidInfoRef = DcmDspDidInfo_CmnMfgSrv_SrvFD01
          DcmDspDidSignal: DcmDspDidDataPos=0, DcmDspDidDataRef=DcmDspData_CmnMfgSrv_SrvFD01
        DcmDspDataInfo_CmnMfgSrv_SrvFD02 (DcmDspDataInfo): DcmDspDataFixedLength=true
        DcmDspData_CmnMfgSrv_SrvFD02 (DcmDspData):
          DcmDspDataSize = 8
          DcmDspDataUsePort = USE_DATA_ASYNCH_FNC
          DcmDspDataType = UINT8
          DcmDspDataConditionCheckReadFncUsed = false
          DcmDspDataReadFnc = CmnMfgSrvIf_Srv0xFD02Rd
          DcmDspDataWriteFnc = CmnMfgSrvIf_Srv0xFD02Wr
          DcmDspDataInfoRef = DcmDspDataInfo_CmnMfgSrv_SrvFD02
        DcmDspDidInfo_CmnMfgSrv_SrvFD02 (DcmDspDidInfo): DcmDspDidDynamicallyDefined=false
          DcmDspDidAccess
            DcmDspDidRead: DcmDspDidReadSessionRef=DcmDspSessionRow_NXTRMFG
            DcmDspDidWrite: DcmDspDidWriteSessionRef=DcmDspSessionRow_NXTRMFG
        DcmDspDid_CmnMfgSrv_SrvFD02 (DcmDspDid):
          DcmDspDidIdentifier = 64770
          DcmDspDidUsed = true
          DcmDspDidUsePort = USE_DATA_ELEMENT_SPECIFIC_INTERFACES
          DcmDspDidInfoRef = DcmDspDidInfo_CmnMfgSrv_SrvFD02
          DcmDspDidSignal: DcmDspDidDataPos=0, DcmDspDidDataRef=DcmDspData_CmnMfgSrv_SrvFD02
        DcmDspDataInfo_CmnMfgSrv_SrvFD03 (DcmDspDataInfo): DcmDspDataFixedLength=true
        DcmDspData_CmnMfgSrv_SrvFD03 (DcmDspData):
          DcmDspDataSize = 32
          DcmDspDataUsePort = USE_DATA_ASYNCH_FNC
          DcmDspDataType = UINT8
          DcmDspDataConditionCheckReadFncUsed = false
          DcmDspDataReadFnc = CmnMfgSrvIf_Srv0xFD03Rd
          DcmDspDataWriteFnc = CmnMfgSrvIf_Srv0xFD03Wr
          DcmDspDataInfoRef = DcmDspDataInfo_CmnMfgSrv_SrvFD03
        DcmDspDidInfo_CmnMfgSrv_SrvFD03 (DcmDspDidInfo): DcmDspDidDynamicallyDefined=false
          DcmDspDidAccess
            DcmDspDidRead: DcmDspDidReadSessionRef=DcmDspSessionRow_NXTRMFG
            DcmDspDidWrite: DcmDspDidWriteSessionRef=DcmDspSessionRow_NXTRMFG
        DcmDspDid_CmnMfgSrv_SrvFD03 (DcmDspDid):
          DcmDspDidIdentifier = 64771
          DcmDspDidUsed = true
          DcmDspDidUsePort = USE_DATA_ELEMENT_SPECIFIC_INTERFACES
          DcmDspDidInfoRef = DcmDspDidInfo_CmnMfgSrv_SrvFD03
          DcmDspDidSignal: DcmDspDidDataPos=0, DcmDspDidDataRef=DcmDspData_CmnMfgSrv_SrvFD03
        DcmDspDataInfo_CmnMfgSrv_SrvFD05 (DcmDspDataInfo): DcmDspDataFixedLength=true
        DcmDspData_CmnMfgSrv_SrvFD05 (DcmDspData):
          DcmDspDataSize = 64
          DcmDspDataUsePort = USE_DATA_ASYNCH_FNC
          DcmDspDataType = UINT8
          DcmDspDataConditionCheckReadFncUsed = false
          DcmDspDataReadFnc = CmnMfgSrvIf_Srv0xFD05Rd
          DcmDspDataWriteFnc = CmnMfgSrvIf_Srv0xFD05Wr
          DcmDspDataInfoRef = DcmDspDataInfo_CmnMfgSrv_SrvFD05
        DcmDspDidInfo_CmnMfgSrv_SrvFD05 (DcmDspDidInfo): DcmDspDidDynamicallyDefined=false
          DcmDspDidAccess
            DcmDspDidRead: DcmDspDidReadSessionRef=DcmDspSessionRow_NXTRMFG
            DcmDspDidWrite: DcmDspDidWriteSessionRef=DcmDspSessionRow_NXTRMFG
        DcmDspDid_CmnMfgSrv_SrvFD05 (DcmDspDid):
          DcmDspDidIdentifier = 64773
          DcmDspDidUsed = true
          DcmDspDidUsePort = USE_DATA_ELEMENT_SPECIFIC_INTERFACES
          DcmDspDidInfoRef = DcmDspDidInfo_CmnMfgSrv_SrvFD05
          DcmDspDidSignal: DcmDspDidDataPos=0, DcmDspDidDataRef=DcmDspData_CmnMfgSrv_SrvFD05
        DcmDspDataInfo_CmnMfgSrv_SrvFD06 (DcmDspDataInfo): DcmDspDataFixedLength=true
        DcmDspData_CmnMfgSrv_SrvFD06 (DcmDspData):
          DcmDspDataSize = 8
          DcmDspDataUsePort = USE_DATA_ASYNCH_FNC
          DcmDspDataType = UINT8
          DcmDspDataConditionCheckReadFncUsed = false
          DcmDspDataReadFnc = CmnMfgSrvIf_Srv0xFD06Rd
          DcmDspDataInfoRef = DcmDspDataInfo_CmnMfgSrv_SrvFD06
        DcmDspDidInfo_CmnMfgSrv_SrvFD06 (DcmDspDidInfo): DcmDspDidDynamicallyDefined=false
          DcmDspDidAccess
            DcmDspDidRead: DcmDspDidReadSessionRef=DcmDspSessionRow_NXTRMFG
        DcmDspDid_CmnMfgSrv_SrvFD06 (DcmDspDid):
          DcmDspDidIdentifier = 64774
          DcmDspDidUsed = true
          DcmDspDidUsePort = USE_DATA_ELEMENT_SPECIFIC_INTERFACES
          DcmDspDidInfoRef = DcmDspDidInfo_CmnMfgSrv_SrvFD06
          DcmDspDidSignal: DcmDspDidDataPos=0, DcmDspDidDataRef=DcmDspData_CmnMfgSrv_SrvFD06
        DcmDspDataInfo_CmnMfgSrv_SrvFD30 (DcmDspDataInfo): DcmDspDataFixedLength=true
        DcmDspData_CmnMfgSrv_SrvFD30 (DcmDspData):
          DcmDspDataSize = 160
          DcmDspDataUsePort = USE_DATA_ASYNCH_FNC
          DcmDspDataType = UINT8
          DcmDspDataConditionCheckReadFncUsed = false
          DcmDspDataReadFnc = CmnMfgSrvIf_Srv0xFD30Rd
          DcmDspDataWriteFnc = CmnMfgSrvIf_Srv0xFD30Wr
          DcmDspDataInfoRef = DcmDspDataInfo_CmnMfgSrv_SrvFD30
        DcmDspDidInfo_CmnMfgSrv_SrvFD30 (DcmDspDidInfo): DcmDspDidDynamicallyDefined=false
          DcmDspDidAccess
            DcmDspDidRead: DcmDspDidReadSessionRef=DcmDspSessionRow_NXTRMFG
            DcmDspDidWrite: DcmDspDidWriteSessionRef=DcmDspSessionRow_NXTRMFG
        DcmDspDid_CmnMfgSrv_SrvFD30 (DcmDspDid):
          DcmDspDidIdentifier = 64816
          DcmDspDidUsed = true
          DcmDspDidUsePort = USE_DATA_ELEMENT_SPECIFIC_INTERFACES
          DcmDspDidInfoRef = DcmDspDidInfo_CmnMfgSrv_SrvFD30
          DcmDspDidSignal: DcmDspDidDataPos=0, DcmDspDidDataRef=DcmDspData_CmnMfgSrv_SrvFD30
        DcmDspDataInfo_CmnMfgSrv_SrvFD31 (DcmDspDataInfo): DcmDspDataFixedLength=true
        DcmDspData_CmnMfgSrv_SrvFD31 (DcmDspData):
          DcmDspDataSize = 160
          DcmDspDataUsePort = USE_DATA_ASYNCH_FNC
          DcmDspDataType = UINT8
          DcmDspDataConditionCheckReadFncUsed = false
          DcmDspDataReadFnc = CmnMfgSrvIf_Srv0xFD31Rd
          DcmDspDataWriteFnc = CmnMfgSrvIf_Srv0xFD31Wr
          DcmDspDataInfoRef = DcmDspDataInfo_CmnMfgSrv_SrvFD31
        DcmDspDidInfo_CmnMfgSrv_SrvFD31 (DcmDspDidInfo): DcmDspDidDynamicallyDefined=false
          DcmDspDidAccess
            DcmDspDidRead: DcmDspDidReadSessionRef=DcmDspSessionRow_NXTRMFG
            DcmDspDidWrite: DcmDspDidWriteSessionRef=DcmDspSessionRow_NXTRMFG
        DcmDspDid_CmnMfgSrv_SrvFD31 (DcmDspDid):
          DcmDspDidIdentifier = 64817
          DcmDspDidUsed = true
          DcmDspDidUsePort = USE_DATA_ELEMENT_SPECIFIC_INTERFACES
          DcmDspDidInfoRef = DcmDspDidInfo_CmnMfgSrv_SrvFD31
          DcmDspDidSignal: DcmDspDidDataPos=0, DcmDspDidDataRef=DcmDspData_CmnMfgSrv_SrvFD31
        DcmDspDataInfo_CmnMfgSrv_SrvFD32 (DcmDspDataInfo): DcmDspDataFixedLength=true
        DcmDspData_CmnMfgSrv_SrvFD32 (DcmDspData):
          DcmDspDataSize = 160
          DcmDspDataUsePort = USE_DATA_ASYNCH_FNC
          DcmDspDataType = UINT8
          DcmDspDataConditionCheckReadFncUsed = false
          DcmDspDataReadFnc = CmnMfgSrvIf_Srv0xFD32Rd
          DcmDspDataWriteFnc = CmnMfgSrvIf_Srv0xFD32Wr
          DcmDspDataInfoRef = DcmDspDataInfo_CmnMfgSrv_SrvFD32
        DcmDspDidInfo_CmnMfgSrv_SrvFD32 (DcmDspDidInfo): DcmDspDidDynamicallyDefined=false
          DcmDspDidAccess
            DcmDspDidRead: DcmDspDidReadSessionRef=DcmDspSessionRow_NXTRMFG
            DcmDspDidWrite: DcmDspDidWriteSessionRef=DcmDspSessionRow_NXTRMFG
        DcmDspDid_CmnMfgSrv_SrvFD32 (DcmDspDid):
          DcmDspDidIdentifier = 64818
          DcmDspDidUsed = true
          DcmDspDidUsePort = USE_DATA_ELEMENT_SPECIFIC_INTERFACES
          DcmDspDidInfoRef = DcmDspDidInfo_CmnMfgSrv_SrvFD32
          DcmDspDidSignal: DcmDspDidDataPos=0, DcmDspDidDataRef=DcmDspData_CmnMfgSrv_SrvFD32
        DcmDspDataInfo_CmnMfgSrv_SrvFD38 (DcmDspDataInfo): DcmDspDataFixedLength=true
        DcmDspData_CmnMfgSrv_SrvFD38 (DcmDspData):
          DcmDspDataSize = 128
          DcmDspDataUsePort = USE_DATA_ASYNCH_FNC
          DcmDspDataType = UINT8
          DcmDspDataConditionCheckReadFncUsed = false
          DcmDspDataReadFnc = CmnMfgSrvIf_Srv0xFD38Rd
          DcmDspDataWriteFnc = CmnMfgSrvIf_Srv0xFD38Wr
          DcmDspDataInfoRef = DcmDspDataInfo_CmnMfgSrv_SrvFD38
        DcmDspDidInfo_CmnMfgSrv_SrvFD38 (DcmDspDidInfo): DcmDspDidDynamicallyDefined=false
          DcmDspDidAccess
            DcmDspDidRead: DcmDspDidReadSessionRef=DcmDspSessionRow_NXTRMFG
            DcmDspDidWrite: DcmDspDidWriteSessionRef=DcmDspSessionRow_NXTRMFG
        DcmDspDid_CmnMfgSrv_SrvFD38 (DcmDspDid):
          DcmDspDidIdentifier = 64824
          DcmDspDidUsed = true
          DcmDspDidUsePort = USE_DATA_ELEMENT_SPECIFIC_INTERFACES
          DcmDspDidInfoRef = DcmDspDidInfo_CmnMfgSrv_SrvFD38
          DcmDspDidSignal: DcmDspDidDataPos=0, DcmDspDidDataRef=DcmDspData_CmnMfgSrv_SrvFD38
        DcmDspDataInfo_CmnMfgSrv_SrvFD39 (DcmDspDataInfo): DcmDspDataFixedLength=true
        DcmDspData_CmnMfgSrv_SrvFD39 (DcmDspData):
          DcmDspDataSize = 128
          DcmDspDataUsePort = USE_DATA_ASYNCH_FNC
          DcmDspDataType = UINT8
          DcmDspDataConditionCheckReadFncUsed = false
          DcmDspDataReadFnc = CmnMfgSrvIf_Srv0xFD39Rd
          DcmDspDataWriteFnc = CmnMfgSrvIf_Srv0xFD39Wr
          DcmDspDataInfoRef = DcmDspDataInfo_CmnMfgSrv_SrvFD39
        DcmDspDidInfo_CmnMfgSrv_SrvFD39 (DcmDspDidInfo): DcmDspDidDynamicallyDefined=false
          DcmDspDidAccess
            DcmDspDidRead: DcmDspDidReadSessionRef=DcmDspSessionRow_NXTRMFG
            DcmDspDidWrite: DcmDspDidWriteSessionRef=DcmDspSessionRow_NXTRMFG
        DcmDspDid_CmnMfgSrv_SrvFD39 (DcmDspDid):
          DcmDspDidIdentifier = 64825
          DcmDspDidUsed = true
          DcmDspDidUsePort = USE_DATA_ELEMENT_SPECIFIC_INTERFACES
          DcmDspDidInfoRef = DcmDspDidInfo_CmnMfgSrv_SrvFD39
          DcmDspDidSignal: DcmDspDidDataPos=0, DcmDspDidDataRef=DcmDspData_CmnMfgSrv_SrvFD39
        DcmDspDataInfo_CmnMfgSrv_SrvFD3A (DcmDspDataInfo): DcmDspDataFixedLength=true
        DcmDspData_CmnMfgSrv_SrvFD3A (DcmDspData):
          DcmDspDataSize = 128
          DcmDspDataUsePort = USE_DATA_ASYNCH_FNC
          DcmDspDataType = UINT8
          DcmDspDataConditionCheckReadFncUsed = false
          DcmDspDataReadFnc = CmnMfgSrvIf_Srv0xFD3ARd
          DcmDspDataWriteFnc = CmnMfgSrvIf_Srv0xFD3AWr
          DcmDspDataInfoRef = DcmDspDataInfo_CmnMfgSrv_SrvFD3A
        DcmDspDidInfo_CmnMfgSrv_SrvFD3A (DcmDspDidInfo): DcmDspDidDynamicallyDefined=false
          DcmDspDidAccess
            DcmDspDidRead: DcmDspDidReadSessionRef=DcmDspSessionRow_NXTRMFG
            DcmDspDidWrite: DcmDspDidWriteSessionRef=DcmDspSessionRow_NXTRMFG
        DcmDspDid_CmnMfgSrv_SrvFD3A (DcmDspDid):
          DcmDspDidIdentifier = 64826
          DcmDspDidUsed = true
          DcmDspDidUsePort = USE_DATA_ELEMENT_SPECIFIC_INTERFACES
          DcmDspDidInfoRef = DcmDspDidInfo_CmnMfgSrv_SrvFD3A
          DcmDspDidSignal: DcmDspDidDataPos=0, DcmDspDidDataRef=DcmDspData_CmnMfgSrv_SrvFD3A
        DcmDspDataInfo_CmnMfgSrv_SrvFD3B (DcmDspDataInfo): DcmDspDataFixedLength=true
        DcmDspData_CmnMfgSrv_SrvFD3B (DcmDspData):
          DcmDspDataSize = 128
          DcmDspDataUsePort = USE_DATA_ASYNCH_FNC
          DcmDspDataType = UINT8
          DcmDspDataConditionCheckReadFncUsed = false
          DcmDspDataReadFnc = CmnMfgSrvIf_Srv0xFD3BRd
          DcmDspDataWriteFnc = CmnMfgSrvIf_Srv0xFD3BWr
          DcmDspDataInfoRef = DcmDspDataInfo_CmnMfgSrv_SrvFD3B
        DcmDspDidInfo_CmnMfgSrv_SrvFD3B (DcmDspDidInfo): DcmDspDidDynamicallyDefined=false
          DcmDspDidAccess
            DcmDspDidRead: DcmDspDidReadSessionRef=DcmDspSessionRow_NXTRMFG
            DcmDspDidWrite: DcmDspDidWriteSessionRef=DcmDspSessionRow_NXTRMFG
        DcmDspDid_CmnMfgSrv_SrvFD3B (DcmDspDid):
          DcmDspDidIdentifier = 64827
          DcmDspDidUsed = true
          DcmDspDidUsePort = USE_DATA_ELEMENT_SPECIFIC_INTERFACES
          DcmDspDidInfoRef = DcmDspDidInfo_CmnMfgSrv_SrvFD3B
          DcmDspDidSignal: DcmDspDidDataPos=0, DcmDspDidDataRef=DcmDspData_CmnMfgSrv_SrvFD3B
        DcmDspDataInfo_CmnMfgSrv_SrvFD3C (DcmDspDataInfo): DcmDspDataFixedLength=true
        DcmDspData_CmnMfgSrv_SrvFD3C (DcmDspData):
          DcmDspDataSize = 128
          DcmDspDataUsePort = USE_DATA_ASYNCH_FNC
          DcmDspDataType = UINT8
          DcmDspDataConditionCheckReadFncUsed = false
          DcmDspDataReadFnc = CmnMfgSrvIf_Srv0xFD3CRd
          DcmDspDataWriteFnc = CmnMfgSrvIf_Srv0xFD3CWr
          DcmDspDataInfoRef = DcmDspDataInfo_CmnMfgSrv_SrvFD3C
        DcmDspDidInfo_CmnMfgSrv_SrvFD3C (DcmDspDidInfo): DcmDspDidDynamicallyDefined=false
          DcmDspDidAccess
            DcmDspDidRead: DcmDspDidReadSessionRef=DcmDspSessionRow_NXTRMFG
            DcmDspDidWrite: DcmDspDidWriteSessionRef=DcmDspSessionRow_NXTRMFG
        DcmDspDid_CmnMfgSrv_SrvFD3C (DcmDspDid):
          DcmDspDidIdentifier = 64828
          DcmDspDidUsed = true
          DcmDspDidUsePort = USE_DATA_ELEMENT_SPECIFIC_INTERFACES
          DcmDspDidInfoRef = DcmDspDidInfo_CmnMfgSrv_SrvFD3C
          DcmDspDidSignal: DcmDspDidDataPos=0, DcmDspDidDataRef=DcmDspData_CmnMfgSrv_SrvFD3C
        DcmDspDataInfo_CmnMfgSrv_SrvFD40 (DcmDspDataInfo): DcmDspDataFixedLength=true
        DcmDspData_CmnMfgSrv_SrvFD40 (DcmDspData):
          DcmDspDataSize = 32
          DcmDspDataUsePort = USE_DATA_ASYNCH_FNC
          DcmDspDataType = UINT8
          DcmDspDataConditionCheckReadFncUsed = false
          DcmDspDataReadFnc = CmnMfgSrvIf_Srv0xFD40Rd
          DcmDspDataInfoRef = DcmDspDataInfo_CmnMfgSrv_SrvFD40
        DcmDspDidInfo_CmnMfgSrv_SrvFD40 (DcmDspDidInfo): DcmDspDidDynamicallyDefined=false
          DcmDspDidAccess
            DcmDspDidRead: DcmDspDidReadSessionRef=DcmDspSessionRow_NXTRMFG
        DcmDspDid_CmnMfgSrv_SrvFD40 (DcmDspDid):
          DcmDspDidIdentifier = 64832
          DcmDspDidUsed = true
          DcmDspDidUsePort = USE_DATA_ELEMENT_SPECIFIC_INTERFACES
          DcmDspDidInfoRef = DcmDspDidInfo_CmnMfgSrv_SrvFD40
          DcmDspDidSignal: DcmDspDidDataPos=0, DcmDspDidDataRef=DcmDspData_CmnMfgSrv_SrvFD40
        DcmDspDataInfo_CmnMfgSrv_SrvFD41 (DcmDspDataInfo): DcmDspDataFixedLength=true
        DcmDspData_CmnMfgSrv_SrvFD41 (DcmDspData):
          DcmDspDataSize = 32
          DcmDspDataUsePort = USE_DATA_ASYNCH_FNC
          DcmDspDataType = UINT8
          DcmDspDataConditionCheckReadFncUsed = false
          DcmDspDataReadFnc = CmnMfgSrvIf_Srv0xFD41Rd
          DcmDspDataInfoRef = DcmDspDataInfo_CmnMfgSrv_SrvFD41
        DcmDspDidInfo_CmnMfgSrv_SrvFD41 (DcmDspDidInfo): DcmDspDidDynamicallyDefined=false
          DcmDspDidAccess
            DcmDspDidRead: DcmDspDidReadSessionRef=DcmDspSessionRow_NXTRMFG
        DcmDspDid_CmnMfgSrv_SrvFD41 (DcmDspDid):
          DcmDspDidIdentifier = 64833
          DcmDspDidUsed = true
          DcmDspDidUsePort = USE_DATA_ELEMENT_SPECIFIC_INTERFACES
          DcmDspDidInfoRef = DcmDspDidInfo_CmnMfgSrv_SrvFD41
          DcmDspDidSignal: DcmDspDidDataPos=0, DcmDspDidDataRef=DcmDspData_CmnMfgSrv_SrvFD41
        DcmDspDataInfo_CmnMfgSrv_SrvFD42 (DcmDspDataInfo): DcmDspDataFixedLength=true
        DcmDspData_CmnMfgSrv_SrvFD42 (DcmDspData):
          DcmDspDataSize = 32
          DcmDspDataUsePort = USE_DATA_ASYNCH_FNC
          DcmDspDataType = UINT8
          DcmDspDataConditionCheckReadFncUsed = false
          DcmDspDataReadFnc = CmnMfgSrvIf_Srv0xFD42Rd
          DcmDspDataInfoRef = DcmDspDataInfo_CmnMfgSrv_SrvFD42
        DcmDspDidInfo_CmnMfgSrv_SrvFD42 (DcmDspDidInfo): DcmDspDidDynamicallyDefined=false
          DcmDspDidAccess
            DcmDspDidRead: DcmDspDidReadSessionRef=DcmDspSessionRow_NXTRMFG
        DcmDspDid_CmnMfgSrv_SrvFD42 (DcmDspDid):
          DcmDspDidIdentifier = 64834
          DcmDspDidUsed = true
          DcmDspDidUsePort = USE_DATA_ELEMENT_SPECIFIC_INTERFACES
          DcmDspDidInfoRef = DcmDspDidInfo_CmnMfgSrv_SrvFD42
          DcmDspDidSignal: DcmDspDidDataPos=0, DcmDspDidDataRef=DcmDspData_CmnMfgSrv_SrvFD42
        DcmDspDataInfo_CmnMfgSrv_SrvFD60 (DcmDspDataInfo): DcmDspDataFixedLength=true
        DcmDspData_CmnMfgSrv_SrvFD60 (DcmDspData):
          DcmDspDataSize = 800
          DcmDspDataUsePort = USE_DATA_ASYNCH_FNC
          DcmDspDataType = UINT8
          DcmDspDataConditionCheckReadFncUsed = false
          DcmDspDataReadFnc = CmnMfgSrvIf_Srv0xFD60Rd
          DcmDspDataInfoRef = DcmDspDataInfo_CmnMfgSrv_SrvFD60
        DcmDspDidInfo_CmnMfgSrv_SrvFD60 (DcmDspDidInfo): DcmDspDidDynamicallyDefined=false
          DcmDspDidAccess
            DcmDspDidRead: DcmDspDidReadSessionRef=DcmDspSessionRow_NXTRMFG
        DcmDspDid_CmnMfgSrv_SrvFD60 (DcmDspDid):
          DcmDspDidIdentifier = 64864
          DcmDspDidUsed = true
          DcmDspDidUsePort = USE_DATA_ELEMENT_SPECIFIC_INTERFACES
          DcmDspDidInfoRef = DcmDspDidInfo_CmnMfgSrv_SrvFD60
          DcmDspDidSignal: DcmDspDidDataPos=0, DcmDspDidDataRef=DcmDspData_CmnMfgSrv_SrvFD60
        DcmDspDataInfo_CmnMfgSrv_SrvFD62 (DcmDspDataInfo): DcmDspDataFixedLength=true
        DcmDspData_CmnMfgSrv_SrvFD62 (DcmDspData):
          DcmDspDataSize = 2048
          DcmDspDataUsePort = USE_DATA_ASYNCH_FNC
          DcmDspDataType = UINT8
          DcmDspDataConditionCheckReadFncUsed = false
          DcmDspDataReadFnc = CmnMfgSrvIf_Srv0xFD62Rd
          DcmDspDataInfoRef = DcmDspDataInfo_CmnMfgSrv_SrvFD62
        DcmDspDidInfo_CmnMfgSrv_SrvFD62 (DcmDspDidInfo): DcmDspDidDynamicallyDefined=false
          DcmDspDidAccess
            DcmDspDidRead: DcmDspDidReadSessionRef=DcmDspSessionRow_NXTRMFG
        DcmDspDid_CmnMfgSrv_SrvFD62 (DcmDspDid):
          DcmDspDidIdentifier = 64866
          DcmDspDidUsed = true
          DcmDspDidUsePort = USE_DATA_ELEMENT_SPECIFIC_INTERFACES
          DcmDspDidInfoRef = DcmDspDidInfo_CmnMfgSrv_SrvFD62
          DcmDspDidSignal: DcmDspDidDataPos=0, DcmDspDidDataRef=DcmDspData_CmnMfgSrv_SrvFD62
        DcmDspDataInfo_CmnMfgSrv_SrvFD63 (DcmDspDataInfo): DcmDspDataFixedLength=true
        DcmDspData_CmnMfgSrv_SrvFD63 (DcmDspData):
          DcmDspDataSize = 160
          DcmDspDataUsePort = USE_DATA_ASYNCH_FNC
          DcmDspDataType = UINT8
          DcmDspDataConditionCheckReadFncUsed = false
          DcmDspDataReadFnc = CmnMfgSrvIf_Srv0xFD63Rd
          DcmDspDataInfoRef = DcmDspDataInfo_CmnMfgSrv_SrvFD63
        DcmDspDidInfo_CmnMfgSrv_SrvFD63 (DcmDspDidInfo): DcmDspDidDynamicallyDefined=false
          DcmDspDidAccess
            DcmDspDidRead: DcmDspDidReadSessionRef=DcmDspSessionRow_NXTRMFG
        DcmDspDid_CmnMfgSrv_SrvFD63 (DcmDspDid):
          DcmDspDidIdentifier = 64867
          DcmDspDidUsed = true
          DcmDspDidUsePort = USE_DATA_ELEMENT_SPECIFIC_INTERFACES
          DcmDspDidInfoRef = DcmDspDidInfo_CmnMfgSrv_SrvFD63
          DcmDspDidSignal: DcmDspDidDataPos=0, DcmDspDidDataRef=DcmDspData_CmnMfgSrv_SrvFD63
        DcmDspDataInfo_CmnMfgSrv_SrvFDB4 (DcmDspDataInfo): DcmDspDataFixedLength=true
        DcmDspData_CmnMfgSrv_SrvFDB4 (DcmDspData):
          DcmDspDataSize = 32
          DcmDspDataUsePort = USE_DATA_ASYNCH_FNC
          DcmDspDataType = UINT8
          DcmDspDataConditionCheckReadFncUsed = false
          DcmDspDataReadFnc = CmnMfgSrvIf_Srv0xFDB4Rd
          DcmDspDataWriteFnc = CmnMfgSrvIf_Srv0xFDB4Wr
          DcmDspDataInfoRef = DcmDspDataInfo_CmnMfgSrv_SrvFDB4
        DcmDspDidInfo_CmnMfgSrv_SrvFDB4 (DcmDspDidInfo): DcmDspDidDynamicallyDefined=false
          DcmDspDidAccess
            DcmDspDidRead: DcmDspDidReadSessionRef=DcmDspSessionRow_NXTRMFG
            DcmDspDidWrite: DcmDspDidWriteSessionRef=DcmDspSessionRow_NXTRMFG
        DcmDspDid_CmnMfgSrv_SrvFDB4 (DcmDspDid):
          DcmDspDidIdentifier = 64948
          DcmDspDidUsed = true
          DcmDspDidUsePort = USE_DATA_ELEMENT_SPECIFIC_INTERFACES
          DcmDspDidInfoRef = DcmDspDidInfo_CmnMfgSrv_SrvFDB4
          DcmDspDidSignal: DcmDspDidDataPos=0, DcmDspDidDataRef=DcmDspData_CmnMfgSrv_SrvFDB4
        DcmDspDataInfo_CmnMfgSrv_SrvFDB5 (DcmDspDataInfo): DcmDspDataFixedLength=true
        DcmDspData_CmnMfgSrv_SrvFDB5 (DcmDspData):
          DcmDspDataSize = 32
          DcmDspDataUsePort = USE_DATA_ASYNCH_FNC
          DcmDspDataType = UINT8
          DcmDspDataConditionCheckReadFncUsed = false
          DcmDspDataReadFnc = CmnMfgSrvIf_Srv0xFDB5Rd
          DcmDspDataWriteFnc = CmnMfgSrvIf_Srv0xFDB5Wr
          DcmDspDataInfoRef = DcmDspDataInfo_CmnMfgSrv_SrvFDB5
        DcmDspDidInfo_CmnMfgSrv_SrvFDB5 (DcmDspDidInfo): DcmDspDidDynamicallyDefined=false
          DcmDspDidAccess
            DcmDspDidRead: DcmDspDidReadSessionRef=DcmDspSessionRow_NXTRMFG
            DcmDspDidWrite: DcmDspDidWriteSessionRef=DcmDspSessionRow_NXTRMFG
        DcmDspDid_CmnMfgSrv_SrvFDB5 (DcmDspDid):
          DcmDspDidIdentifier = 64949
          DcmDspDidUsed = true
          DcmDspDidUsePort = USE_DATA_ELEMENT_SPECIFIC_INTERFACES
          DcmDspDidInfoRef = DcmDspDidInfo_CmnMfgSrv_SrvFDB5
          DcmDspDidSignal: DcmDspDidDataPos=0, DcmDspDidDataRef=DcmDspData_CmnMfgSrv_SrvFDB5
        DcmDspDataInfo_CmnMfgSrv_SrvFDB6 (DcmDspDataInfo): DcmDspDataFixedLength=true
        DcmDspData_CmnMfgSrv_SrvFDB6 (DcmDspData):
          DcmDspDataSize = 32
          DcmDspDataUsePort = USE_DATA_ASYNCH_FNC
          DcmDspDataType = UINT8
          DcmDspDataConditionCheckReadFncUsed = false
          DcmDspDataReadFnc = CmnMfgSrvIf_Srv0xFDB6Rd
          DcmDspDataWriteFnc = CmnMfgSrvIf_Srv0xFDB6Wr
          DcmDspDataInfoRef = DcmDspDataInfo_CmnMfgSrv_SrvFDB6
        DcmDspDidInfo_CmnMfgSrv_SrvFDB6 (DcmDspDidInfo): DcmDspDidDynamicallyDefined=false
          DcmDspDidAccess
            DcmDspDidRead: DcmDspDidReadSessionRef=DcmDspSessionRow_NXTRMFG
            DcmDspDidWrite: DcmDspDidWriteSessionRef=DcmDspSessionRow_NXTRMFG
        DcmDspDid_CmnMfgSrv_SrvFDB6 (DcmDspDid):
          DcmDspDidIdentifier = 64950
          DcmDspDidUsed = true
          DcmDspDidUsePort = USE_DATA_ELEMENT_SPECIFIC_INTERFACES
          DcmDspDidInfoRef = DcmDspDidInfo_CmnMfgSrv_SrvFDB6
          DcmDspDidSignal: DcmDspDidDataPos=0, DcmDspDidDataRef=DcmDspData_CmnMfgSrv_SrvFDB6
        DcmDspDataInfo_CmnMfgSrv_SrvFDB7 (DcmDspDataInfo): DcmDspDataFixedLength=true
        DcmDspData_CmnMfgSrv_SrvFDB7 (DcmDspData):
          DcmDspDataSize = 32
          DcmDspDataUsePort = USE_DATA_ASYNCH_FNC
          DcmDspDataType = UINT8
          DcmDspDataConditionCheckReadFncUsed = false
          DcmDspDataReadFnc = CmnMfgSrvIf_Srv0xFDB7Rd
          DcmDspDataWriteFnc = CmnMfgSrvIf_Srv0xFDB7Wr
          DcmDspDataInfoRef = DcmDspDataInfo_CmnMfgSrv_SrvFDB7
        DcmDspDidInfo_CmnMfgSrv_SrvFDB7 (DcmDspDidInfo): DcmDspDidDynamicallyDefined=false
          DcmDspDidAccess
            DcmDspDidRead: DcmDspDidReadSessionRef=DcmDspSessionRow_NXTRMFG
            DcmDspDidWrite: DcmDspDidWriteSessionRef=DcmDspSessionRow_NXTRMFG
        DcmDspDid_CmnMfgSrv_SrvFDB7 (DcmDspDid):
          DcmDspDidIdentifier = 64951
          DcmDspDidUsed = true
          DcmDspDidUsePort = USE_DATA_ELEMENT_SPECIFIC_INTERFACES
          DcmDspDidInfoRef = DcmDspDidInfo_CmnMfgSrv_SrvFDB7
          DcmDspDidSignal: DcmDspDidDataPos=0, DcmDspDidDataRef=DcmDspData_CmnMfgSrv_SrvFDB7
        DcmDspDataInfo_CmnMfgSrv_SrvFDBC (DcmDspDataInfo): DcmDspDataFixedLength=true
        DcmDspData_CmnMfgSrv_SrvFDBC (DcmDspData):
          DcmDspDataSize = 8
          DcmDspDataUsePort = USE_DATA_ASYNCH_FNC
          DcmDspDataType = UINT8
          DcmDspDataConditionCheckReadFncUsed = false
          DcmDspDataReadFnc = CmnMfgSrvIf_Srv0xFDBCRd
          DcmDspDataInfoRef = DcmDspDataInfo_CmnMfgSrv_SrvFDBC
        DcmDspDidInfo_CmnMfgSrv_SrvFDBC (DcmDspDidInfo): DcmDspDidDynamicallyDefined=false
          DcmDspDidAccess
            DcmDspDidRead: DcmDspDidReadSessionRef=DcmDspSessionRow_NXTRMFG
        DcmDspDid_CmnMfgSrv_SrvFDBC (DcmDspDid):
          DcmDspDidIdentifier = 64956
          DcmDspDidUsed = true
          DcmDspDidUsePort = USE_DATA_ELEMENT_SPECIFIC_INTERFACES
          DcmDspDidInfoRef = DcmDspDidInfo_CmnMfgSrv_SrvFDBC
          DcmDspDidSignal: DcmDspDidDataPos=0, DcmDspDidDataRef=DcmDspData_CmnMfgSrv_SrvFDBC
        DcmDspDataInfo_CmnMfgSrv_SrvFDBD (DcmDspDataInfo): DcmDspDataFixedLength=true
        DcmDspData_CmnMfgSrv_SrvFDBD (DcmDspData):
          DcmDspDataSize = 8
          DcmDspDataUsePort = USE_DATA_ASYNCH_FNC
          DcmDspDataType = UINT8
          DcmDspDataConditionCheckReadFncUsed = false
          DcmDspDataReadFnc = CmnMfgSrvIf_Srv0xFDBDRd
          DcmDspDataInfoRef = DcmDspDataInfo_CmnMfgSrv_SrvFDBD
        DcmDspDidInfo_CmnMfgSrv_SrvFDBD (DcmDspDidInfo): DcmDspDidDynamicallyDefined=false
          DcmDspDidAccess
            DcmDspDidRead: DcmDspDidReadSessionRef=DcmDspSessionRow_NXTRMFG
        DcmDspDid_CmnMfgSrv_SrvFDBD (DcmDspDid):
          DcmDspDidIdentifier = 64957
          DcmDspDidUsed = true
          DcmDspDidUsePort = USE_DATA_ELEMENT_SPECIFIC_INTERFACES
          DcmDspDidInfoRef = DcmDspDidInfo_CmnMfgSrv_SrvFDBD
          DcmDspDidSignal: DcmDspDidDataPos=0, DcmDspDidDataRef=DcmDspData_CmnMfgSrv_SrvFDBD
        DcmDspDataInfo_CmnMfgSrv_SrvFDBE (DcmDspDataInfo): DcmDspDataFixedLength=true
        DcmDspData_CmnMfgSrv_SrvFDBE (DcmDspData):
          DcmDspDataSize = 8
          DcmDspDataUsePort = USE_DATA_ASYNCH_FNC
          DcmDspDataType = UINT8
          DcmDspDataConditionCheckReadFncUsed = false
          DcmDspDataReadFnc = CmnMfgSrvIf_Srv0xFDBERd
          DcmDspDataInfoRef = DcmDspDataInfo_CmnMfgSrv_SrvFDBE
        DcmDspDidInfo_CmnMfgSrv_SrvFDBE (DcmDspDidInfo): DcmDspDidDynamicallyDefined=false
          DcmDspDidAccess
            DcmDspDidRead: DcmDspDidReadSessionRef=DcmDspSessionRow_NXTRMFG
        DcmDspDid_CmnMfgSrv_SrvFDBE (DcmDspDid):
          DcmDspDidIdentifier = 64958
          DcmDspDidUsed = true
          DcmDspDidUsePort = USE_DATA_ELEMENT_SPECIFIC_INTERFACES
          DcmDspDidInfoRef = DcmDspDidInfo_CmnMfgSrv_SrvFDBE
          DcmDspDidSignal: DcmDspDidDataPos=0, DcmDspDidDataRef=DcmDspData_CmnMfgSrv_SrvFDBE
        DcmDspDataInfo_CmnMfgSrv_SrvFDBF (DcmDspDataInfo): DcmDspDataFixedLength=true
        DcmDspData_CmnMfgSrv_SrvFDBF (DcmDspData):
          DcmDspDataSize = 8
          DcmDspDataUsePort = USE_DATA_ASYNCH_FNC
          DcmDspDataType = UINT8
          DcmDspDataConditionCheckReadFncUsed = false
          DcmDspDataReadFnc = CmnMfgSrvIf_Srv0xFDBFRd
          DcmDspDataInfoRef = DcmDspDataInfo_CmnMfgSrv_SrvFDBF
        DcmDspDidInfo_CmnMfgSrv_SrvFDBF (DcmDspDidInfo): DcmDspDidDynamicallyDefined=false
          DcmDspDidAccess
            DcmDspDidRead: DcmDspDidReadSessionRef=DcmDspSessionRow_NXTRMFG
        DcmDspDid_CmnMfgSrv_SrvFDBF (DcmDspDid):
          DcmDspDidIdentifier = 64959
          DcmDspDidUsed = true
          DcmDspDidUsePort = USE_DATA_ELEMENT_SPECIFIC_INTERFACES
          DcmDspDidInfoRef = DcmDspDidInfo_CmnMfgSrv_SrvFDBF
          DcmDspDidSignal: DcmDspDidDataPos=0, DcmDspDidDataRef=DcmDspData_CmnMfgSrv_SrvFDBF
        DcmDspDataInfo_CmnMfgSrv_SrvFDC0 (DcmDspDataInfo): DcmDspDataFixedLength=true
        DcmDspData_CmnMfgSrv_SrvFDC0 (DcmDspData):
          DcmDspDataSize = 16
          DcmDspDataUsePort = USE_DATA_ASYNCH_FNC
          DcmDspDataType = UINT8
          DcmDspDataConditionCheckReadFncUsed = false
          DcmDspDataReadFnc = CmnMfgSrvIf_Srv0xFDC0Rd
          DcmDspDataWriteFnc = CmnMfgSrvIf_Srv0xFDC0Wr
          DcmDspDataInfoRef = DcmDspDataInfo_CmnMfgSrv_SrvFDC0
        DcmDspDidInfo_CmnMfgSrv_SrvFDC0 (DcmDspDidInfo): DcmDspDidDynamicallyDefined=false
          DcmDspDidAccess
            DcmDspDidRead: DcmDspDidReadSessionRef=DcmDspSessionRow_NXTRMFG
            DcmDspDidWrite: DcmDspDidWriteSessionRef=DcmDspSessionRow_NXTRMFG
        DcmDspDid_CmnMfgSrv_SrvFDC0 (DcmDspDid):
          DcmDspDidIdentifier = 64960
          DcmDspDidUsed = true
          DcmDspDidUsePort = USE_DATA_ELEMENT_SPECIFIC_INTERFACES
          DcmDspDidInfoRef = DcmDspDidInfo_CmnMfgSrv_SrvFDC0
          DcmDspDidSignal: DcmDspDidDataPos=0, DcmDspDidDataRef=DcmDspData_CmnMfgSrv_SrvFDC0
        DcmDspDataInfo_CmnMfgSrv_SrvFDD7 (DcmDspDataInfo): DcmDspDataFixedLength=true
        DcmDspData_CmnMfgSrv_SrvFDD7 (DcmDspData):
          DcmDspDataSize = 848
          DcmDspDataUsePort = USE_DATA_ASYNCH_FNC
          DcmDspDataType = UINT8
          DcmDspDataConditionCheckReadFncUsed = false
          DcmDspDataReadFnc = CmnMfgSrvIf_Srv0xFDD7Rd
          DcmDspDataWriteFnc = CmnMfgSrvIf_Srv0xFDD7Wr
          DcmDspDataInfoRef = DcmDspDataInfo_CmnMfgSrv_SrvFDD7
        DcmDspDidInfo_CmnMfgSrv_SrvFDD7 (DcmDspDidInfo): DcmDspDidDynamicallyDefined=false
          DcmDspDidAccess
            DcmDspDidRead: DcmDspDidReadSessionRef=DcmDspSessionRow_NXTRMFG
            DcmDspDidWrite: DcmDspDidWriteSessionRef=DcmDspSessionRow_NXTRMFG
        DcmDspDid_CmnMfgSrv_SrvFDD7 (DcmDspDid):
          DcmDspDidIdentifier = 64983
          DcmDspDidUsed = true
          DcmDspDidUsePort = USE_DATA_ELEMENT_SPECIFIC_INTERFACES
          DcmDspDidInfoRef = DcmDspDidInfo_CmnMfgSrv_SrvFDD7
          DcmDspDidSignal: DcmDspDidDataPos=0, DcmDspDidDataRef=DcmDspData_CmnMfgSrv_SrvFDD7
        DcmDspDataInfo_CmnMfgSrv_SrvFDDF (DcmDspDataInfo): DcmDspDataFixedLength=true
        DcmDspData_CmnMfgSrv_SrvFDDF (DcmDspData):
          DcmDspDataSize = 848
          DcmDspDataUsePort = USE_DATA_ASYNCH_FNC
          DcmDspDataType = UINT8
          DcmDspDataConditionCheckReadFncUsed = false
          DcmDspDataReadFnc = CmnMfgSrvIf_Srv0xFDDFRd
          DcmDspDataWriteFnc = CmnMfgSrvIf_Srv0xFDDFWr
          DcmDspDataInfoRef = DcmDspDataInfo_CmnMfgSrv_SrvFDDF
        DcmDspDidInfo_CmnMfgSrv_SrvFDDF (DcmDspDidInfo): DcmDspDidDynamicallyDefined=false
          DcmDspDidAccess
            DcmDspDidRead: DcmDspDidReadSessionRef=DcmDspSessionRow_NXTRMFG
            DcmDspDidWrite: DcmDspDidWriteSessionRef=DcmDspSessionRow_NXTRMFG
        DcmDspDid_CmnMfgSrv_SrvFDDF (DcmDspDid):
          DcmDspDidIdentifier = 64991
          DcmDspDidUsed = true
          DcmDspDidUsePort = USE_DATA_ELEMENT_SPECIFIC_INTERFACES
          DcmDspDidInfoRef = DcmDspDidInfo_CmnMfgSrv_SrvFDDF
          DcmDspDidSignal: DcmDspDidDataPos=0, DcmDspDidDataRef=DcmDspData_CmnMfgSrv_SrvFDDF
        DcmDspDataInfo_CmnMfgSrv_SrvFDF6 (DcmDspDataInfo): DcmDspDataFixedLength=true
        DcmDspData_CmnMfgSrv_SrvFDF6 (DcmDspData):
          DcmDspDataSize = 96
          DcmDspDataUsePort = USE_DATA_ASYNCH_FNC
          DcmDspDataType = UINT8
          DcmDspDataConditionCheckReadFncUsed = false
          DcmDspDataReadFnc = CmnMfgSrvIf_Srv0xFDF6Rd
          DcmDspDataWriteFnc = CmnMfgSrvIf_Srv0xFDF6Wr
          DcmDspDataInfoRef = DcmDspDataInfo_CmnMfgSrv_SrvFDF6
        DcmDspDidInfo_CmnMfgSrv_SrvFDF6 (DcmDspDidInfo): DcmDspDidDynamicallyDefined=false
          DcmDspDidAccess
            DcmDspDidRead: DcmDspDidReadSessionRef=DcmDspSessionRow_NXTRMFG
            DcmDspDidWrite: DcmDspDidWriteSessionRef=DcmDspSessionRow_NXTRMFG
        DcmDspDid_CmnMfgSrv_SrvFDF6 (DcmDspDid):
          DcmDspDidIdentifier = 65014
          DcmDspDidUsed = true
          DcmDspDidUsePort = USE_DATA_ELEMENT_SPECIFIC_INTERFACES
          DcmDspDidInfoRef = DcmDspDidInfo_CmnMfgSrv_SrvFDF6
          DcmDspDidSignal: DcmDspDidDataPos=0, DcmDspDidDataRef=DcmDspData_CmnMfgSrv_SrvFDF6
        DcmDspDataInfo_CmnMfgSrv_SrvFDF7 (DcmDspDataInfo): DcmDspDataFixedLength=true
        DcmDspData_CmnMfgSrv_SrvFDF7 (DcmDspData):
          DcmDspDataSize = 224
          DcmDspDataUsePort = USE_DATA_ASYNCH_FNC
          DcmDspDataType = UINT8
          DcmDspDataConditionCheckReadFncUsed = false
          DcmDspDataReadFnc = CmnMfgSrvIf_Srv0xFDF7Rd
          DcmDspDataWriteFnc = CmnMfgSrvIf_Srv0xFDF7Wr
          DcmDspDataInfoRef = DcmDspDataInfo_CmnMfgSrv_SrvFDF7
        DcmDspDidInfo_CmnMfgSrv_SrvFDF7 (DcmDspDidInfo): DcmDspDidDynamicallyDefined=false
          DcmDspDidAccess
            DcmDspDidRead: DcmDspDidReadSessionRef=DcmDspSessionRow_NXTRMFG
            DcmDspDidWrite: DcmDspDidWriteSessionRef=DcmDspSessionRow_NXTRMFG
        DcmDspDid_CmnMfgSrv_SrvFDF7 (DcmDspDid):
          DcmDspDidIdentifier = 65015
          DcmDspDidUsed = true
          DcmDspDidUsePort = USE_DATA_ELEMENT_SPECIFIC_INTERFACES
          DcmDspDidInfoRef = DcmDspDidInfo_CmnMfgSrv_SrvFDF7
          DcmDspDidSignal: DcmDspDidDataPos=0, DcmDspDidDataRef=DcmDspData_CmnMfgSrv_SrvFDF7
        DcmDspDataInfo_CmnMfgSrv_SrvFDF8 (DcmDspDataInfo): DcmDspDataFixedLength=true
        DcmDspData_CmnMfgSrv_SrvFDF8 (DcmDspData):
          DcmDspDataSize = 64
          DcmDspDataUsePort = USE_DATA_ASYNCH_FNC
          DcmDspDataType = UINT8
          DcmDspDataConditionCheckReadFncUsed = false
          DcmDspDataReadFnc = CmnMfgSrvIf_Srv0xFDF8Rd
          DcmDspDataWriteFnc = CmnMfgSrvIf_Srv0xFDF8Wr
          DcmDspDataInfoRef = DcmDspDataInfo_CmnMfgSrv_SrvFDF8
        DcmDspDidInfo_CmnMfgSrv_SrvFDF8 (DcmDspDidInfo): DcmDspDidDynamicallyDefined=false
          DcmDspDidAccess
            DcmDspDidRead: DcmDspDidReadSessionRef=DcmDspSessionRow_NXTRMFG
            DcmDspDidWrite: DcmDspDidWriteSessionRef=DcmDspSessionRow_NXTRMFG
        DcmDspDid_CmnMfgSrv_SrvFDF8 (DcmDspDid):
          DcmDspDidIdentifier = 65016
          DcmDspDidUsed = true
          DcmDspDidUsePort = USE_DATA_ELEMENT_SPECIFIC_INTERFACES
          DcmDspDidInfoRef = DcmDspDidInfo_CmnMfgSrv_SrvFDF8
          DcmDspDidSignal: DcmDspDidDataPos=0, DcmDspDidDataRef=DcmDspData_CmnMfgSrv_SrvFDF8
        DcmDspDataInfo_CmnMfgSrv_SrvFE21 (DcmDspDataInfo): DcmDspDataFixedLength=true
        DcmDspData_CmnMfgSrv_SrvFE21 (DcmDspData):
          DcmDspDataSize = 224
          DcmDspDataUsePort = USE_DATA_ASYNCH_FNC
          DcmDspDataType = UINT8
          DcmDspDataConditionCheckReadFncUsed = false
          DcmDspDataReadFnc = CmnMfgSrvIf_Srv0xFE21Rd
          DcmDspDataWriteFnc = CmnMfgSrvIf_Srv0xFE21Wr
          DcmDspDataInfoRef = DcmDspDataInfo_CmnMfgSrv_SrvFE21
        DcmDspDidInfo_CmnMfgSrv_SrvFE21 (DcmDspDidInfo): DcmDspDidDynamicallyDefined=false
          DcmDspDidAccess
            DcmDspDidRead: DcmDspDidReadSessionRef=DcmDspSessionRow_NXTRMFG
            DcmDspDidWrite: DcmDspDidWriteSessionRef=DcmDspSessionRow_NXTRMFG
        DcmDspDid_CmnMfgSrv_SrvFE21 (DcmDspDid):
          DcmDspDidIdentifier = 65057
          DcmDspDidUsed = true
          DcmDspDidUsePort = USE_DATA_ELEMENT_SPECIFIC_INTERFACES
          DcmDspDidInfoRef = DcmDspDidInfo_CmnMfgSrv_SrvFE21
          DcmDspDidSignal: DcmDspDidDataPos=0, DcmDspDidDataRef=DcmDspData_CmnMfgSrv_SrvFE21
        DcmDspDataInfo_CmnMfgSrv_SrvFE81 (DcmDspDataInfo): DcmDspDataFixedLength=true
        DcmDspData_CmnMfgSrv_SrvFE81 (DcmDspData):
          DcmDspDataSize = 104
          DcmDspDataUsePort = USE_DATA_ASYNCH_FNC
          DcmDspDataType = UINT8
          DcmDspDataConditionCheckReadFncUsed = false
          DcmDspDataReadFnc = CmnMfgSrvIf_Srv0xFE81Rd
          DcmDspDataInfoRef = DcmDspDataInfo_CmnMfgSrv_SrvFE81
        DcmDspDidInfo_CmnMfgSrv_SrvFE81 (DcmDspDidInfo): DcmDspDidDynamicallyDefined=false
          DcmDspDidAccess
            DcmDspDidRead: DcmDspDidReadSessionRef=DcmDspSessionRow_NXTRMFG
        DcmDspDid_CmnMfgSrv_SrvFE81 (DcmDspDid):
          DcmDspDidIdentifier = 65153
          DcmDspDidUsed = true
          DcmDspDidUsePort = USE_DATA_ELEMENT_SPECIFIC_INTERFACES
          DcmDspDidInfoRef = DcmDspDidInfo_CmnMfgSrv_SrvFE81
          DcmDspDidSignal: DcmDspDidDataPos=0, DcmDspDidDataRef=DcmDspData_CmnMfgSrv_SrvFE81
        DcmDspDataInfo_CmnMfgSrv_SrvFE82 (DcmDspDataInfo): DcmDspDataFixedLength=true
        DcmDspData_CmnMfgSrv_SrvFE82 (DcmDspData):
          DcmDspDataSize = 32
          DcmDspDataUsePort = USE_DATA_ASYNCH_FNC
          DcmDspDataType = UINT8
          DcmDspDataConditionCheckReadFncUsed = false
          DcmDspDataWriteFnc = CmnMfgSrvIf_Srv0xFE82Wr
          DcmDspDataInfoRef = DcmDspDataInfo_CmnMfgSrv_SrvFE82
        DcmDspDidInfo_CmnMfgSrv_SrvFE82 (DcmDspDidInfo): DcmDspDidDynamicallyDefined=false
          DcmDspDidAccess
            DcmDspDidWrite: DcmDspDidWriteSessionRef=DcmDspSessionRow_NXTRMFG
        DcmDspDid_CmnMfgSrv_SrvFE82 (DcmDspDid):
          DcmDspDidIdentifier = 65154
          DcmDspDidUsed = true
          DcmDspDidUsePort = USE_DATA_ELEMENT_SPECIFIC_INTERFACES
          DcmDspDidInfoRef = DcmDspDidInfo_CmnMfgSrv_SrvFE82
          DcmDspDidSignal: DcmDspDidDataPos=0, DcmDspDidDataRef=DcmDspData_CmnMfgSrv_SrvFE82
        DcmDspDataInfo_CmnMfgSrv_SrvFE83 (DcmDspDataInfo): DcmDspDataFixedLength=true
        DcmDspData_CmnMfgSrv_SrvFE83 (DcmDspData):
          DcmDspDataSize = 32
          DcmDspDataUsePort = USE_DATA_ASYNCH_FNC
          DcmDspDataType = UINT8
          DcmDspDataConditionCheckReadFncUsed = false
          DcmDspDataWriteFnc = CmnMfgSrvIf_Srv0xFE83Wr
          DcmDspDataInfoRef = DcmDspDataInfo_CmnMfgSrv_SrvFE83
        DcmDspDidInfo_CmnMfgSrv_SrvFE83 (DcmDspDidInfo): DcmDspDidDynamicallyDefined=false
          DcmDspDidAccess
            DcmDspDidWrite: DcmDspDidWriteSessionRef=DcmDspSessionRow_NXTRMFG
        DcmDspDid_CmnMfgSrv_SrvFE83 (DcmDspDid):
          DcmDspDidIdentifier = 65155
          DcmDspDidUsed = true
          DcmDspDidUsePort = USE_DATA_ELEMENT_SPECIFIC_INTERFACES
          DcmDspDidInfoRef = DcmDspDidInfo_CmnMfgSrv_SrvFE83
          DcmDspDidSignal: DcmDspDidDataPos=0, DcmDspDidDataRef=DcmDspData_CmnMfgSrv_SrvFE83
        DcmDspDataInfo_CmnMfgSrv_SrvFE8A (DcmDspDataInfo): DcmDspDataFixedLength=true
        DcmDspData_CmnMfgSrv_SrvFE8A (DcmDspData):
          DcmDspDataSize = 56
          DcmDspDataUsePort = USE_DATA_ASYNCH_FNC
          DcmDspDataType = UINT8
          DcmDspDataConditionCheckReadFncUsed = false
          DcmDspDataReadFnc = CmnMfgSrvIf_Srv0xFE8ARd
          DcmDspDataWriteFnc = CmnMfgSrvIf_Srv0xFE8AWr
          DcmDspDataInfoRef = DcmDspDataInfo_CmnMfgSrv_SrvFE8A
        DcmDspDidInfo_CmnMfgSrv_SrvFE8A (DcmDspDidInfo): DcmDspDidDynamicallyDefined=false
          DcmDspDidAccess
            DcmDspDidRead: DcmDspDidReadSessionRef=DcmDspSessionRow_NXTRMFG
            DcmDspDidWrite: DcmDspDidWriteSessionRef=DcmDspSessionRow_NXTRMFG
        DcmDspDid_CmnMfgSrv_SrvFE8A (DcmDspDid):
          DcmDspDidIdentifier = 65162
          DcmDspDidUsed = true
          DcmDspDidUsePort = USE_DATA_ELEMENT_SPECIFIC_INTERFACES
          DcmDspDidInfoRef = DcmDspDidInfo_CmnMfgSrv_SrvFE8A
          DcmDspDidSignal: DcmDspDidDataPos=0, DcmDspDidDataRef=DcmDspData_CmnMfgSrv_SrvFE8A
        DcmDspDataInfo_CmnMfgSrv_SrvFE8B (DcmDspDataInfo): DcmDspDataFixedLength=true
        DcmDspData_CmnMfgSrv_SrvFE8B (DcmDspData):
          DcmDspDataSize = 8
          DcmDspDataUsePort = USE_DATA_ASYNCH_FNC
          DcmDspDataType = UINT8
          DcmDspDataConditionCheckReadFncUsed = false
          DcmDspDataReadFnc = CmnMfgSrvIf_Srv0xFE8BRd
          DcmDspDataWriteFnc = CmnMfgSrvIf_Srv0xFE8BWr
          DcmDspDataInfoRef = DcmDspDataInfo_CmnMfgSrv_SrvFE8B
        DcmDspDidInfo_CmnMfgSrv_SrvFE8B (DcmDspDidInfo): DcmDspDidDynamicallyDefined=false
          DcmDspDidAccess
            DcmDspDidRead: DcmDspDidReadSessionRef=DcmDspSessionRow_NXTRMFG
            DcmDspDidWrite: DcmDspDidWriteSessionRef=DcmDspSessionRow_NXTRMFG
        DcmDspDid_CmnMfgSrv_SrvFE8B (DcmDspDid):
          DcmDspDidIdentifier = 65163
          DcmDspDidUsed = true
          DcmDspDidUsePort = USE_DATA_ELEMENT_SPECIFIC_INTERFACES
          DcmDspDidInfoRef = DcmDspDidInfo_CmnMfgSrv_SrvFE8B
          DcmDspDidSignal: DcmDspDidDataPos=0, DcmDspDidDataRef=DcmDspData_CmnMfgSrv_SrvFE8B
        DcmDspDataInfo_CmnMfgSrv_SrvFE8C (DcmDspDataInfo): DcmDspDataFixedLength=true
        DcmDspData_CmnMfgSrv_SrvFE8C (DcmDspData):
          DcmDspDataSize = 1696
          DcmDspDataUsePort = USE_DATA_ASYNCH_FNC
          DcmDspDataType = UINT8
          DcmDspDataConditionCheckReadFncUsed = false
          DcmDspDataReadFnc = CmnMfgSrvIf_Srv0xFE8CRd
          DcmDspDataWriteFnc = CmnMfgSrvIf_Srv0xFE8CWr
          DcmDspDataInfoRef = DcmDspDataInfo_CmnMfgSrv_SrvFE8C
        DcmDspDidInfo_CmnMfgSrv_SrvFE8C (DcmDspDidInfo): DcmDspDidDynamicallyDefined=false
          DcmDspDidAccess
            DcmDspDidRead: DcmDspDidReadSessionRef=DcmDspSessionRow_NXTRMFG
            DcmDspDidWrite: DcmDspDidWriteSessionRef=DcmDspSessionRow_NXTRMFG
        DcmDspDid_CmnMfgSrv_SrvFE8C (DcmDspDid):
          DcmDspDidIdentifier = 65164
          DcmDspDidUsed = true
          DcmDspDidUsePort = USE_DATA_ELEMENT_SPECIFIC_INTERFACES
          DcmDspDidInfoRef = DcmDspDidInfo_CmnMfgSrv_SrvFE8C
          DcmDspDidSignal: DcmDspDidDataPos=0, DcmDspDidDataRef=DcmDspData_CmnMfgSrv_SrvFE8C
        DcmDspDataInfo_CmnMfgSrv_SrvFE90 (DcmDspDataInfo): DcmDspDataFixedLength=true
        DcmDspData_CmnMfgSrv_SrvFE90 (DcmDspData):
          DcmDspDataSize = 32
          DcmDspDataUsePort = USE_DATA_ASYNCH_FNC
          DcmDspDataType = UINT8
          DcmDspDataConditionCheckReadFncUsed = false
          DcmDspDataReadFnc = CmnMfgSrvIf_Srv0xFE90Rd
          DcmDspDataWriteFnc = CmnMfgSrvIf_Srv0xFE90Wr
          DcmDspDataInfoRef = DcmDspDataInfo_CmnMfgSrv_SrvFE90
        DcmDspDidInfo_CmnMfgSrv_SrvFE90 (DcmDspDidInfo): DcmDspDidDynamicallyDefined=false
          DcmDspDidAccess
            DcmDspDidRead: DcmDspDidReadSessionRef=DcmDspSessionRow_NXTRMFG
            DcmDspDidWrite: DcmDspDidWriteSessionRef=DcmDspSessionRow_NXTRMFG
        DcmDspDid_CmnMfgSrv_SrvFE90 (DcmDspDid):
          DcmDspDidIdentifier = 65168
          DcmDspDidUsed = true
          DcmDspDidUsePort = USE_DATA_ELEMENT_SPECIFIC_INTERFACES
          DcmDspDidInfoRef = DcmDspDidInfo_CmnMfgSrv_SrvFE90
          DcmDspDidSignal: DcmDspDidDataPos=0, DcmDspDidDataRef=DcmDspData_CmnMfgSrv_SrvFE90
        DcmDspDataInfo_CmnMfgSrv_SrvFED0 (DcmDspDataInfo): DcmDspDataFixedLength=true
        DcmDspData_CmnMfgSrv_SrvFED0 (DcmDspData):
          DcmDspDataSize = 8
          DcmDspDataUsePort = USE_DATA_ASYNCH_FNC
          DcmDspDataType = UINT8
          DcmDspDataConditionCheckReadFncUsed = false
          DcmDspDataReadFnc = CmnMfgSrvIf_Srv0xFED0Rd
          DcmDspDataWriteFnc = CmnMfgSrvIf_Srv0xFED0Wr
          DcmDspDataInfoRef = DcmDspDataInfo_CmnMfgSrv_SrvFED0
        DcmDspDidInfo_CmnMfgSrv_SrvFED0 (DcmDspDidInfo): DcmDspDidDynamicallyDefined=false
          DcmDspDidAccess
            DcmDspDidRead: DcmDspDidReadSessionRef=DcmDspSessionRow_NXTRMFG
            DcmDspDidWrite: DcmDspDidWriteSessionRef=DcmDspSessionRow_NXTRMFG
        DcmDspDid_CmnMfgSrv_SrvFED0 (DcmDspDid):
          DcmDspDidIdentifier = 65232
          DcmDspDidUsed = true
          DcmDspDidUsePort = USE_DATA_ELEMENT_SPECIFIC_INTERFACES
          DcmDspDidInfoRef = DcmDspDidInfo_CmnMfgSrv_SrvFED0
          DcmDspDidSignal: DcmDspDidDataPos=0, DcmDspDidDataRef=DcmDspData_CmnMfgSrv_SrvFED0
        DcmDspDataInfo_CmnMfgSrv_SrvFED1 (DcmDspDataInfo): DcmDspDataFixedLength=true
        DcmDspData_CmnMfgSrv_SrvFED1 (DcmDspData):
          DcmDspDataSize = 8
          DcmDspDataUsePort = USE_DATA_ASYNCH_FNC
          DcmDspDataType = UINT8
          DcmDspDataConditionCheckReadFncUsed = false
          DcmDspDataReadFnc = CmnMfgSrvIf_Srv0xFED1Rd
          DcmDspDataWriteFnc = CmnMfgSrvIf_Srv0xFED1Wr
          DcmDspDataInfoRef = DcmDspDataInfo_CmnMfgSrv_SrvFED1
        DcmDspDidInfo_CmnMfgSrv_SrvFED1 (DcmDspDidInfo): DcmDspDidDynamicallyDefined=false
          DcmDspDidAccess
            DcmDspDidRead: DcmDspDidReadSessionRef=DcmDspSessionRow_NXTRMFG
            DcmDspDidWrite: DcmDspDidWriteSessionRef=DcmDspSessionRow_NXTRMFG
        DcmDspDid_CmnMfgSrv_SrvFED1 (DcmDspDid):
          DcmDspDidIdentifier = 65233
          DcmDspDidUsed = true
          DcmDspDidUsePort = USE_DATA_ELEMENT_SPECIFIC_INTERFACES
          DcmDspDidInfoRef = DcmDspDidInfo_CmnMfgSrv_SrvFED1
          DcmDspDidSignal: DcmDspDidDataPos=0, DcmDspDidDataRef=DcmDspData_CmnMfgSrv_SrvFED1
