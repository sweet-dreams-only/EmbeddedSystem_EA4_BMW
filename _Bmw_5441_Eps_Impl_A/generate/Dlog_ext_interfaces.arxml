AUTOSAR XML (schema 4-3-0)
# \copyright BMW AG 2015 - 2017
package /BMW/Platform/Dlog/Coding/PortInterfaces
  impl type Coding_CafIdArrayType: category=ARRAY
    element Coding_CafIdSubarrayType: array-size=8, array-size-semantics=FIXED-SIZE, implementation-data-type=uint8
  client server interface Coding_SVKInterface
    operation GetCafIds: possible-error=Coding_SVKInterface/E_NOT_OK
      arg cafIds: type=Coding_CafIdArrayType, direction=OUT, server-argument-impl-policy=USE-ARRAY-BASE-TYPE
      arg numberOfCafIds: type=uint16, direction=OUT, server-argument-impl-policy=USE-ARGUMENT-TYPE
    error E_NOT_OK: error-code=1
package /BMW/Platform/Dlog/Dcm/ImplementationDataTypes
  14 x impl type:
    Dcm_NegativeResponseCodeType: compu {16=DCM_E_GENERALREJECT, 19=DCM_E_INCORRECTMESSAGELENGTHORINVALIDFORMAT, 33=DCM_E_BUSYREPEATREQUEST, 34=DCM_E_CONDITIONSNOTCORRECT, 36=DCM_E_REQUESTSEQUENCEERROR, 49=DCM_E_REQUESTOUTOFRANGE, 51=DCM_E_SECURITYACCESSDENIED, 114=DCM_E_GENERALPROGRAMMINGFAILURE, 126=DCM_E_SUBFUNCTIONNOTSUPPORTEDINACTIVESESSION, 129=DCM_E_RPMTOOHIGH, 130=DCM_E_RPMTOOLOW, 131=DCM_E_ENGINEISRUNNING, 132=DCM_E_ENGINEISNOTRUNNING, 133=DCM_E_ENGINERUNTIMETOOLOW, 134=DCM_E_TEMPERATURETOOHIGH, 135=DCM_E_TEMPERATURETOOLOW, 136=DCM_E_VEHICLESPEEDTOOHIGH, 137=DCM_E_VEHICLESPEEDTOOLOW, 138=DCM_E_THROTTLE_PEDALTOOHIGH, 139=DCM_E_THROTTLE_PEDALTOOLOW, 140=DCM_E_TRANSMISSIONRANGENOTINNEUTRAL, 141=DCM_E_TRANSMISSIONRANGENOTINGEAR, 143=DCM_E_BRAKESWITCH_NOTCLOSED, 144=DCM_E_SHIFTERLEVERNOTINPARK, 145=DCM_E_TORQUECONVERTERCLUTCHLOCKED, 146=DCM_E_VOLTAGETOOHIGH, 147=DCM_E_VOLTAGETOOLOW}, implementation-data-type=uint8
    Dcm_OpStatusType: compu {0=DCM_INITIAL, 1=DCM_PENDING, 2=DCM_CANCEL, 3=DCM_FORCE_RCRRP_OK}, implementation-data-type=uint8
    DevInfoArrayType: category=ARRAY
      element SubDevInfoArrayType: array-size=11, array-size-semantics=FIXED-SIZE, implementation-data-type=uint8
    Dlog_EcuUidArrayType: category=ARRAY
      element Dlog_EcuUidSubArrayType: array-size=16, array-size-semantics=FIXED-SIZE, implementation-data-type=uint8
    Dlog_HWModificationIndexArrayType: category=ARRAY
      element Dlog_HWModificationIndexSubArrayType: array-size=2, array-size-semantics=FIXED-SIZE, implementation-data-type=uint8
    Dlog_SwfkDeleteSupportedArrayType: category=ARRAY
      element Dlog_SwfkDeleteSupportedSubArrayType: array-size=1, array-size-semantics=FIXED-SIZE, implementation-data-type=uint8
    Dlog_VinArrayType: category=ARRAY
      element SubVinArrayType: array-size=17, array-size-semantics=FIXED-SIZE, implementation-data-type=uint8
    ManufacturingDataArrayType: category=ARRAY
      element SubManufacturingDataArrayType: array-size=3, array-size-semantics=FIXED-SIZE, implementation-data-type=uint8
    RSInputArrayType: category=ARRAY
      element SubRSInputArrayType: array-size=8, array-size-semantics=FIXED-SIZE, implementation-data-type=uint8
    RSOutputArrayType: category=ARRAY
      element SubRSOutputArrayType: array-size=8, array-size-semantics=FIXED-SIZE, implementation-data-type=uint8
    SerialNumberArrayType: category=ARRAY
      element SubSerialNumberArrayType: array-size=10, array-size-semantics=FIXED-SIZE, implementation-data-type=uint8
    SvkDataArrayType: category=ARRAY
      element SubSvkDataArrayType: array-size=100, array-size-semantics=FIXED-SIZE, implementation-data-type=uint8
    SvkHistoryDataArrayType: category=ARRAY
      element SubSvkHistoryDataArrayType: array-size=48, array-size-semantics=FIXED-SIZE, implementation-data-type=uint8
    TimingParametersArrayType: category=ARRAY
      element SubTimingParametersArrayType: array-size=12, array-size-semantics=FIXED-SIZE, implementation-data-type=uint8
package /BMW/Platform/Dlog/Dcm/PortInterfaces
  10 x client server interface, all with is-service=true:
    DataServices_EcuSerialNumber
      operation ReadData: possible-error=DataServices_EcuSerialNumber/E_NOT_OK
        arg Data: type=SerialNumberArrayType, direction=OUT
      error E_NOT_OK: error-code=1
    DataServices_EcuUid
      operation ReadData: possible-error=DataServices_EcuUid/E_NOT_OK
        arg Data: type=Dlog_EcuUidArrayType, direction=OUT
      error E_NOT_OK: error-code=1
    DataServices_FlashTimingParameter
      operation ReadData: possible-error=DataServices_FlashTimingParameter/E_NOT_OK
        arg Data: type=TimingParametersArrayType, direction=OUT
      error E_NOT_OK: error-code=1
    DataServices_HWModificationIndex
      operation ReadData: possible-error=DataServices_HWModificationIndex/E_NOT_OK
        arg Data: type=Dlog_HWModificationIndexArrayType, direction=OUT
      error E_NOT_OK: error-code=1
    DataServices_ManufacturingDate
      operation ReadData: possible-error=DataServices_ManufacturingDate/E_NOT_OK
        arg Data: type=ManufacturingDataArrayType, direction=OUT
      error E_NOT_OK: error-code=1
    DataServices_Svk
      operation ReadData: possible-error=[DataServices_Svk/E_NOT_OK, DataServices_Svk/DCM_E_PENDING]
        arg OpStatus: type=Dcm_OpStatusType, direction=IN
        arg Data: type=SvkDataArrayType, direction=OUT
      operation ReadDataLength: possible-error=[DataServices_Svk/DCM_E_PENDING, DataServices_Svk/E_NOT_OK]
        arg OpStatus: type=Dcm_OpStatusType, direction=IN, server-argument-impl-policy=USE-ARGUMENT-TYPE
        arg DataLength: type=uint16, direction=OUT
      operation ConditionCheckRead: possible-error=[DataServices_Svk/E_NOT_OK, DataServices_Svk/DCM_E_PENDING]
        arg OpStatus: type=Dcm_OpStatusType, direction=IN
        arg ErrorCode: type=Dcm_NegativeResponseCodeType, direction=OUT
      error E_NOT_OK: error-code=1
      error DCM_E_PENDING: error-code=10
    DataServices_SvkHistory
      operation ReadData: possible-error=[DataServices_SvkHistory/E_NOT_OK, DataServices_SvkHistory/DCM_E_PENDING]
        arg OpStatus: type=Dcm_OpStatusType, direction=IN
        arg Data: type=SvkHistoryDataArrayType, direction=OUT
      operation ConditionCheckRead: possible-error=[DataServices_SvkHistory/E_NOT_OK, DataServices_SvkHistory/DCM_E_PENDING]
        arg OpStatus: type=Dcm_OpStatusType, direction=IN
        arg ErrorCode: type=Dcm_NegativeResponseCodeType, direction=OUT
      error E_NOT_OK: error-code=1
      error DCM_E_PENDING: error-code=10
    DataServices_SwfkDeleteSupported: service-kind=BASIC-SOFTWARE-MODE-MANAGER
      operation ReadData: possible-error=DataServices_SwfkDeleteSupported/E_NOT_OK
        arg Data: type=Dlog_SwfkDeleteSupportedArrayType, direction=OUT, server-argument-impl-policy=USE-ARRAY-BASE-TYPE
      error E_NOT_OK: error-code=1
    DataServices_Vin
      operation ReadData: possible-error=DataServices_Vin/E_NOT_OK
        arg OpStatus: type=Dcm_OpStatusType, direction=IN
        arg Data: type=Dlog_VinArrayType, direction=OUT
      operation ConditionCheckRead: possible-error=[DataServices_Vin/E_NOT_OK, DataServices_Vin/DCM_E_PENDING]
        arg OpStatus: type=Dcm_OpStatusType, direction=IN
        arg ErrorCode: type=Dcm_NegativeResponseCodeType, direction=OUT
      error E_NOT_OK: error-code=1
      error DCM_E_PENDING: error-code=10
    RoutineService_DevInfo
      operation Start: possible-error=[RoutineService_DevInfo/E_NOT_OK, RoutineService_DevInfo/DCM_E_PENDING]
        5 x arg:
          DataIn: type=RSInputArrayType, direction=IN
          OpStatus: type=Dcm_OpStatusType, direction=IN
          DataOut: type=DevInfoArrayType, direction=OUT
          CurrentDataLength: type=uint16, direction=INOUT
          ErrorCode: type=Dcm_NegativeResponseCodeType, direction=OUT
      error E_NOT_OK: error-code=1
      error DCM_E_PENDING: error-code=10
package /BMW/Platform/Dlog/Det/PortInterfaces
  client server interface Dlog_DETService: is-service=true
    operation ReportError: possible-error=Dlog_DETService/E_OK
      arg InstanceId: type=uint8, direction=IN
      arg ApiId: type=uint8, direction=IN
      arg ErrorId: type=uint8, direction=IN
    error E_OK: error-code=0
package /BMW/Platform/Dlog/ImplementationDataTypes
  impl type Coding_SgbmIdType: category=ARRAY
    element SubSgbmIdType: array-size=8, array-size-semantics=FIXED-SIZE, implementation-data-type=uint8
package /BMW/Platform/Dlog/NvM/ImplementationDataTypes
  impl type NvM_DstPtrType: category=DATA_REFERENCE, sw-pointer-target-props={target-category=VALUE, base-type=void}
  impl type NvM_RequestResultType: compu {0=NVM_REQ_OK, 1=NVM_REQ_NOT_OK, 2=NVM_REQ_PENDING, 3=NVM_REQ_INTEGRITY_FAILED, 4=NVM_REQ_BLOCK_SKIPPED, 5=NVM_REQ_NV_INVALIDATED, 6=NVM_REQ_CANCELED, 7=NVM_REQ_REDUNDANCY_FAILED, 8=NVM_REQ_RESTORED_FROM_ROM}, implementation-data-type=uint8
  impl type NvM_SrcPtrType: category=DATA_REFERENCE, sw-pointer-target-props={target-category=VALUE, base-type=void, sw-impl-policy=CONST}
package /BMW/Platform/Dlog/NvM/PortInterfaces
  5 x client server interface, all with is-service=true:
    Dlog_NvMAdmin
      operation SetBlockProtection: possible-error=Dlog_NvMAdmin/E_NOT_OK
        arg ProtectionEnabled: type=boolean, direction=IN
      error E_NOT_OK: error-code=1
    Dlog_NvMNotifyInitBlock
      operation InitBlock: possible-error=Dlog_NvMNotifyInitBlock/E_OK
      error E_OK: error-code=0
    Dlog_NvMNotifyJobFinished
      operation JobFinished: possible-error=Dlog_NvMNotifyJobFinished/E_OK
        arg ServiceId: type=uint8, direction=IN
        arg JobResult: type=NvM_RequestResultType, direction=IN
      error E_OK: error-code=0
    NvMService
      5 x operation, all with possible-error=NvMService/E_NOT_OK:
        GetErrorStatus
          arg RequestResultPtr: type=NvM_RequestResultType, direction=OUT
        SetRamBlockStatus
          arg BlockChanged: type=boolean, direction=IN
        ReadBlock
          arg DstPtr: type=NvM_DstPtrType, direction=IN
        WriteBlock
          arg SrcPtr: type=NvM_SrcPtrType, direction=IN, server-argument-impl-policy=USE-VOID
        RestoreBlockDefaults
          arg DstPtr: type=NvM_DstPtrType, direction=IN, server-argument-impl-policy=USE-VOID
      error E_NOT_OK: error-code=1
    NvMServiceSvkEntry
      5 x operation, all with possible-error=NvMServiceSvkEntry/E_NOT_OK:
        GetErrorStatus
          arg RequestResultPtr: type=NvM_RequestResultType, direction=OUT
        SetRamBlockStatus
          arg BlockChanged: type=boolean, direction=IN
        ReadBlock
          arg DstPtr: type=NvM_DstPtrType, direction=IN
        WriteBlock
          arg SrcPtr: type=NvM_SrcPtrType, direction=IN
        SetDataIndex
          arg DataIndex: type=uint8, direction=IN
      error E_NOT_OK: error-code=1
