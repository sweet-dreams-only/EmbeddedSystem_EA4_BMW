AUTOSAR XML (schema 4-2-2)
# \copyright BMW AG 2017
package /BMW/Platform/Darh/ImplementationDataTypes
  4 x impl type, all with category=TYPE_REFERENCE, implementation-data-type=uint8:
    Darh_RoeStateType: compu {0=DARH_ROE_STOPPED, 1=DARH_ROE_STARTED, 2=DARH_ROE_UNKNOWN}
    Darh_DcmIndicationType: compu {0=DARH_DCM_NOINDICATION, 1=DARH_DCM_ACTIVATED, 2=DARH_DCM_STOPPED}
    Darh_SuspendedStateType: compu {0=DARH_NOT_SUSPENDED, 1=DARH_SUSPENDED}
    Darh_LifeCycleRequestType: compu {0=DARH_INITIALIZED, 1=DARH_RUNNING, 2=DARH_STOPPED}
package /BMW/Platform/Darh/PortInterfaces
  client server interface RoeStateInterface
    operation GetRoeState: possible-error=RoeStateInterface/E_NOT_OK
      arg RoeState: type=Darh_RoeStateType, direction=OUT
    error E_NOT_OK: error-code=1
  client server interface DarhControlInterface
    operation SetRoeSuspended: possible-error=DarhControlInterface/E_NOT_OK
      arg suspended: type=boolean, direction=IN
    error E_NOT_OK: error-code=1
  sender receiver interface ILifeCycleRequest: is-service=true
    data requestMode: type=Darh_LifeCycleRequestType
  client server interface DarhReportDynamicallyEvent
    operation EventToReport: possible-error=DarhReportDynamicallyEvent/E_NOT_OK
      arg event: type=Dem_EventIdType, direction=IN
      arg toReport: type=boolean, direction=OUT
    operation EventToReportCount: possible-error=DarhReportDynamicallyEvent/E_NOT_OK
      arg eventCount: type=uint16, direction=OUT
    operation EventIdx2EventId: possible-error=DarhReportDynamicallyEvent/E_NOT_OK
      arg eventIdx: type=uint16, direction=IN
      arg eventId: type=Dem_EventIdType, direction=OUT
    error E_NOT_OK: error-code=1
  mode switch interface DarhReportErrorModeInterface: is-service=true
    mode group DarhReportErrorMode: type=DarhReportErrorMode
  mode switch interface ILifeCycle
    mode group Mode: type=Darh_LifeCycle
package /BMW/Platform/Darh/ModeDeclarationGroups
  mode declaration group DarhReportErrorMode: initial-mode=DARH_REPORT_ERROR_INACTIVE
    mode DARH_REPORT_ERROR_ACTIVE
    mode DARH_REPORT_ERROR_INACTIVE
  mode declaration group Darh_LifeCycle: category=EXPLICIT_ORDER, initial-mode=DARH_STOPPED, on-transition-value=3
    mode DARH_INITIALIZED: value=0
    mode DARH_RUNNING: value=1
    mode DARH_STOPPED: value=2
package /BMW/Platform/Darh/DataTypeMappingSets
  data type mapping set Darh_ModeRequestTypeMappings
    mode-request-type-maps:
      implementation-data-type=Darh_LifeCycleRequestType, mode-group=Darh_LifeCycle
      implementation-data-type=uint8, mode-group=DarhReportErrorMode
