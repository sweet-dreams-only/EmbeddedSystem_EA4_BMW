[part 2 of 3: package /MICROSAR/Dem_swc/ComponentTypes]
AUTOSAR XML (schema 4-3-0)
package /MICROSAR/Dem_swc/ComponentTypes  (continued)
  service sw component type DemSatellite_0: category=SERVICE_COMPONENT  (continued)
    behavior DemSatellite_0InternalBehavior: handle-termination-and-restart=NO-SUPPORT, included-data-type-set=data-type=[Dem_EventIdType, Dem_RatioIdType, Dem_EventStatusType, Dem_UdsStatusByteType, Dem_DTCFormatType, Dem_InitMonitorReasonType, Dem_OperationCycleStateType, Dem_DTCStatusMaskType, Dem_IndicatorStatusType, Dem_MaxDataValueType, Dem_DTCKindType, Dem_DTCGroupType, Dem_IumprDenomCondIdType, Dem_IumprDenomCondStatusType, Dem_DebounceResetStatusType, Dem_DebouncingStateType, Dem_IumprReadinessGroupType, Dem_DTRControlType, Dem_DTCSeverityType, Dem_MonitorStatusType]  (continued)
      924 x operation invoked event:
        OpEventGetEventUdsStatus_GetEventUdsStatus_EvtInfo_MCU_E_CLM_SELFDIAG_FAILURE: start-on-event=DemSatellite_0InternalBehavior/GetEventUdsStatus, operation=EvtInfo_MCU_E_CLM_SELFDIAG_FAILURE.GetEventUdsStatus
        OpEventGetEventUdsStatus_GetEventUdsStatus_EvtInfo_MCU_E_CLOCK_FAILURE: start-on-event=DemSatellite_0InternalBehavior/GetEventUdsStatus, operation=EvtInfo_MCU_E_CLOCK_FAILURE.GetEventUdsStatus
        OpEventGetEventUdsStatus_GetEventUdsStatus_EvtInfo_MCU_E_CVM_SELFDIAG_FAILURE: start-on-event=DemSatellite_0InternalBehavior/GetEventUdsStatus, operation=EvtInfo_MCU_E_CVM_SELFDIAG_FAILURE.GetEventUdsStatus
        OpEventGetEventUdsStatus_GetEventUdsStatus_EvtInfo_MCU_E_ECM_SELFDIAG_FAILURE: start-on-event=DemSatellite_0InternalBehavior/GetEventUdsStatus, operation=EvtInfo_MCU_E_ECM_SELFDIAG_FAILURE.GetEventUdsStatus
        OpEventGetEventUdsStatus_GetEventUdsStatus_EvtInfo_MCU_E_LOCKSTEP_SELFDIAG_FAILURE: start-on-event=DemSatellite_0InternalBehavior/GetEventUdsStatus, operation=EvtInfo_MCU_E_LOCKSTEP_SELFDIAG_FAILURE.GetEventUdsStatus
        OpEventGetEventUdsStatus_GetEventUdsStatus_EvtInfo_MCU_E_WRITE_TIMEOUT_FAILURE: start-on-event=DemSatellite_0InternalBehavior/GetEventUdsStatus, operation=EvtInfo_MCU_E_WRITE_TIMEOUT_FAILURE.GetEventUdsStatus
        OpEventGetEventUdsStatus_GetEventUdsStatus_EvtInfo_MCU_E_REG_WRITE_VERIFY: start-on-event=DemSatellite_0InternalBehavior/GetEventUdsStatus, operation=EvtInfo_MCU_E_REG_WRITE_VERIFY.GetEventUdsStatus
        OpEventGetEventUdsStatus_GetEventUdsStatus_EvtInfo_MCU_E_INT_INCONSISTENT: start-on-event=DemSatellite_0InternalBehavior/GetEventUdsStatus, operation=EvtInfo_MCU_E_INT_INCONSISTENT.GetEventUdsStatus
        OpEventGetEventUdsStatus_GetEventUdsStatus_EvtInfo_MCU_E_RESETCONTROLLER_STARTUP_FAILURE: start-on-event=DemSatellite_0InternalBehavior/GetEventUdsStatus, operation=EvtInfo_MCU_E_RESETCONTROLLER_STARTUP_FAILURE.GetEventUdsStatus
        OpEventGetEventUdsStatus_GetEventUdsStatus_EvtInfo_DIO_E_REG_WRITE_VERIFY: start-on-event=DemSatellite_0InternalBehavior/GetEventUdsStatus, operation=EvtInfo_DIO_E_REG_WRITE_VERIFY.GetEventUdsStatus
        OpEventGetEventUdsStatus_GetEventUdsStatus_EvtInfo_FLS_E_COMPARE_FAILED: start-on-event=DemSatellite_0InternalBehavior/GetEventUdsStatus, operation=EvtInfo_FLS_E_COMPARE_FAILED.GetEventUdsStatus
        OpEventGetEventUdsStatus_GetEventUdsStatus_EvtInfo_FLS_E_ERASE_FAILED: start-on-event=DemSatellite_0InternalBehavior/GetEventUdsStatus, operation=EvtInfo_FLS_E_ERASE_FAILED.GetEventUdsStatus
        OpEventGetEventUdsStatus_GetEventUdsStatus_EvtInfo_FLS_E_READ_FAILED: start-on-event=DemSatellite_0InternalBehavior/GetEventUdsStatus, operation=EvtInfo_FLS_E_READ_FAILED.GetEventUdsStatus
        OpEventGetEventUdsStatus_GetEventUdsStatus_EvtInfo_FLS_E_INT_INCONSISTENT: start-on-event=DemSatellite_0InternalBehavior/GetEventUdsStatus, operation=EvtInfo_FLS_E_INT_INCONSISTENT.GetEventUdsStatus
        OpEventGetEventUdsStatus_GetEventUdsStatus_EvtInfo_FLS_E_REG_WRITE_VERIFY: start-on-event=DemSatellite_0InternalBehavior/GetEventUdsStatus, operation=EvtInfo_FLS_E_REG_WRITE_VERIFY.GetEventUdsStatus
        OpEventGetEventUdsStatus_GetEventUdsStatus_EvtInfo_FLS_E_READ_FAILED_DED: start-on-event=DemSatellite_0InternalBehavior/GetEventUdsStatus, operation=EvtInfo_FLS_E_READ_FAILED_DED.GetEventUdsStatus
        OpEventGetEventUdsStatus_GetEventUdsStatus_EvtInfo_FLS_E_HW_FAILURE: start-on-event=DemSatellite_0InternalBehavior/GetEventUdsStatus, operation=EvtInfo_FLS_E_HW_FAILURE.GetEventUdsStatus
        OpEventGetEventUdsStatus_GetEventUdsStatus_EvtInfo_FLS_E_ECC_FAILED: start-on-event=DemSatellite_0InternalBehavior/GetEventUdsStatus, operation=EvtInfo_FLS_E_ECC_FAILED.GetEventUdsStatus
        OpEventGetEventUdsStatus_GetEventUdsStatus_EvtInfo_FLS_E_UNEXPECTED_FLASH_ID: start-on-event=DemSatellite_0InternalBehavior/GetEventUdsStatus, operation=EvtInfo_FLS_E_UNEXPECTED_FLASH_ID.GetEventUdsStatus
        OpEventGetEventUdsStatus_GetEventUdsStatus_EvtInfo_FLS_E_WRITE_FAILED: start-on-event=DemSatellite_0InternalBehavior/GetEventUdsStatus, operation=EvtInfo_FLS_E_WRITE_FAILED.GetEventUdsStatus
        OpEventGetEventUdsStatus_GetEventUdsStatus_EvtInfo_SPI_E_DATA_TX_TIMEOUT_FAILURE: start-on-event=DemSatellite_0InternalBehavior/GetEventUdsStatus, operation=EvtInfo_SPI_E_DATA_TX_TIMEOUT_FAILURE.GetEventUdsStatus
        OpEventGetEventUdsStatus_GetEventUdsStatus_EvtInfo_SPI_E_ECC_SELFTEST_FAILURE: start-on-event=DemSatellite_0InternalBehavior/GetEventUdsStatus, operation=EvtInfo_SPI_E_ECC_SELFTEST_FAILURE.GetEventUdsStatus
        OpEventGetEventUdsStatus_GetEventUdsStatus_EvtInfo_SPI_E_HARDWARE_ERROR: start-on-event=DemSatellite_0InternalBehavior/GetEventUdsStatus, operation=EvtInfo_SPI_E_HARDWARE_ERROR.GetEventUdsStatus
        OpEventGetEventUdsStatus_GetEventUdsStatus_EvtInfo_SPI_E_INT_INCONSISTENT: start-on-event=DemSatellite_0InternalBehavior/GetEventUdsStatus, operation=EvtInfo_SPI_E_INT_INCONSISTENT.GetEventUdsStatus
        OpEventGetEventUdsStatus_GetEventUdsStatus_EvtInfo_SPI_E_LOOPBACK_SELFTEST_FAILURE: start-on-event=DemSatellite_0InternalBehavior/GetEventUdsStatus, operation=EvtInfo_SPI_E_LOOPBACK_SELFTEST_FAILURE.GetEventUdsStatus
        OpEventGetEventUdsStatus_GetEventUdsStatus_EvtInfo_SPI_E_REG_WRITE_VERIFY: start-on-event=DemSatellite_0InternalBehavior/GetEventUdsStatus, operation=EvtInfo_SPI_E_REG_WRITE_VERIFY.GetEventUdsStatus
        OpEventGetEventUdsStatus_GetEventUdsStatus_EvtInfo_WDGM_E_IMPROPER_CALLER: start-on-event=DemSatellite_0InternalBehavior/GetEventUdsStatus, operation=EvtInfo_WDGM_E_IMPROPER_CALLER.GetEventUdsStatus
        OpEventGetEventUdsStatus_GetEventUdsStatus_EvtInfo_WDGM_E_MONITORING: start-on-event=DemSatellite_0InternalBehavior/GetEventUdsStatus, operation=EvtInfo_WDGM_E_MONITORING.GetEventUdsStatus
        OpEventGetEventUdsStatus_GetEventUdsStatus_EvtInfo_WDGM_E_SET_MODE: start-on-event=DemSatellite_0InternalBehavior/GetEventUdsStatus, operation=EvtInfo_WDGM_E_SET_MODE.GetEventUdsStatus
        OpEventGetEventUdsStatus_GetEventUdsStatus_EvtInfo_WDG_E_DISABLE_REJECTED: start-on-event=DemSatellite_0InternalBehavior/GetEventUdsStatus, operation=EvtInfo_WDG_E_DISABLE_REJECTED.GetEventUdsStatus
        OpEventGetEventUdsStatus_GetEventUdsStatus_EvtInfo_WDG_E_INT_INCONSISTENT: start-on-event=DemSatellite_0InternalBehavior/GetEventUdsStatus, operation=EvtInfo_WDG_E_INT_INCONSISTENT.GetEventUdsStatus
        OpEventGetEventUdsStatus_GetEventUdsStatus_EvtInfo_WDG_E_MODE_FAILED: start-on-event=DemSatellite_0InternalBehavior/GetEventUdsStatus, operation=EvtInfo_WDG_E_MODE_FAILED.GetEventUdsStatus
        OpEventGetEventUdsStatus_GetEventUdsStatus_EvtInfo_WDG_E_REG_WRITE_VERIFY: start-on-event=DemSatellite_0InternalBehavior/GetEventUdsStatus, operation=EvtInfo_WDG_E_REG_WRITE_VERIFY.GetEventUdsStatus
        OpEventGetEventUdsStatus_GetEventUdsStatus_EvtInfo_PORT_E_WRITE_TIMEOUT_FAILURE: start-on-event=DemSatellite_0InternalBehavior/GetEventUdsStatus, operation=EvtInfo_PORT_E_WRITE_TIMEOUT_FAILURE.GetEventUdsStatus
        OpEventGetEventUdsStatus_GetEventUdsStatus_EvtInfo_PORT_E_REG_WRITE_VERIFY: start-on-event=DemSatellite_0InternalBehavior/GetEventUdsStatus, operation=EvtInfo_PORT_E_REG_WRITE_VERIFY.GetEventUdsStatus
        OpEventGetEventUdsStatus_GetEventUdsStatus_EvtInfo_CodingEventNotCoded: start-on-event=DemSatellite_0InternalBehavior/GetEventUdsStatus, operation=EvtInfo_CodingEventNotCoded.GetEventUdsStatus
        OpEventGetEventUdsStatus_GetEventUdsStatus_Event_CodingEventNotCoded: start-on-event=DemSatellite_0InternalBehavior/GetEventUdsStatus, operation=Event_CodingEventNotCoded.GetEventUdsStatus
        OpEventGetEventUdsStatus_GetEventUdsStatus_EvtInfo_CodingEventUnqualifiedData: start-on-event=DemSatellite_0InternalBehavior/GetEventUdsStatus, operation=EvtInfo_CodingEventUnqualifiedData.GetEventUdsStatus
        OpEventGetEventUdsStatus_GetEventUdsStatus_Event_CodingEventUnqualifiedData: start-on-event=DemSatellite_0InternalBehavior/GetEventUdsStatus, operation=Event_CodingEventUnqualifiedData.GetEventUdsStatus
        OpEventGetEventUdsStatus_GetEventUdsStatus_EvtInfo_CodingEventWrongVehicle: start-on-event=DemSatellite_0InternalBehavior/GetEventUdsStatus, operation=EvtInfo_CodingEventWrongVehicle.GetEventUdsStatus
        OpEventGetEventUdsStatus_GetEventUdsStatus_Event_CodingEventWrongVehicle: start-on-event=DemSatellite_0InternalBehavior/GetEventUdsStatus, operation=Event_CodingEventWrongVehicle.GetEventUdsStatus
        OpEventGetEventUdsStatus_GetEventUdsStatus_EvtInfo_DmTestAppl: start-on-event=DemSatellite_0InternalBehavior/GetEventUdsStatus, operation=EvtInfo_DmTestAppl.GetEventUdsStatus
        OpEventGetEventUdsStatus_GetEventUdsStatus_Event_DmTestAppl: start-on-event=DemSatellite_0InternalBehavior/GetEventUdsStatus, operation=Event_DmTestAppl.GetEventUdsStatus
        OpEventGetEventUdsStatus_GetEventUdsStatus_EvtInfo_DmTestCom: start-on-event=DemSatellite_0InternalBehavior/GetEventUdsStatus, operation=EvtInfo_DmTestCom.GetEventUdsStatus
        OpEventGetEventUdsStatus_GetEventUdsStatus_Event_DmTestCom: start-on-event=DemSatellite_0InternalBehavior/GetEventUdsStatus, operation=Event_DmTestCom.GetEventUdsStatus
        OpEventGetEventUdsStatus_GetEventUdsStatus_EvtInfo_FrsmEClusterSyncLoss: start-on-event=DemSatellite_0InternalBehavior/GetEventUdsStatus, operation=EvtInfo_FrsmEClusterSyncLoss.GetEventUdsStatus
        OpEventGetEventUdsStatus_GetEventUdsStatus_Event_FrsmEClusterSyncLoss: start-on-event=DemSatellite_0InternalBehavior/GetEventUdsStatus, operation=Event_FrsmEClusterSyncLoss.GetEventUdsStatus
        OpEventGetEventUdsStatus_GetEventUdsStatus_EvtInfo_FrtrcvEFrBuserrorTrcv0: start-on-event=DemSatellite_0InternalBehavior/GetEventUdsStatus, operation=EvtInfo_FrtrcvEFrBuserrorTrcv0.GetEventUdsStatus
        OpEventGetEventUdsStatus_GetEventUdsStatus_Event_FrtrcvEFrBuserrorTrcv0: start-on-event=DemSatellite_0InternalBehavior/GetEventUdsStatus, operation=Event_FrtrcvEFrBuserrorTrcv0.GetEventUdsStatus
        OpEventGetEventUdsStatus_GetEventUdsStatus_EvtInfo_GlobalOvervoltageExt: start-on-event=DemSatellite_0InternalBehavior/GetEventUdsStatus, operation=EvtInfo_GlobalOvervoltageExt.GetEventUdsStatus
        OpEventGetEventUdsStatus_GetEventUdsStatus_Event_GlobalOvervoltageExt: start-on-event=DemSatellite_0InternalBehavior/GetEventUdsStatus, operation=Event_GlobalOvervoltageExt.GetEventUdsStatus
        OpEventGetEventUdsStatus_GetEventUdsStatus_EvtInfo_GlobalOvervoltageInt: start-on-event=DemSatellite_0InternalBehavior/GetEventUdsStatus, operation=EvtInfo_GlobalOvervoltageInt.GetEventUdsStatus
        OpEventGetEventUdsStatus_GetEventUdsStatus_Event_GlobalOvervoltageInt: start-on-event=DemSatellite_0InternalBehavior/GetEventUdsStatus, operation=Event_GlobalOvervoltageInt.GetEventUdsStatus
        OpEventGetEventUdsStatus_GetEventUdsStatus_EvtInfo_GlobalUndervoltageExt: start-on-event=DemSatellite_0InternalBehavior/GetEventUdsStatus, operation=EvtInfo_GlobalUndervoltageExt.GetEventUdsStatus
        OpEventGetEventUdsStatus_GetEventUdsStatus_Event_GlobalUndervoltageExt: start-on-event=DemSatellite_0InternalBehavior/GetEventUdsStatus, operation=Event_GlobalUndervoltageExt.GetEventUdsStatus
        OpEventGetEventUdsStatus_GetEventUdsStatus_EvtInfo_GlobalUndervoltageInt: start-on-event=DemSatellite_0InternalBehavior/GetEventUdsStatus, operation=EvtInfo_GlobalUndervoltageInt.GetEventUdsStatus
        OpEventGetEventUdsStatus_GetEventUdsStatus_Event_GlobalUndervoltageInt: start-on-event=DemSatellite_0InternalBehavior/GetEventUdsStatus, operation=Event_GlobalUndervoltageInt.GetEventUdsStatus
        OpEventGetEventUdsStatus_GetEventUdsStatus_EvtInfo_LocalOvervoltage: start-on-event=DemSatellite_0InternalBehavior/GetEventUdsStatus, operation=EvtInfo_LocalOvervoltage.GetEventUdsStatus
        OpEventGetEventUdsStatus_GetEventUdsStatus_Event_LocalOvervoltage: start-on-event=DemSatellite_0InternalBehavior/GetEventUdsStatus, operation=Event_LocalOvervoltage.GetEventUdsStatus
        OpEventGetEventUdsStatus_GetEventUdsStatus_EvtInfo_LocalUndervoltage: start-on-event=DemSatellite_0InternalBehavior/GetEventUdsStatus, operation=EvtInfo_LocalUndervoltage.GetEventUdsStatus
        OpEventGetEventUdsStatus_GetEventUdsStatus_Event_LocalUndervoltage: start-on-event=DemSatellite_0InternalBehavior/GetEventUdsStatus, operation=Event_LocalUndervoltage.GetEventUdsStatus
        OpEventGetEventUdsStatus_GetEventUdsStatus_EvtInfo_VsmEventOpmode: start-on-event=DemSatellite_0InternalBehavior/GetEventUdsStatus, operation=EvtInfo_VsmEventOpmode.GetEventUdsStatus
        OpEventGetEventUdsStatus_GetEventUdsStatus_Event_VsmEventOpmode: start-on-event=DemSatellite_0InternalBehavior/GetEventUdsStatus, operation=Event_VsmEventOpmode.GetEventUdsStatus
        OpEventGetEventUdsStatus_GetEventUdsStatus_GeneralEventInfo: start-on-event=DemSatellite_0InternalBehavior/GetEventUdsStatus, operation=GeneralEventInfo.GetEventUdsStatus
        OpEventGetEventStatus_GetEventStatus_EvtInfo_MCU_E_CLM_SELFDIAG_FAILURE: start-on-event=DemSatellite_0InternalBehavior/GetEventStatus, operation=EvtInfo_MCU_E_CLM_SELFDIAG_FAILURE.GetEventStatus
        OpEventGetEventStatus_GetEventStatus_EvtInfo_MCU_E_CLOCK_FAILURE: start-on-event=DemSatellite_0InternalBehavior/GetEventStatus, operation=EvtInfo_MCU_E_CLOCK_FAILURE.GetEventStatus
        OpEventGetEventStatus_GetEventStatus_EvtInfo_MCU_E_CVM_SELFDIAG_FAILURE: start-on-event=DemSatellite_0InternalBehavior/GetEventStatus, operation=EvtInfo_MCU_E_CVM_SELFDIAG_FAILURE.GetEventStatus
        OpEventGetEventStatus_GetEventStatus_EvtInfo_MCU_E_ECM_SELFDIAG_FAILURE: start-on-event=DemSatellite_0InternalBehavior/GetEventStatus, operation=EvtInfo_MCU_E_ECM_SELFDIAG_FAILURE.GetEventStatus
        OpEventGetEventStatus_GetEventStatus_EvtInfo_MCU_E_LOCKSTEP_SELFDIAG_FAILURE: start-on-event=DemSatellite_0InternalBehavior/GetEventStatus, operation=EvtInfo_MCU_E_LOCKSTEP_SELFDIAG_FAILURE.GetEventStatus
        OpEventGetEventStatus_GetEventStatus_EvtInfo_MCU_E_WRITE_TIMEOUT_FAILURE: start-on-event=DemSatellite_0InternalBehavior/GetEventStatus, operation=EvtInfo_MCU_E_WRITE_TIMEOUT_FAILURE.GetEventStatus
        OpEventGetEventStatus_GetEventStatus_EvtInfo_MCU_E_REG_WRITE_VERIFY: start-on-event=DemSatellite_0InternalBehavior/GetEventStatus, operation=EvtInfo_MCU_E_REG_WRITE_VERIFY.GetEventStatus
        OpEventGetEventStatus_GetEventStatus_EvtInfo_MCU_E_INT_INCONSISTENT: start-on-event=DemSatellite_0InternalBehavior/GetEventStatus, operation=EvtInfo_MCU_E_INT_INCONSISTENT.GetEventStatus
        OpEventGetEventStatus_GetEventStatus_EvtInfo_MCU_E_RESETCONTROLLER_STARTUP_FAILURE: start-on-event=DemSatellite_0InternalBehavior/GetEventStatus, operation=EvtInfo_MCU_E_RESETCONTROLLER_STARTUP_FAILURE.GetEventStatus
        OpEventGetEventStatus_GetEventStatus_EvtInfo_DIO_E_REG_WRITE_VERIFY: start-on-event=DemSatellite_0InternalBehavior/GetEventStatus, operation=EvtInfo_DIO_E_REG_WRITE_VERIFY.GetEventStatus
        OpEventGetEventStatus_GetEventStatus_EvtInfo_FLS_E_COMPARE_FAILED: start-on-event=DemSatellite_0InternalBehavior/GetEventStatus, operation=EvtInfo_FLS_E_COMPARE_FAILED.GetEventStatus
        OpEventGetEventStatus_GetEventStatus_EvtInfo_FLS_E_ERASE_FAILED: start-on-event=DemSatellite_0InternalBehavior/GetEventStatus, operation=EvtInfo_FLS_E_ERASE_FAILED.GetEventStatus
        OpEventGetEventStatus_GetEventStatus_EvtInfo_FLS_E_READ_FAILED: start-on-event=DemSatellite_0InternalBehavior/GetEventStatus, operation=EvtInfo_FLS_E_READ_FAILED.GetEventStatus
        OpEventGetEventStatus_GetEventStatus_EvtInfo_FLS_E_INT_INCONSISTENT: start-on-event=DemSatellite_0InternalBehavior/GetEventStatus, operation=EvtInfo_FLS_E_INT_INCONSISTENT.GetEventStatus
        OpEventGetEventStatus_GetEventStatus_EvtInfo_FLS_E_REG_WRITE_VERIFY: start-on-event=DemSatellite_0InternalBehavior/GetEventStatus, operation=EvtInfo_FLS_E_REG_WRITE_VERIFY.GetEventStatus
        OpEventGetEventStatus_GetEventStatus_EvtInfo_FLS_E_READ_FAILED_DED: start-on-event=DemSatellite_0InternalBehavior/GetEventStatus, operation=EvtInfo_FLS_E_READ_FAILED_DED.GetEventStatus
        OpEventGetEventStatus_GetEventStatus_EvtInfo_FLS_E_HW_FAILURE: start-on-event=DemSatellite_0InternalBehavior/GetEventStatus, operation=EvtInfo_FLS_E_HW_FAILURE.GetEventStatus
        OpEventGetEventStatus_GetEventStatus_EvtInfo_FLS_E_ECC_FAILED: start-on-event=DemSatellite_0InternalBehavior/GetEventStatus, operation=EvtInfo_FLS_E_ECC_FAILED.GetEventStatus
        OpEventGetEventStatus_GetEventStatus_EvtInfo_FLS_E_UNEXPECTED_FLASH_ID: start-on-event=DemSatellite_0InternalBehavior/GetEventStatus, operation=EvtInfo_FLS_E_UNEXPECTED_FLASH_ID.GetEventStatus
        OpEventGetEventStatus_GetEventStatus_EvtInfo_FLS_E_WRITE_FAILED: start-on-event=DemSatellite_0InternalBehavior/GetEventStatus, operation=EvtInfo_FLS_E_WRITE_FAILED.GetEventStatus
        OpEventGetEventStatus_GetEventStatus_EvtInfo_SPI_E_DATA_TX_TIMEOUT_FAILURE: start-on-event=DemSatellite_0InternalBehavior/GetEventStatus, operation=EvtInfo_SPI_E_DATA_TX_TIMEOUT_FAILURE.GetEventStatus
        OpEventGetEventStatus_GetEventStatus_EvtInfo_SPI_E_ECC_SELFTEST_FAILURE: start-on-event=DemSatellite_0InternalBehavior/GetEventStatus, operation=EvtInfo_SPI_E_ECC_SELFTEST_FAILURE.GetEventStatus
        OpEventGetEventStatus_GetEventStatus_EvtInfo_SPI_E_HARDWARE_ERROR: start-on-event=DemSatellite_0InternalBehavior/GetEventStatus, operation=EvtInfo_SPI_E_HARDWARE_ERROR.GetEventStatus
        OpEventGetEventStatus_GetEventStatus_EvtInfo_SPI_E_INT_INCONSISTENT: start-on-event=DemSatellite_0InternalBehavior/GetEventStatus, operation=EvtInfo_SPI_E_INT_INCONSISTENT.GetEventStatus
        OpEventGetEventStatus_GetEventStatus_EvtInfo_SPI_E_LOOPBACK_SELFTEST_FAILURE: start-on-event=DemSatellite_0InternalBehavior/GetEventStatus, operation=EvtInfo_SPI_E_LOOPBACK_SELFTEST_FAILURE.GetEventStatus
        OpEventGetEventStatus_GetEventStatus_EvtInfo_SPI_E_REG_WRITE_VERIFY: start-on-event=DemSatellite_0InternalBehavior/GetEventStatus, operation=EvtInfo_SPI_E_REG_WRITE_VERIFY.GetEventStatus
        OpEventGetEventStatus_GetEventStatus_EvtInfo_WDGM_E_IMPROPER_CALLER: start-on-event=DemSatellite_0InternalBehavior/GetEventStatus, operation=EvtInfo_WDGM_E_IMPROPER_CALLER.GetEventStatus
        OpEventGetEventStatus_GetEventStatus_EvtInfo_WDGM_E_MONITORING: start-on-event=DemSatellite_0InternalBehavior/GetEventStatus, operation=EvtInfo_WDGM_E_MONITORING.GetEventStatus
        OpEventGetEventStatus_GetEventStatus_EvtInfo_WDGM_E_SET_MODE: start-on-event=DemSatellite_0InternalBehavior/GetEventStatus, operation=EvtInfo_WDGM_E_SET_MODE.GetEventStatus
        OpEventGetEventStatus_GetEventStatus_EvtInfo_WDG_E_DISABLE_REJECTED: start-on-event=DemSatellite_0InternalBehavior/GetEventStatus, operation=EvtInfo_WDG_E_DISABLE_REJECTED.GetEventStatus
        OpEventGetEventStatus_GetEventStatus_EvtInfo_WDG_E_INT_INCONSISTENT: start-on-event=DemSatellite_0InternalBehavior/GetEventStatus, operation=EvtInfo_WDG_E_INT_INCONSISTENT.GetEventStatus
        OpEventGetEventStatus_GetEventStatus_EvtInfo_WDG_E_MODE_FAILED: start-on-event=DemSatellite_0InternalBehavior/GetEventStatus, operation=EvtInfo_WDG_E_MODE_FAILED.GetEventStatus
        OpEventGetEventStatus_GetEventStatus_EvtInfo_WDG_E_REG_WRITE_VERIFY: start-on-event=DemSatellite_0InternalBehavior/GetEventStatus, operation=EvtInfo_WDG_E_REG_WRITE_VERIFY.GetEventStatus
        OpEventGetEventStatus_GetEventStatus_EvtInfo_PORT_E_WRITE_TIMEOUT_FAILURE: start-on-event=DemSatellite_0InternalBehavior/GetEventStatus, operation=EvtInfo_PORT_E_WRITE_TIMEOUT_FAILURE.GetEventStatus
        OpEventGetEventStatus_GetEventStatus_EvtInfo_PORT_E_REG_WRITE_VERIFY: start-on-event=DemSatellite_0InternalBehavior/GetEventStatus, operation=EvtInfo_PORT_E_REG_WRITE_VERIFY.GetEventStatus
        OpEventGetEventStatus_GetEventStatus_EvtInfo_CodingEventNotCoded: start-on-event=DemSatellite_0InternalBehavior/GetEventStatus, operation=EvtInfo_CodingEventNotCoded.GetEventStatus
        OpEventGetEventStatus_GetEventStatus_Event_CodingEventNotCoded: start-on-event=DemSatellite_0InternalBehavior/GetEventStatus, operation=Event_CodingEventNotCoded.GetEventStatus
        OpEventGetEventStatus_GetEventStatus_EvtInfo_CodingEventUnqualifiedData: start-on-event=DemSatellite_0InternalBehavior/GetEventStatus, operation=EvtInfo_CodingEventUnqualifiedData.GetEventStatus
        OpEventGetEventStatus_GetEventStatus_Event_CodingEventUnqualifiedData: start-on-event=DemSatellite_0InternalBehavior/GetEventStatus, operation=Event_CodingEventUnqualifiedData.GetEventStatus
        OpEventGetEventStatus_GetEventStatus_EvtInfo_CodingEventWrongVehicle: start-on-event=DemSatellite_0InternalBehavior/GetEventStatus, operation=EvtInfo_CodingEventWrongVehicle.GetEventStatus
        OpEventGetEventStatus_GetEventStatus_Event_CodingEventWrongVehicle: start-on-event=DemSatellite_0InternalBehavior/GetEventStatus, operation=Event_CodingEventWrongVehicle.GetEventStatus
        OpEventGetEventStatus_GetEventStatus_EvtInfo_DmTestAppl: start-on-event=DemSatellite_0InternalBehavior/GetEventStatus, operation=EvtInfo_DmTestAppl.GetEventStatus
        OpEventGetEventStatus_GetEventStatus_Event_DmTestAppl: start-on-event=DemSatellite_0InternalBehavior/GetEventStatus, operation=Event_DmTestAppl.GetEventStatus
        OpEventGetEventStatus_GetEventStatus_EvtInfo_DmTestCom: start-on-event=DemSatellite_0InternalBehavior/GetEventStatus, operation=EvtInfo_DmTestCom.GetEventStatus
        OpEventGetEventStatus_GetEventStatus_Event_DmTestCom: start-on-event=DemSatellite_0InternalBehavior/GetEventStatus, operation=Event_DmTestCom.GetEventStatus
        OpEventGetEventStatus_GetEventStatus_EvtInfo_FrsmEClusterSyncLoss: start-on-event=DemSatellite_0InternalBehavior/GetEventStatus, operation=EvtInfo_FrsmEClusterSyncLoss.GetEventStatus
        OpEventGetEventStatus_GetEventStatus_Event_FrsmEClusterSyncLoss: start-on-event=DemSatellite_0InternalBehavior/GetEventStatus, operation=Event_FrsmEClusterSyncLoss.GetEventStatus
        OpEventGetEventStatus_GetEventStatus_EvtInfo_FrtrcvEFrBuserrorTrcv0: start-on-event=DemSatellite_0InternalBehavior/GetEventStatus, operation=EvtInfo_FrtrcvEFrBuserrorTrcv0.GetEventStatus
        OpEventGetEventStatus_GetEventStatus_Event_FrtrcvEFrBuserrorTrcv0: start-on-event=DemSatellite_0InternalBehavior/GetEventStatus, operation=Event_FrtrcvEFrBuserrorTrcv0.GetEventStatus
        OpEventGetEventStatus_GetEventStatus_EvtInfo_GlobalOvervoltageExt: start-on-event=DemSatellite_0InternalBehavior/GetEventStatus, operation=EvtInfo_GlobalOvervoltageExt.GetEventStatus
        OpEventGetEventStatus_GetEventStatus_Event_GlobalOvervoltageExt: start-on-event=DemSatellite_0InternalBehavior/GetEventStatus, operation=Event_GlobalOvervoltageExt.GetEventStatus
        OpEventGetEventStatus_GetEventStatus_EvtInfo_GlobalOvervoltageInt: start-on-event=DemSatellite_0InternalBehavior/GetEventStatus, operation=EvtInfo_GlobalOvervoltageInt.GetEventStatus
        OpEventGetEventStatus_GetEventStatus_Event_GlobalOvervoltageInt: start-on-event=DemSatellite_0InternalBehavior/GetEventStatus, operation=Event_GlobalOvervoltageInt.GetEventStatus
        OpEventGetEventStatus_GetEventStatus_EvtInfo_GlobalUndervoltageExt: start-on-event=DemSatellite_0InternalBehavior/GetEventStatus, operation=EvtInfo_GlobalUndervoltageExt.GetEventStatus
        OpEventGetEventStatus_GetEventStatus_Event_GlobalUndervoltageExt: start-on-event=DemSatellite_0InternalBehavior/GetEventStatus, operation=Event_GlobalUndervoltageExt.GetEventStatus
        OpEventGetEventStatus_GetEventStatus_EvtInfo_GlobalUndervoltageInt: start-on-event=DemSatellite_0InternalBehavior/GetEventStatus, operation=EvtInfo_GlobalUndervoltageInt.GetEventStatus
        OpEventGetEventStatus_GetEventStatus_Event_GlobalUndervoltageInt: start-on-event=DemSatellite_0InternalBehavior/GetEventStatus, operation=Event_GlobalUndervoltageInt.GetEventStatus
        OpEventGetEventStatus_GetEventStatus_EvtInfo_LocalOvervoltage: start-on-event=DemSatellite_0InternalBehavior/GetEventStatus, operation=EvtInfo_LocalOvervoltage.GetEventStatus
        OpEventGetEventStatus_GetEventStatus_Event_LocalOvervoltage: start-on-event=DemSatellite_0InternalBehavior/GetEventStatus, operation=Event_LocalOvervoltage.GetEventStatus
        OpEventGetEventStatus_GetEventStatus_EvtInfo_LocalUndervoltage: start-on-event=DemSatellite_0InternalBehavior/GetEventStatus, operation=EvtInfo_LocalUndervoltage.GetEventStatus
        OpEventGetEventStatus_GetEventStatus_Event_LocalUndervoltage: start-on-event=DemSatellite_0InternalBehavior/GetEventStatus, operation=Event_LocalUndervoltage.GetEventStatus
        OpEventGetEventStatus_GetEventStatus_EvtInfo_VsmEventOpmode: start-on-event=DemSatellite_0InternalBehavior/GetEventStatus, operation=EvtInfo_VsmEventOpmode.GetEventStatus
        OpEventGetEventStatus_GetEventStatus_Event_VsmEventOpmode: start-on-event=DemSatellite_0InternalBehavior/GetEventStatus, operation=Event_VsmEventOpmode.GetEventStatus
        OpEventGetEventStatus_GetEventStatus_GeneralEventInfo: start-on-event=DemSatellite_0InternalBehavior/GetEventStatus, operation=GeneralEventInfo.GetEventStatus
        OpEventGetEventFailed_GetEventFailed_EvtInfo_MCU_E_CLM_SELFDIAG_FAILURE: start-on-event=DemSatellite_0InternalBehavior/GetEventFailed, operation=EvtInfo_MCU_E_CLM_SELFDIAG_FAILURE.GetEventFailed
        OpEventGetEventFailed_GetEventFailed_EvtInfo_MCU_E_CLOCK_FAILURE: start-on-event=DemSatellite_0InternalBehavior/GetEventFailed, operation=EvtInfo_MCU_E_CLOCK_FAILURE.GetEventFailed
        OpEventGetEventFailed_GetEventFailed_EvtInfo_MCU_E_CVM_SELFDIAG_FAILURE: start-on-event=DemSatellite_0InternalBehavior/GetEventFailed, operation=EvtInfo_MCU_E_CVM_SELFDIAG_FAILURE.GetEventFailed
        OpEventGetEventFailed_GetEventFailed_EvtInfo_MCU_E_ECM_SELFDIAG_FAILURE: start-on-event=DemSatellite_0InternalBehavior/GetEventFailed, operation=EvtInfo_MCU_E_ECM_SELFDIAG_FAILURE.GetEventFailed
        OpEventGetEventFailed_GetEventFailed_EvtInfo_MCU_E_LOCKSTEP_SELFDIAG_FAILURE: start-on-event=DemSatellite_0InternalBehavior/GetEventFailed, operation=EvtInfo_MCU_E_LOCKSTEP_SELFDIAG_FAILURE.GetEventFailed
        OpEventGetEventFailed_GetEventFailed_EvtInfo_MCU_E_WRITE_TIMEOUT_FAILURE: start-on-event=DemSatellite_0InternalBehavior/GetEventFailed, operation=EvtInfo_MCU_E_WRITE_TIMEOUT_FAILURE.GetEventFailed
        OpEventGetEventFailed_GetEventFailed_EvtInfo_MCU_E_REG_WRITE_VERIFY: start-on-event=DemSatellite_0InternalBehavior/GetEventFailed, operation=EvtInfo_MCU_E_REG_WRITE_VERIFY.GetEventFailed
        OpEventGetEventFailed_GetEventFailed_EvtInfo_MCU_E_INT_INCONSISTENT: start-on-event=DemSatellite_0InternalBehavior/GetEventFailed, operation=EvtInfo_MCU_E_INT_INCONSISTENT.GetEventFailed
        OpEventGetEventFailed_GetEventFailed_EvtInfo_MCU_E_RESETCONTROLLER_STARTUP_FAILURE: start-on-event=DemSatellite_0InternalBehavior/GetEventFailed, operation=EvtInfo_MCU_E_RESETCONTROLLER_STARTUP_FAILURE.GetEventFailed
        OpEventGetEventFailed_GetEventFailed_EvtInfo_DIO_E_REG_WRITE_VERIFY: start-on-event=DemSatellite_0InternalBehavior/GetEventFailed, operation=EvtInfo_DIO_E_REG_WRITE_VERIFY.GetEventFailed
        OpEventGetEventFailed_GetEventFailed_EvtInfo_FLS_E_COMPARE_FAILED: start-on-event=DemSatellite_0InternalBehavior/GetEventFailed, operation=EvtInfo_FLS_E_COMPARE_FAILED.GetEventFailed
        OpEventGetEventFailed_GetEventFailed_EvtInfo_FLS_E_ERASE_FAILED: start-on-event=DemSatellite_0InternalBehavior/GetEventFailed, operation=EvtInfo_FLS_E_ERASE_FAILED.GetEventFailed
        OpEventGetEventFailed_GetEventFailed_EvtInfo_FLS_E_READ_FAILED: start-on-event=DemSatellite_0InternalBehavior/GetEventFailed, operation=EvtInfo_FLS_E_READ_FAILED.GetEventFailed
        OpEventGetEventFailed_GetEventFailed_EvtInfo_FLS_E_INT_INCONSISTENT: start-on-event=DemSatellite_0InternalBehavior/GetEventFailed, operation=EvtInfo_FLS_E_INT_INCONSISTENT.GetEventFailed
        OpEventGetEventFailed_GetEventFailed_EvtInfo_FLS_E_REG_WRITE_VERIFY: start-on-event=DemSatellite_0InternalBehavior/GetEventFailed, operation=EvtInfo_FLS_E_REG_WRITE_VERIFY.GetEventFailed
        OpEventGetEventFailed_GetEventFailed_EvtInfo_FLS_E_READ_FAILED_DED: start-on-event=DemSatellite_0InternalBehavior/GetEventFailed, operation=EvtInfo_FLS_E_READ_FAILED_DED.GetEventFailed
        OpEventGetEventFailed_GetEventFailed_EvtInfo_FLS_E_HW_FAILURE: start-on-event=DemSatellite_0InternalBehavior/GetEventFailed, operation=EvtInfo_FLS_E_HW_FAILURE.GetEventFailed
        OpEventGetEventFailed_GetEventFailed_EvtInfo_FLS_E_ECC_FAILED: start-on-event=DemSatellite_0InternalBehavior/GetEventFailed, operation=EvtInfo_FLS_E_ECC_FAILED.GetEventFailed
        OpEventGetEventFailed_GetEventFailed_EvtInfo_FLS_E_UNEXPECTED_FLASH_ID: start-on-event=DemSatellite_0InternalBehavior/GetEventFailed, operation=EvtInfo_FLS_E_UNEXPECTED_FLASH_ID.GetEventFailed
        OpEventGetEventFailed_GetEventFailed_EvtInfo_FLS_E_WRITE_FAILED: start-on-event=DemSatellite_0InternalBehavior/GetEventFailed, operation=EvtInfo_FLS_E_WRITE_FAILED.GetEventFailed
        OpEventGetEventFailed_GetEventFailed_EvtInfo_SPI_E_DATA_TX_TIMEOUT_FAILURE: start-on-event=DemSatellite_0InternalBehavior/GetEventFailed, operation=EvtInfo_SPI_E_DATA_TX_TIMEOUT_FAILURE.GetEventFailed
        OpEventGetEventFailed_GetEventFailed_EvtInfo_SPI_E_ECC_SELFTEST_FAILURE: start-on-event=DemSatellite_0InternalBehavior/GetEventFailed, operation=EvtInfo_SPI_E_ECC_SELFTEST_FAILURE.GetEventFailed
        OpEventGetEventFailed_GetEventFailed_EvtInfo_SPI_E_HARDWARE_ERROR: start-on-event=DemSatellite_0InternalBehavior/GetEventFailed, operation=EvtInfo_SPI_E_HARDWARE_ERROR.GetEventFailed
        OpEventGetEventFailed_GetEventFailed_EvtInfo_SPI_E_INT_INCONSISTENT: start-on-event=DemSatellite_0InternalBehavior/GetEventFailed, operation=EvtInfo_SPI_E_INT_INCONSISTENT.GetEventFailed
        OpEventGetEventFailed_GetEventFailed_EvtInfo_SPI_E_LOOPBACK_SELFTEST_FAILURE: start-on-event=DemSatellite_0InternalBehavior/GetEventFailed, operation=EvtInfo_SPI_E_LOOPBACK_SELFTEST_FAILURE.GetEventFailed
        OpEventGetEventFailed_GetEventFailed_EvtInfo_SPI_E_REG_WRITE_VERIFY: start-on-event=DemSatellite_0InternalBehavior/GetEventFailed, operation=EvtInfo_SPI_E_REG_WRITE_VERIFY.GetEventFailed
        OpEventGetEventFailed_GetEventFailed_EvtInfo_WDGM_E_IMPROPER_CALLER: start-on-event=DemSatellite_0InternalBehavior/GetEventFailed, operation=EvtInfo_WDGM_E_IMPROPER_CALLER.GetEventFailed
        OpEventGetEventFailed_GetEventFailed_EvtInfo_WDGM_E_MONITORING: start-on-event=DemSatellite_0InternalBehavior/GetEventFailed, operation=EvtInfo_WDGM_E_MONITORING.GetEventFailed
        OpEventGetEventFailed_GetEventFailed_EvtInfo_WDGM_E_SET_MODE: start-on-event=DemSatellite_0InternalBehavior/GetEventFailed, operation=EvtInfo_WDGM_E_SET_MODE.GetEventFailed
        OpEventGetEventFailed_GetEventFailed_EvtInfo_WDG_E_DISABLE_REJECTED: start-on-event=DemSatellite_0InternalBehavior/GetEventFailed, operation=EvtInfo_WDG_E_DISABLE_REJECTED.GetEventFailed
        OpEventGetEventFailed_GetEventFailed_EvtInfo_WDG_E_INT_INCONSISTENT: start-on-event=DemSatellite_0InternalBehavior/GetEventFailed, operation=EvtInfo_WDG_E_INT_INCONSISTENT.GetEventFailed
        OpEventGetEventFailed_GetEventFailed_EvtInfo_WDG_E_MODE_FAILED: start-on-event=DemSatellite_0InternalBehavior/GetEventFailed, operation=EvtInfo_WDG_E_MODE_FAILED.GetEventFailed
        OpEventGetEventFailed_GetEventFailed_EvtInfo_WDG_E_REG_WRITE_VERIFY: start-on-event=DemSatellite_0InternalBehavior/GetEventFailed, operation=EvtInfo_WDG_E_REG_WRITE_VERIFY.GetEventFailed
        OpEventGetEventFailed_GetEventFailed_EvtInfo_PORT_E_WRITE_TIMEOUT_FAILURE: start-on-event=DemSatellite_0InternalBehavior/GetEventFailed, operation=EvtInfo_PORT_E_WRITE_TIMEOUT_FAILURE.GetEventFailed
        OpEventGetEventFailed_GetEventFailed_EvtInfo_PORT_E_REG_WRITE_VERIFY: start-on-event=DemSatellite_0InternalBehavior/GetEventFailed, operation=EvtInfo_PORT_E_REG_WRITE_VERIFY.GetEventFailed
        OpEventGetEventFailed_GetEventFailed_EvtInfo_CodingEventNotCoded: start-on-event=DemSatellite_0InternalBehavior/GetEventFailed, operation=EvtInfo_CodingEventNotCoded.GetEventFailed
        OpEventGetEventFailed_GetEventFailed_Event_CodingEventNotCoded: start-on-event=DemSatellite_0InternalBehavior/GetEventFailed, operation=Event_CodingEventNotCoded.GetEventFailed
        OpEventGetEventFailed_GetEventFailed_EvtInfo_CodingEventUnqualifiedData: start-on-event=DemSatellite_0InternalBehavior/GetEventFailed, operation=EvtInfo_CodingEventUnqualifiedData.GetEventFailed
        OpEventGetEventFailed_GetEventFailed_Event_CodingEventUnqualifiedData: start-on-event=DemSatellite_0InternalBehavior/GetEventFailed, operation=Event_CodingEventUnqualifiedData.GetEventFailed
        OpEventGetEventFailed_GetEventFailed_EvtInfo_CodingEventWrongVehicle: start-on-event=DemSatellite_0InternalBehavior/GetEventFailed, operation=EvtInfo_CodingEventWrongVehicle.GetEventFailed
        OpEventGetEventFailed_GetEventFailed_Event_CodingEventWrongVehicle: start-on-event=DemSatellite_0InternalBehavior/GetEventFailed, operation=Event_CodingEventWrongVehicle.GetEventFailed
        OpEventGetEventFailed_GetEventFailed_EvtInfo_DmTestAppl: start-on-event=DemSatellite_0InternalBehavior/GetEventFailed, operation=EvtInfo_DmTestAppl.GetEventFailed
        OpEventGetEventFailed_GetEventFailed_Event_DmTestAppl: start-on-event=DemSatellite_0InternalBehavior/GetEventFailed, operation=Event_DmTestAppl.GetEventFailed
        OpEventGetEventFailed_GetEventFailed_EvtInfo_DmTestCom: start-on-event=DemSatellite_0InternalBehavior/GetEventFailed, operation=EvtInfo_DmTestCom.GetEventFailed
        OpEventGetEventFailed_GetEventFailed_Event_DmTestCom: start-on-event=DemSatellite_0InternalBehavior/GetEventFailed, operation=Event_DmTestCom.GetEventFailed
        OpEventGetEventFailed_GetEventFailed_EvtInfo_FrsmEClusterSyncLoss: start-on-event=DemSatellite_0InternalBehavior/GetEventFailed, operation=EvtInfo_FrsmEClusterSyncLoss.GetEventFailed
        OpEventGetEventFailed_GetEventFailed_Event_FrsmEClusterSyncLoss: start-on-event=DemSatellite_0InternalBehavior/GetEventFailed, operation=Event_FrsmEClusterSyncLoss.GetEventFailed
        OpEventGetEventFailed_GetEventFailed_EvtInfo_FrtrcvEFrBuserrorTrcv0: start-on-event=DemSatellite_0InternalBehavior/GetEventFailed, operation=EvtInfo_FrtrcvEFrBuserrorTrcv0.GetEventFailed
        OpEventGetEventFailed_GetEventFailed_Event_FrtrcvEFrBuserrorTrcv0: start-on-event=DemSatellite_0InternalBehavior/GetEventFailed, operation=Event_FrtrcvEFrBuserrorTrcv0.GetEventFailed
        OpEventGetEventFailed_GetEventFailed_EvtInfo_GlobalOvervoltageExt: start-on-event=DemSatellite_0InternalBehavior/GetEventFailed, operation=EvtInfo_GlobalOvervoltageExt.GetEventFailed
        OpEventGetEventFailed_GetEventFailed_Event_GlobalOvervoltageExt: start-on-event=DemSatellite_0InternalBehavior/GetEventFailed, operation=Event_GlobalOvervoltageExt.GetEventFailed
        OpEventGetEventFailed_GetEventFailed_EvtInfo_GlobalOvervoltageInt: start-on-event=DemSatellite_0InternalBehavior/GetEventFailed, operation=EvtInfo_GlobalOvervoltageInt.GetEventFailed
        OpEventGetEventFailed_GetEventFailed_Event_GlobalOvervoltageInt: start-on-event=DemSatellite_0InternalBehavior/GetEventFailed, operation=Event_GlobalOvervoltageInt.GetEventFailed
        OpEventGetEventFailed_GetEventFailed_EvtInfo_GlobalUndervoltageExt: start-on-event=DemSatellite_0InternalBehavior/GetEventFailed, operation=EvtInfo_GlobalUndervoltageExt.GetEventFailed
        OpEventGetEventFailed_GetEventFailed_Event_GlobalUndervoltageExt: start-on-event=DemSatellite_0InternalBehavior/GetEventFailed, operation=Event_GlobalUndervoltageExt.GetEventFailed
        OpEventGetEventFailed_GetEventFailed_EvtInfo_GlobalUndervoltageInt: start-on-event=DemSatellite_0InternalBehavior/GetEventFailed, operation=EvtInfo_GlobalUndervoltageInt.GetEventFailed
        OpEventGetEventFailed_GetEventFailed_Event_GlobalUndervoltageInt: start-on-event=DemSatellite_0InternalBehavior/GetEventFailed, operation=Event_GlobalUndervoltageInt.GetEventFailed
        OpEventGetEventFailed_GetEventFailed_EvtInfo_LocalOvervoltage: start-on-event=DemSatellite_0InternalBehavior/GetEventFailed, operation=EvtInfo_LocalOvervoltage.GetEventFailed
        OpEventGetEventFailed_GetEventFailed_Event_LocalOvervoltage: start-on-event=DemSatellite_0InternalBehavior/GetEventFailed, operation=Event_LocalOvervoltage.GetEventFailed
        OpEventGetEventFailed_GetEventFailed_EvtInfo_LocalUndervoltage: start-on-event=DemSatellite_0InternalBehavior/GetEventFailed, operation=EvtInfo_LocalUndervoltage.GetEventFailed
        OpEventGetEventFailed_GetEventFailed_Event_LocalUndervoltage: start-on-event=DemSatellite_0InternalBehavior/GetEventFailed, operation=Event_LocalUndervoltage.GetEventFailed
        OpEventGetEventFailed_GetEventFailed_EvtInfo_VsmEventOpmode: start-on-event=DemSatellite_0InternalBehavior/GetEventFailed, operation=EvtInfo_VsmEventOpmode.GetEventFailed
        OpEventGetEventFailed_GetEventFailed_Event_VsmEventOpmode: start-on-event=DemSatellite_0InternalBehavior/GetEventFailed, operation=Event_VsmEventOpmode.GetEventFailed
        OpEventGetEventFailed_GetEventFailed_GeneralEventInfo: start-on-event=DemSatellite_0InternalBehavior/GetEventFailed, operation=GeneralEventInfo.GetEventFailed
        OpEventGetEventTested_GetEventTested_EvtInfo_MCU_E_CLM_SELFDIAG_FAILURE: start-on-event=DemSatellite_0InternalBehavior/GetEventTested, operation=EvtInfo_MCU_E_CLM_SELFDIAG_FAILURE.GetEventTested
        OpEventGetEventTested_GetEventTested_EvtInfo_MCU_E_CLOCK_FAILURE: start-on-event=DemSatellite_0InternalBehavior/GetEventTested, operation=EvtInfo_MCU_E_CLOCK_FAILURE.GetEventTested
        OpEventGetEventTested_GetEventTested_EvtInfo_MCU_E_CVM_SELFDIAG_FAILURE: start-on-event=DemSatellite_0InternalBehavior/GetEventTested, operation=EvtInfo_MCU_E_CVM_SELFDIAG_FAILURE.GetEventTested
        OpEventGetEventTested_GetEventTested_EvtInfo_MCU_E_ECM_SELFDIAG_FAILURE: start-on-event=DemSatellite_0InternalBehavior/GetEventTested, operation=EvtInfo_MCU_E_ECM_SELFDIAG_FAILURE.GetEventTested
        OpEventGetEventTested_GetEventTested_EvtInfo_MCU_E_LOCKSTEP_SELFDIAG_FAILURE: start-on-event=DemSatellite_0InternalBehavior/GetEventTested, operation=EvtInfo_MCU_E_LOCKSTEP_SELFDIAG_FAILURE.GetEventTested
        OpEventGetEventTested_GetEventTested_EvtInfo_MCU_E_WRITE_TIMEOUT_FAILURE: start-on-event=DemSatellite_0InternalBehavior/GetEventTested, operation=EvtInfo_MCU_E_WRITE_TIMEOUT_FAILURE.GetEventTested
        OpEventGetEventTested_GetEventTested_EvtInfo_MCU_E_REG_WRITE_VERIFY: start-on-event=DemSatellite_0InternalBehavior/GetEventTested, operation=EvtInfo_MCU_E_REG_WRITE_VERIFY.GetEventTested
        OpEventGetEventTested_GetEventTested_EvtInfo_MCU_E_INT_INCONSISTENT: start-on-event=DemSatellite_0InternalBehavior/GetEventTested, operation=EvtInfo_MCU_E_INT_INCONSISTENT.GetEventTested
        OpEventGetEventTested_GetEventTested_EvtInfo_MCU_E_RESETCONTROLLER_STARTUP_FAILURE: start-on-event=DemSatellite_0InternalBehavior/GetEventTested, operation=EvtInfo_MCU_E_RESETCONTROLLER_STARTUP_FAILURE.GetEventTested
        OpEventGetEventTested_GetEventTested_EvtInfo_DIO_E_REG_WRITE_VERIFY: start-on-event=DemSatellite_0InternalBehavior/GetEventTested, operation=EvtInfo_DIO_E_REG_WRITE_VERIFY.GetEventTested
        OpEventGetEventTested_GetEventTested_EvtInfo_FLS_E_COMPARE_FAILED: start-on-event=DemSatellite_0InternalBehavior/GetEventTested, operation=EvtInfo_FLS_E_COMPARE_FAILED.GetEventTested
        OpEventGetEventTested_GetEventTested_EvtInfo_FLS_E_ERASE_FAILED: start-on-event=DemSatellite_0InternalBehavior/GetEventTested, operation=EvtInfo_FLS_E_ERASE_FAILED.GetEventTested
        OpEventGetEventTested_GetEventTested_EvtInfo_FLS_E_READ_FAILED: start-on-event=DemSatellite_0InternalBehavior/GetEventTested, operation=EvtInfo_FLS_E_READ_FAILED.GetEventTested
        OpEventGetEventTested_GetEventTested_EvtInfo_FLS_E_INT_INCONSISTENT: start-on-event=DemSatellite_0InternalBehavior/GetEventTested, operation=EvtInfo_FLS_E_INT_INCONSISTENT.GetEventTested
        OpEventGetEventTested_GetEventTested_EvtInfo_FLS_E_REG_WRITE_VERIFY: start-on-event=DemSatellite_0InternalBehavior/GetEventTested, operation=EvtInfo_FLS_E_REG_WRITE_VERIFY.GetEventTested
        OpEventGetEventTested_GetEventTested_EvtInfo_FLS_E_READ_FAILED_DED: start-on-event=DemSatellite_0InternalBehavior/GetEventTested, operation=EvtInfo_FLS_E_READ_FAILED_DED.GetEventTested
        OpEventGetEventTested_GetEventTested_EvtInfo_FLS_E_HW_FAILURE: start-on-event=DemSatellite_0InternalBehavior/GetEventTested, operation=EvtInfo_FLS_E_HW_FAILURE.GetEventTested
        OpEventGetEventTested_GetEventTested_EvtInfo_FLS_E_ECC_FAILED: start-on-event=DemSatellite_0InternalBehavior/GetEventTested, operation=EvtInfo_FLS_E_ECC_FAILED.GetEventTested
        OpEventGetEventTested_GetEventTested_EvtInfo_FLS_E_UNEXPECTED_FLASH_ID: start-on-event=DemSatellite_0InternalBehavior/GetEventTested, operation=EvtInfo_FLS_E_UNEXPECTED_FLASH_ID.GetEventTested
        OpEventGetEventTested_GetEventTested_EvtInfo_FLS_E_WRITE_FAILED: start-on-event=DemSatellite_0InternalBehavior/GetEventTested, operation=EvtInfo_FLS_E_WRITE_FAILED.GetEventTested
        OpEventGetEventTested_GetEventTested_EvtInfo_SPI_E_DATA_TX_TIMEOUT_FAILURE: start-on-event=DemSatellite_0InternalBehavior/GetEventTested, operation=EvtInfo_SPI_E_DATA_TX_TIMEOUT_FAILURE.GetEventTested
        OpEventGetEventTested_GetEventTested_EvtInfo_SPI_E_ECC_SELFTEST_FAILURE: start-on-event=DemSatellite_0InternalBehavior/GetEventTested, operation=EvtInfo_SPI_E_ECC_SELFTEST_FAILURE.GetEventTested
        OpEventGetEventTested_GetEventTested_EvtInfo_SPI_E_HARDWARE_ERROR: start-on-event=DemSatellite_0InternalBehavior/GetEventTested, operation=EvtInfo_SPI_E_HARDWARE_ERROR.GetEventTested
        OpEventGetEventTested_GetEventTested_EvtInfo_SPI_E_INT_INCONSISTENT: start-on-event=DemSatellite_0InternalBehavior/GetEventTested, operation=EvtInfo_SPI_E_INT_INCONSISTENT.GetEventTested
        OpEventGetEventTested_GetEventTested_EvtInfo_SPI_E_LOOPBACK_SELFTEST_FAILURE: start-on-event=DemSatellite_0InternalBehavior/GetEventTested, operation=EvtInfo_SPI_E_LOOPBACK_SELFTEST_FAILURE.GetEventTested
        OpEventGetEventTested_GetEventTested_EvtInfo_SPI_E_REG_WRITE_VERIFY: start-on-event=DemSatellite_0InternalBehavior/GetEventTested, operation=EvtInfo_SPI_E_REG_WRITE_VERIFY.GetEventTested
        OpEventGetEventTested_GetEventTested_EvtInfo_WDGM_E_IMPROPER_CALLER: start-on-event=DemSatellite_0InternalBehavior/GetEventTested, operation=EvtInfo_WDGM_E_IMPROPER_CALLER.GetEventTested
        OpEventGetEventTested_GetEventTested_EvtInfo_WDGM_E_MONITORING: start-on-event=DemSatellite_0InternalBehavior/GetEventTested, operation=EvtInfo_WDGM_E_MONITORING.GetEventTested
        OpEventGetEventTested_GetEventTested_EvtInfo_WDGM_E_SET_MODE: start-on-event=DemSatellite_0InternalBehavior/GetEventTested, operation=EvtInfo_WDGM_E_SET_MODE.GetEventTested
        OpEventGetEventTested_GetEventTested_EvtInfo_WDG_E_DISABLE_REJECTED: start-on-event=DemSatellite_0InternalBehavior/GetEventTested, operation=EvtInfo_WDG_E_DISABLE_REJECTED.GetEventTested
        OpEventGetEventTested_GetEventTested_EvtInfo_WDG_E_INT_INCONSISTENT: start-on-event=DemSatellite_0InternalBehavior/GetEventTested, operation=EvtInfo_WDG_E_INT_INCONSISTENT.GetEventTested
        OpEventGetEventTested_GetEventTested_EvtInfo_WDG_E_MODE_FAILED: start-on-event=DemSatellite_0InternalBehavior/GetEventTested, operation=EvtInfo_WDG_E_MODE_FAILED.GetEventTested
        OpEventGetEventTested_GetEventTested_EvtInfo_WDG_E_REG_WRITE_VERIFY: start-on-event=DemSatellite_0InternalBehavior/GetEventTested, operation=EvtInfo_WDG_E_REG_WRITE_VERIFY.GetEventTested
        OpEventGetEventTested_GetEventTested_EvtInfo_PORT_E_WRITE_TIMEOUT_FAILURE: start-on-event=DemSatellite_0InternalBehavior/GetEventTested, operation=EvtInfo_PORT_E_WRITE_TIMEOUT_FAILURE.GetEventTested
        OpEventGetEventTested_GetEventTested_EvtInfo_PORT_E_REG_WRITE_VERIFY: start-on-event=DemSatellite_0InternalBehavior/GetEventTested, operation=EvtInfo_PORT_E_REG_WRITE_VERIFY.GetEventTested
        OpEventGetEventTested_GetEventTested_EvtInfo_CodingEventNotCoded: start-on-event=DemSatellite_0InternalBehavior/GetEventTested, operation=EvtInfo_CodingEventNotCoded.GetEventTested
        OpEventGetEventTested_GetEventTested_Event_CodingEventNotCoded: start-on-event=DemSatellite_0InternalBehavior/GetEventTested, operation=Event_CodingEventNotCoded.GetEventTested
        OpEventGetEventTested_GetEventTested_EvtInfo_CodingEventUnqualifiedData: start-on-event=DemSatellite_0InternalBehavior/GetEventTested, operation=EvtInfo_CodingEventUnqualifiedData.GetEventTested
        OpEventGetEventTested_GetEventTested_Event_CodingEventUnqualifiedData: start-on-event=DemSatellite_0InternalBehavior/GetEventTested, operation=Event_CodingEventUnqualifiedData.GetEventTested
        OpEventGetEventTested_GetEventTested_EvtInfo_CodingEventWrongVehicle: start-on-event=DemSatellite_0InternalBehavior/GetEventTested, operation=EvtInfo_CodingEventWrongVehicle.GetEventTested
        OpEventGetEventTested_GetEventTested_Event_CodingEventWrongVehicle: start-on-event=DemSatellite_0InternalBehavior/GetEventTested, operation=Event_CodingEventWrongVehicle.GetEventTested
        OpEventGetEventTested_GetEventTested_EvtInfo_DmTestAppl: start-on-event=DemSatellite_0InternalBehavior/GetEventTested, operation=EvtInfo_DmTestAppl.GetEventTested
        OpEventGetEventTested_GetEventTested_Event_DmTestAppl: start-on-event=DemSatellite_0InternalBehavior/GetEventTested, operation=Event_DmTestAppl.GetEventTested
        OpEventGetEventTested_GetEventTested_EvtInfo_DmTestCom: start-on-event=DemSatellite_0InternalBehavior/GetEventTested, operation=EvtInfo_DmTestCom.GetEventTested
        OpEventGetEventTested_GetEventTested_Event_DmTestCom: start-on-event=DemSatellite_0InternalBehavior/GetEventTested, operation=Event_DmTestCom.GetEventTested
        OpEventGetEventTested_GetEventTested_EvtInfo_FrsmEClusterSyncLoss: start-on-event=DemSatellite_0InternalBehavior/GetEventTested, operation=EvtInfo_FrsmEClusterSyncLoss.GetEventTested
        OpEventGetEventTested_GetEventTested_Event_FrsmEClusterSyncLoss: start-on-event=DemSatellite_0InternalBehavior/GetEventTested, operation=Event_FrsmEClusterSyncLoss.GetEventTested
        OpEventGetEventTested_GetEventTested_EvtInfo_FrtrcvEFrBuserrorTrcv0: start-on-event=DemSatellite_0InternalBehavior/GetEventTested, operation=EvtInfo_FrtrcvEFrBuserrorTrcv0.GetEventTested
        OpEventGetEventTested_GetEventTested_Event_FrtrcvEFrBuserrorTrcv0: start-on-event=DemSatellite_0InternalBehavior/GetEventTested, operation=Event_FrtrcvEFrBuserrorTrcv0.GetEventTested
        OpEventGetEventTested_GetEventTested_EvtInfo_GlobalOvervoltageExt: start-on-event=DemSatellite_0InternalBehavior/GetEventTested, operation=EvtInfo_GlobalOvervoltageExt.GetEventTested
        OpEventGetEventTested_GetEventTested_Event_GlobalOvervoltageExt: start-on-event=DemSatellite_0InternalBehavior/GetEventTested, operation=Event_GlobalOvervoltageExt.GetEventTested
        OpEventGetEventTested_GetEventTested_EvtInfo_GlobalOvervoltageInt: start-on-event=DemSatellite_0InternalBehavior/GetEventTested, operation=EvtInfo_GlobalOvervoltageInt.GetEventTested
        OpEventGetEventTested_GetEventTested_Event_GlobalOvervoltageInt: start-on-event=DemSatellite_0InternalBehavior/GetEventTested, operation=Event_GlobalOvervoltageInt.GetEventTested
        OpEventGetEventTested_GetEventTested_EvtInfo_GlobalUndervoltageExt: start-on-event=DemSatellite_0InternalBehavior/GetEventTested, operation=EvtInfo_GlobalUndervoltageExt.GetEventTested
        OpEventGetEventTested_GetEventTested_Event_GlobalUndervoltageExt: start-on-event=DemSatellite_0InternalBehavior/GetEventTested, operation=Event_GlobalUndervoltageExt.GetEventTested
        OpEventGetEventTested_GetEventTested_EvtInfo_GlobalUndervoltageInt: start-on-event=DemSatellite_0InternalBehavior/GetEventTested, operation=EvtInfo_GlobalUndervoltageInt.GetEventTested
        OpEventGetEventTested_GetEventTested_Event_GlobalUndervoltageInt: start-on-event=DemSatellite_0InternalBehavior/GetEventTested, operation=Event_GlobalUndervoltageInt.GetEventTested
        OpEventGetEventTested_GetEventTested_EvtInfo_LocalOvervoltage: start-on-event=DemSatellite_0InternalBehavior/GetEventTested, operation=EvtInfo_LocalOvervoltage.GetEventTested
        OpEventGetEventTested_GetEventTested_Event_LocalOvervoltage: start-on-event=DemSatellite_0InternalBehavior/GetEventTested, operation=Event_LocalOvervoltage.GetEventTested
        OpEventGetEventTested_GetEventTested_EvtInfo_LocalUndervoltage: start-on-event=DemSatellite_0InternalBehavior/GetEventTested, operation=EvtInfo_LocalUndervoltage.GetEventTested
        OpEventGetEventTested_GetEventTested_Event_LocalUndervoltage: start-on-event=DemSatellite_0InternalBehavior/GetEventTested, operation=Event_LocalUndervoltage.GetEventTested
        OpEventGetEventTested_GetEventTested_EvtInfo_VsmEventOpmode: start-on-event=DemSatellite_0InternalBehavior/GetEventTested, operation=EvtInfo_VsmEventOpmode.GetEventTested
        OpEventGetEventTested_GetEventTested_Event_VsmEventOpmode: start-on-event=DemSatellite_0InternalBehavior/GetEventTested, operation=Event_VsmEventOpmode.GetEventTested
        OpEventGetEventTested_GetEventTested_GeneralEventInfo: start-on-event=DemSatellite_0InternalBehavior/GetEventTested, operation=GeneralEventInfo.GetEventTested
        OpEventGetDTCOfEvent_GetDTCOfEvent_EvtInfo_MCU_E_CLM_SELFDIAG_FAILURE: start-on-event=DemSatellite_0InternalBehavior/GetDTCOfEvent, operation=EvtInfo_MCU_E_CLM_SELFDIAG_FAILURE.GetDTCOfEvent
        OpEventGetDTCOfEvent_GetDTCOfEvent_EvtInfo_MCU_E_CLOCK_FAILURE: start-on-event=DemSatellite_0InternalBehavior/GetDTCOfEvent, operation=EvtInfo_MCU_E_CLOCK_FAILURE.GetDTCOfEvent
        OpEventGetDTCOfEvent_GetDTCOfEvent_EvtInfo_MCU_E_CVM_SELFDIAG_FAILURE: start-on-event=DemSatellite_0InternalBehavior/GetDTCOfEvent, operation=EvtInfo_MCU_E_CVM_SELFDIAG_FAILURE.GetDTCOfEvent
        OpEventGetDTCOfEvent_GetDTCOfEvent_EvtInfo_MCU_E_ECM_SELFDIAG_FAILURE: start-on-event=DemSatellite_0InternalBehavior/GetDTCOfEvent, operation=EvtInfo_MCU_E_ECM_SELFDIAG_FAILURE.GetDTCOfEvent
        OpEventGetDTCOfEvent_GetDTCOfEvent_EvtInfo_MCU_E_LOCKSTEP_SELFDIAG_FAILURE: start-on-event=DemSatellite_0InternalBehavior/GetDTCOfEvent, operation=EvtInfo_MCU_E_LOCKSTEP_SELFDIAG_FAILURE.GetDTCOfEvent
        OpEventGetDTCOfEvent_GetDTCOfEvent_EvtInfo_MCU_E_WRITE_TIMEOUT_FAILURE: start-on-event=DemSatellite_0InternalBehavior/GetDTCOfEvent, operation=EvtInfo_MCU_E_WRITE_TIMEOUT_FAILURE.GetDTCOfEvent
        OpEventGetDTCOfEvent_GetDTCOfEvent_EvtInfo_MCU_E_REG_WRITE_VERIFY: start-on-event=DemSatellite_0InternalBehavior/GetDTCOfEvent, operation=EvtInfo_MCU_E_REG_WRITE_VERIFY.GetDTCOfEvent
        OpEventGetDTCOfEvent_GetDTCOfEvent_EvtInfo_MCU_E_INT_INCONSISTENT: start-on-event=DemSatellite_0InternalBehavior/GetDTCOfEvent, operation=EvtInfo_MCU_E_INT_INCONSISTENT.GetDTCOfEvent
        OpEventGetDTCOfEvent_GetDTCOfEvent_EvtInfo_MCU_E_RESETCONTROLLER_STARTUP_FAILURE: start-on-event=DemSatellite_0InternalBehavior/GetDTCOfEvent, operation=EvtInfo_MCU_E_RESETCONTROLLER_STARTUP_FAILURE.GetDTCOfEvent
        OpEventGetDTCOfEvent_GetDTCOfEvent_EvtInfo_DIO_E_REG_WRITE_VERIFY: start-on-event=DemSatellite_0InternalBehavior/GetDTCOfEvent, operation=EvtInfo_DIO_E_REG_WRITE_VERIFY.GetDTCOfEvent
        OpEventGetDTCOfEvent_GetDTCOfEvent_EvtInfo_FLS_E_COMPARE_FAILED: start-on-event=DemSatellite_0InternalBehavior/GetDTCOfEvent, operation=EvtInfo_FLS_E_COMPARE_FAILED.GetDTCOfEvent
        OpEventGetDTCOfEvent_GetDTCOfEvent_EvtInfo_FLS_E_ERASE_FAILED: start-on-event=DemSatellite_0InternalBehavior/GetDTCOfEvent, operation=EvtInfo_FLS_E_ERASE_FAILED.GetDTCOfEvent
        OpEventGetDTCOfEvent_GetDTCOfEvent_EvtInfo_FLS_E_READ_FAILED: start-on-event=DemSatellite_0InternalBehavior/GetDTCOfEvent, operation=EvtInfo_FLS_E_READ_FAILED.GetDTCOfEvent
        OpEventGetDTCOfEvent_GetDTCOfEvent_EvtInfo_FLS_E_INT_INCONSISTENT: start-on-event=DemSatellite_0InternalBehavior/GetDTCOfEvent, operation=EvtInfo_FLS_E_INT_INCONSISTENT.GetDTCOfEvent
        OpEventGetDTCOfEvent_GetDTCOfEvent_EvtInfo_FLS_E_REG_WRITE_VERIFY: start-on-event=DemSatellite_0InternalBehavior/GetDTCOfEvent, operation=EvtInfo_FLS_E_REG_WRITE_VERIFY.GetDTCOfEvent
        OpEventGetDTCOfEvent_GetDTCOfEvent_EvtInfo_FLS_E_READ_FAILED_DED: start-on-event=DemSatellite_0InternalBehavior/GetDTCOfEvent, operation=EvtInfo_FLS_E_READ_FAILED_DED.GetDTCOfEvent
        OpEventGetDTCOfEvent_GetDTCOfEvent_EvtInfo_FLS_E_HW_FAILURE: start-on-event=DemSatellite_0InternalBehavior/GetDTCOfEvent, operation=EvtInfo_FLS_E_HW_FAILURE.GetDTCOfEvent
        OpEventGetDTCOfEvent_GetDTCOfEvent_EvtInfo_FLS_E_ECC_FAILED: start-on-event=DemSatellite_0InternalBehavior/GetDTCOfEvent, operation=EvtInfo_FLS_E_ECC_FAILED.GetDTCOfEvent
        OpEventGetDTCOfEvent_GetDTCOfEvent_EvtInfo_FLS_E_UNEXPECTED_FLASH_ID: start-on-event=DemSatellite_0InternalBehavior/GetDTCOfEvent, operation=EvtInfo_FLS_E_UNEXPECTED_FLASH_ID.GetDTCOfEvent
        OpEventGetDTCOfEvent_GetDTCOfEvent_EvtInfo_FLS_E_WRITE_FAILED: start-on-event=DemSatellite_0InternalBehavior/GetDTCOfEvent, operation=EvtInfo_FLS_E_WRITE_FAILED.GetDTCOfEvent
        OpEventGetDTCOfEvent_GetDTCOfEvent_EvtInfo_SPI_E_DATA_TX_TIMEOUT_FAILURE: start-on-event=DemSatellite_0InternalBehavior/GetDTCOfEvent, operation=EvtInfo_SPI_E_DATA_TX_TIMEOUT_FAILURE.GetDTCOfEvent
        OpEventGetDTCOfEvent_GetDTCOfEvent_EvtInfo_SPI_E_ECC_SELFTEST_FAILURE: start-on-event=DemSatellite_0InternalBehavior/GetDTCOfEvent, operation=EvtInfo_SPI_E_ECC_SELFTEST_FAILURE.GetDTCOfEvent
        OpEventGetDTCOfEvent_GetDTCOfEvent_EvtInfo_SPI_E_HARDWARE_ERROR: start-on-event=DemSatellite_0InternalBehavior/GetDTCOfEvent, operation=EvtInfo_SPI_E_HARDWARE_ERROR.GetDTCOfEvent
        OpEventGetDTCOfEvent_GetDTCOfEvent_EvtInfo_SPI_E_INT_INCONSISTENT: start-on-event=DemSatellite_0InternalBehavior/GetDTCOfEvent, operation=EvtInfo_SPI_E_INT_INCONSISTENT.GetDTCOfEvent
        OpEventGetDTCOfEvent_GetDTCOfEvent_EvtInfo_SPI_E_LOOPBACK_SELFTEST_FAILURE: start-on-event=DemSatellite_0InternalBehavior/GetDTCOfEvent, operation=EvtInfo_SPI_E_LOOPBACK_SELFTEST_FAILURE.GetDTCOfEvent
        OpEventGetDTCOfEvent_GetDTCOfEvent_EvtInfo_SPI_E_REG_WRITE_VERIFY: start-on-event=DemSatellite_0InternalBehavior/GetDTCOfEvent, operation=EvtInfo_SPI_E_REG_WRITE_VERIFY.GetDTCOfEvent
        OpEventGetDTCOfEvent_GetDTCOfEvent_EvtInfo_WDGM_E_IMPROPER_CALLER: start-on-event=DemSatellite_0InternalBehavior/GetDTCOfEvent, operation=EvtInfo_WDGM_E_IMPROPER_CALLER.GetDTCOfEvent
        OpEventGetDTCOfEvent_GetDTCOfEvent_EvtInfo_WDGM_E_MONITORING: start-on-event=DemSatellite_0InternalBehavior/GetDTCOfEvent, operation=EvtInfo_WDGM_E_MONITORING.GetDTCOfEvent
        OpEventGetDTCOfEvent_GetDTCOfEvent_EvtInfo_WDGM_E_SET_MODE: start-on-event=DemSatellite_0InternalBehavior/GetDTCOfEvent, operation=EvtInfo_WDGM_E_SET_MODE.GetDTCOfEvent
        OpEventGetDTCOfEvent_GetDTCOfEvent_EvtInfo_WDG_E_DISABLE_REJECTED: start-on-event=DemSatellite_0InternalBehavior/GetDTCOfEvent, operation=EvtInfo_WDG_E_DISABLE_REJECTED.GetDTCOfEvent
        OpEventGetDTCOfEvent_GetDTCOfEvent_EvtInfo_WDG_E_INT_INCONSISTENT: start-on-event=DemSatellite_0InternalBehavior/GetDTCOfEvent, operation=EvtInfo_WDG_E_INT_INCONSISTENT.GetDTCOfEvent
        OpEventGetDTCOfEvent_GetDTCOfEvent_EvtInfo_WDG_E_MODE_FAILED: start-on-event=DemSatellite_0InternalBehavior/GetDTCOfEvent, operation=EvtInfo_WDG_E_MODE_FAILED.GetDTCOfEvent
        OpEventGetDTCOfEvent_GetDTCOfEvent_EvtInfo_WDG_E_REG_WRITE_VERIFY: start-on-event=DemSatellite_0InternalBehavior/GetDTCOfEvent, operation=EvtInfo_WDG_E_REG_WRITE_VERIFY.GetDTCOfEvent
        OpEventGetDTCOfEvent_GetDTCOfEvent_EvtInfo_PORT_E_WRITE_TIMEOUT_FAILURE: start-on-event=DemSatellite_0InternalBehavior/GetDTCOfEvent, operation=EvtInfo_PORT_E_WRITE_TIMEOUT_FAILURE.GetDTCOfEvent
        OpEventGetDTCOfEvent_GetDTCOfEvent_EvtInfo_PORT_E_REG_WRITE_VERIFY: start-on-event=DemSatellite_0InternalBehavior/GetDTCOfEvent, operation=EvtInfo_PORT_E_REG_WRITE_VERIFY.GetDTCOfEvent
        OpEventGetDTCOfEvent_GetDTCOfEvent_EvtInfo_CodingEventNotCoded: start-on-event=DemSatellite_0InternalBehavior/GetDTCOfEvent, operation=EvtInfo_CodingEventNotCoded.GetDTCOfEvent
        OpEventGetDTCOfEvent_GetDTCOfEvent_Event_CodingEventNotCoded: start-on-event=DemSatellite_0InternalBehavior/GetDTCOfEvent, operation=Event_CodingEventNotCoded.GetDTCOfEvent
        OpEventGetDTCOfEvent_GetDTCOfEvent_EvtInfo_CodingEventUnqualifiedData: start-on-event=DemSatellite_0InternalBehavior/GetDTCOfEvent, operation=EvtInfo_CodingEventUnqualifiedData.GetDTCOfEvent
        OpEventGetDTCOfEvent_GetDTCOfEvent_Event_CodingEventUnqualifiedData: start-on-event=DemSatellite_0InternalBehavior/GetDTCOfEvent, operation=Event_CodingEventUnqualifiedData.GetDTCOfEvent
        OpEventGetDTCOfEvent_GetDTCOfEvent_EvtInfo_CodingEventWrongVehicle: start-on-event=DemSatellite_0InternalBehavior/GetDTCOfEvent, operation=EvtInfo_CodingEventWrongVehicle.GetDTCOfEvent
        OpEventGetDTCOfEvent_GetDTCOfEvent_Event_CodingEventWrongVehicle: start-on-event=DemSatellite_0InternalBehavior/GetDTCOfEvent, operation=Event_CodingEventWrongVehicle.GetDTCOfEvent
        OpEventGetDTCOfEvent_GetDTCOfEvent_EvtInfo_DmTestAppl: start-on-event=DemSatellite_0InternalBehavior/GetDTCOfEvent, operation=EvtInfo_DmTestAppl.GetDTCOfEvent
        OpEventGetDTCOfEvent_GetDTCOfEvent_Event_DmTestAppl: start-on-event=DemSatellite_0InternalBehavior/GetDTCOfEvent, operation=Event_DmTestAppl.GetDTCOfEvent
        OpEventGetDTCOfEvent_GetDTCOfEvent_EvtInfo_DmTestCom: start-on-event=DemSatellite_0InternalBehavior/GetDTCOfEvent, operation=EvtInfo_DmTestCom.GetDTCOfEvent
        OpEventGetDTCOfEvent_GetDTCOfEvent_Event_DmTestCom: start-on-event=DemSatellite_0InternalBehavior/GetDTCOfEvent, operation=Event_DmTestCom.GetDTCOfEvent
        OpEventGetDTCOfEvent_GetDTCOfEvent_EvtInfo_FrsmEClusterSyncLoss: start-on-event=DemSatellite_0InternalBehavior/GetDTCOfEvent, operation=EvtInfo_FrsmEClusterSyncLoss.GetDTCOfEvent
        OpEventGetDTCOfEvent_GetDTCOfEvent_Event_FrsmEClusterSyncLoss: start-on-event=DemSatellite_0InternalBehavior/GetDTCOfEvent, operation=Event_FrsmEClusterSyncLoss.GetDTCOfEvent
        OpEventGetDTCOfEvent_GetDTCOfEvent_EvtInfo_FrtrcvEFrBuserrorTrcv0: start-on-event=DemSatellite_0InternalBehavior/GetDTCOfEvent, operation=EvtInfo_FrtrcvEFrBuserrorTrcv0.GetDTCOfEvent
        OpEventGetDTCOfEvent_GetDTCOfEvent_Event_FrtrcvEFrBuserrorTrcv0: start-on-event=DemSatellite_0InternalBehavior/GetDTCOfEvent, operation=Event_FrtrcvEFrBuserrorTrcv0.GetDTCOfEvent
        OpEventGetDTCOfEvent_GetDTCOfEvent_EvtInfo_GlobalOvervoltageExt: start-on-event=DemSatellite_0InternalBehavior/GetDTCOfEvent, operation=EvtInfo_GlobalOvervoltageExt.GetDTCOfEvent
        OpEventGetDTCOfEvent_GetDTCOfEvent_Event_GlobalOvervoltageExt: start-on-event=DemSatellite_0InternalBehavior/GetDTCOfEvent, operation=Event_GlobalOvervoltageExt.GetDTCOfEvent
        OpEventGetDTCOfEvent_GetDTCOfEvent_EvtInfo_GlobalOvervoltageInt: start-on-event=DemSatellite_0InternalBehavior/GetDTCOfEvent, operation=EvtInfo_GlobalOvervoltageInt.GetDTCOfEvent
        OpEventGetDTCOfEvent_GetDTCOfEvent_Event_GlobalOvervoltageInt: start-on-event=DemSatellite_0InternalBehavior/GetDTCOfEvent, operation=Event_GlobalOvervoltageInt.GetDTCOfEvent
        OpEventGetDTCOfEvent_GetDTCOfEvent_EvtInfo_GlobalUndervoltageExt: start-on-event=DemSatellite_0InternalBehavior/GetDTCOfEvent, operation=EvtInfo_GlobalUndervoltageExt.GetDTCOfEvent
        OpEventGetDTCOfEvent_GetDTCOfEvent_Event_GlobalUndervoltageExt: start-on-event=DemSatellite_0InternalBehavior/GetDTCOfEvent, operation=Event_GlobalUndervoltageExt.GetDTCOfEvent
        OpEventGetDTCOfEvent_GetDTCOfEvent_EvtInfo_GlobalUndervoltageInt: start-on-event=DemSatellite_0InternalBehavior/GetDTCOfEvent, operation=EvtInfo_GlobalUndervoltageInt.GetDTCOfEvent
        OpEventGetDTCOfEvent_GetDTCOfEvent_Event_GlobalUndervoltageInt: start-on-event=DemSatellite_0InternalBehavior/GetDTCOfEvent, operation=Event_GlobalUndervoltageInt.GetDTCOfEvent
        OpEventGetDTCOfEvent_GetDTCOfEvent_EvtInfo_LocalOvervoltage: start-on-event=DemSatellite_0InternalBehavior/GetDTCOfEvent, operation=EvtInfo_LocalOvervoltage.GetDTCOfEvent
        OpEventGetDTCOfEvent_GetDTCOfEvent_Event_LocalOvervoltage: start-on-event=DemSatellite_0InternalBehavior/GetDTCOfEvent, operation=Event_LocalOvervoltage.GetDTCOfEvent
        OpEventGetDTCOfEvent_GetDTCOfEvent_EvtInfo_LocalUndervoltage: start-on-event=DemSatellite_0InternalBehavior/GetDTCOfEvent, operation=EvtInfo_LocalUndervoltage.GetDTCOfEvent
        OpEventGetDTCOfEvent_GetDTCOfEvent_Event_LocalUndervoltage: start-on-event=DemSatellite_0InternalBehavior/GetDTCOfEvent, operation=Event_LocalUndervoltage.GetDTCOfEvent
        OpEventGetDTCOfEvent_GetDTCOfEvent_EvtInfo_VsmEventOpmode: start-on-event=DemSatellite_0InternalBehavior/GetDTCOfEvent, operation=EvtInfo_VsmEventOpmode.GetDTCOfEvent
        OpEventGetDTCOfEvent_GetDTCOfEvent_Event_VsmEventOpmode: start-on-event=DemSatellite_0InternalBehavior/GetDTCOfEvent, operation=Event_VsmEventOpmode.GetDTCOfEvent
        OpEventGetDTCOfEvent_GetDTCOfEvent_GeneralEventInfo: start-on-event=DemSatellite_0InternalBehavior/GetDTCOfEvent, operation=GeneralEventInfo.GetDTCOfEvent
        OpEventGetFaultDetectionCounter_GetFaultDetectionCounter_EvtInfo_MCU_E_CLM_SELFDIAG_FAILURE: start-on-event=DemSatellite_0InternalBehavior/GetFaultDetectionCounter, operation=EvtInfo_MCU_E_CLM_SELFDIAG_FAILURE.GetFaultDetectionCounter
        OpEventGetFaultDetectionCounter_GetFaultDetectionCounter_EvtInfo_MCU_E_CLOCK_FAILURE: start-on-event=DemSatellite_0InternalBehavior/GetFaultDetectionCounter, operation=EvtInfo_MCU_E_CLOCK_FAILURE.GetFaultDetectionCounter
        OpEventGetFaultDetectionCounter_GetFaultDetectionCounter_EvtInfo_MCU_E_CVM_SELFDIAG_FAILURE: start-on-event=DemSatellite_0InternalBehavior/GetFaultDetectionCounter, operation=EvtInfo_MCU_E_CVM_SELFDIAG_FAILURE.GetFaultDetectionCounter
        OpEventGetFaultDetectionCounter_GetFaultDetectionCounter_EvtInfo_MCU_E_ECM_SELFDIAG_FAILURE: start-on-event=DemSatellite_0InternalBehavior/GetFaultDetectionCounter, operation=EvtInfo_MCU_E_ECM_SELFDIAG_FAILURE.GetFaultDetectionCounter
        OpEventGetFaultDetectionCounter_GetFaultDetectionCounter_EvtInfo_MCU_E_LOCKSTEP_SELFDIAG_FAILURE: start-on-event=DemSatellite_0InternalBehavior/GetFaultDetectionCounter, operation=EvtInfo_MCU_E_LOCKSTEP_SELFDIAG_FAILURE.GetFaultDetectionCounter
        OpEventGetFaultDetectionCounter_GetFaultDetectionCounter_EvtInfo_MCU_E_WRITE_TIMEOUT_FAILURE: start-on-event=DemSatellite_0InternalBehavior/GetFaultDetectionCounter, operation=EvtInfo_MCU_E_WRITE_TIMEOUT_FAILURE.GetFaultDetectionCounter
        OpEventGetFaultDetectionCounter_GetFaultDetectionCounter_EvtInfo_MCU_E_REG_WRITE_VERIFY: start-on-event=DemSatellite_0InternalBehavior/GetFaultDetectionCounter, operation=EvtInfo_MCU_E_REG_WRITE_VERIFY.GetFaultDetectionCounter
        OpEventGetFaultDetectionCounter_GetFaultDetectionCounter_EvtInfo_MCU_E_INT_INCONSISTENT: start-on-event=DemSatellite_0InternalBehavior/GetFaultDetectionCounter, operation=EvtInfo_MCU_E_INT_INCONSISTENT.GetFaultDetectionCounter
        OpEventGetFaultDetectionCounter_GetFaultDetectionCounter_EvtInfo_MCU_E_RESETCONTROLLER_STARTUP_FAILURE: start-on-event=DemSatellite_0InternalBehavior/GetFaultDetectionCounter, operation=EvtInfo_MCU_E_RESETCONTROLLER_STARTUP_FAILURE.GetFaultDetectionCounter
        OpEventGetFaultDetectionCounter_GetFaultDetectionCounter_EvtInfo_DIO_E_REG_WRITE_VERIFY: start-on-event=DemSatellite_0InternalBehavior/GetFaultDetectionCounter, operation=EvtInfo_DIO_E_REG_WRITE_VERIFY.GetFaultDetectionCounter
        OpEventGetFaultDetectionCounter_GetFaultDetectionCounter_EvtInfo_FLS_E_COMPARE_FAILED: start-on-event=DemSatellite_0InternalBehavior/GetFaultDetectionCounter, operation=EvtInfo_FLS_E_COMPARE_FAILED.GetFaultDetectionCounter
        OpEventGetFaultDetectionCounter_GetFaultDetectionCounter_EvtInfo_FLS_E_ERASE_FAILED: start-on-event=DemSatellite_0InternalBehavior/GetFaultDetectionCounter, operation=EvtInfo_FLS_E_ERASE_FAILED.GetFaultDetectionCounter
        OpEventGetFaultDetectionCounter_GetFaultDetectionCounter_EvtInfo_FLS_E_READ_FAILED: start-on-event=DemSatellite_0InternalBehavior/GetFaultDetectionCounter, operation=EvtInfo_FLS_E_READ_FAILED.GetFaultDetectionCounter
        OpEventGetFaultDetectionCounter_GetFaultDetectionCounter_EvtInfo_FLS_E_INT_INCONSISTENT: start-on-event=DemSatellite_0InternalBehavior/GetFaultDetectionCounter, operation=EvtInfo_FLS_E_INT_INCONSISTENT.GetFaultDetectionCounter
        OpEventGetFaultDetectionCounter_GetFaultDetectionCounter_EvtInfo_FLS_E_REG_WRITE_VERIFY: start-on-event=DemSatellite_0InternalBehavior/GetFaultDetectionCounter, operation=EvtInfo_FLS_E_REG_WRITE_VERIFY.GetFaultDetectionCounter
        OpEventGetFaultDetectionCounter_GetFaultDetectionCounter_EvtInfo_FLS_E_READ_FAILED_DED: start-on-event=DemSatellite_0InternalBehavior/GetFaultDetectionCounter, operation=EvtInfo_FLS_E_READ_FAILED_DED.GetFaultDetectionCounter
        OpEventGetFaultDetectionCounter_GetFaultDetectionCounter_EvtInfo_FLS_E_HW_FAILURE: start-on-event=DemSatellite_0InternalBehavior/GetFaultDetectionCounter, operation=EvtInfo_FLS_E_HW_FAILURE.GetFaultDetectionCounter
        OpEventGetFaultDetectionCounter_GetFaultDetectionCounter_EvtInfo_FLS_E_ECC_FAILED: start-on-event=DemSatellite_0InternalBehavior/GetFaultDetectionCounter, operation=EvtInfo_FLS_E_ECC_FAILED.GetFaultDetectionCounter
        OpEventGetFaultDetectionCounter_GetFaultDetectionCounter_EvtInfo_FLS_E_UNEXPECTED_FLASH_ID: start-on-event=DemSatellite_0InternalBehavior/GetFaultDetectionCounter, operation=EvtInfo_FLS_E_UNEXPECTED_FLASH_ID.GetFaultDetectionCounter
        OpEventGetFaultDetectionCounter_GetFaultDetectionCounter_EvtInfo_FLS_E_WRITE_FAILED: start-on-event=DemSatellite_0InternalBehavior/GetFaultDetectionCounter, operation=EvtInfo_FLS_E_WRITE_FAILED.GetFaultDetectionCounter
        OpEventGetFaultDetectionCounter_GetFaultDetectionCounter_EvtInfo_SPI_E_DATA_TX_TIMEOUT_FAILURE: start-on-event=DemSatellite_0InternalBehavior/GetFaultDetectionCounter, operation=EvtInfo_SPI_E_DATA_TX_TIMEOUT_FAILURE.GetFaultDetectionCounter
        OpEventGetFaultDetectionCounter_GetFaultDetectionCounter_EvtInfo_SPI_E_ECC_SELFTEST_FAILURE: start-on-event=DemSatellite_0InternalBehavior/GetFaultDetectionCounter, operation=EvtInfo_SPI_E_ECC_SELFTEST_FAILURE.GetFaultDetectionCounter
        OpEventGetFaultDetectionCounter_GetFaultDetectionCounter_EvtInfo_SPI_E_HARDWARE_ERROR: start-on-event=DemSatellite_0InternalBehavior/GetFaultDetectionCounter, operation=EvtInfo_SPI_E_HARDWARE_ERROR.GetFaultDetectionCounter
        OpEventGetFaultDetectionCounter_GetFaultDetectionCounter_EvtInfo_SPI_E_INT_INCONSISTENT: start-on-event=DemSatellite_0InternalBehavior/GetFaultDetectionCounter, operation=EvtInfo_SPI_E_INT_INCONSISTENT.GetFaultDetectionCounter
        OpEventGetFaultDetectionCounter_GetFaultDetectionCounter_EvtInfo_SPI_E_LOOPBACK_SELFTEST_FAILURE: start-on-event=DemSatellite_0InternalBehavior/GetFaultDetectionCounter, operation=EvtInfo_SPI_E_LOOPBACK_SELFTEST_FAILURE.GetFaultDetectionCounter
        OpEventGetFaultDetectionCounter_GetFaultDetectionCounter_EvtInfo_SPI_E_REG_WRITE_VERIFY: start-on-event=DemSatellite_0InternalBehavior/GetFaultDetectionCounter, operation=EvtInfo_SPI_E_REG_WRITE_VERIFY.GetFaultDetectionCounter
        OpEventGetFaultDetectionCounter_GetFaultDetectionCounter_EvtInfo_WDGM_E_IMPROPER_CALLER: start-on-event=DemSatellite_0InternalBehavior/GetFaultDetectionCounter, operation=EvtInfo_WDGM_E_IMPROPER_CALLER.GetFaultDetectionCounter
        OpEventGetFaultDetectionCounter_GetFaultDetectionCounter_EvtInfo_WDGM_E_MONITORING: start-on-event=DemSatellite_0InternalBehavior/GetFaultDetectionCounter, operation=EvtInfo_WDGM_E_MONITORING.GetFaultDetectionCounter
        OpEventGetFaultDetectionCounter_GetFaultDetectionCounter_EvtInfo_WDGM_E_SET_MODE: start-on-event=DemSatellite_0InternalBehavior/GetFaultDetectionCounter, operation=EvtInfo_WDGM_E_SET_MODE.GetFaultDetectionCounter
        OpEventGetFaultDetectionCounter_GetFaultDetectionCounter_EvtInfo_WDG_E_DISABLE_REJECTED: start-on-event=DemSatellite_0InternalBehavior/GetFaultDetectionCounter, operation=EvtInfo_WDG_E_DISABLE_REJECTED.GetFaultDetectionCounter
        OpEventGetFaultDetectionCounter_GetFaultDetectionCounter_EvtInfo_WDG_E_INT_INCONSISTENT: start-on-event=DemSatellite_0InternalBehavior/GetFaultDetectionCounter, operation=EvtInfo_WDG_E_INT_INCONSISTENT.GetFaultDetectionCounter
        OpEventGetFaultDetectionCounter_GetFaultDetectionCounter_EvtInfo_WDG_E_MODE_FAILED: start-on-event=DemSatellite_0InternalBehavior/GetFaultDetectionCounter, operation=EvtInfo_WDG_E_MODE_FAILED.GetFaultDetectionCounter
        OpEventGetFaultDetectionCounter_GetFaultDetectionCounter_EvtInfo_WDG_E_REG_WRITE_VERIFY: start-on-event=DemSatellite_0InternalBehavior/GetFaultDetectionCounter, operation=EvtInfo_WDG_E_REG_WRITE_VERIFY.GetFaultDetectionCounter
        OpEventGetFaultDetectionCounter_GetFaultDetectionCounter_EvtInfo_PORT_E_WRITE_TIMEOUT_FAILURE: start-on-event=DemSatellite_0InternalBehavior/GetFaultDetectionCounter, operation=EvtInfo_PORT_E_WRITE_TIMEOUT_FAILURE.GetFaultDetectionCounter
        OpEventGetFaultDetectionCounter_GetFaultDetectionCounter_EvtInfo_PORT_E_REG_WRITE_VERIFY: start-on-event=DemSatellite_0InternalBehavior/GetFaultDetectionCounter, operation=EvtInfo_PORT_E_REG_WRITE_VERIFY.GetFaultDetectionCounter
        OpEventGetFaultDetectionCounter_GetFaultDetectionCounter_EvtInfo_CodingEventNotCoded: start-on-event=DemSatellite_0InternalBehavior/GetFaultDetectionCounter, operation=EvtInfo_CodingEventNotCoded.GetFaultDetectionCounter
        OpEventGetFaultDetectionCounter_GetFaultDetectionCounter_Event_CodingEventNotCoded: start-on-event=DemSatellite_0InternalBehavior/GetFaultDetectionCounter, operation=Event_CodingEventNotCoded.GetFaultDetectionCounter
        OpEventGetFaultDetectionCounter_GetFaultDetectionCounter_EvtInfo_CodingEventUnqualifiedData: start-on-event=DemSatellite_0InternalBehavior/GetFaultDetectionCounter, operation=EvtInfo_CodingEventUnqualifiedData.GetFaultDetectionCounter
        OpEventGetFaultDetectionCounter_GetFaultDetectionCounter_Event_CodingEventUnqualifiedData: start-on-event=DemSatellite_0InternalBehavior/GetFaultDetectionCounter, operation=Event_CodingEventUnqualifiedData.GetFaultDetectionCounter
        OpEventGetFaultDetectionCounter_GetFaultDetectionCounter_EvtInfo_CodingEventWrongVehicle: start-on-event=DemSatellite_0InternalBehavior/GetFaultDetectionCounter, operation=EvtInfo_CodingEventWrongVehicle.GetFaultDetectionCounter
        OpEventGetFaultDetectionCounter_GetFaultDetectionCounter_Event_CodingEventWrongVehicle: start-on-event=DemSatellite_0InternalBehavior/GetFaultDetectionCounter, operation=Event_CodingEventWrongVehicle.GetFaultDetectionCounter
        OpEventGetFaultDetectionCounter_GetFaultDetectionCounter_EvtInfo_DmTestAppl: start-on-event=DemSatellite_0InternalBehavior/GetFaultDetectionCounter, operation=EvtInfo_DmTestAppl.GetFaultDetectionCounter
        OpEventGetFaultDetectionCounter_GetFaultDetectionCounter_Event_DmTestAppl: start-on-event=DemSatellite_0InternalBehavior/GetFaultDetectionCounter, operation=Event_DmTestAppl.GetFaultDetectionCounter
        OpEventGetFaultDetectionCounter_GetFaultDetectionCounter_EvtInfo_DmTestCom: start-on-event=DemSatellite_0InternalBehavior/GetFaultDetectionCounter, operation=EvtInfo_DmTestCom.GetFaultDetectionCounter
        OpEventGetFaultDetectionCounter_GetFaultDetectionCounter_Event_DmTestCom: start-on-event=DemSatellite_0InternalBehavior/GetFaultDetectionCounter, operation=Event_DmTestCom.GetFaultDetectionCounter
        OpEventGetFaultDetectionCounter_GetFaultDetectionCounter_EvtInfo_FrsmEClusterSyncLoss: start-on-event=DemSatellite_0InternalBehavior/GetFaultDetectionCounter, operation=EvtInfo_FrsmEClusterSyncLoss.GetFaultDetectionCounter
        OpEventGetFaultDetectionCounter_GetFaultDetectionCounter_Event_FrsmEClusterSyncLoss: start-on-event=DemSatellite_0InternalBehavior/GetFaultDetectionCounter, operation=Event_FrsmEClusterSyncLoss.GetFaultDetectionCounter
        OpEventGetFaultDetectionCounter_GetFaultDetectionCounter_EvtInfo_FrtrcvEFrBuserrorTrcv0: start-on-event=DemSatellite_0InternalBehavior/GetFaultDetectionCounter, operation=EvtInfo_FrtrcvEFrBuserrorTrcv0.GetFaultDetectionCounter
        OpEventGetFaultDetectionCounter_GetFaultDetectionCounter_Event_FrtrcvEFrBuserrorTrcv0: start-on-event=DemSatellite_0InternalBehavior/GetFaultDetectionCounter, operation=Event_FrtrcvEFrBuserrorTrcv0.GetFaultDetectionCounter
        OpEventGetFaultDetectionCounter_GetFaultDetectionCounter_EvtInfo_GlobalOvervoltageExt: start-on-event=DemSatellite_0InternalBehavior/GetFaultDetectionCounter, operation=EvtInfo_GlobalOvervoltageExt.GetFaultDetectionCounter
        OpEventGetFaultDetectionCounter_GetFaultDetectionCounter_Event_GlobalOvervoltageExt: start-on-event=DemSatellite_0InternalBehavior/GetFaultDetectionCounter, operation=Event_GlobalOvervoltageExt.GetFaultDetectionCounter
        OpEventGetFaultDetectionCounter_GetFaultDetectionCounter_EvtInfo_GlobalOvervoltageInt: start-on-event=DemSatellite_0InternalBehavior/GetFaultDetectionCounter, operation=EvtInfo_GlobalOvervoltageInt.GetFaultDetectionCounter
        OpEventGetFaultDetectionCounter_GetFaultDetectionCounter_Event_GlobalOvervoltageInt: start-on-event=DemSatellite_0InternalBehavior/GetFaultDetectionCounter, operation=Event_GlobalOvervoltageInt.GetFaultDetectionCounter
        OpEventGetFaultDetectionCounter_GetFaultDetectionCounter_EvtInfo_GlobalUndervoltageExt: start-on-event=DemSatellite_0InternalBehavior/GetFaultDetectionCounter, operation=EvtInfo_GlobalUndervoltageExt.GetFaultDetectionCounter
        OpEventGetFaultDetectionCounter_GetFaultDetectionCounter_Event_GlobalUndervoltageExt: start-on-event=DemSatellite_0InternalBehavior/GetFaultDetectionCounter, operation=Event_GlobalUndervoltageExt.GetFaultDetectionCounter
        OpEventGetFaultDetectionCounter_GetFaultDetectionCounter_EvtInfo_GlobalUndervoltageInt: start-on-event=DemSatellite_0InternalBehavior/GetFaultDetectionCounter, operation=EvtInfo_GlobalUndervoltageInt.GetFaultDetectionCounter
        OpEventGetFaultDetectionCounter_GetFaultDetectionCounter_Event_GlobalUndervoltageInt: start-on-event=DemSatellite_0InternalBehavior/GetFaultDetectionCounter, operation=Event_GlobalUndervoltageInt.GetFaultDetectionCounter
        OpEventGetFaultDetectionCounter_GetFaultDetectionCounter_EvtInfo_LocalOvervoltage: start-on-event=DemSatellite_0InternalBehavior/GetFaultDetectionCounter, operation=EvtInfo_LocalOvervoltage.GetFaultDetectionCounter
        OpEventGetFaultDetectionCounter_GetFaultDetectionCounter_Event_LocalOvervoltage: start-on-event=DemSatellite_0InternalBehavior/GetFaultDetectionCounter, operation=Event_LocalOvervoltage.GetFaultDetectionCounter
        OpEventGetFaultDetectionCounter_GetFaultDetectionCounter_EvtInfo_LocalUndervoltage: start-on-event=DemSatellite_0InternalBehavior/GetFaultDetectionCounter, operation=EvtInfo_LocalUndervoltage.GetFaultDetectionCounter
        OpEventGetFaultDetectionCounter_GetFaultDetectionCounter_Event_LocalUndervoltage: start-on-event=DemSatellite_0InternalBehavior/GetFaultDetectionCounter, operation=Event_LocalUndervoltage.GetFaultDetectionCounter
        OpEventGetFaultDetectionCounter_GetFaultDetectionCounter_EvtInfo_VsmEventOpmode: start-on-event=DemSatellite_0InternalBehavior/GetFaultDetectionCounter, operation=EvtInfo_VsmEventOpmode.GetFaultDetectionCounter
        OpEventGetFaultDetectionCounter_GetFaultDetectionCounter_Event_VsmEventOpmode: start-on-event=DemSatellite_0InternalBehavior/GetFaultDetectionCounter, operation=Event_VsmEventOpmode.GetFaultDetectionCounter
        OpEventGetFaultDetectionCounter_GetFaultDetectionCounter_GeneralEventInfo: start-on-event=DemSatellite_0InternalBehavior/GetFaultDetectionCounter, operation=GeneralEventInfo.GetFaultDetectionCounter
        OpEventGetEventFreezeFrameDataEx_GetEventFreezeFrameDataEx_EvtInfo_MCU_E_CLM_SELFDIAG_FAILURE: start-on-event=DemSatellite_0InternalBehavior/GetEventFreezeFrameDataEx, operation=EvtInfo_MCU_E_CLM_SELFDIAG_FAILURE.GetEventFreezeFrameDataEx
        OpEventGetEventFreezeFrameDataEx_GetEventFreezeFrameDataEx_EvtInfo_MCU_E_CLOCK_FAILURE: start-on-event=DemSatellite_0InternalBehavior/GetEventFreezeFrameDataEx, operation=EvtInfo_MCU_E_CLOCK_FAILURE.GetEventFreezeFrameDataEx
        OpEventGetEventFreezeFrameDataEx_GetEventFreezeFrameDataEx_EvtInfo_MCU_E_CVM_SELFDIAG_FAILURE: start-on-event=DemSatellite_0InternalBehavior/GetEventFreezeFrameDataEx, operation=EvtInfo_MCU_E_CVM_SELFDIAG_FAILURE.GetEventFreezeFrameDataEx
        OpEventGetEventFreezeFrameDataEx_GetEventFreezeFrameDataEx_EvtInfo_MCU_E_ECM_SELFDIAG_FAILURE: start-on-event=DemSatellite_0InternalBehavior/GetEventFreezeFrameDataEx, operation=EvtInfo_MCU_E_ECM_SELFDIAG_FAILURE.GetEventFreezeFrameDataEx
        OpEventGetEventFreezeFrameDataEx_GetEventFreezeFrameDataEx_EvtInfo_MCU_E_LOCKSTEP_SELFDIAG_FAILURE: start-on-event=DemSatellite_0InternalBehavior/GetEventFreezeFrameDataEx, operation=EvtInfo_MCU_E_LOCKSTEP_SELFDIAG_FAILURE.GetEventFreezeFrameDataEx
        OpEventGetEventFreezeFrameDataEx_GetEventFreezeFrameDataEx_EvtInfo_MCU_E_WRITE_TIMEOUT_FAILURE: start-on-event=DemSatellite_0InternalBehavior/GetEventFreezeFrameDataEx, operation=EvtInfo_MCU_E_WRITE_TIMEOUT_FAILURE.GetEventFreezeFrameDataEx
        OpEventGetEventFreezeFrameDataEx_GetEventFreezeFrameDataEx_EvtInfo_MCU_E_REG_WRITE_VERIFY: start-on-event=DemSatellite_0InternalBehavior/GetEventFreezeFrameDataEx, operation=EvtInfo_MCU_E_REG_WRITE_VERIFY.GetEventFreezeFrameDataEx
        OpEventGetEventFreezeFrameDataEx_GetEventFreezeFrameDataEx_EvtInfo_MCU_E_INT_INCONSISTENT: start-on-event=DemSatellite_0InternalBehavior/GetEventFreezeFrameDataEx, operation=EvtInfo_MCU_E_INT_INCONSISTENT.GetEventFreezeFrameDataEx
        OpEventGetEventFreezeFrameDataEx_GetEventFreezeFrameDataEx_EvtInfo_MCU_E_RESETCONTROLLER_STARTUP_FAILURE: start-on-event=DemSatellite_0InternalBehavior/GetEventFreezeFrameDataEx, operation=EvtInfo_MCU_E_RESETCONTROLLER_STARTUP_FAILURE.GetEventFreezeFrameDataEx
        OpEventGetEventFreezeFrameDataEx_GetEventFreezeFrameDataEx_EvtInfo_DIO_E_REG_WRITE_VERIFY: start-on-event=DemSatellite_0InternalBehavior/GetEventFreezeFrameDataEx, operation=EvtInfo_DIO_E_REG_WRITE_VERIFY.GetEventFreezeFrameDataEx
        OpEventGetEventFreezeFrameDataEx_GetEventFreezeFrameDataEx_EvtInfo_FLS_E_COMPARE_FAILED: start-on-event=DemSatellite_0InternalBehavior/GetEventFreezeFrameDataEx, operation=EvtInfo_FLS_E_COMPARE_FAILED.GetEventFreezeFrameDataEx
        OpEventGetEventFreezeFrameDataEx_GetEventFreezeFrameDataEx_EvtInfo_FLS_E_ERASE_FAILED: start-on-event=DemSatellite_0InternalBehavior/GetEventFreezeFrameDataEx, operation=EvtInfo_FLS_E_ERASE_FAILED.GetEventFreezeFrameDataEx
        OpEventGetEventFreezeFrameDataEx_GetEventFreezeFrameDataEx_EvtInfo_FLS_E_READ_FAILED: start-on-event=DemSatellite_0InternalBehavior/GetEventFreezeFrameDataEx, operation=EvtInfo_FLS_E_READ_FAILED.GetEventFreezeFrameDataEx
        OpEventGetEventFreezeFrameDataEx_GetEventFreezeFrameDataEx_EvtInfo_FLS_E_INT_INCONSISTENT: start-on-event=DemSatellite_0InternalBehavior/GetEventFreezeFrameDataEx, operation=EvtInfo_FLS_E_INT_INCONSISTENT.GetEventFreezeFrameDataEx
        OpEventGetEventFreezeFrameDataEx_GetEventFreezeFrameDataEx_EvtInfo_FLS_E_REG_WRITE_VERIFY: start-on-event=DemSatellite_0InternalBehavior/GetEventFreezeFrameDataEx, operation=EvtInfo_FLS_E_REG_WRITE_VERIFY.GetEventFreezeFrameDataEx
        OpEventGetEventFreezeFrameDataEx_GetEventFreezeFrameDataEx_EvtInfo_FLS_E_READ_FAILED_DED: start-on-event=DemSatellite_0InternalBehavior/GetEventFreezeFrameDataEx, operation=EvtInfo_FLS_E_READ_FAILED_DED.GetEventFreezeFrameDataEx
        OpEventGetEventFreezeFrameDataEx_GetEventFreezeFrameDataEx_EvtInfo_FLS_E_HW_FAILURE: start-on-event=DemSatellite_0InternalBehavior/GetEventFreezeFrameDataEx, operation=EvtInfo_FLS_E_HW_FAILURE.GetEventFreezeFrameDataEx
        OpEventGetEventFreezeFrameDataEx_GetEventFreezeFrameDataEx_EvtInfo_FLS_E_ECC_FAILED: start-on-event=DemSatellite_0InternalBehavior/GetEventFreezeFrameDataEx, operation=EvtInfo_FLS_E_ECC_FAILED.GetEventFreezeFrameDataEx
        OpEventGetEventFreezeFrameDataEx_GetEventFreezeFrameDataEx_EvtInfo_FLS_E_UNEXPECTED_FLASH_ID: start-on-event=DemSatellite_0InternalBehavior/GetEventFreezeFrameDataEx, operation=EvtInfo_FLS_E_UNEXPECTED_FLASH_ID.GetEventFreezeFrameDataEx
        OpEventGetEventFreezeFrameDataEx_GetEventFreezeFrameDataEx_EvtInfo_FLS_E_WRITE_FAILED: start-on-event=DemSatellite_0InternalBehavior/GetEventFreezeFrameDataEx, operation=EvtInfo_FLS_E_WRITE_FAILED.GetEventFreezeFrameDataEx
        OpEventGetEventFreezeFrameDataEx_GetEventFreezeFrameDataEx_EvtInfo_SPI_E_DATA_TX_TIMEOUT_FAILURE: start-on-event=DemSatellite_0InternalBehavior/GetEventFreezeFrameDataEx, operation=EvtInfo_SPI_E_DATA_TX_TIMEOUT_FAILURE.GetEventFreezeFrameDataEx
        OpEventGetEventFreezeFrameDataEx_GetEventFreezeFrameDataEx_EvtInfo_SPI_E_ECC_SELFTEST_FAILURE: start-on-event=DemSatellite_0InternalBehavior/GetEventFreezeFrameDataEx, operation=EvtInfo_SPI_E_ECC_SELFTEST_FAILURE.GetEventFreezeFrameDataEx
        OpEventGetEventFreezeFrameDataEx_GetEventFreezeFrameDataEx_EvtInfo_SPI_E_HARDWARE_ERROR: start-on-event=DemSatellite_0InternalBehavior/GetEventFreezeFrameDataEx, operation=EvtInfo_SPI_E_HARDWARE_ERROR.GetEventFreezeFrameDataEx
        OpEventGetEventFreezeFrameDataEx_GetEventFreezeFrameDataEx_EvtInfo_SPI_E_INT_INCONSISTENT: start-on-event=DemSatellite_0InternalBehavior/GetEventFreezeFrameDataEx, operation=EvtInfo_SPI_E_INT_INCONSISTENT.GetEventFreezeFrameDataEx
        OpEventGetEventFreezeFrameDataEx_GetEventFreezeFrameDataEx_EvtInfo_SPI_E_LOOPBACK_SELFTEST_FAILURE: start-on-event=DemSatellite_0InternalBehavior/GetEventFreezeFrameDataEx, operation=EvtInfo_SPI_E_LOOPBACK_SELFTEST_FAILURE.GetEventFreezeFrameDataEx
        OpEventGetEventFreezeFrameDataEx_GetEventFreezeFrameDataEx_EvtInfo_SPI_E_REG_WRITE_VERIFY: start-on-event=DemSatellite_0InternalBehavior/GetEventFreezeFrameDataEx, operation=EvtInfo_SPI_E_REG_WRITE_VERIFY.GetEventFreezeFrameDataEx
        OpEventGetEventFreezeFrameDataEx_GetEventFreezeFrameDataEx_EvtInfo_WDGM_E_IMPROPER_CALLER: start-on-event=DemSatellite_0InternalBehavior/GetEventFreezeFrameDataEx, operation=EvtInfo_WDGM_E_IMPROPER_CALLER.GetEventFreezeFrameDataEx
        OpEventGetEventFreezeFrameDataEx_GetEventFreezeFrameDataEx_EvtInfo_WDGM_E_MONITORING: start-on-event=DemSatellite_0InternalBehavior/GetEventFreezeFrameDataEx, operation=EvtInfo_WDGM_E_MONITORING.GetEventFreezeFrameDataEx
        OpEventGetEventFreezeFrameDataEx_GetEventFreezeFrameDataEx_EvtInfo_WDGM_E_SET_MODE: start-on-event=DemSatellite_0InternalBehavior/GetEventFreezeFrameDataEx, operation=EvtInfo_WDGM_E_SET_MODE.GetEventFreezeFrameDataEx
        OpEventGetEventFreezeFrameDataEx_GetEventFreezeFrameDataEx_EvtInfo_WDG_E_DISABLE_REJECTED: start-on-event=DemSatellite_0InternalBehavior/GetEventFreezeFrameDataEx, operation=EvtInfo_WDG_E_DISABLE_REJECTED.GetEventFreezeFrameDataEx
        OpEventGetEventFreezeFrameDataEx_GetEventFreezeFrameDataEx_EvtInfo_WDG_E_INT_INCONSISTENT: start-on-event=DemSatellite_0InternalBehavior/GetEventFreezeFrameDataEx, operation=EvtInfo_WDG_E_INT_INCONSISTENT.GetEventFreezeFrameDataEx
        OpEventGetEventFreezeFrameDataEx_GetEventFreezeFrameDataEx_EvtInfo_WDG_E_MODE_FAILED: start-on-event=DemSatellite_0InternalBehavior/GetEventFreezeFrameDataEx, operation=EvtInfo_WDG_E_MODE_FAILED.GetEventFreezeFrameDataEx
        OpEventGetEventFreezeFrameDataEx_GetEventFreezeFrameDataEx_EvtInfo_WDG_E_REG_WRITE_VERIFY: start-on-event=DemSatellite_0InternalBehavior/GetEventFreezeFrameDataEx, operation=EvtInfo_WDG_E_REG_WRITE_VERIFY.GetEventFreezeFrameDataEx
        OpEventGetEventFreezeFrameDataEx_GetEventFreezeFrameDataEx_EvtInfo_PORT_E_WRITE_TIMEOUT_FAILURE: start-on-event=DemSatellite_0InternalBehavior/GetEventFreezeFrameDataEx, operation=EvtInfo_PORT_E_WRITE_TIMEOUT_FAILURE.GetEventFreezeFrameDataEx
        OpEventGetEventFreezeFrameDataEx_GetEventFreezeFrameDataEx_EvtInfo_PORT_E_REG_WRITE_VERIFY: start-on-event=DemSatellite_0InternalBehavior/GetEventFreezeFrameDataEx, operation=EvtInfo_PORT_E_REG_WRITE_VERIFY.GetEventFreezeFrameDataEx
        OpEventGetEventFreezeFrameDataEx_GetEventFreezeFrameDataEx_EvtInfo_CodingEventNotCoded: start-on-event=DemSatellite_0InternalBehavior/GetEventFreezeFrameDataEx, operation=EvtInfo_CodingEventNotCoded.GetEventFreezeFrameDataEx
        OpEventGetEventFreezeFrameDataEx_GetEventFreezeFrameDataEx_Event_CodingEventNotCoded: start-on-event=DemSatellite_0InternalBehavior/GetEventFreezeFrameDataEx, operation=Event_CodingEventNotCoded.GetEventFreezeFrameDataEx
        OpEventGetEventFreezeFrameDataEx_GetEventFreezeFrameDataEx_EvtInfo_CodingEventUnqualifiedData: start-on-event=DemSatellite_0InternalBehavior/GetEventFreezeFrameDataEx, operation=EvtInfo_CodingEventUnqualifiedData.GetEventFreezeFrameDataEx
        OpEventGetEventFreezeFrameDataEx_GetEventFreezeFrameDataEx_Event_CodingEventUnqualifiedData: start-on-event=DemSatellite_0InternalBehavior/GetEventFreezeFrameDataEx, operation=Event_CodingEventUnqualifiedData.GetEventFreezeFrameDataEx
        OpEventGetEventFreezeFrameDataEx_GetEventFreezeFrameDataEx_EvtInfo_CodingEventWrongVehicle: start-on-event=DemSatellite_0InternalBehavior/GetEventFreezeFrameDataEx, operation=EvtInfo_CodingEventWrongVehicle.GetEventFreezeFrameDataEx
        OpEventGetEventFreezeFrameDataEx_GetEventFreezeFrameDataEx_Event_CodingEventWrongVehicle: start-on-event=DemSatellite_0InternalBehavior/GetEventFreezeFrameDataEx, operation=Event_CodingEventWrongVehicle.GetEventFreezeFrameDataEx
        OpEventGetEventFreezeFrameDataEx_GetEventFreezeFrameDataEx_EvtInfo_DmTestAppl: start-on-event=DemSatellite_0InternalBehavior/GetEventFreezeFrameDataEx, operation=EvtInfo_DmTestAppl.GetEventFreezeFrameDataEx
        OpEventGetEventFreezeFrameDataEx_GetEventFreezeFrameDataEx_Event_DmTestAppl: start-on-event=DemSatellite_0InternalBehavior/GetEventFreezeFrameDataEx, operation=Event_DmTestAppl.GetEventFreezeFrameDataEx
        OpEventGetEventFreezeFrameDataEx_GetEventFreezeFrameDataEx_EvtInfo_DmTestCom: start-on-event=DemSatellite_0InternalBehavior/GetEventFreezeFrameDataEx, operation=EvtInfo_DmTestCom.GetEventFreezeFrameDataEx
        OpEventGetEventFreezeFrameDataEx_GetEventFreezeFrameDataEx_Event_DmTestCom: start-on-event=DemSatellite_0InternalBehavior/GetEventFreezeFrameDataEx, operation=Event_DmTestCom.GetEventFreezeFrameDataEx
        OpEventGetEventFreezeFrameDataEx_GetEventFreezeFrameDataEx_EvtInfo_FrsmEClusterSyncLoss: start-on-event=DemSatellite_0InternalBehavior/GetEventFreezeFrameDataEx, operation=EvtInfo_FrsmEClusterSyncLoss.GetEventFreezeFrameDataEx
        OpEventGetEventFreezeFrameDataEx_GetEventFreezeFrameDataEx_Event_FrsmEClusterSyncLoss: start-on-event=DemSatellite_0InternalBehavior/GetEventFreezeFrameDataEx, operation=Event_FrsmEClusterSyncLoss.GetEventFreezeFrameDataEx
        OpEventGetEventFreezeFrameDataEx_GetEventFreezeFrameDataEx_EvtInfo_FrtrcvEFrBuserrorTrcv0: start-on-event=DemSatellite_0InternalBehavior/GetEventFreezeFrameDataEx, operation=EvtInfo_FrtrcvEFrBuserrorTrcv0.GetEventFreezeFrameDataEx
        OpEventGetEventFreezeFrameDataEx_GetEventFreezeFrameDataEx_Event_FrtrcvEFrBuserrorTrcv0: start-on-event=DemSatellite_0InternalBehavior/GetEventFreezeFrameDataEx, operation=Event_FrtrcvEFrBuserrorTrcv0.GetEventFreezeFrameDataEx
        OpEventGetEventFreezeFrameDataEx_GetEventFreezeFrameDataEx_EvtInfo_GlobalOvervoltageExt: start-on-event=DemSatellite_0InternalBehavior/GetEventFreezeFrameDataEx, operation=EvtInfo_GlobalOvervoltageExt.GetEventFreezeFrameDataEx
        OpEventGetEventFreezeFrameDataEx_GetEventFreezeFrameDataEx_Event_GlobalOvervoltageExt: start-on-event=DemSatellite_0InternalBehavior/GetEventFreezeFrameDataEx, operation=Event_GlobalOvervoltageExt.GetEventFreezeFrameDataEx
        OpEventGetEventFreezeFrameDataEx_GetEventFreezeFrameDataEx_EvtInfo_GlobalOvervoltageInt: start-on-event=DemSatellite_0InternalBehavior/GetEventFreezeFrameDataEx, operation=EvtInfo_GlobalOvervoltageInt.GetEventFreezeFrameDataEx
        OpEventGetEventFreezeFrameDataEx_GetEventFreezeFrameDataEx_Event_GlobalOvervoltageInt: start-on-event=DemSatellite_0InternalBehavior/GetEventFreezeFrameDataEx, operation=Event_GlobalOvervoltageInt.GetEventFreezeFrameDataEx
        OpEventGetEventFreezeFrameDataEx_GetEventFreezeFrameDataEx_EvtInfo_GlobalUndervoltageExt: start-on-event=DemSatellite_0InternalBehavior/GetEventFreezeFrameDataEx, operation=EvtInfo_GlobalUndervoltageExt.GetEventFreezeFrameDataEx
        OpEventGetEventFreezeFrameDataEx_GetEventFreezeFrameDataEx_Event_GlobalUndervoltageExt: start-on-event=DemSatellite_0InternalBehavior/GetEventFreezeFrameDataEx, operation=Event_GlobalUndervoltageExt.GetEventFreezeFrameDataEx
        OpEventGetEventFreezeFrameDataEx_GetEventFreezeFrameDataEx_EvtInfo_GlobalUndervoltageInt: start-on-event=DemSatellite_0InternalBehavior/GetEventFreezeFrameDataEx, operation=EvtInfo_GlobalUndervoltageInt.GetEventFreezeFrameDataEx
        OpEventGetEventFreezeFrameDataEx_GetEventFreezeFrameDataEx_Event_GlobalUndervoltageInt: start-on-event=DemSatellite_0InternalBehavior/GetEventFreezeFrameDataEx, operation=Event_GlobalUndervoltageInt.GetEventFreezeFrameDataEx
        OpEventGetEventFreezeFrameDataEx_GetEventFreezeFrameDataEx_EvtInfo_LocalOvervoltage: start-on-event=DemSatellite_0InternalBehavior/GetEventFreezeFrameDataEx, operation=EvtInfo_LocalOvervoltage.GetEventFreezeFrameDataEx
        OpEventGetEventFreezeFrameDataEx_GetEventFreezeFrameDataEx_Event_LocalOvervoltage: start-on-event=DemSatellite_0InternalBehavior/GetEventFreezeFrameDataEx, operation=Event_LocalOvervoltage.GetEventFreezeFrameDataEx
        OpEventGetEventFreezeFrameDataEx_GetEventFreezeFrameDataEx_EvtInfo_LocalUndervoltage: start-on-event=DemSatellite_0InternalBehavior/GetEventFreezeFrameDataEx, operation=EvtInfo_LocalUndervoltage.GetEventFreezeFrameDataEx
        OpEventGetEventFreezeFrameDataEx_GetEventFreezeFrameDataEx_Event_LocalUndervoltage: start-on-event=DemSatellite_0InternalBehavior/GetEventFreezeFrameDataEx, operation=Event_LocalUndervoltage.GetEventFreezeFrameDataEx
        OpEventGetEventFreezeFrameDataEx_GetEventFreezeFrameDataEx_EvtInfo_VsmEventOpmode: start-on-event=DemSatellite_0InternalBehavior/GetEventFreezeFrameDataEx, operation=EvtInfo_VsmEventOpmode.GetEventFreezeFrameDataEx
        OpEventGetEventFreezeFrameDataEx_GetEventFreezeFrameDataEx_Event_VsmEventOpmode: start-on-event=DemSatellite_0InternalBehavior/GetEventFreezeFrameDataEx, operation=Event_VsmEventOpmode.GetEventFreezeFrameDataEx
        OpEventGetEventFreezeFrameDataEx_GetEventFreezeFrameDataEx_GeneralEventInfo: start-on-event=DemSatellite_0InternalBehavior/GetEventFreezeFrameDataEx, operation=GeneralEventInfo.GetEventFreezeFrameDataEx
        OpEventGetEventExtendedDataRecordEx_GetEventExtendedDataRecordEx_EvtInfo_MCU_E_CLM_SELFDIAG_FAILURE: start-on-event=DemSatellite_0InternalBehavior/GetEventExtendedDataRecordEx, operation=EvtInfo_MCU_E_CLM_SELFDIAG_FAILURE.GetEventExtendedDataRecordEx
        OpEventGetEventExtendedDataRecordEx_GetEventExtendedDataRecordEx_EvtInfo_MCU_E_CLOCK_FAILURE: start-on-event=DemSatellite_0InternalBehavior/GetEventExtendedDataRecordEx, operation=EvtInfo_MCU_E_CLOCK_FAILURE.GetEventExtendedDataRecordEx
        OpEventGetEventExtendedDataRecordEx_GetEventExtendedDataRecordEx_EvtInfo_MCU_E_CVM_SELFDIAG_FAILURE: start-on-event=DemSatellite_0InternalBehavior/GetEventExtendedDataRecordEx, operation=EvtInfo_MCU_E_CVM_SELFDIAG_FAILURE.GetEventExtendedDataRecordEx
        OpEventGetEventExtendedDataRecordEx_GetEventExtendedDataRecordEx_EvtInfo_MCU_E_ECM_SELFDIAG_FAILURE: start-on-event=DemSatellite_0InternalBehavior/GetEventExtendedDataRecordEx, operation=EvtInfo_MCU_E_ECM_SELFDIAG_FAILURE.GetEventExtendedDataRecordEx
        OpEventGetEventExtendedDataRecordEx_GetEventExtendedDataRecordEx_EvtInfo_MCU_E_LOCKSTEP_SELFDIAG_FAILURE: start-on-event=DemSatellite_0InternalBehavior/GetEventExtendedDataRecordEx, operation=EvtInfo_MCU_E_LOCKSTEP_SELFDIAG_FAILURE.GetEventExtendedDataRecordEx
        OpEventGetEventExtendedDataRecordEx_GetEventExtendedDataRecordEx_EvtInfo_MCU_E_WRITE_TIMEOUT_FAILURE: start-on-event=DemSatellite_0InternalBehavior/GetEventExtendedDataRecordEx, operation=EvtInfo_MCU_E_WRITE_TIMEOUT_FAILURE.GetEventExtendedDataRecordEx
        OpEventGetEventExtendedDataRecordEx_GetEventExtendedDataRecordEx_EvtInfo_MCU_E_REG_WRITE_VERIFY: start-on-event=DemSatellite_0InternalBehavior/GetEventExtendedDataRecordEx, operation=EvtInfo_MCU_E_REG_WRITE_VERIFY.GetEventExtendedDataRecordEx
        OpEventGetEventExtendedDataRecordEx_GetEventExtendedDataRecordEx_EvtInfo_MCU_E_INT_INCONSISTENT: start-on-event=DemSatellite_0InternalBehavior/GetEventExtendedDataRecordEx, operation=EvtInfo_MCU_E_INT_INCONSISTENT.GetEventExtendedDataRecordEx
        OpEventGetEventExtendedDataRecordEx_GetEventExtendedDataRecordEx_EvtInfo_MCU_E_RESETCONTROLLER_STARTUP_FAILURE: start-on-event=DemSatellite_0InternalBehavior/GetEventExtendedDataRecordEx, operation=EvtInfo_MCU_E_RESETCONTROLLER_STARTUP_FAILURE.GetEventExtendedDataRecordEx
        OpEventGetEventExtendedDataRecordEx_GetEventExtendedDataRecordEx_EvtInfo_DIO_E_REG_WRITE_VERIFY: start-on-event=DemSatellite_0InternalBehavior/GetEventExtendedDataRecordEx, operation=EvtInfo_DIO_E_REG_WRITE_VERIFY.GetEventExtendedDataRecordEx
        OpEventGetEventExtendedDataRecordEx_GetEventExtendedDataRecordEx_EvtInfo_FLS_E_COMPARE_FAILED: start-on-event=DemSatellite_0InternalBehavior/GetEventExtendedDataRecordEx, operation=EvtInfo_FLS_E_COMPARE_FAILED.GetEventExtendedDataRecordEx
        OpEventGetEventExtendedDataRecordEx_GetEventExtendedDataRecordEx_EvtInfo_FLS_E_ERASE_FAILED: start-on-event=DemSatellite_0InternalBehavior/GetEventExtendedDataRecordEx, operation=EvtInfo_FLS_E_ERASE_FAILED.GetEventExtendedDataRecordEx
        OpEventGetEventExtendedDataRecordEx_GetEventExtendedDataRecordEx_EvtInfo_FLS_E_READ_FAILED: start-on-event=DemSatellite_0InternalBehavior/GetEventExtendedDataRecordEx, operation=EvtInfo_FLS_E_READ_FAILED.GetEventExtendedDataRecordEx
        OpEventGetEventExtendedDataRecordEx_GetEventExtendedDataRecordEx_EvtInfo_FLS_E_INT_INCONSISTENT: start-on-event=DemSatellite_0InternalBehavior/GetEventExtendedDataRecordEx, operation=EvtInfo_FLS_E_INT_INCONSISTENT.GetEventExtendedDataRecordEx
        OpEventGetEventExtendedDataRecordEx_GetEventExtendedDataRecordEx_EvtInfo_FLS_E_REG_WRITE_VERIFY: start-on-event=DemSatellite_0InternalBehavior/GetEventExtendedDataRecordEx, operation=EvtInfo_FLS_E_REG_WRITE_VERIFY.GetEventExtendedDataRecordEx
        OpEventGetEventExtendedDataRecordEx_GetEventExtendedDataRecordEx_EvtInfo_FLS_E_READ_FAILED_DED: start-on-event=DemSatellite_0InternalBehavior/GetEventExtendedDataRecordEx, operation=EvtInfo_FLS_E_READ_FAILED_DED.GetEventExtendedDataRecordEx
        OpEventGetEventExtendedDataRecordEx_GetEventExtendedDataRecordEx_EvtInfo_FLS_E_HW_FAILURE: start-on-event=DemSatellite_0InternalBehavior/GetEventExtendedDataRecordEx, operation=EvtInfo_FLS_E_HW_FAILURE.GetEventExtendedDataRecordEx
        OpEventGetEventExtendedDataRecordEx_GetEventExtendedDataRecordEx_EvtInfo_FLS_E_ECC_FAILED: start-on-event=DemSatellite_0InternalBehavior/GetEventExtendedDataRecordEx, operation=EvtInfo_FLS_E_ECC_FAILED.GetEventExtendedDataRecordEx
        OpEventGetEventExtendedDataRecordEx_GetEventExtendedDataRecordEx_EvtInfo_FLS_E_UNEXPECTED_FLASH_ID: start-on-event=DemSatellite_0InternalBehavior/GetEventExtendedDataRecordEx, operation=EvtInfo_FLS_E_UNEXPECTED_FLASH_ID.GetEventExtendedDataRecordEx
        OpEventGetEventExtendedDataRecordEx_GetEventExtendedDataRecordEx_EvtInfo_FLS_E_WRITE_FAILED: start-on-event=DemSatellite_0InternalBehavior/GetEventExtendedDataRecordEx, operation=EvtInfo_FLS_E_WRITE_FAILED.GetEventExtendedDataRecordEx
        OpEventGetEventExtendedDataRecordEx_GetEventExtendedDataRecordEx_EvtInfo_SPI_E_DATA_TX_TIMEOUT_FAILURE: start-on-event=DemSatellite_0InternalBehavior/GetEventExtendedDataRecordEx, operation=EvtInfo_SPI_E_DATA_TX_TIMEOUT_FAILURE.GetEventExtendedDataRecordEx
        OpEventGetEventExtendedDataRecordEx_GetEventExtendedDataRecordEx_EvtInfo_SPI_E_ECC_SELFTEST_FAILURE: start-on-event=DemSatellite_0InternalBehavior/GetEventExtendedDataRecordEx, operation=EvtInfo_SPI_E_ECC_SELFTEST_FAILURE.GetEventExtendedDataRecordEx
        OpEventGetEventExtendedDataRecordEx_GetEventExtendedDataRecordEx_EvtInfo_SPI_E_HARDWARE_ERROR: start-on-event=DemSatellite_0InternalBehavior/GetEventExtendedDataRecordEx, operation=EvtInfo_SPI_E_HARDWARE_ERROR.GetEventExtendedDataRecordEx
        OpEventGetEventExtendedDataRecordEx_GetEventExtendedDataRecordEx_EvtInfo_SPI_E_INT_INCONSISTENT: start-on-event=DemSatellite_0InternalBehavior/GetEventExtendedDataRecordEx, operation=EvtInfo_SPI_E_INT_INCONSISTENT.GetEventExtendedDataRecordEx
        OpEventGetEventExtendedDataRecordEx_GetEventExtendedDataRecordEx_EvtInfo_SPI_E_LOOPBACK_SELFTEST_FAILURE: start-on-event=DemSatellite_0InternalBehavior/GetEventExtendedDataRecordEx, operation=EvtInfo_SPI_E_LOOPBACK_SELFTEST_FAILURE.GetEventExtendedDataRecordEx
        OpEventGetEventExtendedDataRecordEx_GetEventExtendedDataRecordEx_EvtInfo_SPI_E_REG_WRITE_VERIFY: start-on-event=DemSatellite_0InternalBehavior/GetEventExtendedDataRecordEx, operation=EvtInfo_SPI_E_REG_WRITE_VERIFY.GetEventExtendedDataRecordEx
        OpEventGetEventExtendedDataRecordEx_GetEventExtendedDataRecordEx_EvtInfo_WDGM_E_IMPROPER_CALLER: start-on-event=DemSatellite_0InternalBehavior/GetEventExtendedDataRecordEx, operation=EvtInfo_WDGM_E_IMPROPER_CALLER.GetEventExtendedDataRecordEx
        OpEventGetEventExtendedDataRecordEx_GetEventExtendedDataRecordEx_EvtInfo_WDGM_E_MONITORING: start-on-event=DemSatellite_0InternalBehavior/GetEventExtendedDataRecordEx, operation=EvtInfo_WDGM_E_MONITORING.GetEventExtendedDataRecordEx
        OpEventGetEventExtendedDataRecordEx_GetEventExtendedDataRecordEx_EvtInfo_WDGM_E_SET_MODE: start-on-event=DemSatellite_0InternalBehavior/GetEventExtendedDataRecordEx, operation=EvtInfo_WDGM_E_SET_MODE.GetEventExtendedDataRecordEx
        OpEventGetEventExtendedDataRecordEx_GetEventExtendedDataRecordEx_EvtInfo_WDG_E_DISABLE_REJECTED: start-on-event=DemSatellite_0InternalBehavior/GetEventExtendedDataRecordEx, operation=EvtInfo_WDG_E_DISABLE_REJECTED.GetEventExtendedDataRecordEx
        OpEventGetEventExtendedDataRecordEx_GetEventExtendedDataRecordEx_EvtInfo_WDG_E_INT_INCONSISTENT: start-on-event=DemSatellite_0InternalBehavior/GetEventExtendedDataRecordEx, operation=EvtInfo_WDG_E_INT_INCONSISTENT.GetEventExtendedDataRecordEx
        OpEventGetEventExtendedDataRecordEx_GetEventExtendedDataRecordEx_EvtInfo_WDG_E_MODE_FAILED: start-on-event=DemSatellite_0InternalBehavior/GetEventExtendedDataRecordEx, operation=EvtInfo_WDG_E_MODE_FAILED.GetEventExtendedDataRecordEx
        OpEventGetEventExtendedDataRecordEx_GetEventExtendedDataRecordEx_EvtInfo_WDG_E_REG_WRITE_VERIFY: start-on-event=DemSatellite_0InternalBehavior/GetEventExtendedDataRecordEx, operation=EvtInfo_WDG_E_REG_WRITE_VERIFY.GetEventExtendedDataRecordEx
        OpEventGetEventExtendedDataRecordEx_GetEventExtendedDataRecordEx_EvtInfo_PORT_E_WRITE_TIMEOUT_FAILURE: start-on-event=DemSatellite_0InternalBehavior/GetEventExtendedDataRecordEx, operation=EvtInfo_PORT_E_WRITE_TIMEOUT_FAILURE.GetEventExtendedDataRecordEx
        OpEventGetEventExtendedDataRecordEx_GetEventExtendedDataRecordEx_EvtInfo_PORT_E_REG_WRITE_VERIFY: start-on-event=DemSatellite_0InternalBehavior/GetEventExtendedDataRecordEx, operation=EvtInfo_PORT_E_REG_WRITE_VERIFY.GetEventExtendedDataRecordEx
        OpEventGetEventExtendedDataRecordEx_GetEventExtendedDataRecordEx_EvtInfo_CodingEventNotCoded: start-on-event=DemSatellite_0InternalBehavior/GetEventExtendedDataRecordEx, operation=EvtInfo_CodingEventNotCoded.GetEventExtendedDataRecordEx
        OpEventGetEventExtendedDataRecordEx_GetEventExtendedDataRecordEx_Event_CodingEventNotCoded: start-on-event=DemSatellite_0InternalBehavior/GetEventExtendedDataRecordEx, operation=Event_CodingEventNotCoded.GetEventExtendedDataRecordEx
        OpEventGetEventExtendedDataRecordEx_GetEventExtendedDataRecordEx_EvtInfo_CodingEventUnqualifiedData: start-on-event=DemSatellite_0InternalBehavior/GetEventExtendedDataRecordEx, operation=EvtInfo_CodingEventUnqualifiedData.GetEventExtendedDataRecordEx
        OpEventGetEventExtendedDataRecordEx_GetEventExtendedDataRecordEx_Event_CodingEventUnqualifiedData: start-on-event=DemSatellite_0InternalBehavior/GetEventExtendedDataRecordEx, operation=Event_CodingEventUnqualifiedData.GetEventExtendedDataRecordEx
        OpEventGetEventExtendedDataRecordEx_GetEventExtendedDataRecordEx_EvtInfo_CodingEventWrongVehicle: start-on-event=DemSatellite_0InternalBehavior/GetEventExtendedDataRecordEx, operation=EvtInfo_CodingEventWrongVehicle.GetEventExtendedDataRecordEx
        OpEventGetEventExtendedDataRecordEx_GetEventExtendedDataRecordEx_Event_CodingEventWrongVehicle: start-on-event=DemSatellite_0InternalBehavior/GetEventExtendedDataRecordEx, operation=Event_CodingEventWrongVehicle.GetEventExtendedDataRecordEx
        OpEventGetEventExtendedDataRecordEx_GetEventExtendedDataRecordEx_EvtInfo_DmTestAppl: start-on-event=DemSatellite_0InternalBehavior/GetEventExtendedDataRecordEx, operation=EvtInfo_DmTestAppl.GetEventExtendedDataRecordEx
        OpEventGetEventExtendedDataRecordEx_GetEventExtendedDataRecordEx_Event_DmTestAppl: start-on-event=DemSatellite_0InternalBehavior/GetEventExtendedDataRecordEx, operation=Event_DmTestAppl.GetEventExtendedDataRecordEx
        OpEventGetEventExtendedDataRecordEx_GetEventExtendedDataRecordEx_EvtInfo_DmTestCom: start-on-event=DemSatellite_0InternalBehavior/GetEventExtendedDataRecordEx, operation=EvtInfo_DmTestCom.GetEventExtendedDataRecordEx
        OpEventGetEventExtendedDataRecordEx_GetEventExtendedDataRecordEx_Event_DmTestCom: start-on-event=DemSatellite_0InternalBehavior/GetEventExtendedDataRecordEx, operation=Event_DmTestCom.GetEventExtendedDataRecordEx
        OpEventGetEventExtendedDataRecordEx_GetEventExtendedDataRecordEx_EvtInfo_FrsmEClusterSyncLoss: start-on-event=DemSatellite_0InternalBehavior/GetEventExtendedDataRecordEx, operation=EvtInfo_FrsmEClusterSyncLoss.GetEventExtendedDataRecordEx
        OpEventGetEventExtendedDataRecordEx_GetEventExtendedDataRecordEx_Event_FrsmEClusterSyncLoss: start-on-event=DemSatellite_0InternalBehavior/GetEventExtendedDataRecordEx, operation=Event_FrsmEClusterSyncLoss.GetEventExtendedDataRecordEx
        OpEventGetEventExtendedDataRecordEx_GetEventExtendedDataRecordEx_EvtInfo_FrtrcvEFrBuserrorTrcv0: start-on-event=DemSatellite_0InternalBehavior/GetEventExtendedDataRecordEx, operation=EvtInfo_FrtrcvEFrBuserrorTrcv0.GetEventExtendedDataRecordEx
        OpEventGetEventExtendedDataRecordEx_GetEventExtendedDataRecordEx_Event_FrtrcvEFrBuserrorTrcv0: start-on-event=DemSatellite_0InternalBehavior/GetEventExtendedDataRecordEx, operation=Event_FrtrcvEFrBuserrorTrcv0.GetEventExtendedDataRecordEx
        OpEventGetEventExtendedDataRecordEx_GetEventExtendedDataRecordEx_EvtInfo_GlobalOvervoltageExt: start-on-event=DemSatellite_0InternalBehavior/GetEventExtendedDataRecordEx, operation=EvtInfo_GlobalOvervoltageExt.GetEventExtendedDataRecordEx
        OpEventGetEventExtendedDataRecordEx_GetEventExtendedDataRecordEx_Event_GlobalOvervoltageExt: start-on-event=DemSatellite_0InternalBehavior/GetEventExtendedDataRecordEx, operation=Event_GlobalOvervoltageExt.GetEventExtendedDataRecordEx
        OpEventGetEventExtendedDataRecordEx_GetEventExtendedDataRecordEx_EvtInfo_GlobalOvervoltageInt: start-on-event=DemSatellite_0InternalBehavior/GetEventExtendedDataRecordEx, operation=EvtInfo_GlobalOvervoltageInt.GetEventExtendedDataRecordEx
        OpEventGetEventExtendedDataRecordEx_GetEventExtendedDataRecordEx_Event_GlobalOvervoltageInt: start-on-event=DemSatellite_0InternalBehavior/GetEventExtendedDataRecordEx, operation=Event_GlobalOvervoltageInt.GetEventExtendedDataRecordEx
        OpEventGetEventExtendedDataRecordEx_GetEventExtendedDataRecordEx_EvtInfo_GlobalUndervoltageExt: start-on-event=DemSatellite_0InternalBehavior/GetEventExtendedDataRecordEx, operation=EvtInfo_GlobalUndervoltageExt.GetEventExtendedDataRecordEx
        OpEventGetEventExtendedDataRecordEx_GetEventExtendedDataRecordEx_Event_GlobalUndervoltageExt: start-on-event=DemSatellite_0InternalBehavior/GetEventExtendedDataRecordEx, operation=Event_GlobalUndervoltageExt.GetEventExtendedDataRecordEx
        OpEventGetEventExtendedDataRecordEx_GetEventExtendedDataRecordEx_EvtInfo_GlobalUndervoltageInt: start-on-event=DemSatellite_0InternalBehavior/GetEventExtendedDataRecordEx, operation=EvtInfo_GlobalUndervoltageInt.GetEventExtendedDataRecordEx
        OpEventGetEventExtendedDataRecordEx_GetEventExtendedDataRecordEx_Event_GlobalUndervoltageInt: start-on-event=DemSatellite_0InternalBehavior/GetEventExtendedDataRecordEx, operation=Event_GlobalUndervoltageInt.GetEventExtendedDataRecordEx
        OpEventGetEventExtendedDataRecordEx_GetEventExtendedDataRecordEx_EvtInfo_LocalOvervoltage: start-on-event=DemSatellite_0InternalBehavior/GetEventExtendedDataRecordEx, operation=EvtInfo_LocalOvervoltage.GetEventExtendedDataRecordEx
        OpEventGetEventExtendedDataRecordEx_GetEventExtendedDataRecordEx_Event_LocalOvervoltage: start-on-event=DemSatellite_0InternalBehavior/GetEventExtendedDataRecordEx, operation=Event_LocalOvervoltage.GetEventExtendedDataRecordEx
        OpEventGetEventExtendedDataRecordEx_GetEventExtendedDataRecordEx_EvtInfo_LocalUndervoltage: start-on-event=DemSatellite_0InternalBehavior/GetEventExtendedDataRecordEx, operation=EvtInfo_LocalUndervoltage.GetEventExtendedDataRecordEx
        OpEventGetEventExtendedDataRecordEx_GetEventExtendedDataRecordEx_Event_LocalUndervoltage: start-on-event=DemSatellite_0InternalBehavior/GetEventExtendedDataRecordEx, operation=Event_LocalUndervoltage.GetEventExtendedDataRecordEx
        OpEventGetEventExtendedDataRecordEx_GetEventExtendedDataRecordEx_EvtInfo_VsmEventOpmode: start-on-event=DemSatellite_0InternalBehavior/GetEventExtendedDataRecordEx, operation=EvtInfo_VsmEventOpmode.GetEventExtendedDataRecordEx
        OpEventGetEventExtendedDataRecordEx_GetEventExtendedDataRecordEx_Event_VsmEventOpmode: start-on-event=DemSatellite_0InternalBehavior/GetEventExtendedDataRecordEx, operation=Event_VsmEventOpmode.GetEventExtendedDataRecordEx
        OpEventGetEventExtendedDataRecordEx_GetEventExtendedDataRecordEx_GeneralEventInfo: start-on-event=DemSatellite_0InternalBehavior/GetEventExtendedDataRecordEx, operation=GeneralEventInfo.GetEventExtendedDataRecordEx
        OpEventGetEventEnableCondition_GetEventEnableCondition_EvtInfo_MCU_E_CLM_SELFDIAG_FAILURE: start-on-event=DemSatellite_0InternalBehavior/GetEventEnableCondition, operation=EvtInfo_MCU_E_CLM_SELFDIAG_FAILURE.GetEventEnableCondition
        OpEventGetEventEnableCondition_GetEventEnableCondition_EvtInfo_MCU_E_CLOCK_FAILURE: start-on-event=DemSatellite_0InternalBehavior/GetEventEnableCondition, operation=EvtInfo_MCU_E_CLOCK_FAILURE.GetEventEnableCondition
        OpEventGetEventEnableCondition_GetEventEnableCondition_EvtInfo_MCU_E_CVM_SELFDIAG_FAILURE: start-on-event=DemSatellite_0InternalBehavior/GetEventEnableCondition, operation=EvtInfo_MCU_E_CVM_SELFDIAG_FAILURE.GetEventEnableCondition
        OpEventGetEventEnableCondition_GetEventEnableCondition_EvtInfo_MCU_E_ECM_SELFDIAG_FAILURE: start-on-event=DemSatellite_0InternalBehavior/GetEventEnableCondition, operation=EvtInfo_MCU_E_ECM_SELFDIAG_FAILURE.GetEventEnableCondition
        OpEventGetEventEnableCondition_GetEventEnableCondition_EvtInfo_MCU_E_LOCKSTEP_SELFDIAG_FAILURE: start-on-event=DemSatellite_0InternalBehavior/GetEventEnableCondition, operation=EvtInfo_MCU_E_LOCKSTEP_SELFDIAG_FAILURE.GetEventEnableCondition
        OpEventGetEventEnableCondition_GetEventEnableCondition_EvtInfo_MCU_E_WRITE_TIMEOUT_FAILURE: start-on-event=DemSatellite_0InternalBehavior/GetEventEnableCondition, operation=EvtInfo_MCU_E_WRITE_TIMEOUT_FAILURE.GetEventEnableCondition
        OpEventGetEventEnableCondition_GetEventEnableCondition_EvtInfo_MCU_E_REG_WRITE_VERIFY: start-on-event=DemSatellite_0InternalBehavior/GetEventEnableCondition, operation=EvtInfo_MCU_E_REG_WRITE_VERIFY.GetEventEnableCondition
        OpEventGetEventEnableCondition_GetEventEnableCondition_EvtInfo_MCU_E_INT_INCONSISTENT: start-on-event=DemSatellite_0InternalBehavior/GetEventEnableCondition, operation=EvtInfo_MCU_E_INT_INCONSISTENT.GetEventEnableCondition
        OpEventGetEventEnableCondition_GetEventEnableCondition_EvtInfo_MCU_E_RESETCONTROLLER_STARTUP_FAILURE: start-on-event=DemSatellite_0InternalBehavior/GetEventEnableCondition, operation=EvtInfo_MCU_E_RESETCONTROLLER_STARTUP_FAILURE.GetEventEnableCondition
        OpEventGetEventEnableCondition_GetEventEnableCondition_EvtInfo_DIO_E_REG_WRITE_VERIFY: start-on-event=DemSatellite_0InternalBehavior/GetEventEnableCondition, operation=EvtInfo_DIO_E_REG_WRITE_VERIFY.GetEventEnableCondition
        OpEventGetEventEnableCondition_GetEventEnableCondition_EvtInfo_FLS_E_COMPARE_FAILED: start-on-event=DemSatellite_0InternalBehavior/GetEventEnableCondition, operation=EvtInfo_FLS_E_COMPARE_FAILED.GetEventEnableCondition
        OpEventGetEventEnableCondition_GetEventEnableCondition_EvtInfo_FLS_E_ERASE_FAILED: start-on-event=DemSatellite_0InternalBehavior/GetEventEnableCondition, operation=EvtInfo_FLS_E_ERASE_FAILED.GetEventEnableCondition
        OpEventGetEventEnableCondition_GetEventEnableCondition_EvtInfo_FLS_E_READ_FAILED: start-on-event=DemSatellite_0InternalBehavior/GetEventEnableCondition, operation=EvtInfo_FLS_E_READ_FAILED.GetEventEnableCondition
        OpEventGetEventEnableCondition_GetEventEnableCondition_EvtInfo_FLS_E_INT_INCONSISTENT: start-on-event=DemSatellite_0InternalBehavior/GetEventEnableCondition, operation=EvtInfo_FLS_E_INT_INCONSISTENT.GetEventEnableCondition
        OpEventGetEventEnableCondition_GetEventEnableCondition_EvtInfo_FLS_E_REG_WRITE_VERIFY: start-on-event=DemSatellite_0InternalBehavior/GetEventEnableCondition, operation=EvtInfo_FLS_E_REG_WRITE_VERIFY.GetEventEnableCondition
        OpEventGetEventEnableCondition_GetEventEnableCondition_EvtInfo_FLS_E_READ_FAILED_DED: start-on-event=DemSatellite_0InternalBehavior/GetEventEnableCondition, operation=EvtInfo_FLS_E_READ_FAILED_DED.GetEventEnableCondition
        OpEventGetEventEnableCondition_GetEventEnableCondition_EvtInfo_FLS_E_HW_FAILURE: start-on-event=DemSatellite_0InternalBehavior/GetEventEnableCondition, operation=EvtInfo_FLS_E_HW_FAILURE.GetEventEnableCondition
        OpEventGetEventEnableCondition_GetEventEnableCondition_EvtInfo_FLS_E_ECC_FAILED: start-on-event=DemSatellite_0InternalBehavior/GetEventEnableCondition, operation=EvtInfo_FLS_E_ECC_FAILED.GetEventEnableCondition
        OpEventGetEventEnableCondition_GetEventEnableCondition_EvtInfo_FLS_E_UNEXPECTED_FLASH_ID: start-on-event=DemSatellite_0InternalBehavior/GetEventEnableCondition, operation=EvtInfo_FLS_E_UNEXPECTED_FLASH_ID.GetEventEnableCondition
        OpEventGetEventEnableCondition_GetEventEnableCondition_EvtInfo_FLS_E_WRITE_FAILED: start-on-event=DemSatellite_0InternalBehavior/GetEventEnableCondition, operation=EvtInfo_FLS_E_WRITE_FAILED.GetEventEnableCondition
        OpEventGetEventEnableCondition_GetEventEnableCondition_EvtInfo_SPI_E_DATA_TX_TIMEOUT_FAILURE: start-on-event=DemSatellite_0InternalBehavior/GetEventEnableCondition, operation=EvtInfo_SPI_E_DATA_TX_TIMEOUT_FAILURE.GetEventEnableCondition
        OpEventGetEventEnableCondition_GetEventEnableCondition_EvtInfo_SPI_E_ECC_SELFTEST_FAILURE: start-on-event=DemSatellite_0InternalBehavior/GetEventEnableCondition, operation=EvtInfo_SPI_E_ECC_SELFTEST_FAILURE.GetEventEnableCondition
        OpEventGetEventEnableCondition_GetEventEnableCondition_EvtInfo_SPI_E_HARDWARE_ERROR: start-on-event=DemSatellite_0InternalBehavior/GetEventEnableCondition, operation=EvtInfo_SPI_E_HARDWARE_ERROR.GetEventEnableCondition
        OpEventGetEventEnableCondition_GetEventEnableCondition_EvtInfo_SPI_E_INT_INCONSISTENT: start-on-event=DemSatellite_0InternalBehavior/GetEventEnableCondition, operation=EvtInfo_SPI_E_INT_INCONSISTENT.GetEventEnableCondition
        OpEventGetEventEnableCondition_GetEventEnableCondition_EvtInfo_SPI_E_LOOPBACK_SELFTEST_FAILURE: start-on-event=DemSatellite_0InternalBehavior/GetEventEnableCondition, operation=EvtInfo_SPI_E_LOOPBACK_SELFTEST_FAILURE.GetEventEnableCondition
        OpEventGetEventEnableCondition_GetEventEnableCondition_EvtInfo_SPI_E_REG_WRITE_VERIFY: start-on-event=DemSatellite_0InternalBehavior/GetEventEnableCondition, operation=EvtInfo_SPI_E_REG_WRITE_VERIFY.GetEventEnableCondition
        OpEventGetEventEnableCondition_GetEventEnableCondition_EvtInfo_WDGM_E_IMPROPER_CALLER: start-on-event=DemSatellite_0InternalBehavior/GetEventEnableCondition, operation=EvtInfo_WDGM_E_IMPROPER_CALLER.GetEventEnableCondition
        OpEventGetEventEnableCondition_GetEventEnableCondition_EvtInfo_WDGM_E_MONITORING: start-on-event=DemSatellite_0InternalBehavior/GetEventEnableCondition, operation=EvtInfo_WDGM_E_MONITORING.GetEventEnableCondition
        OpEventGetEventEnableCondition_GetEventEnableCondition_EvtInfo_WDGM_E_SET_MODE: start-on-event=DemSatellite_0InternalBehavior/GetEventEnableCondition, operation=EvtInfo_WDGM_E_SET_MODE.GetEventEnableCondition
        OpEventGetEventEnableCondition_GetEventEnableCondition_EvtInfo_WDG_E_DISABLE_REJECTED: start-on-event=DemSatellite_0InternalBehavior/GetEventEnableCondition, operation=EvtInfo_WDG_E_DISABLE_REJECTED.GetEventEnableCondition
        OpEventGetEventEnableCondition_GetEventEnableCondition_EvtInfo_WDG_E_INT_INCONSISTENT: start-on-event=DemSatellite_0InternalBehavior/GetEventEnableCondition, operation=EvtInfo_WDG_E_INT_INCONSISTENT.GetEventEnableCondition
        OpEventGetEventEnableCondition_GetEventEnableCondition_EvtInfo_WDG_E_MODE_FAILED: start-on-event=DemSatellite_0InternalBehavior/GetEventEnableCondition, operation=EvtInfo_WDG_E_MODE_FAILED.GetEventEnableCondition
        OpEventGetEventEnableCondition_GetEventEnableCondition_EvtInfo_WDG_E_REG_WRITE_VERIFY: start-on-event=DemSatellite_0InternalBehavior/GetEventEnableCondition, operation=EvtInfo_WDG_E_REG_WRITE_VERIFY.GetEventEnableCondition
        OpEventGetEventEnableCondition_GetEventEnableCondition_EvtInfo_PORT_E_WRITE_TIMEOUT_FAILURE: start-on-event=DemSatellite_0InternalBehavior/GetEventEnableCondition, operation=EvtInfo_PORT_E_WRITE_TIMEOUT_FAILURE.GetEventEnableCondition
        OpEventGetEventEnableCondition_GetEventEnableCondition_EvtInfo_PORT_E_REG_WRITE_VERIFY: start-on-event=DemSatellite_0InternalBehavior/GetEventEnableCondition, operation=EvtInfo_PORT_E_REG_WRITE_VERIFY.GetEventEnableCondition
        OpEventGetEventEnableCondition_GetEventEnableCondition_EvtInfo_CodingEventNotCoded: start-on-event=DemSatellite_0InternalBehavior/GetEventEnableCondition, operation=EvtInfo_CodingEventNotCoded.GetEventEnableCondition
        OpEventGetEventEnableCondition_GetEventEnableCondition_EvtInfo_CodingEventUnqualifiedData: start-on-event=DemSatellite_0InternalBehavior/GetEventEnableCondition, operation=EvtInfo_CodingEventUnqualifiedData.GetEventEnableCondition
        OpEventGetEventEnableCondition_GetEventEnableCondition_EvtInfo_CodingEventWrongVehicle: start-on-event=DemSatellite_0InternalBehavior/GetEventEnableCondition, operation=EvtInfo_CodingEventWrongVehicle.GetEventEnableCondition
        OpEventGetEventEnableCondition_GetEventEnableCondition_EvtInfo_DmTestAppl: start-on-event=DemSatellite_0InternalBehavior/GetEventEnableCondition, operation=EvtInfo_DmTestAppl.GetEventEnableCondition
        OpEventGetEventEnableCondition_GetEventEnableCondition_EvtInfo_DmTestCom: start-on-event=DemSatellite_0InternalBehavior/GetEventEnableCondition, operation=EvtInfo_DmTestCom.GetEventEnableCondition
        OpEventGetEventEnableCondition_GetEventEnableCondition_EvtInfo_FrsmEClusterSyncLoss: start-on-event=DemSatellite_0InternalBehavior/GetEventEnableCondition, operation=EvtInfo_FrsmEClusterSyncLoss.GetEventEnableCondition
        OpEventGetEventEnableCondition_GetEventEnableCondition_EvtInfo_FrtrcvEFrBuserrorTrcv0: start-on-event=DemSatellite_0InternalBehavior/GetEventEnableCondition, operation=EvtInfo_FrtrcvEFrBuserrorTrcv0.GetEventEnableCondition
        OpEventGetEventEnableCondition_GetEventEnableCondition_EvtInfo_GlobalOvervoltageExt: start-on-event=DemSatellite_0InternalBehavior/GetEventEnableCondition, operation=EvtInfo_GlobalOvervoltageExt.GetEventEnableCondition
        OpEventGetEventEnableCondition_GetEventEnableCondition_EvtInfo_GlobalOvervoltageInt: start-on-event=DemSatellite_0InternalBehavior/GetEventEnableCondition, operation=EvtInfo_GlobalOvervoltageInt.GetEventEnableCondition
        OpEventGetEventEnableCondition_GetEventEnableCondition_EvtInfo_GlobalUndervoltageExt: start-on-event=DemSatellite_0InternalBehavior/GetEventEnableCondition, operation=EvtInfo_GlobalUndervoltageExt.GetEventEnableCondition
        OpEventGetEventEnableCondition_GetEventEnableCondition_EvtInfo_GlobalUndervoltageInt: start-on-event=DemSatellite_0InternalBehavior/GetEventEnableCondition, operation=EvtInfo_GlobalUndervoltageInt.GetEventEnableCondition
        OpEventGetEventEnableCondition_GetEventEnableCondition_EvtInfo_LocalOvervoltage: start-on-event=DemSatellite_0InternalBehavior/GetEventEnableCondition, operation=EvtInfo_LocalOvervoltage.GetEventEnableCondition
        OpEventGetEventEnableCondition_GetEventEnableCondition_EvtInfo_LocalUndervoltage: start-on-event=DemSatellite_0InternalBehavior/GetEventEnableCondition, operation=EvtInfo_LocalUndervoltage.GetEventEnableCondition
        OpEventGetEventEnableCondition_GetEventEnableCondition_EvtInfo_VsmEventOpmode: start-on-event=DemSatellite_0InternalBehavior/GetEventEnableCondition, operation=EvtInfo_VsmEventOpmode.GetEventEnableCondition
        OpEventGetEventEnableCondition_GetEventEnableCondition_GeneralEventInfo: start-on-event=DemSatellite_0InternalBehavior/GetEventEnableCondition, operation=GeneralEventInfo.GetEventEnableCondition
        OpEventGetDebouncingOfEvent_GetDebouncingOfEvent_EvtInfo_MCU_E_CLM_SELFDIAG_FAILURE: start-on-event=DemSatellite_0InternalBehavior/GetDebouncingOfEvent, operation=EvtInfo_MCU_E_CLM_SELFDIAG_FAILURE.GetDebouncingOfEvent
        OpEventGetDebouncingOfEvent_GetDebouncingOfEvent_EvtInfo_MCU_E_CLOCK_FAILURE: start-on-event=DemSatellite_0InternalBehavior/GetDebouncingOfEvent, operation=EvtInfo_MCU_E_CLOCK_FAILURE.GetDebouncingOfEvent
        OpEventGetDebouncingOfEvent_GetDebouncingOfEvent_EvtInfo_MCU_E_CVM_SELFDIAG_FAILURE: start-on-event=DemSatellite_0InternalBehavior/GetDebouncingOfEvent, operation=EvtInfo_MCU_E_CVM_SELFDIAG_FAILURE.GetDebouncingOfEvent
        OpEventGetDebouncingOfEvent_GetDebouncingOfEvent_EvtInfo_MCU_E_ECM_SELFDIAG_FAILURE: start-on-event=DemSatellite_0InternalBehavior/GetDebouncingOfEvent, operation=EvtInfo_MCU_E_ECM_SELFDIAG_FAILURE.GetDebouncingOfEvent
        OpEventGetDebouncingOfEvent_GetDebouncingOfEvent_EvtInfo_MCU_E_LOCKSTEP_SELFDIAG_FAILURE: start-on-event=DemSatellite_0InternalBehavior/GetDebouncingOfEvent, operation=EvtInfo_MCU_E_LOCKSTEP_SELFDIAG_FAILURE.GetDebouncingOfEvent
        OpEventGetDebouncingOfEvent_GetDebouncingOfEvent_EvtInfo_MCU_E_WRITE_TIMEOUT_FAILURE: start-on-event=DemSatellite_0InternalBehavior/GetDebouncingOfEvent, operation=EvtInfo_MCU_E_WRITE_TIMEOUT_FAILURE.GetDebouncingOfEvent
        OpEventGetDebouncingOfEvent_GetDebouncingOfEvent_EvtInfo_MCU_E_REG_WRITE_VERIFY: start-on-event=DemSatellite_0InternalBehavior/GetDebouncingOfEvent, operation=EvtInfo_MCU_E_REG_WRITE_VERIFY.GetDebouncingOfEvent
        OpEventGetDebouncingOfEvent_GetDebouncingOfEvent_EvtInfo_MCU_E_INT_INCONSISTENT: start-on-event=DemSatellite_0InternalBehavior/GetDebouncingOfEvent, operation=EvtInfo_MCU_E_INT_INCONSISTENT.GetDebouncingOfEvent
        OpEventGetDebouncingOfEvent_GetDebouncingOfEvent_EvtInfo_MCU_E_RESETCONTROLLER_STARTUP_FAILURE: start-on-event=DemSatellite_0InternalBehavior/GetDebouncingOfEvent, operation=EvtInfo_MCU_E_RESETCONTROLLER_STARTUP_FAILURE.GetDebouncingOfEvent
        OpEventGetDebouncingOfEvent_GetDebouncingOfEvent_EvtInfo_DIO_E_REG_WRITE_VERIFY: start-on-event=DemSatellite_0InternalBehavior/GetDebouncingOfEvent, operation=EvtInfo_DIO_E_REG_WRITE_VERIFY.GetDebouncingOfEvent
        OpEventGetDebouncingOfEvent_GetDebouncingOfEvent_EvtInfo_FLS_E_COMPARE_FAILED: start-on-event=DemSatellite_0InternalBehavior/GetDebouncingOfEvent, operation=EvtInfo_FLS_E_COMPARE_FAILED.GetDebouncingOfEvent
        OpEventGetDebouncingOfEvent_GetDebouncingOfEvent_EvtInfo_FLS_E_ERASE_FAILED: start-on-event=DemSatellite_0InternalBehavior/GetDebouncingOfEvent, operation=EvtInfo_FLS_E_ERASE_FAILED.GetDebouncingOfEvent
        OpEventGetDebouncingOfEvent_GetDebouncingOfEvent_EvtInfo_FLS_E_READ_FAILED: start-on-event=DemSatellite_0InternalBehavior/GetDebouncingOfEvent, operation=EvtInfo_FLS_E_READ_FAILED.GetDebouncingOfEvent
        OpEventGetDebouncingOfEvent_GetDebouncingOfEvent_EvtInfo_FLS_E_INT_INCONSISTENT: start-on-event=DemSatellite_0InternalBehavior/GetDebouncingOfEvent, operation=EvtInfo_FLS_E_INT_INCONSISTENT.GetDebouncingOfEvent
        OpEventGetDebouncingOfEvent_GetDebouncingOfEvent_EvtInfo_FLS_E_REG_WRITE_VERIFY: start-on-event=DemSatellite_0InternalBehavior/GetDebouncingOfEvent, operation=EvtInfo_FLS_E_REG_WRITE_VERIFY.GetDebouncingOfEvent
        OpEventGetDebouncingOfEvent_GetDebouncingOfEvent_EvtInfo_FLS_E_READ_FAILED_DED: start-on-event=DemSatellite_0InternalBehavior/GetDebouncingOfEvent, operation=EvtInfo_FLS_E_READ_FAILED_DED.GetDebouncingOfEvent
        OpEventGetDebouncingOfEvent_GetDebouncingOfEvent_EvtInfo_FLS_E_HW_FAILURE: start-on-event=DemSatellite_0InternalBehavior/GetDebouncingOfEvent, operation=EvtInfo_FLS_E_HW_FAILURE.GetDebouncingOfEvent
        OpEventGetDebouncingOfEvent_GetDebouncingOfEvent_EvtInfo_FLS_E_ECC_FAILED: start-on-event=DemSatellite_0InternalBehavior/GetDebouncingOfEvent, operation=EvtInfo_FLS_E_ECC_FAILED.GetDebouncingOfEvent
        OpEventGetDebouncingOfEvent_GetDebouncingOfEvent_EvtInfo_FLS_E_UNEXPECTED_FLASH_ID: start-on-event=DemSatellite_0InternalBehavior/GetDebouncingOfEvent, operation=EvtInfo_FLS_E_UNEXPECTED_FLASH_ID.GetDebouncingOfEvent
        OpEventGetDebouncingOfEvent_GetDebouncingOfEvent_EvtInfo_FLS_E_WRITE_FAILED: start-on-event=DemSatellite_0InternalBehavior/GetDebouncingOfEvent, operation=EvtInfo_FLS_E_WRITE_FAILED.GetDebouncingOfEvent
        OpEventGetDebouncingOfEvent_GetDebouncingOfEvent_EvtInfo_SPI_E_DATA_TX_TIMEOUT_FAILURE: start-on-event=DemSatellite_0InternalBehavior/GetDebouncingOfEvent, operation=EvtInfo_SPI_E_DATA_TX_TIMEOUT_FAILURE.GetDebouncingOfEvent
        OpEventGetDebouncingOfEvent_GetDebouncingOfEvent_EvtInfo_SPI_E_ECC_SELFTEST_FAILURE: start-on-event=DemSatellite_0InternalBehavior/GetDebouncingOfEvent, operation=EvtInfo_SPI_E_ECC_SELFTEST_FAILURE.GetDebouncingOfEvent
        OpEventGetDebouncingOfEvent_GetDebouncingOfEvent_EvtInfo_SPI_E_HARDWARE_ERROR: start-on-event=DemSatellite_0InternalBehavior/GetDebouncingOfEvent, operation=EvtInfo_SPI_E_HARDWARE_ERROR.GetDebouncingOfEvent
        OpEventGetDebouncingOfEvent_GetDebouncingOfEvent_EvtInfo_SPI_E_INT_INCONSISTENT: start-on-event=DemSatellite_0InternalBehavior/GetDebouncingOfEvent, operation=EvtInfo_SPI_E_INT_INCONSISTENT.GetDebouncingOfEvent
        OpEventGetDebouncingOfEvent_GetDebouncingOfEvent_EvtInfo_SPI_E_LOOPBACK_SELFTEST_FAILURE: start-on-event=DemSatellite_0InternalBehavior/GetDebouncingOfEvent, operation=EvtInfo_SPI_E_LOOPBACK_SELFTEST_FAILURE.GetDebouncingOfEvent
        OpEventGetDebouncingOfEvent_GetDebouncingOfEvent_EvtInfo_SPI_E_REG_WRITE_VERIFY: start-on-event=DemSatellite_0InternalBehavior/GetDebouncingOfEvent, operation=EvtInfo_SPI_E_REG_WRITE_VERIFY.GetDebouncingOfEvent
        OpEventGetDebouncingOfEvent_GetDebouncingOfEvent_EvtInfo_WDGM_E_IMPROPER_CALLER: start-on-event=DemSatellite_0InternalBehavior/GetDebouncingOfEvent, operation=EvtInfo_WDGM_E_IMPROPER_CALLER.GetDebouncingOfEvent
        OpEventGetDebouncingOfEvent_GetDebouncingOfEvent_EvtInfo_WDGM_E_MONITORING: start-on-event=DemSatellite_0InternalBehavior/GetDebouncingOfEvent, operation=EvtInfo_WDGM_E_MONITORING.GetDebouncingOfEvent
        OpEventGetDebouncingOfEvent_GetDebouncingOfEvent_EvtInfo_WDGM_E_SET_MODE: start-on-event=DemSatellite_0InternalBehavior/GetDebouncingOfEvent, operation=EvtInfo_WDGM_E_SET_MODE.GetDebouncingOfEvent
        OpEventGetDebouncingOfEvent_GetDebouncingOfEvent_EvtInfo_WDG_E_DISABLE_REJECTED: start-on-event=DemSatellite_0InternalBehavior/GetDebouncingOfEvent, operation=EvtInfo_WDG_E_DISABLE_REJECTED.GetDebouncingOfEvent
        OpEventGetDebouncingOfEvent_GetDebouncingOfEvent_EvtInfo_WDG_E_INT_INCONSISTENT: start-on-event=DemSatellite_0InternalBehavior/GetDebouncingOfEvent, operation=EvtInfo_WDG_E_INT_INCONSISTENT.GetDebouncingOfEvent
        OpEventGetDebouncingOfEvent_GetDebouncingOfEvent_EvtInfo_WDG_E_MODE_FAILED: start-on-event=DemSatellite_0InternalBehavior/GetDebouncingOfEvent, operation=EvtInfo_WDG_E_MODE_FAILED.GetDebouncingOfEvent
        OpEventGetDebouncingOfEvent_GetDebouncingOfEvent_EvtInfo_WDG_E_REG_WRITE_VERIFY: start-on-event=DemSatellite_0InternalBehavior/GetDebouncingOfEvent, operation=EvtInfo_WDG_E_REG_WRITE_VERIFY.GetDebouncingOfEvent
        OpEventGetDebouncingOfEvent_GetDebouncingOfEvent_EvtInfo_PORT_E_WRITE_TIMEOUT_FAILURE: start-on-event=DemSatellite_0InternalBehavior/GetDebouncingOfEvent, operation=EvtInfo_PORT_E_WRITE_TIMEOUT_FAILURE.GetDebouncingOfEvent
        OpEventGetDebouncingOfEvent_GetDebouncingOfEvent_EvtInfo_PORT_E_REG_WRITE_VERIFY: start-on-event=DemSatellite_0InternalBehavior/GetDebouncingOfEvent, operation=EvtInfo_PORT_E_REG_WRITE_VERIFY.GetDebouncingOfEvent
        OpEventGetDebouncingOfEvent_GetDebouncingOfEvent_EvtInfo_CodingEventNotCoded: start-on-event=DemSatellite_0InternalBehavior/GetDebouncingOfEvent, operation=EvtInfo_CodingEventNotCoded.GetDebouncingOfEvent
        OpEventGetDebouncingOfEvent_GetDebouncingOfEvent_EvtInfo_CodingEventUnqualifiedData: start-on-event=DemSatellite_0InternalBehavior/GetDebouncingOfEvent, operation=EvtInfo_CodingEventUnqualifiedData.GetDebouncingOfEvent
        OpEventGetDebouncingOfEvent_GetDebouncingOfEvent_EvtInfo_CodingEventWrongVehicle: start-on-event=DemSatellite_0InternalBehavior/GetDebouncingOfEvent, operation=EvtInfo_CodingEventWrongVehicle.GetDebouncingOfEvent
        OpEventGetDebouncingOfEvent_GetDebouncingOfEvent_EvtInfo_DmTestAppl: start-on-event=DemSatellite_0InternalBehavior/GetDebouncingOfEvent, operation=EvtInfo_DmTestAppl.GetDebouncingOfEvent
        OpEventGetDebouncingOfEvent_GetDebouncingOfEvent_EvtInfo_DmTestCom: start-on-event=DemSatellite_0InternalBehavior/GetDebouncingOfEvent, operation=EvtInfo_DmTestCom.GetDebouncingOfEvent
        OpEventGetDebouncingOfEvent_GetDebouncingOfEvent_EvtInfo_FrsmEClusterSyncLoss: start-on-event=DemSatellite_0InternalBehavior/GetDebouncingOfEvent, operation=EvtInfo_FrsmEClusterSyncLoss.GetDebouncingOfEvent
        OpEventGetDebouncingOfEvent_GetDebouncingOfEvent_EvtInfo_FrtrcvEFrBuserrorTrcv0: start-on-event=DemSatellite_0InternalBehavior/GetDebouncingOfEvent, operation=EvtInfo_FrtrcvEFrBuserrorTrcv0.GetDebouncingOfEvent
        OpEventGetDebouncingOfEvent_GetDebouncingOfEvent_EvtInfo_GlobalOvervoltageExt: start-on-event=DemSatellite_0InternalBehavior/GetDebouncingOfEvent, operation=EvtInfo_GlobalOvervoltageExt.GetDebouncingOfEvent
        OpEventGetDebouncingOfEvent_GetDebouncingOfEvent_EvtInfo_GlobalOvervoltageInt: start-on-event=DemSatellite_0InternalBehavior/GetDebouncingOfEvent, operation=EvtInfo_GlobalOvervoltageInt.GetDebouncingOfEvent
        OpEventGetDebouncingOfEvent_GetDebouncingOfEvent_EvtInfo_GlobalUndervoltageExt: start-on-event=DemSatellite_0InternalBehavior/GetDebouncingOfEvent, operation=EvtInfo_GlobalUndervoltageExt.GetDebouncingOfEvent
        OpEventGetDebouncingOfEvent_GetDebouncingOfEvent_EvtInfo_GlobalUndervoltageInt: start-on-event=DemSatellite_0InternalBehavior/GetDebouncingOfEvent, operation=EvtInfo_GlobalUndervoltageInt.GetDebouncingOfEvent
        OpEventGetDebouncingOfEvent_GetDebouncingOfEvent_EvtInfo_LocalOvervoltage: start-on-event=DemSatellite_0InternalBehavior/GetDebouncingOfEvent, operation=EvtInfo_LocalOvervoltage.GetDebouncingOfEvent
        OpEventGetDebouncingOfEvent_GetDebouncingOfEvent_EvtInfo_LocalUndervoltage: start-on-event=DemSatellite_0InternalBehavior/GetDebouncingOfEvent, operation=EvtInfo_LocalUndervoltage.GetDebouncingOfEvent
        OpEventGetDebouncingOfEvent_GetDebouncingOfEvent_EvtInfo_VsmEventOpmode: start-on-event=DemSatellite_0InternalBehavior/GetDebouncingOfEvent, operation=EvtInfo_VsmEventOpmode.GetDebouncingOfEvent
        OpEventGetDebouncingOfEvent_GetDebouncingOfEvent_GeneralEventInfo: start-on-event=DemSatellite_0InternalBehavior/GetDebouncingOfEvent, operation=GeneralEventInfo.GetDebouncingOfEvent
        OpEventGetMonitorStatus_GetMonitorStatus_EvtInfo_MCU_E_CLM_SELFDIAG_FAILURE: start-on-event=DemSatellite_0InternalBehavior/GetMonitorStatus, operation=EvtInfo_MCU_E_CLM_SELFDIAG_FAILURE.GetMonitorStatus
        OpEventGetMonitorStatus_GetMonitorStatus_EvtInfo_MCU_E_CLOCK_FAILURE: start-on-event=DemSatellite_0InternalBehavior/GetMonitorStatus, operation=EvtInfo_MCU_E_CLOCK_FAILURE.GetMonitorStatus
        OpEventGetMonitorStatus_GetMonitorStatus_EvtInfo_MCU_E_CVM_SELFDIAG_FAILURE: start-on-event=DemSatellite_0InternalBehavior/GetMonitorStatus, operation=EvtInfo_MCU_E_CVM_SELFDIAG_FAILURE.GetMonitorStatus
        OpEventGetMonitorStatus_GetMonitorStatus_EvtInfo_MCU_E_ECM_SELFDIAG_FAILURE: start-on-event=DemSatellite_0InternalBehavior/GetMonitorStatus, operation=EvtInfo_MCU_E_ECM_SELFDIAG_FAILURE.GetMonitorStatus
        OpEventGetMonitorStatus_GetMonitorStatus_EvtInfo_MCU_E_LOCKSTEP_SELFDIAG_FAILURE: start-on-event=DemSatellite_0InternalBehavior/GetMonitorStatus, operation=EvtInfo_MCU_E_LOCKSTEP_SELFDIAG_FAILURE.GetMonitorStatus
        OpEventGetMonitorStatus_GetMonitorStatus_EvtInfo_MCU_E_WRITE_TIMEOUT_FAILURE: start-on-event=DemSatellite_0InternalBehavior/GetMonitorStatus, operation=EvtInfo_MCU_E_WRITE_TIMEOUT_FAILURE.GetMonitorStatus
        OpEventGetMonitorStatus_GetMonitorStatus_EvtInfo_MCU_E_REG_WRITE_VERIFY: start-on-event=DemSatellite_0InternalBehavior/GetMonitorStatus, operation=EvtInfo_MCU_E_REG_WRITE_VERIFY.GetMonitorStatus
        OpEventGetMonitorStatus_GetMonitorStatus_EvtInfo_MCU_E_INT_INCONSISTENT: start-on-event=DemSatellite_0InternalBehavior/GetMonitorStatus, operation=EvtInfo_MCU_E_INT_INCONSISTENT.GetMonitorStatus
        OpEventGetMonitorStatus_GetMonitorStatus_EvtInfo_MCU_E_RESETCONTROLLER_STARTUP_FAILURE: start-on-event=DemSatellite_0InternalBehavior/GetMonitorStatus, operation=EvtInfo_MCU_E_RESETCONTROLLER_STARTUP_FAILURE.GetMonitorStatus
        OpEventGetMonitorStatus_GetMonitorStatus_EvtInfo_DIO_E_REG_WRITE_VERIFY: start-on-event=DemSatellite_0InternalBehavior/GetMonitorStatus, operation=EvtInfo_DIO_E_REG_WRITE_VERIFY.GetMonitorStatus
        OpEventGetMonitorStatus_GetMonitorStatus_EvtInfo_FLS_E_COMPARE_FAILED: start-on-event=DemSatellite_0InternalBehavior/GetMonitorStatus, operation=EvtInfo_FLS_E_COMPARE_FAILED.GetMonitorStatus
        OpEventGetMonitorStatus_GetMonitorStatus_EvtInfo_FLS_E_ERASE_FAILED: start-on-event=DemSatellite_0InternalBehavior/GetMonitorStatus, operation=EvtInfo_FLS_E_ERASE_FAILED.GetMonitorStatus
        OpEventGetMonitorStatus_GetMonitorStatus_EvtInfo_FLS_E_READ_FAILED: start-on-event=DemSatellite_0InternalBehavior/GetMonitorStatus, operation=EvtInfo_FLS_E_READ_FAILED.GetMonitorStatus
        OpEventGetMonitorStatus_GetMonitorStatus_EvtInfo_FLS_E_INT_INCONSISTENT: start-on-event=DemSatellite_0InternalBehavior/GetMonitorStatus, operation=EvtInfo_FLS_E_INT_INCONSISTENT.GetMonitorStatus
        OpEventGetMonitorStatus_GetMonitorStatus_EvtInfo_FLS_E_REG_WRITE_VERIFY: start-on-event=DemSatellite_0InternalBehavior/GetMonitorStatus, operation=EvtInfo_FLS_E_REG_WRITE_VERIFY.GetMonitorStatus
        OpEventGetMonitorStatus_GetMonitorStatus_EvtInfo_FLS_E_READ_FAILED_DED: start-on-event=DemSatellite_0InternalBehavior/GetMonitorStatus, operation=EvtInfo_FLS_E_READ_FAILED_DED.GetMonitorStatus
        OpEventGetMonitorStatus_GetMonitorStatus_EvtInfo_FLS_E_HW_FAILURE: start-on-event=DemSatellite_0InternalBehavior/GetMonitorStatus, operation=EvtInfo_FLS_E_HW_FAILURE.GetMonitorStatus
        OpEventGetMonitorStatus_GetMonitorStatus_EvtInfo_FLS_E_ECC_FAILED: start-on-event=DemSatellite_0InternalBehavior/GetMonitorStatus, operation=EvtInfo_FLS_E_ECC_FAILED.GetMonitorStatus
        OpEventGetMonitorStatus_GetMonitorStatus_EvtInfo_FLS_E_UNEXPECTED_FLASH_ID: start-on-event=DemSatellite_0InternalBehavior/GetMonitorStatus, operation=EvtInfo_FLS_E_UNEXPECTED_FLASH_ID.GetMonitorStatus
        OpEventGetMonitorStatus_GetMonitorStatus_EvtInfo_FLS_E_WRITE_FAILED: start-on-event=DemSatellite_0InternalBehavior/GetMonitorStatus, operation=EvtInfo_FLS_E_WRITE_FAILED.GetMonitorStatus
        OpEventGetMonitorStatus_GetMonitorStatus_EvtInfo_SPI_E_DATA_TX_TIMEOUT_FAILURE: start-on-event=DemSatellite_0InternalBehavior/GetMonitorStatus, operation=EvtInfo_SPI_E_DATA_TX_TIMEOUT_FAILURE.GetMonitorStatus
        OpEventGetMonitorStatus_GetMonitorStatus_EvtInfo_SPI_E_ECC_SELFTEST_FAILURE: start-on-event=DemSatellite_0InternalBehavior/GetMonitorStatus, operation=EvtInfo_SPI_E_ECC_SELFTEST_FAILURE.GetMonitorStatus
        OpEventGetMonitorStatus_GetMonitorStatus_EvtInfo_SPI_E_HARDWARE_ERROR: start-on-event=DemSatellite_0InternalBehavior/GetMonitorStatus, operation=EvtInfo_SPI_E_HARDWARE_ERROR.GetMonitorStatus
        OpEventGetMonitorStatus_GetMonitorStatus_EvtInfo_SPI_E_INT_INCONSISTENT: start-on-event=DemSatellite_0InternalBehavior/GetMonitorStatus, operation=EvtInfo_SPI_E_INT_INCONSISTENT.GetMonitorStatus
        OpEventGetMonitorStatus_GetMonitorStatus_EvtInfo_SPI_E_LOOPBACK_SELFTEST_FAILURE: start-on-event=DemSatellite_0InternalBehavior/GetMonitorStatus, operation=EvtInfo_SPI_E_LOOPBACK_SELFTEST_FAILURE.GetMonitorStatus
        OpEventGetMonitorStatus_GetMonitorStatus_EvtInfo_SPI_E_REG_WRITE_VERIFY: start-on-event=DemSatellite_0InternalBehavior/GetMonitorStatus, operation=EvtInfo_SPI_E_REG_WRITE_VERIFY.GetMonitorStatus
        OpEventGetMonitorStatus_GetMonitorStatus_EvtInfo_WDGM_E_IMPROPER_CALLER: start-on-event=DemSatellite_0InternalBehavior/GetMonitorStatus, operation=EvtInfo_WDGM_E_IMPROPER_CALLER.GetMonitorStatus
        OpEventGetMonitorStatus_GetMonitorStatus_EvtInfo_WDGM_E_MONITORING: start-on-event=DemSatellite_0InternalBehavior/GetMonitorStatus, operation=EvtInfo_WDGM_E_MONITORING.GetMonitorStatus
        OpEventGetMonitorStatus_GetMonitorStatus_EvtInfo_WDGM_E_SET_MODE: start-on-event=DemSatellite_0InternalBehavior/GetMonitorStatus, operation=EvtInfo_WDGM_E_SET_MODE.GetMonitorStatus
        OpEventGetMonitorStatus_GetMonitorStatus_EvtInfo_WDG_E_DISABLE_REJECTED: start-on-event=DemSatellite_0InternalBehavior/GetMonitorStatus, operation=EvtInfo_WDG_E_DISABLE_REJECTED.GetMonitorStatus
        OpEventGetMonitorStatus_GetMonitorStatus_EvtInfo_WDG_E_INT_INCONSISTENT: start-on-event=DemSatellite_0InternalBehavior/GetMonitorStatus, operation=EvtInfo_WDG_E_INT_INCONSISTENT.GetMonitorStatus
        OpEventGetMonitorStatus_GetMonitorStatus_EvtInfo_WDG_E_MODE_FAILED: start-on-event=DemSatellite_0InternalBehavior/GetMonitorStatus, operation=EvtInfo_WDG_E_MODE_FAILED.GetMonitorStatus
        OpEventGetMonitorStatus_GetMonitorStatus_EvtInfo_WDG_E_REG_WRITE_VERIFY: start-on-event=DemSatellite_0InternalBehavior/GetMonitorStatus, operation=EvtInfo_WDG_E_REG_WRITE_VERIFY.GetMonitorStatus
        OpEventGetMonitorStatus_GetMonitorStatus_EvtInfo_PORT_E_WRITE_TIMEOUT_FAILURE: start-on-event=DemSatellite_0InternalBehavior/GetMonitorStatus, operation=EvtInfo_PORT_E_WRITE_TIMEOUT_FAILURE.GetMonitorStatus
        OpEventGetMonitorStatus_GetMonitorStatus_EvtInfo_PORT_E_REG_WRITE_VERIFY: start-on-event=DemSatellite_0InternalBehavior/GetMonitorStatus, operation=EvtInfo_PORT_E_REG_WRITE_VERIFY.GetMonitorStatus
        OpEventGetMonitorStatus_GetMonitorStatus_EvtInfo_CodingEventNotCoded: start-on-event=DemSatellite_0InternalBehavior/GetMonitorStatus, operation=EvtInfo_CodingEventNotCoded.GetMonitorStatus
        OpEventGetMonitorStatus_GetMonitorStatus_EvtInfo_CodingEventUnqualifiedData: start-on-event=DemSatellite_0InternalBehavior/GetMonitorStatus, operation=EvtInfo_CodingEventUnqualifiedData.GetMonitorStatus
        OpEventGetMonitorStatus_GetMonitorStatus_EvtInfo_CodingEventWrongVehicle: start-on-event=DemSatellite_0InternalBehavior/GetMonitorStatus, operation=EvtInfo_CodingEventWrongVehicle.GetMonitorStatus
        OpEventGetMonitorStatus_GetMonitorStatus_EvtInfo_DmTestAppl: start-on-event=DemSatellite_0InternalBehavior/GetMonitorStatus, operation=EvtInfo_DmTestAppl.GetMonitorStatus
        OpEventGetMonitorStatus_GetMonitorStatus_EvtInfo_DmTestCom: start-on-event=DemSatellite_0InternalBehavior/GetMonitorStatus, operation=EvtInfo_DmTestCom.GetMonitorStatus
        OpEventGetMonitorStatus_GetMonitorStatus_EvtInfo_FrsmEClusterSyncLoss: start-on-event=DemSatellite_0InternalBehavior/GetMonitorStatus, operation=EvtInfo_FrsmEClusterSyncLoss.GetMonitorStatus
        OpEventGetMonitorStatus_GetMonitorStatus_EvtInfo_FrtrcvEFrBuserrorTrcv0: start-on-event=DemSatellite_0InternalBehavior/GetMonitorStatus, operation=EvtInfo_FrtrcvEFrBuserrorTrcv0.GetMonitorStatus
        OpEventGetMonitorStatus_GetMonitorStatus_EvtInfo_GlobalOvervoltageExt: start-on-event=DemSatellite_0InternalBehavior/GetMonitorStatus, operation=EvtInfo_GlobalOvervoltageExt.GetMonitorStatus
        OpEventGetMonitorStatus_GetMonitorStatus_EvtInfo_GlobalOvervoltageInt: start-on-event=DemSatellite_0InternalBehavior/GetMonitorStatus, operation=EvtInfo_GlobalOvervoltageInt.GetMonitorStatus
        OpEventGetMonitorStatus_GetMonitorStatus_EvtInfo_GlobalUndervoltageExt: start-on-event=DemSatellite_0InternalBehavior/GetMonitorStatus, operation=EvtInfo_GlobalUndervoltageExt.GetMonitorStatus
        OpEventGetMonitorStatus_GetMonitorStatus_EvtInfo_GlobalUndervoltageInt: start-on-event=DemSatellite_0InternalBehavior/GetMonitorStatus, operation=EvtInfo_GlobalUndervoltageInt.GetMonitorStatus
        OpEventGetMonitorStatus_GetMonitorStatus_EvtInfo_LocalOvervoltage: start-on-event=DemSatellite_0InternalBehavior/GetMonitorStatus, operation=EvtInfo_LocalOvervoltage.GetMonitorStatus
        OpEventGetMonitorStatus_GetMonitorStatus_EvtInfo_LocalUndervoltage: start-on-event=DemSatellite_0InternalBehavior/GetMonitorStatus, operation=EvtInfo_LocalUndervoltage.GetMonitorStatus
        OpEventGetMonitorStatus_GetMonitorStatus_EvtInfo_VsmEventOpmode: start-on-event=DemSatellite_0InternalBehavior/GetMonitorStatus, operation=EvtInfo_VsmEventOpmode.GetMonitorStatus
        OpEventGetMonitorStatus_GetMonitorStatus_GeneralEventInfo: start-on-event=DemSatellite_0InternalBehavior/GetMonitorStatus, operation=GeneralEventInfo.GetMonitorStatus
        OpEventSetEventStatus_SetEventStatus_Event_CodingEventNotCoded: start-on-event=SetEventStatus, operation=Event_CodingEventNotCoded.SetEventStatus
        OpEventSetEventStatus_SetEventStatus_Event_CodingEventUnqualifiedData: start-on-event=SetEventStatus, operation=Event_CodingEventUnqualifiedData.SetEventStatus
        OpEventSetEventStatus_SetEventStatus_Event_CodingEventWrongVehicle: start-on-event=SetEventStatus, operation=Event_CodingEventWrongVehicle.SetEventStatus
        OpEventSetEventStatus_SetEventStatus_Event_DmTestAppl: start-on-event=SetEventStatus, operation=Event_DmTestAppl.SetEventStatus
        OpEventSetEventStatus_SetEventStatus_Event_DmTestCom: start-on-event=SetEventStatus, operation=Event_DmTestCom.SetEventStatus
        OpEventSetEventStatus_SetEventStatus_Event_FrsmEClusterSyncLoss: start-on-event=SetEventStatus, operation=Event_FrsmEClusterSyncLoss.SetEventStatus
        OpEventSetEventStatus_SetEventStatus_Event_FrtrcvEFrBuserrorTrcv0: start-on-event=SetEventStatus, operation=Event_FrtrcvEFrBuserrorTrcv0.SetEventStatus
        OpEventSetEventStatus_SetEventStatus_Event_GlobalOvervoltageExt: start-on-event=SetEventStatus, operation=Event_GlobalOvervoltageExt.SetEventStatus
        OpEventSetEventStatus_SetEventStatus_Event_GlobalOvervoltageInt: start-on-event=SetEventStatus, operation=Event_GlobalOvervoltageInt.SetEventStatus
        OpEventSetEventStatus_SetEventStatus_Event_GlobalUndervoltageExt: start-on-event=SetEventStatus, operation=Event_GlobalUndervoltageExt.SetEventStatus
        OpEventSetEventStatus_SetEventStatus_Event_GlobalUndervoltageInt: start-on-event=SetEventStatus, operation=Event_GlobalUndervoltageInt.SetEventStatus
        OpEventSetEventStatus_SetEventStatus_Event_LocalOvervoltage: start-on-event=SetEventStatus, operation=Event_LocalOvervoltage.SetEventStatus
        OpEventSetEventStatus_SetEventStatus_Event_LocalUndervoltage: start-on-event=SetEventStatus, operation=Event_LocalUndervoltage.SetEventStatus
        OpEventSetEventStatus_SetEventStatus_Event_VsmEventOpmode: start-on-event=SetEventStatus, operation=Event_VsmEventOpmode.SetEventStatus
        OpEventResetEventStatus_ResetEventStatus_Event_CodingEventNotCoded: start-on-event=ResetEventStatus, operation=Event_CodingEventNotCoded.ResetEventStatus
        OpEventResetEventStatus_ResetEventStatus_Event_CodingEventUnqualifiedData: start-on-event=ResetEventStatus, operation=Event_CodingEventUnqualifiedData.ResetEventStatus
        OpEventResetEventStatus_ResetEventStatus_Event_CodingEventWrongVehicle: start-on-event=ResetEventStatus, operation=Event_CodingEventWrongVehicle.ResetEventStatus
        OpEventResetEventStatus_ResetEventStatus_Event_DmTestAppl: start-on-event=ResetEventStatus, operation=Event_DmTestAppl.ResetEventStatus
        OpEventResetEventStatus_ResetEventStatus_Event_DmTestCom: start-on-event=ResetEventStatus, operation=Event_DmTestCom.ResetEventStatus
        OpEventResetEventStatus_ResetEventStatus_Event_FrsmEClusterSyncLoss: start-on-event=ResetEventStatus, operation=Event_FrsmEClusterSyncLoss.ResetEventStatus
        OpEventResetEventStatus_ResetEventStatus_Event_FrtrcvEFrBuserrorTrcv0: start-on-event=ResetEventStatus, operation=Event_FrtrcvEFrBuserrorTrcv0.ResetEventStatus
        OpEventResetEventStatus_ResetEventStatus_Event_GlobalOvervoltageExt: start-on-event=ResetEventStatus, operation=Event_GlobalOvervoltageExt.ResetEventStatus
        OpEventResetEventStatus_ResetEventStatus_Event_GlobalOvervoltageInt: start-on-event=ResetEventStatus, operation=Event_GlobalOvervoltageInt.ResetEventStatus
        OpEventResetEventStatus_ResetEventStatus_Event_GlobalUndervoltageExt: start-on-event=ResetEventStatus, operation=Event_GlobalUndervoltageExt.ResetEventStatus
        OpEventResetEventStatus_ResetEventStatus_Event_GlobalUndervoltageInt: start-on-event=ResetEventStatus, operation=Event_GlobalUndervoltageInt.ResetEventStatus
        OpEventResetEventStatus_ResetEventStatus_Event_LocalOvervoltage: start-on-event=ResetEventStatus, operation=Event_LocalOvervoltage.ResetEventStatus
        OpEventResetEventStatus_ResetEventStatus_Event_LocalUndervoltage: start-on-event=ResetEventStatus, operation=Event_LocalUndervoltage.ResetEventStatus
        OpEventResetEventStatus_ResetEventStatus_Event_VsmEventOpmode: start-on-event=ResetEventStatus, operation=Event_VsmEventOpmode.ResetEventStatus
        OpEventResetEventDebounceStatus_ResetEventDebounceStatus_Event_CodingEventNotCoded: start-on-event=ResetEventDebounceStatus, operation=Event_CodingEventNotCoded.ResetEventDebounceStatus
        OpEventResetEventDebounceStatus_ResetEventDebounceStatus_Event_CodingEventUnqualifiedData: start-on-event=ResetEventDebounceStatus, operation=Event_CodingEventUnqualifiedData.ResetEventDebounceStatus
        OpEventResetEventDebounceStatus_ResetEventDebounceStatus_Event_CodingEventWrongVehicle: start-on-event=ResetEventDebounceStatus, operation=Event_CodingEventWrongVehicle.ResetEventDebounceStatus
        OpEventResetEventDebounceStatus_ResetEventDebounceStatus_Event_DmTestAppl: start-on-event=ResetEventDebounceStatus, operation=Event_DmTestAppl.ResetEventDebounceStatus
        OpEventResetEventDebounceStatus_ResetEventDebounceStatus_Event_DmTestCom: start-on-event=ResetEventDebounceStatus, operation=Event_DmTestCom.ResetEventDebounceStatus
        OpEventResetEventDebounceStatus_ResetEventDebounceStatus_Event_FrsmEClusterSyncLoss: start-on-event=ResetEventDebounceStatus, operation=Event_FrsmEClusterSyncLoss.ResetEventDebounceStatus
        OpEventResetEventDebounceStatus_ResetEventDebounceStatus_Event_FrtrcvEFrBuserrorTrcv0: start-on-event=ResetEventDebounceStatus, operation=Event_FrtrcvEFrBuserrorTrcv0.ResetEventDebounceStatus
        OpEventResetEventDebounceStatus_ResetEventDebounceStatus_Event_GlobalOvervoltageExt: start-on-event=ResetEventDebounceStatus, operation=Event_GlobalOvervoltageExt.ResetEventDebounceStatus
        OpEventResetEventDebounceStatus_ResetEventDebounceStatus_Event_GlobalOvervoltageInt: start-on-event=ResetEventDebounceStatus, operation=Event_GlobalOvervoltageInt.ResetEventDebounceStatus
        OpEventResetEventDebounceStatus_ResetEventDebounceStatus_Event_GlobalUndervoltageExt: start-on-event=ResetEventDebounceStatus, operation=Event_GlobalUndervoltageExt.ResetEventDebounceStatus
        OpEventResetEventDebounceStatus_ResetEventDebounceStatus_Event_GlobalUndervoltageInt: start-on-event=ResetEventDebounceStatus, operation=Event_GlobalUndervoltageInt.ResetEventDebounceStatus
        OpEventResetEventDebounceStatus_ResetEventDebounceStatus_Event_LocalOvervoltage: start-on-event=ResetEventDebounceStatus, operation=Event_LocalOvervoltage.ResetEventDebounceStatus
        OpEventResetEventDebounceStatus_ResetEventDebounceStatus_Event_LocalUndervoltage: start-on-event=ResetEventDebounceStatus, operation=Event_LocalUndervoltage.ResetEventDebounceStatus
        OpEventResetEventDebounceStatus_ResetEventDebounceStatus_Event_VsmEventOpmode: start-on-event=ResetEventDebounceStatus, operation=Event_VsmEventOpmode.ResetEventDebounceStatus
        OpEventGetEventUdsStatus_GetEventUdsStatus_EvtInfo_PriEve4822E4_SecEve21F100: start-on-event=DemSatellite_0InternalBehavior/GetEventUdsStatus, operation=EvtInfo_PriEve4822E4_SecEve21F100.GetEventUdsStatus
        OpEventGetEventUdsStatus_GetEventUdsStatus_Event_PriEve4822E4_SecEve21F100: start-on-event=DemSatellite_0InternalBehavior/GetEventUdsStatus, operation=Event_PriEve4822E4_SecEve21F100.GetEventUdsStatus
        OpEventGetEventUdsStatus_GetEventUdsStatus_EvtInfo_PriEve4822E4_SecEve31F100: start-on-event=DemSatellite_0InternalBehavior/GetEventUdsStatus, operation=EvtInfo_PriEve4822E4_SecEve31F100.GetEventUdsStatus
        OpEventGetEventUdsStatus_GetEventUdsStatus_Event_PriEve4822E4_SecEve31F100: start-on-event=DemSatellite_0InternalBehavior/GetEventUdsStatus, operation=Event_PriEve4822E4_SecEve31F100.GetEventUdsStatus
        OpEventGetEventUdsStatus_GetEventUdsStatus_EvtInfo_PriEve4822F5_SecEve21F300: start-on-event=DemSatellite_0InternalBehavior/GetEventUdsStatus, operation=EvtInfo_PriEve4822F5_SecEve21F300.GetEventUdsStatus
        OpEventGetEventUdsStatus_GetEventUdsStatus_Event_PriEve4822F5_SecEve21F300: start-on-event=DemSatellite_0InternalBehavior/GetEventUdsStatus, operation=Event_PriEve4822F5_SecEve21F300.GetEventUdsStatus
        OpEventGetEventUdsStatus_GetEventUdsStatus_EvtInfo_PriEve4822F5_SecEve31F300: start-on-event=DemSatellite_0InternalBehavior/GetEventUdsStatus, operation=EvtInfo_PriEve4822F5_SecEve31F300.GetEventUdsStatus
        OpEventGetEventUdsStatus_GetEventUdsStatus_Event_PriEve4822F5_SecEve31F300: start-on-event=DemSatellite_0InternalBehavior/GetEventUdsStatus, operation=Event_PriEve4822F5_SecEve31F300.GetEventUdsStatus
        OpEventGetEventUdsStatus_GetEventUdsStatus_EvtInfo_SecondaryEve_20F300: start-on-event=DemSatellite_0InternalBehavior/GetEventUdsStatus, operation=EvtInfo_SecondaryEve_20F300.GetEventUdsStatus
        OpEventGetEventUdsStatus_GetEventUdsStatus_Event_SecondaryEve_20F300: start-on-event=DemSatellite_0InternalBehavior/GetEventUdsStatus, operation=Event_SecondaryEve_20F300.GetEventUdsStatus
        OpEventGetEventUdsStatus_GetEventUdsStatus_EvtInfo_SecondaryEve_21F100: start-on-event=DemSatellite_0InternalBehavior/GetEventUdsStatus, operation=EvtInfo_SecondaryEve_21F100.GetEventUdsStatus
        OpEventGetEventUdsStatus_GetEventUdsStatus_Event_SecondaryEve_21F100: start-on-event=DemSatellite_0InternalBehavior/GetEventUdsStatus, operation=Event_SecondaryEve_21F100.GetEventUdsStatus
        OpEventGetEventUdsStatus_GetEventUdsStatus_EvtInfo_SecondaryEve_21F300: start-on-event=DemSatellite_0InternalBehavior/GetEventUdsStatus, operation=EvtInfo_SecondaryEve_21F300.GetEventUdsStatus
        OpEventGetEventUdsStatus_GetEventUdsStatus_Event_SecondaryEve_21F300: start-on-event=DemSatellite_0InternalBehavior/GetEventUdsStatus, operation=Event_SecondaryEve_21F300.GetEventUdsStatus
        OpEventGetEventUdsStatus_GetEventUdsStatus_EvtInfo_SecondaryEve_30F300: start-on-event=DemSatellite_0InternalBehavior/GetEventUdsStatus, operation=EvtInfo_SecondaryEve_30F300.GetEventUdsStatus
        OpEventGetEventUdsStatus_GetEventUdsStatus_Event_SecondaryEve_30F300: start-on-event=DemSatellite_0InternalBehavior/GetEventUdsStatus, operation=Event_SecondaryEve_30F300.GetEventUdsStatus
        OpEventGetEventUdsStatus_GetEventUdsStatus_EvtInfo_SecondaryEve_31F100: start-on-event=DemSatellite_0InternalBehavior/GetEventUdsStatus, operation=EvtInfo_SecondaryEve_31F100.GetEventUdsStatus
        OpEventGetEventUdsStatus_GetEventUdsStatus_Event_SecondaryEve_31F100: start-on-event=DemSatellite_0InternalBehavior/GetEventUdsStatus, operation=Event_SecondaryEve_31F100.GetEventUdsStatus
        OpEventGetEventUdsStatus_GetEventUdsStatus_EvtInfo_SecondaryEve_31F300: start-on-event=DemSatellite_0InternalBehavior/GetEventUdsStatus, operation=EvtInfo_SecondaryEve_31F300.GetEventUdsStatus
        OpEventGetEventUdsStatus_GetEventUdsStatus_Event_SecondaryEve_31F300: start-on-event=DemSatellite_0InternalBehavior/GetEventUdsStatus, operation=Event_SecondaryEve_31F300.GetEventUdsStatus
        OpEventGetEventStatus_GetEventStatus_EvtInfo_PriEve4822E4_SecEve21F100: start-on-event=DemSatellite_0InternalBehavior/GetEventStatus, operation=EvtInfo_PriEve4822E4_SecEve21F100.GetEventStatus
        OpEventGetEventStatus_GetEventStatus_Event_PriEve4822E4_SecEve21F100: start-on-event=DemSatellite_0InternalBehavior/GetEventStatus, operation=Event_PriEve4822E4_SecEve21F100.GetEventStatus
        OpEventGetEventStatus_GetEventStatus_EvtInfo_PriEve4822E4_SecEve31F100: start-on-event=DemSatellite_0InternalBehavior/GetEventStatus, operation=EvtInfo_PriEve4822E4_SecEve31F100.GetEventStatus
        OpEventGetEventStatus_GetEventStatus_Event_PriEve4822E4_SecEve31F100: start-on-event=DemSatellite_0InternalBehavior/GetEventStatus, operation=Event_PriEve4822E4_SecEve31F100.GetEventStatus
        OpEventGetEventStatus_GetEventStatus_EvtInfo_PriEve4822F5_SecEve21F300: start-on-event=DemSatellite_0InternalBehavior/GetEventStatus, operation=EvtInfo_PriEve4822F5_SecEve21F300.GetEventStatus
        OpEventGetEventStatus_GetEventStatus_Event_PriEve4822F5_SecEve21F300: start-on-event=DemSatellite_0InternalBehavior/GetEventStatus, operation=Event_PriEve4822F5_SecEve21F300.GetEventStatus
        OpEventGetEventStatus_GetEventStatus_EvtInfo_PriEve4822F5_SecEve31F300: start-on-event=DemSatellite_0InternalBehavior/GetEventStatus, operation=EvtInfo_PriEve4822F5_SecEve31F300.GetEventStatus
        OpEventGetEventStatus_GetEventStatus_Event_PriEve4822F5_SecEve31F300: start-on-event=DemSatellite_0InternalBehavior/GetEventStatus, operation=Event_PriEve4822F5_SecEve31F300.GetEventStatus
        OpEventGetEventStatus_GetEventStatus_EvtInfo_SecondaryEve_20F300: start-on-event=DemSatellite_0InternalBehavior/GetEventStatus, operation=EvtInfo_SecondaryEve_20F300.GetEventStatus
        OpEventGetEventStatus_GetEventStatus_Event_SecondaryEve_20F300: start-on-event=DemSatellite_0InternalBehavior/GetEventStatus, operation=Event_SecondaryEve_20F300.GetEventStatus
        OpEventGetEventStatus_GetEventStatus_EvtInfo_SecondaryEve_21F100: start-on-event=DemSatellite_0InternalBehavior/GetEventStatus, operation=EvtInfo_SecondaryEve_21F100.GetEventStatus
        OpEventGetEventStatus_GetEventStatus_Event_SecondaryEve_21F100: start-on-event=DemSatellite_0InternalBehavior/GetEventStatus, operation=Event_SecondaryEve_21F100.GetEventStatus
        OpEventGetEventStatus_GetEventStatus_EvtInfo_SecondaryEve_21F300: start-on-event=DemSatellite_0InternalBehavior/GetEventStatus, operation=EvtInfo_SecondaryEve_21F300.GetEventStatus
        OpEventGetEventStatus_GetEventStatus_Event_SecondaryEve_21F300: start-on-event=DemSatellite_0InternalBehavior/GetEventStatus, operation=Event_SecondaryEve_21F300.GetEventStatus
        OpEventGetEventStatus_GetEventStatus_EvtInfo_SecondaryEve_30F300: start-on-event=DemSatellite_0InternalBehavior/GetEventStatus, operation=EvtInfo_SecondaryEve_30F300.GetEventStatus
        OpEventGetEventStatus_GetEventStatus_Event_SecondaryEve_30F300: start-on-event=DemSatellite_0InternalBehavior/GetEventStatus, operation=Event_SecondaryEve_30F300.GetEventStatus
        OpEventGetEventStatus_GetEventStatus_EvtInfo_SecondaryEve_31F100: start-on-event=DemSatellite_0InternalBehavior/GetEventStatus, operation=EvtInfo_SecondaryEve_31F100.GetEventStatus
        OpEventGetEventStatus_GetEventStatus_Event_SecondaryEve_31F100: start-on-event=DemSatellite_0InternalBehavior/GetEventStatus, operation=Event_SecondaryEve_31F100.GetEventStatus
        OpEventGetEventStatus_GetEventStatus_EvtInfo_SecondaryEve_31F300: start-on-event=DemSatellite_0InternalBehavior/GetEventStatus, operation=EvtInfo_SecondaryEve_31F300.GetEventStatus
        OpEventGetEventStatus_GetEventStatus_Event_SecondaryEve_31F300: start-on-event=DemSatellite_0InternalBehavior/GetEventStatus, operation=Event_SecondaryEve_31F300.GetEventStatus
        OpEventGetEventFailed_GetEventFailed_EvtInfo_PriEve4822E4_SecEve21F100: start-on-event=DemSatellite_0InternalBehavior/GetEventFailed, operation=EvtInfo_PriEve4822E4_SecEve21F100.GetEventFailed
        OpEventGetEventFailed_GetEventFailed_Event_PriEve4822E4_SecEve21F100: start-on-event=DemSatellite_0InternalBehavior/GetEventFailed, operation=Event_PriEve4822E4_SecEve21F100.GetEventFailed
        OpEventGetEventFailed_GetEventFailed_EvtInfo_PriEve4822E4_SecEve31F100: start-on-event=DemSatellite_0InternalBehavior/GetEventFailed, operation=EvtInfo_PriEve4822E4_SecEve31F100.GetEventFailed
        OpEventGetEventFailed_GetEventFailed_Event_PriEve4822E4_SecEve31F100: start-on-event=DemSatellite_0InternalBehavior/GetEventFailed, operation=Event_PriEve4822E4_SecEve31F100.GetEventFailed
        OpEventGetEventFailed_GetEventFailed_EvtInfo_PriEve4822F5_SecEve21F300: start-on-event=DemSatellite_0InternalBehavior/GetEventFailed, operation=EvtInfo_PriEve4822F5_SecEve21F300.GetEventFailed
        OpEventGetEventFailed_GetEventFailed_Event_PriEve4822F5_SecEve21F300: start-on-event=DemSatellite_0InternalBehavior/GetEventFailed, operation=Event_PriEve4822F5_SecEve21F300.GetEventFailed
        OpEventGetEventFailed_GetEventFailed_EvtInfo_PriEve4822F5_SecEve31F300: start-on-event=DemSatellite_0InternalBehavior/GetEventFailed, operation=EvtInfo_PriEve4822F5_SecEve31F300.GetEventFailed
        OpEventGetEventFailed_GetEventFailed_Event_PriEve4822F5_SecEve31F300: start-on-event=DemSatellite_0InternalBehavior/GetEventFailed, operation=Event_PriEve4822F5_SecEve31F300.GetEventFailed
        OpEventGetEventFailed_GetEventFailed_EvtInfo_SecondaryEve_20F300: start-on-event=DemSatellite_0InternalBehavior/GetEventFailed, operation=EvtInfo_SecondaryEve_20F300.GetEventFailed
        OpEventGetEventFailed_GetEventFailed_Event_SecondaryEve_20F300: start-on-event=DemSatellite_0InternalBehavior/GetEventFailed, operation=Event_SecondaryEve_20F300.GetEventFailed
        OpEventGetEventFailed_GetEventFailed_EvtInfo_SecondaryEve_21F100: start-on-event=DemSatellite_0InternalBehavior/GetEventFailed, operation=EvtInfo_SecondaryEve_21F100.GetEventFailed
        OpEventGetEventFailed_GetEventFailed_Event_SecondaryEve_21F100: start-on-event=DemSatellite_0InternalBehavior/GetEventFailed, operation=Event_SecondaryEve_21F100.GetEventFailed
        OpEventGetEventFailed_GetEventFailed_EvtInfo_SecondaryEve_21F300: start-on-event=DemSatellite_0InternalBehavior/GetEventFailed, operation=EvtInfo_SecondaryEve_21F300.GetEventFailed
        OpEventGetEventFailed_GetEventFailed_Event_SecondaryEve_21F300: start-on-event=DemSatellite_0InternalBehavior/GetEventFailed, operation=Event_SecondaryEve_21F300.GetEventFailed
        OpEventGetEventFailed_GetEventFailed_EvtInfo_SecondaryEve_30F300: start-on-event=DemSatellite_0InternalBehavior/GetEventFailed, operation=EvtInfo_SecondaryEve_30F300.GetEventFailed
        OpEventGetEventFailed_GetEventFailed_Event_SecondaryEve_30F300: start-on-event=DemSatellite_0InternalBehavior/GetEventFailed, operation=Event_SecondaryEve_30F300.GetEventFailed
        OpEventGetEventFailed_GetEventFailed_EvtInfo_SecondaryEve_31F100: start-on-event=DemSatellite_0InternalBehavior/GetEventFailed, operation=EvtInfo_SecondaryEve_31F100.GetEventFailed
        OpEventGetEventFailed_GetEventFailed_Event_SecondaryEve_31F100: start-on-event=DemSatellite_0InternalBehavior/GetEventFailed, operation=Event_SecondaryEve_31F100.GetEventFailed
        OpEventGetEventFailed_GetEventFailed_EvtInfo_SecondaryEve_31F300: start-on-event=DemSatellite_0InternalBehavior/GetEventFailed, operation=EvtInfo_SecondaryEve_31F300.GetEventFailed
        OpEventGetEventFailed_GetEventFailed_Event_SecondaryEve_31F300: start-on-event=DemSatellite_0InternalBehavior/GetEventFailed, operation=Event_SecondaryEve_31F300.GetEventFailed
        OpEventGetEventTested_GetEventTested_EvtInfo_PriEve4822E4_SecEve21F100: start-on-event=DemSatellite_0InternalBehavior/GetEventTested, operation=EvtInfo_PriEve4822E4_SecEve21F100.GetEventTested
        OpEventGetEventTested_GetEventTested_Event_PriEve4822E4_SecEve21F100: start-on-event=DemSatellite_0InternalBehavior/GetEventTested, operation=Event_PriEve4822E4_SecEve21F100.GetEventTested
        OpEventGetEventTested_GetEventTested_EvtInfo_PriEve4822E4_SecEve31F100: start-on-event=DemSatellite_0InternalBehavior/GetEventTested, operation=EvtInfo_PriEve4822E4_SecEve31F100.GetEventTested
        OpEventGetEventTested_GetEventTested_Event_PriEve4822E4_SecEve31F100: start-on-event=DemSatellite_0InternalBehavior/GetEventTested, operation=Event_PriEve4822E4_SecEve31F100.GetEventTested
        OpEventGetEventTested_GetEventTested_EvtInfo_PriEve4822F5_SecEve21F300: start-on-event=DemSatellite_0InternalBehavior/GetEventTested, operation=EvtInfo_PriEve4822F5_SecEve21F300.GetEventTested
        OpEventGetEventTested_GetEventTested_Event_PriEve4822F5_SecEve21F300: start-on-event=DemSatellite_0InternalBehavior/GetEventTested, operation=Event_PriEve4822F5_SecEve21F300.GetEventTested
        OpEventGetEventTested_GetEventTested_EvtInfo_PriEve4822F5_SecEve31F300: start-on-event=DemSatellite_0InternalBehavior/GetEventTested, operation=EvtInfo_PriEve4822F5_SecEve31F300.GetEventTested
        OpEventGetEventTested_GetEventTested_Event_PriEve4822F5_SecEve31F300: start-on-event=DemSatellite_0InternalBehavior/GetEventTested, operation=Event_PriEve4822F5_SecEve31F300.GetEventTested
        OpEventGetEventTested_GetEventTested_EvtInfo_SecondaryEve_20F300: start-on-event=DemSatellite_0InternalBehavior/GetEventTested, operation=EvtInfo_SecondaryEve_20F300.GetEventTested
        OpEventGetEventTested_GetEventTested_Event_SecondaryEve_20F300: start-on-event=DemSatellite_0InternalBehavior/GetEventTested, operation=Event_SecondaryEve_20F300.GetEventTested
        OpEventGetEventTested_GetEventTested_EvtInfo_SecondaryEve_21F100: start-on-event=DemSatellite_0InternalBehavior/GetEventTested, operation=EvtInfo_SecondaryEve_21F100.GetEventTested
        OpEventGetEventTested_GetEventTested_Event_SecondaryEve_21F100: start-on-event=DemSatellite_0InternalBehavior/GetEventTested, operation=Event_SecondaryEve_21F100.GetEventTested
        OpEventGetEventTested_GetEventTested_EvtInfo_SecondaryEve_21F300: start-on-event=DemSatellite_0InternalBehavior/GetEventTested, operation=EvtInfo_SecondaryEve_21F300.GetEventTested
        OpEventGetEventTested_GetEventTested_Event_SecondaryEve_21F300: start-on-event=DemSatellite_0InternalBehavior/GetEventTested, operation=Event_SecondaryEve_21F300.GetEventTested
        OpEventGetEventTested_GetEventTested_EvtInfo_SecondaryEve_30F300: start-on-event=DemSatellite_0InternalBehavior/GetEventTested, operation=EvtInfo_SecondaryEve_30F300.GetEventTested
        OpEventGetEventTested_GetEventTested_Event_SecondaryEve_30F300: start-on-event=DemSatellite_0InternalBehavior/GetEventTested, operation=Event_SecondaryEve_30F300.GetEventTested
        OpEventGetEventTested_GetEventTested_EvtInfo_SecondaryEve_31F100: start-on-event=DemSatellite_0InternalBehavior/GetEventTested, operation=EvtInfo_SecondaryEve_31F100.GetEventTested
        OpEventGetEventTested_GetEventTested_Event_SecondaryEve_31F100: start-on-event=DemSatellite_0InternalBehavior/GetEventTested, operation=Event_SecondaryEve_31F100.GetEventTested
        OpEventGetEventTested_GetEventTested_EvtInfo_SecondaryEve_31F300: start-on-event=DemSatellite_0InternalBehavior/GetEventTested, operation=EvtInfo_SecondaryEve_31F300.GetEventTested
        OpEventGetEventTested_GetEventTested_Event_SecondaryEve_31F300: start-on-event=DemSatellite_0InternalBehavior/GetEventTested, operation=Event_SecondaryEve_31F300.GetEventTested
        OpEventGetDTCOfEvent_GetDTCOfEvent_EvtInfo_PriEve4822E4_SecEve21F100: start-on-event=DemSatellite_0InternalBehavior/GetDTCOfEvent, operation=EvtInfo_PriEve4822E4_SecEve21F100.GetDTCOfEvent
        OpEventGetDTCOfEvent_GetDTCOfEvent_Event_PriEve4822E4_SecEve21F100: start-on-event=DemSatellite_0InternalBehavior/GetDTCOfEvent, operation=Event_PriEve4822E4_SecEve21F100.GetDTCOfEvent
        OpEventGetDTCOfEvent_GetDTCOfEvent_EvtInfo_PriEve4822E4_SecEve31F100: start-on-event=DemSatellite_0InternalBehavior/GetDTCOfEvent, operation=EvtInfo_PriEve4822E4_SecEve31F100.GetDTCOfEvent
        OpEventGetDTCOfEvent_GetDTCOfEvent_Event_PriEve4822E4_SecEve31F100: start-on-event=DemSatellite_0InternalBehavior/GetDTCOfEvent, operation=Event_PriEve4822E4_SecEve31F100.GetDTCOfEvent
        OpEventGetDTCOfEvent_GetDTCOfEvent_EvtInfo_PriEve4822F5_SecEve21F300: start-on-event=DemSatellite_0InternalBehavior/GetDTCOfEvent, operation=EvtInfo_PriEve4822F5_SecEve21F300.GetDTCOfEvent
        OpEventGetDTCOfEvent_GetDTCOfEvent_Event_PriEve4822F5_SecEve21F300: start-on-event=DemSatellite_0InternalBehavior/GetDTCOfEvent, operation=Event_PriEve4822F5_SecEve21F300.GetDTCOfEvent
        OpEventGetDTCOfEvent_GetDTCOfEvent_EvtInfo_PriEve4822F5_SecEve31F300: start-on-event=DemSatellite_0InternalBehavior/GetDTCOfEvent, operation=EvtInfo_PriEve4822F5_SecEve31F300.GetDTCOfEvent
        OpEventGetDTCOfEvent_GetDTCOfEvent_Event_PriEve4822F5_SecEve31F300: start-on-event=DemSatellite_0InternalBehavior/GetDTCOfEvent, operation=Event_PriEve4822F5_SecEve31F300.GetDTCOfEvent
        OpEventGetDTCOfEvent_GetDTCOfEvent_EvtInfo_SecondaryEve_20F300: start-on-event=DemSatellite_0InternalBehavior/GetDTCOfEvent, operation=EvtInfo_SecondaryEve_20F300.GetDTCOfEvent
        OpEventGetDTCOfEvent_GetDTCOfEvent_Event_SecondaryEve_20F300: start-on-event=DemSatellite_0InternalBehavior/GetDTCOfEvent, operation=Event_SecondaryEve_20F300.GetDTCOfEvent
        OpEventGetDTCOfEvent_GetDTCOfEvent_EvtInfo_SecondaryEve_21F100: start-on-event=DemSatellite_0InternalBehavior/GetDTCOfEvent, operation=EvtInfo_SecondaryEve_21F100.GetDTCOfEvent
        OpEventGetDTCOfEvent_GetDTCOfEvent_Event_SecondaryEve_21F100: start-on-event=DemSatellite_0InternalBehavior/GetDTCOfEvent, operation=Event_SecondaryEve_21F100.GetDTCOfEvent
        OpEventGetDTCOfEvent_GetDTCOfEvent_EvtInfo_SecondaryEve_21F300: start-on-event=DemSatellite_0InternalBehavior/GetDTCOfEvent, operation=EvtInfo_SecondaryEve_21F300.GetDTCOfEvent
        OpEventGetDTCOfEvent_GetDTCOfEvent_Event_SecondaryEve_21F300: start-on-event=DemSatellite_0InternalBehavior/GetDTCOfEvent, operation=Event_SecondaryEve_21F300.GetDTCOfEvent
        OpEventGetDTCOfEvent_GetDTCOfEvent_EvtInfo_SecondaryEve_30F300: start-on-event=DemSatellite_0InternalBehavior/GetDTCOfEvent, operation=EvtInfo_SecondaryEve_30F300.GetDTCOfEvent
        OpEventGetDTCOfEvent_GetDTCOfEvent_Event_SecondaryEve_30F300: start-on-event=DemSatellite_0InternalBehavior/GetDTCOfEvent, operation=Event_SecondaryEve_30F300.GetDTCOfEvent
        OpEventGetDTCOfEvent_GetDTCOfEvent_EvtInfo_SecondaryEve_31F100: start-on-event=DemSatellite_0InternalBehavior/GetDTCOfEvent, operation=EvtInfo_SecondaryEve_31F100.GetDTCOfEvent
        OpEventGetDTCOfEvent_GetDTCOfEvent_Event_SecondaryEve_31F100: start-on-event=DemSatellite_0InternalBehavior/GetDTCOfEvent, operation=Event_SecondaryEve_31F100.GetDTCOfEvent
        OpEventGetDTCOfEvent_GetDTCOfEvent_EvtInfo_SecondaryEve_31F300: start-on-event=DemSatellite_0InternalBehavior/GetDTCOfEvent, operation=EvtInfo_SecondaryEve_31F300.GetDTCOfEvent
        OpEventGetDTCOfEvent_GetDTCOfEvent_Event_SecondaryEve_31F300: start-on-event=DemSatellite_0InternalBehavior/GetDTCOfEvent, operation=Event_SecondaryEve_31F300.GetDTCOfEvent
        OpEventGetFaultDetectionCounter_GetFaultDetectionCounter_EvtInfo_PriEve4822E4_SecEve21F100: start-on-event=DemSatellite_0InternalBehavior/GetFaultDetectionCounter, operation=EvtInfo_PriEve4822E4_SecEve21F100.GetFaultDetectionCounter
        OpEventGetFaultDetectionCounter_GetFaultDetectionCounter_Event_PriEve4822E4_SecEve21F100: start-on-event=DemSatellite_0InternalBehavior/GetFaultDetectionCounter, operation=Event_PriEve4822E4_SecEve21F100.GetFaultDetectionCounter
        OpEventGetFaultDetectionCounter_GetFaultDetectionCounter_EvtInfo_PriEve4822E4_SecEve31F100: start-on-event=DemSatellite_0InternalBehavior/GetFaultDetectionCounter, operation=EvtInfo_PriEve4822E4_SecEve31F100.GetFaultDetectionCounter
        OpEventGetFaultDetectionCounter_GetFaultDetectionCounter_Event_PriEve4822E4_SecEve31F100: start-on-event=DemSatellite_0InternalBehavior/GetFaultDetectionCounter, operation=Event_PriEve4822E4_SecEve31F100.GetFaultDetectionCounter
        OpEventGetFaultDetectionCounter_GetFaultDetectionCounter_EvtInfo_PriEve4822F5_SecEve21F300: start-on-event=DemSatellite_0InternalBehavior/GetFaultDetectionCounter, operation=EvtInfo_PriEve4822F5_SecEve21F300.GetFaultDetectionCounter
        OpEventGetFaultDetectionCounter_GetFaultDetectionCounter_Event_PriEve4822F5_SecEve21F300: start-on-event=DemSatellite_0InternalBehavior/GetFaultDetectionCounter, operation=Event_PriEve4822F5_SecEve21F300.GetFaultDetectionCounter
        OpEventGetFaultDetectionCounter_GetFaultDetectionCounter_EvtInfo_PriEve4822F5_SecEve31F300: start-on-event=DemSatellite_0InternalBehavior/GetFaultDetectionCounter, operation=EvtInfo_PriEve4822F5_SecEve31F300.GetFaultDetectionCounter
        OpEventGetFaultDetectionCounter_GetFaultDetectionCounter_Event_PriEve4822F5_SecEve31F300: start-on-event=DemSatellite_0InternalBehavior/GetFaultDetectionCounter, operation=Event_PriEve4822F5_SecEve31F300.GetFaultDetectionCounter
        OpEventGetFaultDetectionCounter_GetFaultDetectionCounter_EvtInfo_SecondaryEve_20F300: start-on-event=DemSatellite_0InternalBehavior/GetFaultDetectionCounter, operation=EvtInfo_SecondaryEve_20F300.GetFaultDetectionCounter
        OpEventGetFaultDetectionCounter_GetFaultDetectionCounter_Event_SecondaryEve_20F300: start-on-event=DemSatellite_0InternalBehavior/GetFaultDetectionCounter, operation=Event_SecondaryEve_20F300.GetFaultDetectionCounter
        OpEventGetFaultDetectionCounter_GetFaultDetectionCounter_EvtInfo_SecondaryEve_21F100: start-on-event=DemSatellite_0InternalBehavior/GetFaultDetectionCounter, operation=EvtInfo_SecondaryEve_21F100.GetFaultDetectionCounter
        OpEventGetFaultDetectionCounter_GetFaultDetectionCounter_Event_SecondaryEve_21F100: start-on-event=DemSatellite_0InternalBehavior/GetFaultDetectionCounter, operation=Event_SecondaryEve_21F100.GetFaultDetectionCounter
        OpEventGetFaultDetectionCounter_GetFaultDetectionCounter_EvtInfo_SecondaryEve_21F300: start-on-event=DemSatellite_0InternalBehavior/GetFaultDetectionCounter, operation=EvtInfo_SecondaryEve_21F300.GetFaultDetectionCounter
        OpEventGetFaultDetectionCounter_GetFaultDetectionCounter_Event_SecondaryEve_21F300: start-on-event=DemSatellite_0InternalBehavior/GetFaultDetectionCounter, operation=Event_SecondaryEve_21F300.GetFaultDetectionCounter
        OpEventGetFaultDetectionCounter_GetFaultDetectionCounter_EvtInfo_SecondaryEve_30F300: start-on-event=DemSatellite_0InternalBehavior/GetFaultDetectionCounter, operation=EvtInfo_SecondaryEve_30F300.GetFaultDetectionCounter
        OpEventGetFaultDetectionCounter_GetFaultDetectionCounter_Event_SecondaryEve_30F300: start-on-event=DemSatellite_0InternalBehavior/GetFaultDetectionCounter, operation=Event_SecondaryEve_30F300.GetFaultDetectionCounter
        OpEventGetFaultDetectionCounter_GetFaultDetectionCounter_EvtInfo_SecondaryEve_31F100: start-on-event=DemSatellite_0InternalBehavior/GetFaultDetectionCounter, operation=EvtInfo_SecondaryEve_31F100.GetFaultDetectionCounter
        OpEventGetFaultDetectionCounter_GetFaultDetectionCounter_Event_SecondaryEve_31F100: start-on-event=DemSatellite_0InternalBehavior/GetFaultDetectionCounter, operation=Event_SecondaryEve_31F100.GetFaultDetectionCounter
        OpEventGetFaultDetectionCounter_GetFaultDetectionCounter_EvtInfo_SecondaryEve_31F300: start-on-event=DemSatellite_0InternalBehavior/GetFaultDetectionCounter, operation=EvtInfo_SecondaryEve_31F300.GetFaultDetectionCounter
        OpEventGetFaultDetectionCounter_GetFaultDetectionCounter_Event_SecondaryEve_31F300: start-on-event=DemSatellite_0InternalBehavior/GetFaultDetectionCounter, operation=Event_SecondaryEve_31F300.GetFaultDetectionCounter
        OpEventGetEventFreezeFrameDataEx_GetEventFreezeFrameDataEx_EvtInfo_PriEve4822E4_SecEve21F100: start-on-event=DemSatellite_0InternalBehavior/GetEventFreezeFrameDataEx, operation=EvtInfo_PriEve4822E4_SecEve21F100.GetEventFreezeFrameDataEx
        OpEventGetEventFreezeFrameDataEx_GetEventFreezeFrameDataEx_Event_PriEve4822E4_SecEve21F100: start-on-event=DemSatellite_0InternalBehavior/GetEventFreezeFrameDataEx, operation=Event_PriEve4822E4_SecEve21F100.GetEventFreezeFrameDataEx
        OpEventGetEventFreezeFrameDataEx_GetEventFreezeFrameDataEx_EvtInfo_PriEve4822E4_SecEve31F100: start-on-event=DemSatellite_0InternalBehavior/GetEventFreezeFrameDataEx, operation=EvtInfo_PriEve4822E4_SecEve31F100.GetEventFreezeFrameDataEx
        OpEventGetEventFreezeFrameDataEx_GetEventFreezeFrameDataEx_Event_PriEve4822E4_SecEve31F100: start-on-event=DemSatellite_0InternalBehavior/GetEventFreezeFrameDataEx, operation=Event_PriEve4822E4_SecEve31F100.GetEventFreezeFrameDataEx
        OpEventGetEventFreezeFrameDataEx_GetEventFreezeFrameDataEx_EvtInfo_PriEve4822F5_SecEve21F300: start-on-event=DemSatellite_0InternalBehavior/GetEventFreezeFrameDataEx, operation=EvtInfo_PriEve4822F5_SecEve21F300.GetEventFreezeFrameDataEx
        OpEventGetEventFreezeFrameDataEx_GetEventFreezeFrameDataEx_Event_PriEve4822F5_SecEve21F300: start-on-event=DemSatellite_0InternalBehavior/GetEventFreezeFrameDataEx, operation=Event_PriEve4822F5_SecEve21F300.GetEventFreezeFrameDataEx
        OpEventGetEventFreezeFrameDataEx_GetEventFreezeFrameDataEx_EvtInfo_PriEve4822F5_SecEve31F300: start-on-event=DemSatellite_0InternalBehavior/GetEventFreezeFrameDataEx, operation=EvtInfo_PriEve4822F5_SecEve31F300.GetEventFreezeFrameDataEx
        OpEventGetEventFreezeFrameDataEx_GetEventFreezeFrameDataEx_Event_PriEve4822F5_SecEve31F300: start-on-event=DemSatellite_0InternalBehavior/GetEventFreezeFrameDataEx, operation=Event_PriEve4822F5_SecEve31F300.GetEventFreezeFrameDataEx
        OpEventGetEventFreezeFrameDataEx_GetEventFreezeFrameDataEx_EvtInfo_SecondaryEve_20F300: start-on-event=DemSatellite_0InternalBehavior/GetEventFreezeFrameDataEx, operation=EvtInfo_SecondaryEve_20F300.GetEventFreezeFrameDataEx
        OpEventGetEventFreezeFrameDataEx_GetEventFreezeFrameDataEx_Event_SecondaryEve_20F300: start-on-event=DemSatellite_0InternalBehavior/GetEventFreezeFrameDataEx, operation=Event_SecondaryEve_20F300.GetEventFreezeFrameDataEx
        OpEventGetEventFreezeFrameDataEx_GetEventFreezeFrameDataEx_EvtInfo_SecondaryEve_21F100: start-on-event=DemSatellite_0InternalBehavior/GetEventFreezeFrameDataEx, operation=EvtInfo_SecondaryEve_21F100.GetEventFreezeFrameDataEx
        OpEventGetEventFreezeFrameDataEx_GetEventFreezeFrameDataEx_Event_SecondaryEve_21F100: start-on-event=DemSatellite_0InternalBehavior/GetEventFreezeFrameDataEx, operation=Event_SecondaryEve_21F100.GetEventFreezeFrameDataEx
        OpEventGetEventFreezeFrameDataEx_GetEventFreezeFrameDataEx_EvtInfo_SecondaryEve_21F300: start-on-event=DemSatellite_0InternalBehavior/GetEventFreezeFrameDataEx, operation=EvtInfo_SecondaryEve_21F300.GetEventFreezeFrameDataEx
        OpEventGetEventFreezeFrameDataEx_GetEventFreezeFrameDataEx_Event_SecondaryEve_21F300: start-on-event=DemSatellite_0InternalBehavior/GetEventFreezeFrameDataEx, operation=Event_SecondaryEve_21F300.GetEventFreezeFrameDataEx
        OpEventGetEventFreezeFrameDataEx_GetEventFreezeFrameDataEx_EvtInfo_SecondaryEve_30F300: start-on-event=DemSatellite_0InternalBehavior/GetEventFreezeFrameDataEx, operation=EvtInfo_SecondaryEve_30F300.GetEventFreezeFrameDataEx
        OpEventGetEventFreezeFrameDataEx_GetEventFreezeFrameDataEx_Event_SecondaryEve_30F300: start-on-event=DemSatellite_0InternalBehavior/GetEventFreezeFrameDataEx, operation=Event_SecondaryEve_30F300.GetEventFreezeFrameDataEx
        OpEventGetEventFreezeFrameDataEx_GetEventFreezeFrameDataEx_EvtInfo_SecondaryEve_31F100: start-on-event=DemSatellite_0InternalBehavior/GetEventFreezeFrameDataEx, operation=EvtInfo_SecondaryEve_31F100.GetEventFreezeFrameDataEx
        OpEventGetEventFreezeFrameDataEx_GetEventFreezeFrameDataEx_Event_SecondaryEve_31F100: start-on-event=DemSatellite_0InternalBehavior/GetEventFreezeFrameDataEx, operation=Event_SecondaryEve_31F100.GetEventFreezeFrameDataEx
        OpEventGetEventFreezeFrameDataEx_GetEventFreezeFrameDataEx_EvtInfo_SecondaryEve_31F300: start-on-event=DemSatellite_0InternalBehavior/GetEventFreezeFrameDataEx, operation=EvtInfo_SecondaryEve_31F300.GetEventFreezeFrameDataEx
        OpEventGetEventFreezeFrameDataEx_GetEventFreezeFrameDataEx_Event_SecondaryEve_31F300: start-on-event=DemSatellite_0InternalBehavior/GetEventFreezeFrameDataEx, operation=Event_SecondaryEve_31F300.GetEventFreezeFrameDataEx
        OpEventGetEventExtendedDataRecordEx_GetEventExtendedDataRecordEx_EvtInfo_PriEve4822E4_SecEve21F100: start-on-event=DemSatellite_0InternalBehavior/GetEventExtendedDataRecordEx, operation=EvtInfo_PriEve4822E4_SecEve21F100.GetEventExtendedDataRecordEx
        OpEventGetEventExtendedDataRecordEx_GetEventExtendedDataRecordEx_Event_PriEve4822E4_SecEve21F100: start-on-event=DemSatellite_0InternalBehavior/GetEventExtendedDataRecordEx, operation=Event_PriEve4822E4_SecEve21F100.GetEventExtendedDataRecordEx
        OpEventGetEventExtendedDataRecordEx_GetEventExtendedDataRecordEx_EvtInfo_PriEve4822E4_SecEve31F100: start-on-event=DemSatellite_0InternalBehavior/GetEventExtendedDataRecordEx, operation=EvtInfo_PriEve4822E4_SecEve31F100.GetEventExtendedDataRecordEx
        OpEventGetEventExtendedDataRecordEx_GetEventExtendedDataRecordEx_Event_PriEve4822E4_SecEve31F100: start-on-event=DemSatellite_0InternalBehavior/GetEventExtendedDataRecordEx, operation=Event_PriEve4822E4_SecEve31F100.GetEventExtendedDataRecordEx
        OpEventGetEventExtendedDataRecordEx_GetEventExtendedDataRecordEx_EvtInfo_PriEve4822F5_SecEve21F300: start-on-event=DemSatellite_0InternalBehavior/GetEventExtendedDataRecordEx, operation=EvtInfo_PriEve4822F5_SecEve21F300.GetEventExtendedDataRecordEx
        OpEventGetEventExtendedDataRecordEx_GetEventExtendedDataRecordEx_Event_PriEve4822F5_SecEve21F300: start-on-event=DemSatellite_0InternalBehavior/GetEventExtendedDataRecordEx, operation=Event_PriEve4822F5_SecEve21F300.GetEventExtendedDataRecordEx
        OpEventGetEventExtendedDataRecordEx_GetEventExtendedDataRecordEx_EvtInfo_PriEve4822F5_SecEve31F300: start-on-event=DemSatellite_0InternalBehavior/GetEventExtendedDataRecordEx, operation=EvtInfo_PriEve4822F5_SecEve31F300.GetEventExtendedDataRecordEx
        OpEventGetEventExtendedDataRecordEx_GetEventExtendedDataRecordEx_Event_PriEve4822F5_SecEve31F300: start-on-event=DemSatellite_0InternalBehavior/GetEventExtendedDataRecordEx, operation=Event_PriEve4822F5_SecEve31F300.GetEventExtendedDataRecordEx
        OpEventGetEventExtendedDataRecordEx_GetEventExtendedDataRecordEx_EvtInfo_SecondaryEve_20F300: start-on-event=DemSatellite_0InternalBehavior/GetEventExtendedDataRecordEx, operation=EvtInfo_SecondaryEve_20F300.GetEventExtendedDataRecordEx
        OpEventGetEventExtendedDataRecordEx_GetEventExtendedDataRecordEx_Event_SecondaryEve_20F300: start-on-event=DemSatellite_0InternalBehavior/GetEventExtendedDataRecordEx, operation=Event_SecondaryEve_20F300.GetEventExtendedDataRecordEx
        OpEventGetEventExtendedDataRecordEx_GetEventExtendedDataRecordEx_EvtInfo_SecondaryEve_21F100: start-on-event=DemSatellite_0InternalBehavior/GetEventExtendedDataRecordEx, operation=EvtInfo_SecondaryEve_21F100.GetEventExtendedDataRecordEx
        OpEventGetEventExtendedDataRecordEx_GetEventExtendedDataRecordEx_Event_SecondaryEve_21F100: start-on-event=DemSatellite_0InternalBehavior/GetEventExtendedDataRecordEx, operation=Event_SecondaryEve_21F100.GetEventExtendedDataRecordEx
        OpEventGetEventExtendedDataRecordEx_GetEventExtendedDataRecordEx_EvtInfo_SecondaryEve_21F300: start-on-event=DemSatellite_0InternalBehavior/GetEventExtendedDataRecordEx, operation=EvtInfo_SecondaryEve_21F300.GetEventExtendedDataRecordEx
        OpEventGetEventExtendedDataRecordEx_GetEventExtendedDataRecordEx_Event_SecondaryEve_21F300: start-on-event=DemSatellite_0InternalBehavior/GetEventExtendedDataRecordEx, operation=Event_SecondaryEve_21F300.GetEventExtendedDataRecordEx
        OpEventGetEventExtendedDataRecordEx_GetEventExtendedDataRecordEx_EvtInfo_SecondaryEve_30F300: start-on-event=DemSatellite_0InternalBehavior/GetEventExtendedDataRecordEx, operation=EvtInfo_SecondaryEve_30F300.GetEventExtendedDataRecordEx
        OpEventGetEventExtendedDataRecordEx_GetEventExtendedDataRecordEx_Event_SecondaryEve_30F300: start-on-event=DemSatellite_0InternalBehavior/GetEventExtendedDataRecordEx, operation=Event_SecondaryEve_30F300.GetEventExtendedDataRecordEx
        OpEventGetEventExtendedDataRecordEx_GetEventExtendedDataRecordEx_EvtInfo_SecondaryEve_31F100: start-on-event=DemSatellite_0InternalBehavior/GetEventExtendedDataRecordEx, operation=EvtInfo_SecondaryEve_31F100.GetEventExtendedDataRecordEx
        OpEventGetEventExtendedDataRecordEx_GetEventExtendedDataRecordEx_Event_SecondaryEve_31F100: start-on-event=DemSatellite_0InternalBehavior/GetEventExtendedDataRecordEx, operation=Event_SecondaryEve_31F100.GetEventExtendedDataRecordEx
        OpEventGetEventExtendedDataRecordEx_GetEventExtendedDataRecordEx_EvtInfo_SecondaryEve_31F300: start-on-event=DemSatellite_0InternalBehavior/GetEventExtendedDataRecordEx, operation=EvtInfo_SecondaryEve_31F300.GetEventExtendedDataRecordEx
        OpEventGetEventExtendedDataRecordEx_GetEventExtendedDataRecordEx_Event_SecondaryEve_31F300: start-on-event=DemSatellite_0InternalBehavior/GetEventExtendedDataRecordEx, operation=Event_SecondaryEve_31F300.GetEventExtendedDataRecordEx
        OpEventGetEventEnableCondition_GetEventEnableCondition_EvtInfo_PriEve4822E4_SecEve21F100: start-on-event=DemSatellite_0InternalBehavior/GetEventEnableCondition, operation=EvtInfo_PriEve4822E4_SecEve21F100.GetEventEnableCondition
        OpEventGetEventEnableCondition_GetEventEnableCondition_EvtInfo_PriEve4822E4_SecEve31F100: start-on-event=DemSatellite_0InternalBehavior/GetEventEnableCondition, operation=EvtInfo_PriEve4822E4_SecEve31F100.GetEventEnableCondition
        OpEventGetEventEnableCondition_GetEventEnableCondition_EvtInfo_PriEve4822F5_SecEve21F300: start-on-event=DemSatellite_0InternalBehavior/GetEventEnableCondition, operation=EvtInfo_PriEve4822F5_SecEve21F300.GetEventEnableCondition
        OpEventGetEventEnableCondition_GetEventEnableCondition_EvtInfo_PriEve4822F5_SecEve31F300: start-on-event=DemSatellite_0InternalBehavior/GetEventEnableCondition, operation=EvtInfo_PriEve4822F5_SecEve31F300.GetEventEnableCondition
        OpEventGetEventEnableCondition_GetEventEnableCondition_EvtInfo_SecondaryEve_20F300: start-on-event=DemSatellite_0InternalBehavior/GetEventEnableCondition, operation=EvtInfo_SecondaryEve_20F300.GetEventEnableCondition
        OpEventGetEventEnableCondition_GetEventEnableCondition_EvtInfo_SecondaryEve_21F100: start-on-event=DemSatellite_0InternalBehavior/GetEventEnableCondition, operation=EvtInfo_SecondaryEve_21F100.GetEventEnableCondition
        OpEventGetEventEnableCondition_GetEventEnableCondition_EvtInfo_SecondaryEve_21F300: start-on-event=DemSatellite_0InternalBehavior/GetEventEnableCondition, operation=EvtInfo_SecondaryEve_21F300.GetEventEnableCondition
        OpEventGetEventEnableCondition_GetEventEnableCondition_EvtInfo_SecondaryEve_30F300: start-on-event=DemSatellite_0InternalBehavior/GetEventEnableCondition, operation=EvtInfo_SecondaryEve_30F300.GetEventEnableCondition
        OpEventGetEventEnableCondition_GetEventEnableCondition_EvtInfo_SecondaryEve_31F100: start-on-event=DemSatellite_0InternalBehavior/GetEventEnableCondition, operation=EvtInfo_SecondaryEve_31F100.GetEventEnableCondition
        OpEventGetEventEnableCondition_GetEventEnableCondition_EvtInfo_SecondaryEve_31F300: start-on-event=DemSatellite_0InternalBehavior/GetEventEnableCondition, operation=EvtInfo_SecondaryEve_31F300.GetEventEnableCondition
        OpEventGetDebouncingOfEvent_GetDebouncingOfEvent_EvtInfo_PriEve4822E4_SecEve21F100: start-on-event=DemSatellite_0InternalBehavior/GetDebouncingOfEvent, operation=EvtInfo_PriEve4822E4_SecEve21F100.GetDebouncingOfEvent
        OpEventGetDebouncingOfEvent_GetDebouncingOfEvent_EvtInfo_PriEve4822E4_SecEve31F100: start-on-event=DemSatellite_0InternalBehavior/GetDebouncingOfEvent, operation=EvtInfo_PriEve4822E4_SecEve31F100.GetDebouncingOfEvent
        OpEventGetDebouncingOfEvent_GetDebouncingOfEvent_EvtInfo_PriEve4822F5_SecEve21F300: start-on-event=DemSatellite_0InternalBehavior/GetDebouncingOfEvent, operation=EvtInfo_PriEve4822F5_SecEve21F300.GetDebouncingOfEvent
        OpEventGetDebouncingOfEvent_GetDebouncingOfEvent_EvtInfo_PriEve4822F5_SecEve31F300: start-on-event=DemSatellite_0InternalBehavior/GetDebouncingOfEvent, operation=EvtInfo_PriEve4822F5_SecEve31F300.GetDebouncingOfEvent
        OpEventGetDebouncingOfEvent_GetDebouncingOfEvent_EvtInfo_SecondaryEve_20F300: start-on-event=DemSatellite_0InternalBehavior/GetDebouncingOfEvent, operation=EvtInfo_SecondaryEve_20F300.GetDebouncingOfEvent
        OpEventGetDebouncingOfEvent_GetDebouncingOfEvent_EvtInfo_SecondaryEve_21F100: start-on-event=DemSatellite_0InternalBehavior/GetDebouncingOfEvent, operation=EvtInfo_SecondaryEve_21F100.GetDebouncingOfEvent
        OpEventGetDebouncingOfEvent_GetDebouncingOfEvent_EvtInfo_SecondaryEve_21F300: start-on-event=DemSatellite_0InternalBehavior/GetDebouncingOfEvent, operation=EvtInfo_SecondaryEve_21F300.GetDebouncingOfEvent
        OpEventGetDebouncingOfEvent_GetDebouncingOfEvent_EvtInfo_SecondaryEve_30F300: start-on-event=DemSatellite_0InternalBehavior/GetDebouncingOfEvent, operation=EvtInfo_SecondaryEve_30F300.GetDebouncingOfEvent
        OpEventGetDebouncingOfEvent_GetDebouncingOfEvent_EvtInfo_SecondaryEve_31F100: start-on-event=DemSatellite_0InternalBehavior/GetDebouncingOfEvent, operation=EvtInfo_SecondaryEve_31F100.GetDebouncingOfEvent
        OpEventGetDebouncingOfEvent_GetDebouncingOfEvent_EvtInfo_SecondaryEve_31F300: start-on-event=DemSatellite_0InternalBehavior/GetDebouncingOfEvent, operation=EvtInfo_SecondaryEve_31F300.GetDebouncingOfEvent
        OpEventGetMonitorStatus_GetMonitorStatus_EvtInfo_PriEve4822E4_SecEve21F100: start-on-event=DemSatellite_0InternalBehavior/GetMonitorStatus, operation=EvtInfo_PriEve4822E4_SecEve21F100.GetMonitorStatus
        OpEventGetMonitorStatus_GetMonitorStatus_EvtInfo_PriEve4822E4_SecEve31F100: start-on-event=DemSatellite_0InternalBehavior/GetMonitorStatus, operation=EvtInfo_PriEve4822E4_SecEve31F100.GetMonitorStatus
        OpEventGetMonitorStatus_GetMonitorStatus_EvtInfo_PriEve4822F5_SecEve21F300: start-on-event=DemSatellite_0InternalBehavior/GetMonitorStatus, operation=EvtInfo_PriEve4822F5_SecEve21F300.GetMonitorStatus
        OpEventGetMonitorStatus_GetMonitorStatus_EvtInfo_PriEve4822F5_SecEve31F300: start-on-event=DemSatellite_0InternalBehavior/GetMonitorStatus, operation=EvtInfo_PriEve4822F5_SecEve31F300.GetMonitorStatus
        OpEventGetMonitorStatus_GetMonitorStatus_EvtInfo_SecondaryEve_20F300: start-on-event=DemSatellite_0InternalBehavior/GetMonitorStatus, operation=EvtInfo_SecondaryEve_20F300.GetMonitorStatus
        OpEventGetMonitorStatus_GetMonitorStatus_EvtInfo_SecondaryEve_21F100: start-on-event=DemSatellite_0InternalBehavior/GetMonitorStatus, operation=EvtInfo_SecondaryEve_21F100.GetMonitorStatus
        OpEventGetMonitorStatus_GetMonitorStatus_EvtInfo_SecondaryEve_21F300: start-on-event=DemSatellite_0InternalBehavior/GetMonitorStatus, operation=EvtInfo_SecondaryEve_21F300.GetMonitorStatus
        OpEventGetMonitorStatus_GetMonitorStatus_EvtInfo_SecondaryEve_30F300: start-on-event=DemSatellite_0InternalBehavior/GetMonitorStatus, operation=EvtInfo_SecondaryEve_30F300.GetMonitorStatus
        OpEventGetMonitorStatus_GetMonitorStatus_EvtInfo_SecondaryEve_31F100: start-on-event=DemSatellite_0InternalBehavior/GetMonitorStatus, operation=EvtInfo_SecondaryEve_31F100.GetMonitorStatus
        OpEventGetMonitorStatus_GetMonitorStatus_EvtInfo_SecondaryEve_31F300: start-on-event=DemSatellite_0InternalBehavior/GetMonitorStatus, operation=EvtInfo_SecondaryEve_31F300.GetMonitorStatus
        OpEventSetEventStatus_SetEventStatus_Event_PriEve4822E4_SecEve21F100: start-on-event=SetEventStatus, operation=Event_PriEve4822E4_SecEve21F100.SetEventStatus
        OpEventSetEventStatus_SetEventStatus_Event_PriEve4822E4_SecEve31F100: start-on-event=SetEventStatus, operation=Event_PriEve4822E4_SecEve31F100.SetEventStatus
        OpEventSetEventStatus_SetEventStatus_Event_PriEve4822F5_SecEve21F300: start-on-event=SetEventStatus, operation=Event_PriEve4822F5_SecEve21F300.SetEventStatus
        OpEventSetEventStatus_SetEventStatus_Event_PriEve4822F5_SecEve31F300: start-on-event=SetEventStatus, operation=Event_PriEve4822F5_SecEve31F300.SetEventStatus
        OpEventSetEventStatus_SetEventStatus_Event_SecondaryEve_20F300: start-on-event=SetEventStatus, operation=Event_SecondaryEve_20F300.SetEventStatus
        OpEventSetEventStatus_SetEventStatus_Event_SecondaryEve_21F100: start-on-event=SetEventStatus, operation=Event_SecondaryEve_21F100.SetEventStatus
        OpEventSetEventStatus_SetEventStatus_Event_SecondaryEve_21F300: start-on-event=SetEventStatus, operation=Event_SecondaryEve_21F300.SetEventStatus
        OpEventSetEventStatus_SetEventStatus_Event_SecondaryEve_30F300: start-on-event=SetEventStatus, operation=Event_SecondaryEve_30F300.SetEventStatus
        OpEventSetEventStatus_SetEventStatus_Event_SecondaryEve_31F100: start-on-event=SetEventStatus, operation=Event_SecondaryEve_31F100.SetEventStatus
        OpEventSetEventStatus_SetEventStatus_Event_SecondaryEve_31F300: start-on-event=SetEventStatus, operation=Event_SecondaryEve_31F300.SetEventStatus
        OpEventResetEventStatus_ResetEventStatus_Event_PriEve4822E4_SecEve21F100: start-on-event=ResetEventStatus, operation=Event_PriEve4822E4_SecEve21F100.ResetEventStatus
        OpEventResetEventStatus_ResetEventStatus_Event_PriEve4822E4_SecEve31F100: start-on-event=ResetEventStatus, operation=Event_PriEve4822E4_SecEve31F100.ResetEventStatus
        OpEventResetEventStatus_ResetEventStatus_Event_PriEve4822F5_SecEve21F300: start-on-event=ResetEventStatus, operation=Event_PriEve4822F5_SecEve21F300.ResetEventStatus
        OpEventResetEventStatus_ResetEventStatus_Event_PriEve4822F5_SecEve31F300: start-on-event=ResetEventStatus, operation=Event_PriEve4822F5_SecEve31F300.ResetEventStatus
        OpEventResetEventStatus_ResetEventStatus_Event_SecondaryEve_20F300: start-on-event=ResetEventStatus, operation=Event_SecondaryEve_20F300.ResetEventStatus
        OpEventResetEventStatus_ResetEventStatus_Event_SecondaryEve_21F100: start-on-event=ResetEventStatus, operation=Event_SecondaryEve_21F100.ResetEventStatus
        OpEventResetEventStatus_ResetEventStatus_Event_SecondaryEve_21F300: start-on-event=ResetEventStatus, operation=Event_SecondaryEve_21F300.ResetEventStatus
        OpEventResetEventStatus_ResetEventStatus_Event_SecondaryEve_30F300: start-on-event=ResetEventStatus, operation=Event_SecondaryEve_30F300.ResetEventStatus
        OpEventResetEventStatus_ResetEventStatus_Event_SecondaryEve_31F100: start-on-event=ResetEventStatus, operation=Event_SecondaryEve_31F100.ResetEventStatus
        OpEventResetEventStatus_ResetEventStatus_Event_SecondaryEve_31F300: start-on-event=ResetEventStatus, operation=Event_SecondaryEve_31F300.ResetEventStatus
        OpEventResetEventDebounceStatus_ResetEventDebounceStatus_Event_PriEve4822E4_SecEve21F100: start-on-event=ResetEventDebounceStatus, operation=Event_PriEve4822E4_SecEve21F100.ResetEventDebounceStatus
        OpEventResetEventDebounceStatus_ResetEventDebounceStatus_Event_PriEve4822E4_SecEve31F100: start-on-event=ResetEventDebounceStatus, operation=Event_PriEve4822E4_SecEve31F100.ResetEventDebounceStatus
        OpEventResetEventDebounceStatus_ResetEventDebounceStatus_Event_PriEve4822F5_SecEve21F300: start-on-event=ResetEventDebounceStatus, operation=Event_PriEve4822F5_SecEve21F300.ResetEventDebounceStatus
        OpEventResetEventDebounceStatus_ResetEventDebounceStatus_Event_PriEve4822F5_SecEve31F300: start-on-event=ResetEventDebounceStatus, operation=Event_PriEve4822F5_SecEve31F300.ResetEventDebounceStatus
        OpEventResetEventDebounceStatus_ResetEventDebounceStatus_Event_SecondaryEve_20F300: start-on-event=ResetEventDebounceStatus, operation=Event_SecondaryEve_20F300.ResetEventDebounceStatus
        OpEventResetEventDebounceStatus_ResetEventDebounceStatus_Event_SecondaryEve_21F100: start-on-event=ResetEventDebounceStatus, operation=Event_SecondaryEve_21F100.ResetEventDebounceStatus
        OpEventResetEventDebounceStatus_ResetEventDebounceStatus_Event_SecondaryEve_21F300: start-on-event=ResetEventDebounceStatus, operation=Event_SecondaryEve_21F300.ResetEventDebounceStatus
        OpEventResetEventDebounceStatus_ResetEventDebounceStatus_Event_SecondaryEve_30F300: start-on-event=ResetEventDebounceStatus, operation=Event_SecondaryEve_30F300.ResetEventDebounceStatus
        OpEventResetEventDebounceStatus_ResetEventDebounceStatus_Event_SecondaryEve_31F100: start-on-event=ResetEventDebounceStatus, operation=Event_SecondaryEve_31F100.ResetEventDebounceStatus
        OpEventResetEventDebounceStatus_ResetEventDebounceStatus_Event_SecondaryEve_31F300: start-on-event=ResetEventDebounceStatus, operation=Event_SecondaryEve_31F300.ResetEventDebounceStatus
