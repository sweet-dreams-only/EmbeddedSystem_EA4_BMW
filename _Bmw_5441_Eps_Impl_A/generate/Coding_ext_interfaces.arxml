AUTOSAR XML (schema 4-3-0)
# \copyright  BMW AG 2016 - 2017
package /BMW/Platform/Coding/Dlog/ImplementationDataTypes
  impl type Dlog_ProgIdArrayType: category=ARRAY
    element Dlog_ProgIdSubArrayType: array-size=8, array-size-semantics=FIXED-SIZE, implementation-data-type=uint8
package /BMW/Platform/Coding/Dlog/PortInterfaces
  sender receiver interface ProgId
    data progId: type=Dlog_ProgIdArrayType
package /BMW/Platform/Coding/Vin/ImplementationDataTypes
  impl type VinArrayType: category=ARRAY
    element idteVinSubArray: array-size=7, array-size-semantics=FIXED-SIZE, implementation-data-type=uint8
  impl type Vin_QualifierType: compu {0=VIN_QUAL_INIT, 1=VIN_QUAL_RECEIVED, 2=VIN_QUAL_EQ_INTERNAL, 4=VIN_QUAL_SECURE_PENDING, 8=VIN_QUAL_SECURE_FINISHED, 16=VIN_QUAL_SECURE_OK, 28=VIN_QUAL_SECURE_MASK, else VIN_QUAL_INIT}, implementation-data-type=uint8
  impl type Vin_VinType: category=STRUCTURE
    element Vin: implementation-data-type=VinArrayType
    element Qualifier: sw-bit-representation={bit-position=0, number-of-bits=4}, implementation-data-type=Vin_QualifierType
package /BMW/Platform/Coding/Vin/PortInterfaces
  sender receiver interface Vin
    data Vin: type=Vin_VinType
package /BMW/Platform/Coding/Dem/ImplementationDataTypes
  impl type Dem_EventStatusType: compu {0x00=DEM_EVENT_STATUS_PASSED, 0x01=DEM_EVENT_STATUS_FAILED, 0x02=DEM_EVENT_STATUS_PREPASSED, 0x03=DEM_EVENT_STATUS_PREFAILED, 0x04=DEM_EVENT_STATUS_FDC_THRESHOLD_REACHED}, range raw 0x00..0x04, implementation-data-type=uint8
package /BMW/Platform/Coding/Dem/PortInterfaces
  client server interface DiagnosticMonitor: is-service=true
    operation SetEventStatus: possible-error=[DiagnosticMonitor/E_OK, DiagnosticMonitor/E_NOT_OK]
      arg EventStatus: type=Dem_EventStatusType, direction=IN
    error E_OK: error-code=0
    error E_NOT_OK: error-code=1
  client server interface CallbackClearEventAllowed: is-service=true
    operation ClearEventAllowed: possible-error=[CallbackClearEventAllowed/E_OK, CallbackClearEventAllowed/E_NOT_OK]
      arg allowed: type=boolean, direction=OUT
    error E_OK: error-code=0
    error E_NOT_OK: error-code=1
package /BMW/Platform/Coding/NvM/ImplementationDataTypes
  impl type NvM_RequestResultType: compu {0x00=NVM_REQ_OK, 0x01=NVM_REQ_NOT_OK, 0x02=NVM_REQ_PENDING, 0x03=NVM_REQ_INTEGRITY_FAILED, 0x04=NVM_REQ_BLOCK_SKIPPED, 0x05=NVM_REQ_NV_INVALIDATED, 0x06=NVM_REQ_CANCELED, 0x07=NVM_REQ_REDUNDANCY_FAILED, 0x08=NVM_REQ_RESTORED_FROM_ROM}, range raw 0x00..0x08, implementation-data-type=uint8
  impl type ConstVoidPtr: category=DATA_REFERENCE, sw-pointer-target-props={target-category=VALUE, base-type=void, sw-impl-policy=CONST}
  impl type VoidPtr: category=DATA_REFERENCE, sw-pointer-target-props={target-category=VALUE, base-type=void}
package /BMW/Platform/Coding/NvM/PortInterfaces
  client server interface NvMService: is-service=true
    operation ReadBlock: possible-error=[NvMService/E_OK, NvMService/E_NOT_OK]
      arg DstPtr: type=VoidPtr, direction=IN
    operation WriteBlock: possible-error=[NvMService/E_OK, NvMService/E_NOT_OK]
      arg SrcPtr: type=ConstVoidPtr, direction=IN
    error E_OK: error-code=0
    error E_NOT_OK: error-code=1
  client server interface NvMNotifyJobFinished: is-service=true
    operation JobFinished: possible-error=NvMNotifyJobFinished/E_OK
      arg ServiceId: type=uint8, direction=IN
      arg JobResult: type=NvM_RequestResultType, direction=IN
    error E_OK: error-code=0
package /BMW/Platform/Coding/Dcm/ImplementationDataTypes
  8 x impl type:
    Dcm_NegativeResponseCodeType:
      compu {0x8F=DCM_E_BRAKESWITCH_NOTCLOSED, 0x21=DCM_E_BUSYREPEATREQUEST, 0x22=DCM_E_CONDITIONSNOTCORRECT, 0x84=DCM_E_ENGINEISNOTRUNNING, 0x83=DCM_E_ENGINEISRUNNING, 0x85=DCM_E_ENGINERUNTIMETOOLOW, 0x36=DCM_E_EXCEEDNUMBEROFATTEMPTS, 0x26=DCM_E_FAILUREPREVENTSEXECUTIONOFREQUESTEDACTION, 0x72=DCM_E_GENERALPROGRAMMINGFAILURE, 0x10=DCM_E_GENERALREJECT, 0x13=DCM_E_INCORRECTMESSAGELENGTHORINVALIDFORMAT, 0x35=DCM_E_INVALIDKEY, 0x25=DCM_E_NORESPONSEFROMSUBNETCOMPONENT, 0x31=DCM_E_REQUESTOUTOFRANGE, 0x24=DCM_E_REQUESTSEQUENCEERROR, 0x37=DCM_E_REQUIREDTIMEDELAYNOTEXPIRED, 0x14=DCM_E_RESPONSETOOLONG, 0x81=DCM_E_RPMTOOHIGH, 0x82=DCM_E_RPMTOOLOW, 0x33=DCM_E_SECURITYACCESSDENIED, 0x11=DCM_E_SERVICENOTSUPPORTED, 0x7F=DCM_E_SERVICENOTSUPPORTEDINACTIVESESSION, 0x90=DCM_E_SHIFTERLEVERNOTINPARK, 0x12=DCM_E_SUBFUNCTIONNOTSUPPORTED, 0x7E=DCM_E_SUBFUNCTIONNOTSUPPORTEDINACTIVESESSION, 0x86=DCM_E_TEMPERATURETOOHIGH, 0x87=DCM_E_TEMPERATURETOOLOW, 0x8A=DCM_E_THROTTLE_PEDALTOOHIGH, 0x8B=DCM_E_THROTTLE_PEDALTOOLOW, 0x91=DCM_E_TORQUECONVERTERCLUTCHLOCKED, 0x71=DCM_E_TRANSFERDATASUSPENDED, 0x8D=DCM_E_TRANSMISSIONRANGENOTINGEAR, 0x8C=DCM_E_TRANSMISSIONRANGENOTINNEUTRAL, 0x70=DCM_E_UPLOADDOWNLOADNOTACCEPTED, 0x88=DCM_E_VEHICLESPEEDTOOHIGH, 0x89=DCM_E_VEHICLESPEEDTOOLOW, 0x92=DCM_E_VOLTAGETOOHIGH, 0x93=DCM_E_VOLTAGETOOLOW, 0x73=DCM_E_WRONGBLOCKSEQUENCECOUNTER, 0xF0=DCM_E_VMSCNC_0, 0xF1=DCM_E_VMSCNC_1, 0xF2=DCM_E_VMSCNC_2, 0xF3=DCM_E_VMSCNC_3, 0xF4=DCM_E_VMSCNC_4, 0xF5=DCM_E_VMSCNC_5, 0xF6=DCM_E_VMSCNC_6, 0xF7=DCM_E_VMSCNC_7, 0xF8=DCM_E_VMSCNC_8, 0xF9=DCM_E_VMSCNC_9, 0xFA=DCM_E_VMSCNC_A, 0xFB=DCM_E_VMSCNC_B, 0xFC=DCM_E_VMSCNC_C, 0xFD=DCM_E_VMSCNC_D, 0xFE=DCM_E_VMSCNC_E}
      range raw 0x10..0xFE
      implementation-data-type=uint8
    Dcm_OpStatusType: compu {0x00=DCM_INITIAL, 0x01=DCM_PENDING, 0x02=DCM_CANCEL, 0x03=DCM_FORCE_RCRRP_OK}, range raw 0x00..0x03, implementation-data-type=uint8
    Dcm_ConfirmationStatusType: compu {0=DCM_RES_POS_OK, 1=DCM_RES_POS_NOT_OK, 2=DCM_RES_NEG_OK, 3=DCM_RES_NEG_NOT_OK}, implementation-data-type=uint8
    Dcm_Data6ByteType: category=ARRAY, sw-calibration-access=READ-ONLY
      element Dcm_Data6ByteTypeElement: array-size=6, array-size-semantics=FIXED-SIZE, implementation-data-type=uint8
    Dcm_Data9ByteType: category=ARRAY, sw-calibration-access=READ-ONLY
      element Dcm_Data9ByteTypeElement: array-size=9, array-size-semantics=FIXED-SIZE, implementation-data-type=uint8
    Dcm_Data18ByteType: category=ARRAY, sw-calibration-access=READ-ONLY
      element Dcm_Data18ByteTypeElement: array-size=18, array-size-semantics=FIXED-SIZE, implementation-data-type=uint8
    Dcm_Data1014ByteType: category=ARRAY, sw-calibration-access=READ-ONLY
      element Dcm_Data1014ByteTypeElement: array-size=1014, array-size-semantics=FIXED-SIZE, implementation-data-type=uint8
    Dcm_Data1024ByteType: category=ARRAY
      element Dcm_Data1024ByteTypeElement: array-size=1024, array-size-semantics=FIXED-SIZE, implementation-data-type=uint8
package /BMW/Platform/Coding/Dcm/PortInterfaces
  6 x client server interface, all with is-service=true:
    ServiceRequestNotification
      operation Confirmation: possible-error=[ServiceRequestNotification/E_OK, ServiceRequestNotification/E_NOT_OK]
        4 x arg, all with direction=IN:
          SID: type=uint8
          ReqType: type=uint8
          SourceAddress: type=uint16
          ConfirmationStatus: type=Dcm_ConfirmationStatusType
      operation Indication: possible-error=[ServiceRequestNotification/E_OK, ServiceRequestNotification/E_NOT_OK, E_REQUEST_NOT_ACCEPTED]
        6 x arg:
          SID: type=uint8, direction=IN
          RequestData: type=Dcm_Data1024ByteType, direction=IN
          DataSize: type=uint16, direction=IN
          ReqType: type=uint8, direction=IN
          SourceAddress: type=uint16, direction=IN
          ErrorCode: type=Dcm_NegativeResponseCodeType, direction=OUT
      error E_OK: error-code=0
      error E_NOT_OK: error-code=1
      error E_REQUEST_NOT_ACCEPTED: error-code=8
    DataServices_DcmDspData_CPS
      operation ReadData: possible-error=[DataServices_DcmDspData_CPS/E_OK, DataServices_DcmDspData_CPS/E_NOT_OK]
        arg Data: type=Dcm_Data18ByteType, direction=OUT
      operation ConditionCheckRead: possible-error=[DataServices_DcmDspData_CPS/E_OK, DataServices_DcmDspData_CPS/E_NOT_OK]
        arg ErrorCode: type=Dcm_NegativeResponseCodeType, direction=OUT
      error E_OK: error-code=0
      error E_NOT_OK: error-code=1
    DataServices_DcmDspData_protocolData
      operation ReadData: possible-error=[DataServices_DcmDspData_protocolData/E_OK, DataServices_DcmDspData_protocolData/E_NOT_OK]
        arg Data: type=Dcm_Data9ByteType, direction=OUT
      operation ConditionCheckRead: possible-error=[DataServices_DcmDspData_protocolData/E_OK, DataServices_DcmDspData_protocolData/E_NOT_OK]
        arg ErrorCode: type=Dcm_NegativeResponseCodeType, direction=OUT
      error E_OK: error-code=0
      error E_NOT_OK: error-code=1
    RoutineServices_DcmDspRoutine_readNCD
      operation Start: possible-error=[RoutineServices_DcmDspRoutine_readNCD/E_NOT_OK, RoutineServices_DcmDspRoutine_readNCD/DCM_E_PENDING, RoutineServices_DcmDspRoutine_readNCD/DCM_E_FORCE_RCRRP]
        5 x arg:
          DcmDspStartRoutineInSignal: type=Dcm_Data6ByteType, direction=IN
          OpStatus: type=Dcm_OpStatusType, direction=IN
          DcmDspStartRoutineOutSignal: type=Dcm_Data1024ByteType, direction=OUT
          DataLength: type=uint16, direction=INOUT
          ErrorCode: type=Dcm_NegativeResponseCodeType, direction=OUT
      error E_NOT_OK: error-code=1
      error DCM_E_PENDING: error-code=10
      error DCM_E_FORCE_RCRRP: error-code=12
    RoutineServices_DcmDspRoutine_writeNCD
      operation Start: possible-error=[RoutineServices_DcmDspRoutine_writeNCD/E_NOT_OK, RoutineServices_DcmDspRoutine_writeNCD/DCM_E_PENDING, RoutineServices_DcmDspRoutine_writeNCD/DCM_E_FORCE_RCRRP]
        4 x arg:
          DcmDspStartRoutineInSignal: type=Dcm_Data1024ByteType, direction=IN
          OpStatus: type=Dcm_OpStatusType, direction=IN
          DataLength: type=uint16, direction=IN
          ErrorCode: type=Dcm_NegativeResponseCodeType, direction=OUT
      error E_NOT_OK: error-code=1
      error DCM_E_PENDING: error-code=10
      error DCM_E_FORCE_RCRRP: error-code=12
    RoutineServices_DcmDspRoutine_checkNCD
      operation Start: possible-error=[RoutineServices_DcmDspRoutine_checkNCD/E_NOT_OK, RoutineServices_DcmDspRoutine_checkNCD/DCM_E_PENDING, RoutineServices_DcmDspRoutine_checkNCD/DCM_E_FORCE_RCRRP]
        5 x arg:
          DcmDspStartRoutineInSignal: type=Dcm_Data18ByteType, direction=IN
          OpStatus: type=Dcm_OpStatusType, direction=IN
          DcmDspStartRoutineOutSignal: type=uint8, direction=OUT
          DataLength: type=uint16, direction=IN
          ErrorCode: type=Dcm_NegativeResponseCodeType, direction=OUT
      error E_NOT_OK: error-code=1
      error DCM_E_PENDING: error-code=10
      error DCM_E_FORCE_RCRRP: error-code=12
