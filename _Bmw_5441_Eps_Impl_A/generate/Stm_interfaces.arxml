AUTOSAR XML (schema 4-3-0)
# \copyright BMW AG 2017
package /BMW/Platform/Stm/ImplementationDataTypes
  impl type Stm_CentralErrorLockType: compu {0=STM_CEL_UNLOCKED, 1=STM_CEL_LOCKED, 3=STM_CEL_INVALID}, implementation-data-type=uint8
  impl type Stm_EnergyStateType: compu {0=STM_ENERGY_GOOD, 1=STM_ENERGY_OK, 2=STM_ENERGY_SHORTAGE, 3=STM_ENERGY_SEVERE_SHORTAGE, 15=STM_ENERGY_INVALID}, implementation-data-type=uint8
  impl type Stm_VehicleStateType: compu {1=STM_VEHICLE_STATE_PARKING_BN_NOK, 2=STM_VEHICLE_STATE_PARKING_BN_OK, 3=STM_VEHICLE_STATE_CUSTOMER_ABSENT, 5=STM_VEHICLE_STATE_LIVING, 7=STM_VEHICLE_STATE_CHECK_ANALYS_DIAGNOSTICS, 8=STM_VEHICLE_STATE_READINESS_TO_DRIVE_INIT, 10=STM_VEHICLE_STATE_DRIVE, 12=STM_VEHICLE_STATE_READINESS_TO_DRIVE_STOP, 14=STM_VEHICLE_STATE_UNAVAILABLE, 15=STM_VEHICLE_STATE_INVALID}, implementation-data-type=uint8
package /BMW/Platform/Stm/DataTypeMappingSets
  4 x data type mapping set:
    Stm_CentralErrorLockModeRequestTypeMap: mode-request-type-map{implementation-data-type=Stm_CentralErrorLockType, mode-group=Stm_CentralErrorLockMode}
    Stm_EnergyStateModeRequestTypeMap: mode-request-type-map{implementation-data-type=Stm_EnergyStateType, mode-group=Stm_EnergyStateMode}
    Stm_VehicleStatModeRequestTypeMap: mode-request-type-map{implementation-data-type=Stm_VehicleStateType, mode-group=Stm_VehicleStateMode}
    Stm_EMLS_Mapping: mode-request-type-map{implementation-data-type=uint8, mode-group=ErrorMemoryLockSignalReceptionMode}
package /BMW/Platform/Stm/ModeDeclarationGroups
  4 x mode declaration group:
    Stm_CentralErrorLockMode: initial-mode=STM_CEL_INVALID
      mode STM_CEL_INVALID
      mode STM_CEL_LOCKED
      mode STM_CEL_UNLOCKED
    Stm_EnergyStateMode: initial-mode=STM_ENERGY_INVALID
      5 x mode:
        STM_ENERGY_GOOD
        STM_ENERGY_INVALID
        STM_ENERGY_OK
        STM_ENERGY_SEVERE_SHORTAGE
        STM_ENERGY_SHORTAGE
    Stm_VehicleStateMode: initial-mode=STM_VEHICLE_STATE_UNAVAILABLE
      10 x mode:
        STM_VEHICLE_STATE_PARKING_BN_NOK
        STM_VEHICLE_STATE_PARKING_BN_OK
        STM_VEHICLE_STATE_CUSTOMER_ABSENT
        STM_VEHICLE_STATE_LIVING
        STM_VEHICLE_STATE_CHECK_ANALYS_DIAGNOSTICS
        STM_VEHICLE_STATE_READINESS_TO_DRIVE_INIT
        STM_VEHICLE_STATE_DRIVE
        STM_VEHICLE_STATE_READINESS_TO_DRIVE_STOP
        STM_VEHICLE_STATE_UNAVAILABLE
        STM_VEHICLE_STATE_INVALID
    ErrorMemoryLockSignalReceptionMode: initial-mode=EM_LOCK_NOT_RECEIVABLE
      mode EM_LOCK_RECEIVABLE
      mode EM_LOCK_NOT_RECEIVABLE
package /BMW/Platform/Stm/PortInterfaces
  mode switch interface EMLockSignalReceptionModeInterface: is-service=true
    mode group currentEMLockSignalReceptionMode: type=ErrorMemoryLockSignalReceptionMode
  mode switch interface CentralErrorLockModeInterface
    mode group currentCentralErrorLockMode: type=Stm_CentralErrorLockMode
  sender receiver interface CentralErrorLockSignalInterface
    data centralErrorLock: type=Stm_CentralErrorLockType
  mode switch interface EnergyStateModeInterface
    mode group currentEnergyMode: type=Stm_EnergyStateMode
  sender receiver interface EnergyStateSignalInterface
    data energyState: type=Stm_EnergyStateType
  mode switch interface VehicleStateModeInterface
    mode group currentVehicleStateMode: type=Stm_VehicleStateMode
  sender receiver interface VehicleStateSignalInterface
    data VehicleState: type=Stm_VehicleStateType
