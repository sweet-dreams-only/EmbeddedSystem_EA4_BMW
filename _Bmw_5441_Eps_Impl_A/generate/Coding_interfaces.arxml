AUTOSAR XML (schema 4-3-0)
# \copyright BMW AG 2016 - 2017
package /BMW/Platform/Coding/ImplementationDataTypes
  impl type Coding_LifeCycleRequestType: compu {0=CODING_INITIALIZED, 1=CODING_RUNNING, 2=CODING_STOPPED}, implementation-data-type=uint8
  impl type Coding_CafIdArrayType: category=ARRAY
    element Coding_CafIdSubarrayType: array-size=8, array-size-semantics=FIXED-SIZE, implementation-data-type=uint8
package /BMW/Platform/Coding/PortInterfaces
  sender receiver interface ILifeCycleRequest: is-service=true
    data requestMode: type=Coding_LifeCycleRequestType
  client server interface Coding_SVKInterface
    operation GetCafIds: possible-error=E_OK
      arg cafIds: type=Coding_CafIdArrayType, direction=OUT
      arg numberOfCafIds: type=uint16, direction=OUT
    error E_OK: error-code=0
  client server interface CheckCurrentLimit
    operation CheckPlausibility: possible-error=CheckCurrentLimit/E_NOT_OK
      arg Value: type=uint8, direction=IN
    error E_NOT_OK: error-code=1
  5 x mode switch interface:
    Coding_BusCom: is-service=true
      mode group Mode: type=Coding_BusComMode
    Coding_DataMode
      mode group currentDataMode: type=Coding_DataMode
    SessionChangeIndication: is-service=true
      mode group currentSessionMode: type=Coding_SessionMode
    ILifeCycle
      mode group Mode: type=Coding_LifeCycle
    ConditionMode
      mode group currentConditionMode: type=Coding_ConditionMode
  client server interface Data
    72 x operation, all with possible-error=Data/E_NOT_OK:
      GetNAME00_00_CalculationOfLoadMinusstateMinusdependentSteeringAssistance
        arg Value: type=boolean, direction=OUT
      GetNAME00_01_CalculationOfActiveReturn
        arg Value: type=boolean, direction=OUT
      GetNAME00_02_reserved
        arg Value: type=boolean, direction=OUT
      GetNAME00_03_ActiveInfluenceOnTheSteeringHysterisis
        arg Value: type=boolean, direction=OUT
      GetNAME00_04_reserved
        arg Value: type=boolean, direction=OUT
      GetNAME00_05_reserved
        arg Value: type=boolean, direction=OUT
      GetNAME00_06_reserved
        arg Value: type=boolean, direction=OUT
      GetNAME00_07_reserved
        arg Value: type=boolean, direction=OUT
      GetCurrentLimit
        arg Value: type=uint8, direction=OUT
      GetSpeedMinuslimitForMaxCurrent
        arg Value: type=uint8, direction=OUT
      GetNAME08_reserved
        arg Value: type=uint8, direction=OUT
      GetNAME09_reserved
        arg Value: type=uint8, direction=OUT
      GetNAME10_reserved
        arg Value: type=uint8, direction=OUT
      GetNAME11_reserved
        arg Value: type=uint8, direction=OUT
      GetNAME12_reserved
        arg Value: type=uint8, direction=OUT
      GetNAME13_reserved
        arg Value: type=uint8, direction=OUT
      GetNAME14_reserved
        arg Value: type=uint8, direction=OUT
      GetNAME15_reserved
        arg Value: type=uint8, direction=OUT
      GetNAME16_reserved
        arg Value: type=uint8, direction=OUT
      GetNAME17_reserved
        arg Value: type=uint8, direction=OUT
      GetNAME18_reserved
        arg Value: type=uint8, direction=OUT
      GetNAME19_reserved
        arg Value: type=uint8, direction=OUT
      GetNAME20_reserved
        arg Value: type=uint8, direction=OUT
      GetNAME21_reserved
        arg Value: type=uint8, direction=OUT
      GetNAME22_reserved
        arg Value: type=uint8, direction=OUT
      GetNAME23_reserved
        arg Value: type=uint8, direction=OUT
      GetNAME24_reserved
        arg Value: type=uint8, direction=OUT
      GetNAME25_reserved
        arg Value: type=uint8, direction=OUT
      GetNAME26_reserved
        arg Value: type=uint8, direction=OUT
      GetNAME27_reserved
        arg Value: type=uint8, direction=OUT
      GetNAME28_reserved
        arg Value: type=uint8, direction=OUT
      GetNAME01_00_reserved
        arg Value: type=boolean, direction=OUT
      GetNAME01_01_reserved
        arg Value: type=boolean, direction=OUT
      GetNAME01_02_reserved
        arg Value: type=boolean, direction=OUT
      GetNAME01_03_ParkingPowerDamping
        arg Value: type=boolean, direction=OUT
      GetNAME01_04_reserved
        arg Value: type=boolean, direction=OUT
      GetNAME01_05_reserved
        arg Value: type=boolean, direction=OUT
      GetNAME01_06_reserved
        arg Value: type=boolean, direction=OUT
      GetNAME01_07_reserved
        arg Value: type=boolean, direction=OUT
      GetNAME02_00_CompensationOfFriction
        arg Value: type=boolean, direction=OUT
      GetNAME02_01_CompensationOfConstantSteeringPullAndLateralInclinationPull
        arg Value: type=boolean, direction=OUT
      GetNAME02_02
        arg Value: type=boolean, direction=OUT
      GetNAME02_03
        arg Value: type=boolean, direction=OUT
      GetNAME02_04_CompensationOfInertiaOfTheSteeringGear
        arg Value: type=boolean, direction=OUT
      GetNAME02_05_CompensationOfInertiaOfTheSteeringWheel
        arg Value: type=boolean, direction=OUT
      GetNAME02_06
        arg Value: type=boolean, direction=OUT
      GetNAME02_07
        arg Value: type=boolean, direction=OUT
      GetNAME03_00_reserved
        arg Value: type=boolean, direction=OUT
      GetNAME03_01_VoltageDependantDegredation
        arg Value: type=boolean, direction=OUT
      GetNAME03_02_SpeedDependantDegredation
        arg Value: type=boolean, direction=OUT
      GetNAME03_03_reserved
        arg Value: type=boolean, direction=OUT
      GetNAME03_04_reserved
        arg Value: type=boolean, direction=OUT
      GetNAME03_05_reserved
        arg Value: type=boolean, direction=OUT
      GetNAME03_06_reserved
        arg Value: type=boolean, direction=OUT
      GetNAME03_07_reserved
        arg Value: type=boolean, direction=OUT
      GetNAME04_00_DrivingDynamicsInterfaceMinusDriversTorque
        arg Value: type=boolean, direction=OUT
      GetNAME04_00_DrivingDynamicsInterfaceMinusMotorTorque
        arg Value: type=boolean, direction=OUT
      GetNAME04_02_DrivingDynamicsInterfaceMinusFactors
        arg Value: type=boolean, direction=OUT
      GetNAME04_03_DrivingDynamicsInterfaceMinusAdditionalDamping
        arg Value: type=boolean, direction=OUT
      GetNAME04_04_EPSVibration
        arg Value: type=boolean, direction=OUT
      GetNAME04_05_DrivingExperienceSwitch
        arg Value: type=boolean, direction=OUT
      GetNAME04_06_reserved
        arg Value: type=boolean, direction=OUT
      GetNAME04_07_automaticEngineStartStopFunction
        arg Value: type=boolean, direction=OUT
      GetNAME05_00_ActiveFanActuation
        arg Value: type=boolean, direction=OUT
      GetNAME05_01_reserved
        arg Value: type=boolean, direction=OUT
      GetNAME05_02_reserved
        arg Value: type=boolean, direction=OUT
      GetNAME05_03_reserved
        arg Value: type=boolean, direction=OUT
      GetNAME05_04_reserved
        arg Value: type=boolean, direction=OUT
      GetNAME05_05_reserved
        arg Value: type=boolean, direction=OUT
      GetNAME05_06_reserved
        arg Value: type=boolean, direction=OUT
      GetNAME05_07_reserved
        arg Value: type=boolean, direction=OUT
      GetNAME29_reserved
        arg Value: type=uint8, direction=OUT
    error E_NOT_OK: error-code=1
package /BMW/Platform/Coding/ModeDeclarationGroups
  5 x mode declaration group, all with category=EXPLICIT_ORDER:
    Coding_DataMode: initial-mode=NCDSTATE_UNDEFINED, on-transition-value=5
      5 x mode:
        NCDSTATE_INPROGRESS: value=0
        NCDSTATE_DEFAULT: value=1
        NCDSTATE_QUALIFIED: value=2
        NCDSTATE_UNDEFINED: value=3
        NCDSTATE_UNQUALIFIED: value=4
    Coding_BusComMode: initial-mode=CODING_BUSCOMOFF, on-transition-value=2
      mode CODING_BUSCOMOFF: value=0
      mode CODING_BUSCOMON: value=1
    Coding_LifeCycle: initial-mode=CODING_STOPPED, on-transition-value=3
      mode CODING_INITIALIZED: value=0
      mode CODING_RUNNING: value=1
      mode CODING_STOPPED: value=2
    Coding_SessionMode: initial-mode=CODING_SESSION_INACTIVE, on-transition-value=2
      mode CODING_SESSION_ACTIVE: value=0
      mode CODING_SESSION_INACTIVE: value=1
    Coding_ConditionMode: initial-mode=CODING_ALLOWED, on-transition-value=2
      mode CODING_ALLOWED: value=0
      mode CODING_NOT_ALLOWED: value=1
package /BMW/Platform/Coding/DataTypeMappingSets
  data type mapping set Coding_DataTypeMappingSets
    mode-request-type-maps:
      implementation-data-type=Coding_LifeCycleRequestType, mode-group=Coding_LifeCycle
      implementation-data-type=uint8, mode-group=Coding_SessionMode
      implementation-data-type=uint8, mode-group=Coding_ConditionMode
      implementation-data-type=uint8, mode-group=Coding_DataMode
      implementation-data-type=uint8, mode-group=Coding_BusComMode
