AUTOSAR XML (schema 4-0-3)
package /DaVinci_Project
  module config Com
    ComConfig
      31 x ComSignal:
        ANFRAGE_ID2_fbd80461_In: ComNotification=Rte_COMCbk_ANFRAGE_ID2_fbd80461_In, ComSignalType=UINT16
        AVL_STEA_PNI_OFFS_9678c0e9: ComNotification=Rte_COMCbk_AVL_STEA_PNI_OFFS_9678c0e9, ComTimeoutNotification=Rte_COMCbkRxTOut_AVL_STEA_PNI_OFFS_9678c0e9, ComTimeout=0.11, ComSignalType=UINT16
        BATT_VLTG_EPS_df324712: ComSignalType=UINT16
        CTR_WARN_DIR_VIB_EPS_66c73f8f: ComNotification=Rte_COMCbk_CTR_WARN_DIR_VIB_EPS_66c73f8f, ComTimeoutNotification=Rte_COMCbkRxTOut_CTR_WARN_DIR_VIB_EPS_66c73f8f, ComTimeout=0.55, ComSignalType=UINT8
        CTR_WARN_ILVL_VIB_EPS_66c73f8f: ComNotification=Rte_COMCbk_CTR_WARN_ILVL_VIB_EPS_66c73f8f, ComTimeoutNotification=Rte_COMCbkRxTOut_CTR_WARN_ILVL_VIB_EPS_66c73f8f, ComTimeout=0.55, ComSignalType=UINT8
        CTR_WARN_PTRN_VIB_EPS_66c73f8f: ComNotification=Rte_COMCbk_CTR_WARN_PTRN_VIB_EPS_66c73f8f, ComTimeoutNotification=Rte_COMCbkRxTOut_CTR_WARN_PTRN_VIB_EPS_66c73f8f, ComTimeout=0.55, ComSignalType=UINT8
        DBG_EPS_BS_MOD_58_BYTE_ID2_df324712: ComSignalType=UINT8
        ECU_TEMP_EPS_df324712: ComSignalType=UINT8
        FACT_MO_STE_SO_DXP_59dc6376: ComNotification=Rte_COMCbk_FACT_MO_STE_SO_DXP_59dc6376, ComTimeoutNotification=Rte_COMCbkRxTOut_FACT_MO_STE_SO_DXP_59dc6376, ComTimeout=0.045, ComSignalType=UINT8
        MILE_KM_a6dd5496: ComNotification=Rte_COMCbk_MILE_KM_a6dd5496, ComTimeoutNotification=Rte_COMCbkRxTOut_MILE_KM_a6dd5496, ComTimeout=11, ComSignalType=UINT32
        MOT_FET_TEMP_EPS_df324712: ComSignalType=UINT8
        MOT_MAG_TEMP_EPS_df324712: ComSignalType=UINT8
        MOT_TQ_CMD_EPS_df324712: ComSignalType=UINT16
        MOT_TQ_CMD_LIMD_EPS_df324712: ComSignalType=UINT16
        MOT_VEL_EPS_df324712: ComSignalType=UINT16
        MOT_WIDG_TEMP_EPS_df324712: ComSignalType=UINT16
        NO_VECH_{1..7}_13b7b7e4: ComSignalType=UINT8_N
        PRIM_HW_TQ_SNSR_VLTG_EPS_df324712: ComSignalType=UINT8
        SECDRY_HW_TQ_SNSR_VLTG_EPS_df324712: ComSignalType=UINT8
        ST_ENERG_FZM_e7ce1a0c: ComNotification=Rte_COMCbk_ST_ENERG_FZM_e7ce1a0c, ComTimeoutNotification=Rte_COMCbkRxTOut_ST_ENERG_FZM_e7ce1a0c, ComTimeout=21, ComSignalType=UINT8
        ST_ILK_ERRM_FZM_e7ce1a0c: ComNotification=Rte_COMCbk_ST_ILK_ERRM_FZM_e7ce1a0c, ComTimeoutNotification=Rte_COMCbkRxTOut_ST_ILK_ERRM_FZM_e7ce1a0c, ComTimeout=21, ComSignalType=UINT8
        SU_CLU_STMOM_SFE_DXP_59dc6376: ComNotification=Rte_COMCbk_SU_CLU_STMOM_SFE_DXP_59dc6376, ComTimeoutNotification=Rte_COMCbkRxTOut_SU_CLU_STMOM_SFE_DXP_59dc6376, ComTimeout=0.045, ComSignalType=UINT8
        TRGG_ENGTORQ_EPS_4e565a26: ComSignalType=UINT16
        T_SEC_COU_REL_0b27fbfe: ComNotification=Rte_COMCbk_T_SEC_COU_REL_0b27fbfe, ComSignalType=UINT32
        VEH_SPD_EPS_df324712: ComSignalType=UINT16
      15 x ComSignalGroup:
        sigGroup_ACLNY_MASSCNTR_461c64b1: ComNotification=Rte_COMCbk_sigGroup_ACLNY_MASSCNTR_461c64b1, ComTimeoutNotification=Rte_COMCbkRxTOut_sigGroup_ACLNY_MASSCNTR_461c64b1, ComTimeout=0.015
          6 x ComGroupSignal:
            ACLNY_COG_1311692d: ComSignalType=UINT16
            ACLNY_COG_ERR_AMP_1311692d: ComSignalType=UINT16
            ACLNY_MASSCNTR_dummy_12_15_1311692d: ComSignalType=UINT8
            ALIV_ACLNY_COG_1311692d: ComSignalType=UINT8
            CRC_ACLNY_COG_1311692d: ComSignalType=UINT8
            QU_ACLNY_COG_1311692d: ComSignalType=UINT8
        sigGroup_AVL_FORC_GRD_19621f3f
          6 x ComGroupSignal:
            ALIV_AVL_FORC_GRD_c0f3c255: ComSignalType=UINT8
            AVL_FORC_GRD_c0f3c255: ComSignalType=UINT16
            AVL_FORC_GRD_dummy_12_15_c0f3c255: ComSignalType=UINT8
            AVL_PWR_EL_EPS_COOD_c0f3c255: ComSignalType=UINT8
            CRC_AVL_FORC_GRD_c0f3c255: ComSignalType=UINT8
            QU_AVL_FORC_GRD_c0f3c255: ComSignalType=UINT8
        sigGroup_AVL_PO_EPS_290f0f6e
          8 x ComGroupSignal:
            ALIV_AVL_PO_EPS_4bf7fe20: ComSignalType=UINT8
            AVL_PO_EPS_4bf7fe20: ComSignalType=UINT16
            AVL_PO_IDX_EPS_4bf7fe20: ComSignalType=UINT16
            CRC_AVL_PO_EPS_4bf7fe20: ComSignalType=UINT8
            IDX_TORQ_SEN_4bf7fe20: ComSignalType=UINT8
            OFFS_GRD_MID_EPS_4bf7fe20: ComSignalType=UINT16
            QU_AVL_PO_EPS_4bf7fe20: ComSignalType=UINT8
            UN_PO_EPS_4bf7fe20: ComSignalType=UINT8
        sigGroup_AVL_STMOM_DV_ACT_744f32e2
          5 x ComGroupSignal:
            ALIV_AVL_STMOM_DV_ACT_3ef6286e: ComSignalType=UINT8
            AVL_STMOM_DV_ACT_3ef6286e: ComSignalType=UINT16
            AVL_STMOM_DV_ACT_dummy_12_15_3ef6286e: ComSignalType=UINT8
            CRC_AVL_STMOM_DV_ACT_3ef6286e: ComSignalType=UINT8
            QU_AVL_STMOM_DV_ACT_3ef6286e: ComSignalType=UINT8
        sigGroup_CON_VEH_675e7344: ComNotification=Rte_COMCbk_sigGroup_CON_VEH_675e7344, ComTimeoutNotification=Rte_COMCbkRxTOut_sigGroup_CON_VEH_675e7344, ComTimeout=0.11
          7 x ComGroupSignal:
            ALIV_CON_VEH_c1ae6ae9: ComSignalType=UINT8
            CON_VEH_dummy_56_63_c1ae6ae9: ComSignalType=UINT8
            CRC_CON_VEH_c1ae6ae9: ComSignalType=UINT8
            CTR_BS_PRTNT_c1ae6ae9: ComSignalType=UINT8
            CTR_FKTN_PRTNT_c1ae6ae9: ComSignalType=UINT32
            QU_ST_CON_VEH_c1ae6ae9: ComSignalType=UINT8
            ST_CON_VEH_c1ae6ae9: ComSignalType=UINT8
        sigGroup_DISP_CC_EPS_ad160a0a
          7 x ComGroupSignal:
            ALIV_DISP_CC_EPS_8a192f9a: ComSignalType=UINT8
            CHL_DISP_CC_EPS_8a192f9a: ComSignalType=UINT8
            CRC_DISP_CC_EPS_8a192f9a: ComSignalType=UINT8
            NO_CC_EPS_8a192f9a: ComSignalType=UINT16
            ST_CC_EPS_8a192f9a: ComSignalType=UINT8
            ST_IDC_CC_EPS_8a192f9a: ComSignalType=UINT8
            TRANF_CC_EPS_8a192f9a: ComSignalType=UINT8
        sigGroup_DT_EST_68b5ac35
          9 x ComGroupSignal:
            ALIV_DT_EST_dcba517d: ComSignalType=UINT8
            AVL_I_ACT_EST_dcba517d: ComSignalType=UINT8
            CRC_DT_EST_dcba517d: ComSignalType=UINT8
            DT_EST_dummy_12_15_dcba517d: ComSignalType=UINT8
            DT_EST_dummy_16_47_dcba517d: ComSignalType=UINT32
            DT_EST_dummy_64_95_dcba517d: ComSignalType=UINT32
            DT_EST_dummy_96_127_dcba517d: ComSignalType=UINT32
            QU_AVL_I_ACT_EST_dcba517d: ComSignalType=UINT8
            ST_CULI_EST_dcba517d: ComSignalType=UINT8
        sigGroup_ENERG_DGR_DRDY_3f76efd3: ComNotification=Rte_COMCbk_sigGroup_ENERG_DGR_DRDY_3f76efd3, ComTimeoutNotification=Rte_COMCbkRxTOut_sigGroup_ENERG_DGR_DRDY_3f76efd3, ComTimeout=0.015
          10 x ComGroupSignal, all with ComSignalType=UINT8:
            ALIV_ENERG_DGR_DRDY_6d50c911
            CRC_ENERG_DGR_DRDY_6d50c911
            ENERG_AVAI_ARS_6d50c911
            ENERG_DGR_DRDY_dummy_12_15_6d50c911
            MAX_I_LD_SPEC_ARS_6d50c911
            MAX_I_RECUP_SPEC_ARS_6d50c911
            MAX_I_SPEC_BAX_STE_6d50c911
            MAX_I_SPEC_EPS_6d50c911
            QU_DGR_AISP_ENERG_6d50c911
            RQ_CULI_EST_SFY_6d50c911
        sigGroup_OFFS_QUAD_EPS_cc150a52: ComNotification=Rte_COMCbk_sigGroup_OFFS_QUAD_EPS_cc150a52, ComTimeoutNotification=Rte_COMCbkRxTOut_sigGroup_OFFS_QUAD_EPS_cc150a52, ComTimeout=1.1
          5 x ComGroupSignal:
            ALIV_OFFS_QUAD_EPS_1a5f7888: ComSignalType=UINT8
            AVL_PO_IDX_ICM_1a5f7888: ComSignalType=UINT16
            CRC_OFFS_QUAD_EPS_1a5f7888: ComSignalType=UINT8
            OFFS_QUAD_RTR_EPS_1a5f7888: ComSignalType=UINT8
            ST_OFFS_QUAD_EPS_1a5f7888: ComSignalType=UINT8
        sigGroup_ST_EST_76669e16
          6 x ComGroupSignal, all with ComSignalType=UINT8:
            ALIV_ST_EST_FTAX_eef8e21d
            CRC_ST_EST_FTAX_eef8e21d
            QU_FN_EST_eef8e21d
            QU_FN_VIB_EPS_eef8e21d
            QU_SER_STMOM_DV_ACT_eef8e21d
            ST_EST_dummy_16_23_eef8e21d
        sigGroup_SU_EPS_fe4f71c6
          6 x ComGroupSignal:
            ALIV_SU_EPS_f544de28: ComSignalType=UINT8
            CRC_SU_EPS_f544de28: ComSignalType=UINT8
            SU_EPS_dummy_14_19_f544de28: ComSignalType=UINT8
            SU_EPS_dummy_20_51_f544de28: ComSignalType=UINT32
            TOT_STR_EPS_f544de28: ComSignalType=UINT16
            UN_TOT_STR_EPS_f544de28: ComSignalType=UINT8
        sigGroup_TAR_QTA_STRMOM_DV_231dfb08: ComNotification=Rte_COMCbk_sigGroup_TAR_QTA_STRMOM_DV_231dfb08, ComTimeoutNotification=Rte_COMCbkRxTOut_sigGroup_TAR_QTA_STRMOM_DV_231dfb08, ComTimeout=0.015
          10 x ComGroupSignal:
            ALIV_TAR_QTA_STMOM_DV_54d7ae59: ComSignalType=UINT8
            CRC_TAR_QTA_STMOM_DV_54d7ae59: ComSignalType=UINT8
            CTR_DEAC_EPS_FNS_54d7ae59: ComSignalType=UINT8
            FACT_ASS_STMOM_FTAX_54d7ae59: ComSignalType=UINT8
            FACT_CTRR_STMOM_FTAX_54d7ae59: ComSignalType=UINT8
            FACT_DMPNG_STMOM_FTAX_54d7ae59: ComSignalType=UINT8
            QU_TAR_FACT_STMOM_FTAX_54d7ae59: ComSignalType=UINT8
            QU_TAR_QTA_STMOM_DV_54d7ae59: ComSignalType=UINT8
            TAR_QTA_STMOM_DV_54d7ae59: ComSignalType=UINT16
            TAR_QTA_STRMOM_DV_dummy_12_15_54d7ae59: ComSignalType=UINT8
        sigGroup_TAR_STMOM_DV_ACT_9a7b28d3: ComNotification=Rte_COMCbk_sigGroup_TAR_STMOM_DV_ACT_9a7b28d3, ComTimeoutNotification=Rte_COMCbkRxTOut_sigGroup_TAR_STMOM_DV_ACT_9a7b28d3, ComTimeout=0.015
          8 x ComGroupSignal:
            ALIV_TAR_STMOM_DV_ACT_56e1c987: ComSignalType=UINT8
            CRC_TAR_STMOM_DV_ACT_56e1c987: ComSignalType=UINT8
            FACT_DMPNG_ADDON_STMOM_FTAX_56e1c987: ComSignalType=UINT8
            QU_TAR_DMPNG_ADDON_STMOM_FTAX_56e1c987: ComSignalType=UINT8
            QU_TAR_STMOM_DV_ACT_56e1c987: ComSignalType=UINT8
            TAR_STMOM_DV_ACT_56e1c987: ComSignalType=UINT16
            TAR_STMOM_DV_ACT_dummy_12_15_56e1c987: ComSignalType=UINT8
            TAR_STMOM_DV_ACT_dummy_32_51_56e1c987: ComSignalType=UINT32
        sigGroup_VYAW_VEH_fc66be94: ComNotification=Rte_COMCbk_sigGroup_VYAW_VEH_fc66be94, ComTimeoutNotification=Rte_COMCbkRxTOut_sigGroup_VYAW_VEH_fc66be94, ComTimeout=0.015
          6 x ComGroupSignal:
            ALIV_VYAW_VEH_dc9eeb12: ComSignalType=UINT8
            CRC_VYAW_VEH_dc9eeb12: ComSignalType=UINT8
            QU_VYAW_VEH_dc9eeb12: ComSignalType=UINT8
            VYAW_VEH_ERR_AMP_dc9eeb12: ComSignalType=UINT16
            VYAW_VEH_dc9eeb12: ComSignalType=UINT16
            VYAW_VEH_dummy_12_15_dc9eeb12: ComSignalType=UINT8
        sigGroup_V_VEH_2fe00c20: ComNotification=Rte_COMCbk_sigGroup_V_VEH_2fe00c20, ComTimeoutNotification=Rte_COMCbkRxTOut_sigGroup_V_VEH_2fe00c20, ComTimeout=0.02
          7 x ComGroupSignal:
            ALIV_V_VEH_579a99a0: ComSignalType=UINT8
            CRC_V_VEH_579a99a0: ComSignalType=UINT8
            DVCO_VEH_579a99a0: ComSignalType=UINT8
            QU_V_VEH_COG_579a99a0: ComSignalType=UINT8
            ST_V_VEH_NSS_579a99a0: ComSignalType=UINT8
            V_VEH_COG_579a99a0: ComSignalType=UINT16
            V_VEH_dummy_39_39_579a99a0: ComSignalType=UINT8
  module config Rte
    27 x RteBswModuleInstance:
      BswM
        BswM_MainFunctionTimingEvent0 (RteBswEventToTaskMapping): RteBswUsedOsAlarmRef=Os/Rte_Al_TE2_Task_10msBsw_Appl10_0_10ms
      ChkPt
        ChkPt_10msBswAppl10EndTimingEvent0 (RteBswEventToTaskMapping): RteBswUsedOsAlarmRef=Os/Rte_Al_TE2_Task_10msBsw_Appl10_0_10ms
        ChkPt_10msBswAppl10StrtTimingEvent0 (RteBswEventToTaskMapping): RteBswUsedOsAlarmRef=Os/Rte_Al_TE2_Task_10msBsw_Appl10_0_10ms
      Com
        Com_MainFunctionRxTimingEvent0 (RteBswEventToTaskMapping): RteBswUsedOsEventRef=Rte_Ev_Cyclic2_Task_ComBsw_Appl10_0_5ms, RteBswUsedOsAlarmRef=Os/Rte_Al_TE2_Task_ComBsw_Appl10_0_5ms
        Com_MainFunctionTxTimingEvent0 (RteBswEventToTaskMapping): RteBswUsedOsEventRef=Rte_Ev_Cyclic2_Task_ComBsw_Appl10_0_5ms, RteBswUsedOsAlarmRef=Os/Rte_Al_TE2_Task_ComBsw_Appl10_0_5ms
      ComM
        ComM_MainFunction_0TimingEvent0 (RteBswEventToTaskMapping): RteBswUsedOsEventRef=Rte_Ev_Cyclic2_Task_5msBsw_Appl10_0_5ms, RteBswUsedOsAlarmRef=Os/Rte_Al_TE2_Task_5msBsw_Appl10_0_5ms
      Dcm
        Dcm_MainFunctionTimingEvent0 (RteBswEventToTaskMapping): RteBswUsedOsEventRef=Rte_Ev_Cyclic2_Task_5msBsw_Appl10_0_5ms, RteBswUsedOsAlarmRef=Os/Rte_Al_TE2_Task_5msBsw_Appl10_0_5ms
      Dem
        Dem_MasterMainFunctionTimingEvent0 (RteBswEventToTaskMapping): RteBswUsedOsAlarmRef=Os/Rte_Al_TE2_Task_10msBsw_Appl10_0_10ms
        Dem_SatelliteMainFunctionTimingEvent0 (RteBswEventToTaskMapping): RteBswUsedOsAlarmRef=Os/Rte_Al_TE2_Task_10msBsw_Appl10_0_10ms
      Det
      Dio
      EcuM
        EcuM_MainFunctionTimingEvent0 (RteBswEventToTaskMapping): RteBswUsedOsAlarmRef=Os/Rte_Al_TE2_Task_10msBsw_Appl10_0_10ms
      Fee
        Fee_30_SmallSector_MainFunctionTimingEvent0 (RteBswEventToTaskMapping): RteBswUsedOsAlarmRef=Os/Rte_Al_TE2_Task_10msBsw_Appl10_0_10ms
      Fls
        Fls_MainFunctionTimingEvent0 (RteBswEventToTaskMapping): RteBswUsedOsAlarmRef=Os/Rte_Al_TE2_Task_10msBsw_Appl10_0_10ms
      Fr
      FrIf
        FrIf_MainFunction_0TimingEvent0 (RteBswEventToTaskMapping): RteBswUsedOsEventRef=Rte_Ev_Cyclic2_Task_5msBsw_Appl10_0_5ms, RteBswUsedOsAlarmRef=Os/Rte_Al_TE2_Task_5msBsw_Appl10_0_5ms
      FrSM
        FrSM_MainFunction_0TimingEvent0 (RteBswEventToTaskMapping): RteBswUsedOsEventRef=Rte_Ev_Cyclic2_Task_5msBsw_Appl10_0_5ms, RteBswUsedOsAlarmRef=Os/Rte_Al_TE2_Task_5msBsw_Appl10_0_5ms
      FrTp
        FrTp_MainFunctionTimingEvent0 (RteBswEventToTaskMapping): RteBswUsedOsEventRef=Rte_Ev_Cyclic2_Task_ComBsw_Appl10_0_5ms, RteBswUsedOsAlarmRef=Os/Rte_Al_TE2_Task_ComBsw_Appl10_0_5ms
      FrTrcv
        FrTrcv_30_Tja1082_MainFunctionTimingEvent0 (RteBswEventToTaskMapping): RteBswUsedOsEventRef=Rte_Ev_Cyclic2_Task_5msBsw_Appl10_0_5ms, RteBswUsedOsAlarmRef=Os/Rte_Al_TE2_Task_5msBsw_Appl10_0_5ms
      IoHwAb
      IpduM
        IpduM_MainFunctionRxTimingEvent0 (RteBswEventToTaskMapping): RteBswUsedOsEventRef=Rte_Ev_Cyclic2_Task_ComBsw_Appl10_0_5ms, RteBswUsedOsAlarmRef=Os/Rte_Al_TE2_Task_ComBsw_Appl10_0_5ms
        IpduM_MainFunctionTxTimingEvent0 (RteBswEventToTaskMapping): RteBswUsedOsEventRef=Rte_Ev_Cyclic2_Task_ComBsw_Appl10_0_5ms, RteBswUsedOsAlarmRef=Os/Rte_Al_TE2_Task_ComBsw_Appl10_0_5ms
      Mcu
      NvM
        NvM_MainFunctionTimingEvent0 (RteBswEventToTaskMapping): RteBswUsedOsAlarmRef=Os/Rte_Al_TE2_Task_10msBsw_Appl10_0_10ms
      NvMProxy
        NvMProxy_MainFunctionTimingEvent0 (RteBswEventToTaskMapping): RteBswUsedOsAlarmRef=Os/Rte_Al_TE2_Task_10msBsw_Appl10_0_10ms
      PduR
      Port
      Spi
        Spi_MainFunction_HandlingTimingEvent0 (RteBswEventToTaskMapping)
      WdgM
        WdgM_MainFunctionTimingEvent0 (RteBswEventToTaskMapping): RteBswUsedOsAlarmRef=Os/Rte_Al_TE2_Task_4msBsw_Appl10_0_4ms
      Wdg
      Xcp
        3 x RteBswEventToTaskMapping, all with RteBswUsedOsEventRef=Rte_Ev_Cyclic2_Task_5msBsw_Appl10_0_5ms, RteBswUsedOsAlarmRef=Os/Rte_Al_TE2_Task_5msBsw_Appl10_0_5ms:
          FrXcp_MainFunctionRxTimingEvent0
          FrXcp_MainFunctionTxTimingEvent0
          Xcp_MainFunctionTimingEvent0
    223 x RteSwComponentInstance:
      AAACalRegn01Inin00GroupA_Dummy_EcuSwComposition
      AAACalRegn01Inin00GroupC_Dummy_EcuSwComposition
      AAACalRegn01Inin00GroupD_Dummy_EcuSwComposition
      AAACalRegn01Inin00_Dummy_EcuSwComposition
      AAACalRegn01Inin01GroupA_Dummy_EcuSwComposition
      AAACalRegn01Inin01GroupC_Dummy_EcuSwComposition
      AAACalRegn01Inin01GroupD_Dummy_EcuSwComposition
      AAACalRegn01Inin01_Dummy_EcuSwComposition
      AAACalRegn01Inin02GroupA_Dummy_EcuSwComposition
      AAACalRegn01Inin02GroupC_Dummy_EcuSwComposition
      AAACalRegn01Inin02GroupD_Dummy_EcuSwComposition
      AAACalRegn01Inin02_Dummy_EcuSwComposition
      AAACalRegn01Inin03GroupA_Dummy_EcuSwComposition
      AAACalRegn01Inin03GroupC_Dummy_EcuSwComposition
      AAACalRegn01Inin03GroupD_Dummy_EcuSwComposition
      AAACalRegn01Inin03_Dummy_EcuSwComposition
      AAACalRegn01Inin04GroupA_Dummy_EcuSwComposition
      AAACalRegn01Inin04GroupC_Dummy_EcuSwComposition
      AAACalRegn01Inin04GroupD_Dummy_EcuSwComposition
      AAACalRegn01Inin04_Dummy_EcuSwComposition
      AAACalRegn01Inin05GroupA_Dummy_EcuSwComposition
      AAACalRegn01Inin05GroupC_Dummy_EcuSwComposition
      AAACalRegn01Inin05GroupD_Dummy_EcuSwComposition
      AAACalRegn01Inin05_Dummy_EcuSwComposition
      AAACalRegn01Inin06GroupA_Dummy_EcuSwComposition
      AAACalRegn01Inin06GroupC_Dummy_EcuSwComposition
      AAACalRegn01Inin06GroupD_Dummy_EcuSwComposition
      AAACalRegn01Inin06_Dummy_EcuSwComposition
      AAACalRegn01IninOptSetA{00..03}_Dummy_EcuSwComposition
      AAACalRegn02Rt00GroupA_Dummy_EcuSwComposition
      AAACalRegn02Rt00GroupC_Dummy_EcuSwComposition
      AAACalRegn02Rt00GroupD_Dummy_EcuSwComposition
      AAACalRegn02Rt00_Dummy_EcuSwComposition
      AAACalRegn02Rt01GroupA_Dummy_EcuSwComposition
      AAACalRegn02Rt01GroupC_Dummy_EcuSwComposition
      AAACalRegn02Rt01GroupD_Dummy_EcuSwComposition
      AAACalRegn02Rt01_Dummy_EcuSwComposition
      AAACalRegn02Rt02GroupA_Dummy_EcuSwComposition
      AAACalRegn02Rt02GroupC_Dummy_EcuSwComposition
      AAACalRegn02Rt02GroupD_Dummy_EcuSwComposition
      AAACalRegn02Rt02_Dummy_EcuSwComposition
      AAACalRegn02Rt03GroupA_Dummy_EcuSwComposition
      AAACalRegn02Rt03GroupC_Dummy_EcuSwComposition
      AAACalRegn02Rt03GroupD_Dummy_EcuSwComposition
      AAACalRegn02Rt03_Dummy_EcuSwComposition
      BacComIf_EcuSwComposition
        TMT_VinUpdate (RteEventToTaskMapping): RteUsedOsEventRef=Rte_Ev_Cyclic_Task_100ms_Appl10_0_100ms, RteUsedOsAlarmRef=Os/Rte_Al_TE_Task_100ms_Appl10_0_100ms
      BattVltg_EcuSwComposition
        TMT_BattVltgPer1 (RteEventToTaskMapping): RteUsedOsAlarmRef=Os/Rte_Al_TE_Task_2msB_Appl10_0_2ms
      BattVltgCorrln_EcuSwComposition
        TMT_BattVltgCorrlnPer1 (RteEventToTaskMapping): RteUsedOsAlarmRef=Os/Rte_Al_TE_Task_2msB_Appl10_0_2ms
      BmwDiagcSrvHndlg_EcuSwComposition
        TMT_BmwDiagcSrvHndlgPer1 (RteEventToTaskMapping): RteUsedOsEventRef=Rte_Ev_Cyclic_Task_10ms_Appl10_0_10ms, RteUsedOsAlarmRef=Os/Rte_Al_TE_Task_10ms_Appl10_0_10ms
        4 x RteNvRamAllocation:
          NvmBlock_BmwDiagcSrvHndlg_NvmMilesKmEeprom: RteNvmRamBlockLocationSymbol=Rte_BmwDiagcSrvHndlg_MilesKmEeprom, RteNvmBlockRef=Rte_NvmBlock_BmwDiagcSrvHndlg_MilesKmEeprom
          NvmBlock_BmwDiagcSrvHndlg_NvmProgCntr: RteNvmRamBlockLocationSymbol=Rte_BmwDiagcSrvHndlg_ProgCntr, RteNvmBlockRef=Rte_NvmBlock_BmwDiagcSrvHndlg_ProgCntr
          NvmBlock_BmwDiagcSrvHndlg_NvmProgCntrMaxVal: RteNvmRamBlockLocationSymbol=Rte_BmwDiagcSrvHndlg_ProgCntrMaxVal, RteNvmRomBlockLocationSymbol=Rte_ProgCntrMaxValDft, RteNvmBlockRef=Rte_NvmBlock_BmwDiagcSrvHndlg_ProgCntrMaxVal
          NvmBlock_BmwDiagcSrvHndlg_NvmTestStamp: RteNvmRamBlockLocationSymbol=Rte_BmwDiagcSrvHndlg_TestStamp, RteNvmBlockRef=Rte_NvmBlock_BmwDiagcSrvHndlg_TestStamp
      BmwDrvgDynStMac_EcuSwComposition
        TMT_BmwDrvgDynStMacPer1 (RteEventToTaskMapping): RteUsedOsAlarmRef=Os/Rte_Al_TE_Task_2msB_Appl10_0_2ms
      BmwFltHndlg_EcuSwComposition
        TMT_BmwFltHndlgPer1 (RteEventToTaskMapping): RteUsedOsAlarmRef=Os/Rte_Al_TE_Task_2ms_Appl7_0_2ms
      BmwHaptcFb_EcuSwComposition
        TMT_BmwHaptcFbPer1 (RteEventToTaskMapping): RteUsedOsAlarmRef=Os/Rte_Al_TE_Task_2ms_Appl7_0_2ms
      BmwHwAgArbnAndEotPosn_EcuSwComposition
        TMT_BmwHwAgArbnAndEotPosnPer1 (RteEventToTaskMapping): RteUsedOsAlarmRef=Os/Rte_Al_TE_Task_2msA_Appl10_0_2ms
        NvmBlock_BmwHwAgArbnAndEotPosn_NvmBmwVehCentrOffs (RteNvRamAllocation): RteNvmRamBlockLocationSymbol=Rte_BmwHwAgArbnAndEotPosn_BmwVehCentrOffs, RteNvmBlockRef=Rte_NvmBlock_BmwHwAgArbnAndEotPosn_BmwVehCentrOffs
      BmwHwTqOvrlArbn_EcuSwComposition
        TMT_BmwHwTqOvrlArbnPer1 (RteEventToTaskMapping): RteUsedOsAlarmRef=Os/Rte_Al_TE_Task_2ms_Appl7_0_2ms
      BmwMotTqOvrlArbn_EcuSwComposition
        TMT_BmwMotTqOvrlArbnPer1 (RteEventToTaskMapping): RteUsedOsAlarmRef=Os/Rte_Al_TE_Task_2msB_Appl10_0_2ms
      BmwMsgSlot107Bas0Repn1BusFrChA_EcuSwComposition
        DRET_OFFS_QUAD_EPS_Missing_Oper_sigGroup_OFFS_QUAD_EPS_sigGroup_OFFS_QUAD_EPS (RteEventToTaskMapping): RteUsedOsEventRef=Rte_Ev_Run_BmwMsgSlot107Bas0Repn1BusFrChA_OFFS_QUAD_EPS_Missing_Oper
        DRT_OFFS_QUAD_EPS_Received_Oper_sigGroup_OFFS_QUAD_EPS_sigGroup_OFFS_QUAD_EPS (RteEventToTaskMapping): RteUsedOsEventRef=Rte_Ev_Run_BmwMsgSlot107Bas0Repn1BusFrChA_OFFS_QUAD_EPS_Received_Oper
      BmwMsgSlot108Bas0Repn2BusFrChA_EcuSwComposition
        DRET_STEA_OFFS_Missing_Oper_AVL_STEA_PNI_OFFS_AVL_STEA_PNI_OFFS (RteEventToTaskMapping): RteUsedOsEventRef=Rte_Ev_Run_BmwMsgSlot108Bas0Repn2BusFrChA_STEA_OFFS_Missing_Oper
        DRT_STEA_OFFS_Received_Oper_AVL_STEA_PNI_OFFS_AVL_STEA_PNI_OFFS (RteEventToTaskMapping): RteUsedOsEventRef=Rte_Ev_Run_BmwMsgSlot108Bas0Repn2BusFrChA_STEA_OFFS_Received_Oper
      BmwMsgSlot121Bas1Repn2BusFrChA_EcuSwComposition
        DRET_CON_VEH_Missing_Oper_sigGroup_CON_VEH_sigGroup_CON_VEH (RteEventToTaskMapping): RteUsedOsEventRef=Rte_Ev_Run_BmwMsgSlot121Bas1Repn2BusFrChA_CON_VEH_Missing_Oper
        DRT_CON_VEH_Received_Oper_sigGroup_CON_VEH_sigGroup_CON_VEH (RteEventToTaskMapping): RteUsedOsEventRef=Rte_Ev_Run_BmwMsgSlot121Bas1Repn2BusFrChA_CON_VEH_Received_Oper
      BmwMsgSlot234Bas1Repn2BusFrChA_EcuSwComposition
        TMT_BmwMsgSlot234Bas1Repn2BusFrChAPer1 (RteEventToTaskMapping): RteUsedOsEventRef=Rte_Ev_Cyclic_Task_ComBsw_Appl10_0_10ms, RteUsedOsAlarmRef=Os/Rte_Al_TE_Task_ComBsw_Appl10_0_10ms
      BmwMsgSlot269Bas2Repn4BusFrChA_EcuSwComposition
        6 x RteEventToTaskMapping:
          DRET_CTR_VIB_STW_DISP_EXMI_SP2015_Missing_CTR_WARN_DIR_VIB_EPS_CTR_WARN_DIR_VIB_EPS: RteUsedOsEventRef=Rte_Ev_Run_BmwMsgSlot269Bas2Repn4BusFrChA_CTR_VIB_STW_DISP_EXMI_SP2015_Missing
          DRET_CTR_VIB_STW_DISP_EXMI_SP2015_Missing_CTR_WARN_ILVL_VIB_EPS_CTR_WARN_ILVL_VIB_EPS: RteUsedOsEventRef=Rte_Ev_Run_BmwMsgSlot269Bas2Repn4BusFrChA_CTR_VIB_STW_DISP_EXMI_SP2015_Missing
          DRET_CTR_VIB_STW_DISP_EXMI_SP2015_Missing_CTR_WARN_PTRN_VIB_EPS_CTR_WARN_PTRN_VIB_EPS: RteUsedOsEventRef=Rte_Ev_Run_BmwMsgSlot269Bas2Repn4BusFrChA_CTR_VIB_STW_DISP_EXMI_SP2015_Missing
          DRT_CTR_VIB_STW_DISP_EXMI_SP2015_Received_CTR_WARN_DIR_VIB_EPS_CTR_WARN_DIR_VIB_EPS: RteUsedOsEventRef=Rte_Ev_Run_BmwMsgSlot269Bas2Repn4BusFrChA_CTR_VIB_STW_DISP_EXMI_SP2015_Received
          DRT_CTR_VIB_STW_DISP_EXMI_SP2015_Received_CTR_WARN_ILVL_VIB_EPS_CTR_WARN_ILVL_VIB_EPS: RteUsedOsEventRef=Rte_Ev_Run_BmwMsgSlot269Bas2Repn4BusFrChA_CTR_VIB_STW_DISP_EXMI_SP2015_Received
          DRT_CTR_VIB_STW_DISP_EXMI_SP2015_Received_CTR_WARN_PTRN_VIB_EPS_CTR_WARN_PTRN_VIB_EPS: RteUsedOsEventRef=Rte_Ev_Run_BmwMsgSlot269Bas2Repn4BusFrChA_CTR_VIB_STW_DISP_EXMI_SP2015_Received
      BmwMsgSlot274Bas0Repn8BusFrChA_EcuSwComposition
        TMT_BmwMsgSlot274Bas0Repn8BusFrChAPer1 (RteEventToTaskMapping): RteUsedOsEventRef=Rte_Ev_Cyclic_Task_ComBsw_Appl10_0_10ms, RteUsedOsAlarmRef=Os/Rte_Al_TE_Task_ComBsw_Appl10_0_10ms
      BmwMsgSlot274Bas2Repn4BusFrChA_EcuSwComposition
        TMT_BmwMsgSlot274Bas2Repn4BusFrChAPer1 (RteEventToTaskMapping): RteUsedOsEventRef=Rte_Ev_Cyclic_Task_ComBsw_Appl10_0_10ms, RteUsedOsAlarmRef=Os/Rte_Al_TE_Task_ComBsw_Appl10_0_10ms
      BmwMsgSlot276Bas4Repn8BusFrChA_EcuSwComposition
        DRET_MILE_KM_Missing_Oper_MILE_KM_MILE_KM (RteEventToTaskMapping): RteUsedOsEventRef=Rte_Ev_Run_BmwMsgSlot276Bas4Repn8BusFrChA_MILE_KM_Missing_Oper
        DRT_MILE_KM_Received_Oper_MILE_KM_MILE_KM (RteEventToTaskMapping): RteUsedOsEventRef=Rte_Ev_Run_BmwMsgSlot276Bas4Repn8BusFrChA_MILE_KM_Received_Oper
      BmwMsgSlot315Bas0Repn1BusFrChA_EcuSwComposition
        TMT_BmwMsgSlot315Bas0Repn1BusFrChA_Per1 (RteEventToTaskMapping): RteUsedOsEventRef=Rte_Ev_Cyclic_Task_ComBsw_Appl10_0_10ms, RteUsedOsAlarmRef=Os/Rte_Al_TE_Task_ComBsw_Appl10_0_10ms
      BmwMsgSlot49Bas0Repn2BusFrChA_EcuSwComposition
        TMT_BmwMsgSlot49Bas0Repn2BusFrChA_Per1 (RteEventToTaskMapping): RteUsedOsEventRef=Rte_Ev_Cyclic_Task_ComBsw_Appl10_0_10ms, RteUsedOsAlarmRef=Os/Rte_Al_TE_Task_ComBsw_Appl10_0_10ms
      BmwMsgSlot49Bas1Repn2BusFrChA_EcuSwComposition
        TMT_BmwMsgSlot49Bas1Repn2BusFrChA_Per1 (RteEventToTaskMapping): RteUsedOsEventRef=Rte_Ev_Cyclic_Task_ComBsw_Appl10_0_10ms, RteUsedOsAlarmRef=Os/Rte_Al_TE_Task_ComBsw_Appl10_0_10ms
      BmwMsgSlot51Bas0Repn2BusFrChA_EcuSwComposition
        TMT_BmwMsgSlot51Bas0Repn2BusFrChAPer1 (RteEventToTaskMapping): RteUsedOsEventRef=Rte_Ev_Cyclic_Task_ComBsw_Appl10_0_10ms, RteUsedOsAlarmRef=Os/Rte_Al_TE_Task_ComBsw_Appl10_0_10ms
      BmwMsgSlot53Bas3Repn8BusFrChA_EcuSwComposition
        4 x RteEventToTaskMapping:
          DRET_SU_CLE_DRDY_DXP_Miss_FACT_MO_STE_SO_DXP_FACT_MO_STE_SO_DXP: RteUsedOsEventRef=Rte_Ev_Run_BmwMsgSlot53Bas3Repn8BusFrChA_SU_CLE_DRDY_DXP_Miss
          DRET_SU_CLE_DRDY_DXP_Miss_SU_CLU_STMOM_SFE_DXP_SU_CLU_STMOM_SFE_DXP: RteUsedOsEventRef=Rte_Ev_Run_BmwMsgSlot53Bas3Repn8BusFrChA_SU_CLE_DRDY_DXP_Miss
          DRT_SU_CLE_DRDY_DXP_Rxd_FACT_MO_STE_SO_DXP_FACT_MO_STE_SO_DXP: RteUsedOsEventRef=Rte_Ev_Run_BmwMsgSlot53Bas3Repn8BusFrChA_SU_CLE_DRDY_DXP_Rxd
          DRT_SU_CLE_DRDY_DXP_Rxd_SU_CLU_STMOM_SFE_DXP_SU_CLU_STMOM_SFE_DXP: RteUsedOsEventRef=Rte_Ev_Run_BmwMsgSlot53Bas3Repn8BusFrChA_SU_CLE_DRDY_DXP_Rxd
      BmwMsgSlot55Bas0Repn2BusFrChA_EcuSwComposition
        DRET_ACLNY_MASSCNTR_Missing_Oper_sigGroup_ACLNY_MASSCNTR_sigGroup_ACLNY_MASSCNTR (RteEventToTaskMapping): RteUsedOsEventRef=Rte_Ev_Run_BmwMsgSlot55Bas0Repn2BusFrChA_ACLNY_MASSCNTR_Missing_Oper
        DRT_ACLNY_MASSCNTR_Received_Oper_sigGroup_ACLNY_MASSCNTR_sigGroup_ACLNY_MASSCNTR (RteEventToTaskMapping): RteUsedOsEventRef=Rte_Ev_Run_BmwMsgSlot55Bas0Repn2BusFrChA_ACLNY_MASSCNTR_Received_Oper
      BmwMsgSlot55Bas3Repn4BusFrChA_EcuSwComposition
        DRET_V_VEH_Missing_Oper_sigGroup_V_VEH_sigGroup_V_VEH (RteEventToTaskMapping): RteUsedOsEventRef=Rte_Ev_Run_BmwMsgSlot55Bas3Repn4BusFrChA_V_VEH_Missing_Oper
        DRT_V_VEH_Received_Oper_sigGroup_V_VEH_sigGroup_V_VEH (RteEventToTaskMapping): RteUsedOsEventRef=Rte_Ev_Run_BmwMsgSlot55Bas3Repn4BusFrChA_V_VEH_Received_Oper
      BmwMsgSlot56Bas0Repn2BusFrChA_EcuSwComposition
        DRET_VYAW_VEH_Missing_Oper_sigGroup_VYAW_VEH_sigGroup_VYAW_VEH (RteEventToTaskMapping): RteUsedOsEventRef=Rte_Ev_Run_BmwMsgSlot56Bas0Repn2BusFrChA_VYAW_VEH_Missing_Oper
        DRT_VYAW_VEH_Received_Oper_sigGroup_VYAW_VEH_sigGroup_VYAW_VEH (RteEventToTaskMapping): RteUsedOsEventRef=Rte_Ev_Run_BmwMsgSlot56Bas0Repn2BusFrChA_VYAW_VEH_Received_Oper
      BmwMsgSlot68Bas0Repn2BusFrChA_EcuSwComposition
        4 x RteEventToTaskMapping:
          DRET_TAR_QTA_STRMOM_DV_Miss_sigGroup_TAR_QTA_STRMOM_DV_sigGroup_TAR_QTA_STRMOM_DV: RteUsedOsEventRef=Rte_Ev_Run_BmwMsgSlot68Bas0Repn2BusFrChA_TAR_QTA_STRMOM_DV_Miss
          DRT_TAR_QTA_STRMOM_DV_Rxd_sigGroup_TAR_QTA_STRMOM_DV_sigGroup_TAR_QTA_STRMOM_DV: RteUsedOsEventRef=Rte_Ev_Run_BmwMsgSlot68Bas0Repn2BusFrChA_TAR_QTA_STRMOM_DV_Rxd
          DRET_TAR_STMOM_DV_ACT_Miss_sigGroup_TAR_STMOM_DV_ACT_sigGroup_TAR_STMOM_DV_ACT: RteUsedOsEventRef=Rte_Ev_Run_BmwMsgSlot68Bas0Repn2BusFrChA_TAR_STMOM_DV_ACT_Miss
          DRT_TAR_STMOM_DV_ACT_Rxd_sigGroup_TAR_STMOM_DV_ACT_sigGroup_TAR_STMOM_DV_ACT: RteUsedOsEventRef=Rte_Ev_Run_BmwMsgSlot68Bas0Repn2BusFrChA_TAR_STMOM_DV_ACT_Rxd
      BmwMsgSlot68Bas1Repn2BusFrChA_EcuSwComposition
        DRET_ENERG_DGR_DRDY_Missing_Oper_sigGroup_ENERG_DGR_DRDY_sigGroup_ENERG_DGR_DRDY (RteEventToTaskMapping): RteUsedOsEventRef=Rte_Ev_Run_BmwMsgSlot68Bas1Repn2BusFrChA_ENERG_DGR_DRDY_Missing_Oper
        DRT_ENERG_DGR_DRDY_Received_Oper_sigGroup_ENERG_DGR_DRDY_sigGroup_ENERG_DGR_DRDY (RteEventToTaskMapping): RteUsedOsEventRef=Rte_Ev_Run_BmwMsgSlot68Bas1Repn2BusFrChA_ENERG_DGR_DRDY_Received_Oper
      BmwPwrPrkgDampg_EcuSwComposition
        TMT_BmwPwrPrkgDampgPer1 (RteEventToTaskMapping): RteUsedOsAlarmRef=Os/Rte_Al_TE_Task_2ms_Appl7_0_2ms
      BmwSplyCurrLim_EcuSwComposition
        TMT_BmwSplyCurrLimPer1 (RteEventToTaskMapping): RteUsedOsAlarmRef=Os/Rte_Al_TE_Task_2ms_Appl9_0_2ms
      BmwStReqMgr_EcuSwComposition
        TMT_BmwStReqMgrPer1 (RteEventToTaskMapping): RteUsedOsAlarmRef=Os/Rte_Al_TE_Task_2msB_Appl10_0_2ms
      BmwSwFctDi_EcuSwComposition
        TMT_BmwSwFctDiPer1 (RteEventToTaskMapping): RteUsedOsEventRef=Rte_Ev_Cyclic_Task_10ms_Appl10_0_10ms, RteUsedOsAlarmRef=Os/Rte_Al_TE_Task_10ms_Appl10_0_10ms
      BmwTqOvrlCdngAndDrvgDynFac_EcuSwComposition
        TMT_BmwTqOvrlCdngAndDrvgDynFacPer1 (RteEventToTaskMapping): RteUsedOsAlarmRef=Os/Rte_Al_TE_Task_2msB_Appl10_0_2ms
      BmwTrfcJamAssiDampg_EcuSwComposition
        TMT_BmwTrfcJamAssiDampgPer1 (RteEventToTaskMapping): RteUsedOsAlarmRef=Os/Rte_Al_TE_Task_2ms_Appl7_0_2ms
      BmwTunSetHndlr_EcuSwComposition
        TMT_BmwTunSetHndlrPer1 (RteEventToTaskMapping): RteUsedOsEventRef=Rte_Ev_Cyclic_Task_10ms_Appl10_0_10ms, RteUsedOsAlarmRef=Os/Rte_Al_TE_Task_10ms_Appl10_0_10ms
        NvmBlock_BmwTunSetHndlr_NvmBmwDesIninIdx (RteNvRamAllocation):
          RteNvmRamBlockLocationSymbol = Rte_BmwTunSetHndlr_BmwDesIninIdx
          RteNvmRomBlockLocationSymbol = Rte_BmwDesIninIdxDft
          RteNvmBlockRef = Rte_NvmBlock_BmwTunSetHndlr_BmwDesIninIdx
        NvmBlock_BmwTunSetHndlr_NvmBmwDesIninOptSetAIdx (RteNvRamAllocation):
          RteNvmRamBlockLocationSymbol = Rte_BmwTunSetHndlr_BmwDesIninOptSetAIdx
          RteNvmRomBlockLocationSymbol = Rte_BmwDesIninOptSetAIdxDft
          RteNvmBlockRef = Rte_NvmBlock_BmwTunSetHndlr_NvmBmwDesIninOptSetAIdx
      BmwVehSpd_EcuSwComposition
        TMT_BmwVehSpdPer1 (RteEventToTaskMapping): RteUsedOsAlarmRef=Os/Rte_Al_TE_Task_2ms_Appl9_0_2ms
      BswM_EcuSwComposition
        Timer_BswM_MainFunction (RteEventToTaskMapping): RteUsedOsAlarmRef=Os/Rte_Al_TE2_Task_10msBsw_Appl10_0_10ms
        DataReceivedEvent_BswM_Read_StdDiag_ComControlModeRequest_Request_StdDiag_ComControlModeRequest_requestedMode (RteEventToTaskMapping): RteUsedOsEventRef=Rte_Ev_Run_BswM_BswM_Read_StdDiag_ComControlModeRequest
      CDD_Adc0CfgAndUse_EcuSwComposition
      CDD_Adc1CfgAndUse_EcuSwComposition
        TMT_Adc1CfgAndUsePer1 (RteEventToTaskMapping): RteUsedOsAlarmRef=Os/Rte_Al_TE_Task_2msA_Appl10_0_2ms
        TMT_Adc1CfgAndUsePer2 (RteEventToTaskMapping): RteUsedOsAlarmRef=Os/Rte_Al_TE_Task_2msA_Appl10_0_2ms
      CDD_AdcDiagc_EcuSwComposition
        TMT_AdcDiagcPer1 (RteEventToTaskMapping): RteUsedOsAlarmRef=Os/Rte_Al_TE_Task_2msA_Appl10_0_2ms
      CDD_BattRtnCurr_EcuSwComposition
        TMT_BattRtnCurrPer2 (RteEventToTaskMapping): RteUsedOsAlarmRef=Os/Rte_Al_TE_Task_2ms_Appl8_0_2ms
      CDD_Bmw5441McuCfg_EcuSwComposition
        TMT_Bmw5441McuCfgPer2 (RteEventToTaskMapping): RteUsedOsAlarmRef=Os/Rte_Al_TE_Task_2msA_Appl10_0_2ms
        TMT_Bmw5441McuCfgPer3 (RteEventToTaskMapping): RteUsedOsAlarmRef=Os/Rte_Al_TE_Task_2msA_Appl10_0_2ms
      CDD_ChkPtAppl10_EcuSwComposition
        10 x RteEventToTaskMapping:
          TMT_ChkPt_100msAppl10End: RteUsedOsEventRef=Rte_Ev_Cyclic_Task_100ms_Appl10_0_100ms, RteUsedOsAlarmRef=Os/Rte_Al_TE_Task_100ms_Appl10_0_100ms
          TMT_ChkPt_100msAppl10Strt: RteUsedOsEventRef=Rte_Ev_Cyclic_Task_100ms_Appl10_0_100ms, RteUsedOsAlarmRef=Os/Rte_Al_TE_Task_100ms_Appl10_0_100ms
          TMT_ChkPt_10msAppl10End: RteUsedOsEventRef=Rte_Ev_Cyclic_Task_10ms_Appl10_0_10ms, RteUsedOsAlarmRef=Os/Rte_Al_TE_Task_10ms_Appl10_0_10ms
          TMT_ChkPt_10msAppl10Strt: RteUsedOsEventRef=Rte_Ev_Cyclic_Task_10ms_Appl10_0_10ms, RteUsedOsAlarmRef=Os/Rte_Al_TE_Task_10ms_Appl10_0_10ms
          TMT_ChkPt_2msAAppl10End: RteUsedOsAlarmRef=Os/Rte_Al_TE_Task_2msA_Appl10_0_2ms
          TMT_ChkPt_2msAAppl10Strt: RteUsedOsAlarmRef=Os/Rte_Al_TE_Task_2msA_Appl10_0_2ms
          TMT_ChkPt_2msBAppl10End: RteUsedOsAlarmRef=Os/Rte_Al_TE_Task_2msB_Appl10_0_2ms
          TMT_ChkPt_2msBAppl10Strt: RteUsedOsAlarmRef=Os/Rte_Al_TE_Task_2msB_Appl10_0_2ms
          TMT_ChkPt_4msAppl10End: RteUsedOsAlarmRef=Os/Rte_Al_TE_Task_4ms_Appl10_0_4ms
          TMT_ChkPt_4msAppl10Strt: RteUsedOsAlarmRef=Os/Rte_Al_TE_Task_4ms_Appl10_0_4ms
      CDD_ChkPtAppl7_EcuSwComposition
        8 x RteEventToTaskMapping:
          TMT_ChkPt_100msAppl7End: RteUsedOsAlarmRef=Os/Rte_Al_TE_Task_100ms_Appl7_0_100ms
          TMT_ChkPt_100msAppl7Strt: RteUsedOsAlarmRef=Os/Rte_Al_TE_Task_100ms_Appl7_0_100ms
          TMT_ChkPt_10msAppl7End: RteUsedOsAlarmRef=Os/Rte_Al_TE_Task_10ms_Appl7_0_10ms
          TMT_ChkPt_10msAppl7Strt: RteUsedOsAlarmRef=Os/Rte_Al_TE_Task_10ms_Appl7_0_10ms
          TMT_ChkPt_2msAppl7End: RteUsedOsAlarmRef=Os/Rte_Al_TE_Task_2ms_Appl7_0_2ms
          TMT_ChkPt_2msAppl7Strt: RteUsedOsAlarmRef=Os/Rte_Al_TE_Task_2ms_Appl7_0_2ms
          TMT_ChkPt_4msAppl7End: RteUsedOsAlarmRef=Os/Rte_Al_TE_Task_4ms_Appl7_0_4ms
          TMT_ChkPt_4msAppl7Strt: RteUsedOsAlarmRef=Os/Rte_Al_TE_Task_4ms_Appl7_0_4ms
      CDD_ChkPtAppl8_EcuSwComposition
        4 x RteEventToTaskMapping:
          TMT_ChkPt_10msAppl8End: RteUsedOsAlarmRef=Os/Rte_Al_TE_Task_10ms_Appl8_0_10ms
          TMT_ChkPt_10msAppl8Strt: RteUsedOsAlarmRef=Os/Rte_Al_TE_Task_10ms_Appl8_0_10ms
          TMT_ChkPt_2msAppl8End: RteUsedOsAlarmRef=Os/Rte_Al_TE_Task_2ms_Appl8_0_2ms
          TMT_ChkPt_2msAppl8Strt: RteUsedOsAlarmRef=Os/Rte_Al_TE_Task_2ms_Appl8_0_2ms
      CDD_ChkPtAppl9_EcuSwComposition
        6 x RteEventToTaskMapping:
          TMT_ChkPt_100msAppl9End: RteUsedOsAlarmRef=Os/Rte_Al_TE_Task_100ms_Appl9_0_100ms
          TMT_ChkPt_100msAppl9Strt: RteUsedOsAlarmRef=Os/Rte_Al_TE_Task_100ms_Appl9_0_100ms
          TMT_ChkPt_10msAppl9End: RteUsedOsAlarmRef=Os/Rte_Al_TE_Task_10ms_Appl9_0_10ms
          TMT_ChkPt_10msAppl9Strt: RteUsedOsAlarmRef=Os/Rte_Al_TE_Task_10ms_Appl9_0_10ms
          TMT_ChkPt_2msAppl9End: RteUsedOsAlarmRef=Os/Rte_Al_TE_Task_2ms_Appl9_0_2ms
          TMT_ChkPt_2msAppl9Strt: RteUsedOsAlarmRef=Os/Rte_Al_TE_Task_2ms_Appl9_0_2ms
      CDD_CoreVltgMonr_EcuSwComposition
      CDD_CurrMeas_EcuSwComposition
        TMT_CurrMeasPer1 (RteEventToTaskMapping): RteUsedOsAlarmRef=Os/Rte_Al_TE_Task_2msB_Appl10_0_2ms
        TMT_CurrMeasPer3 (RteEventToTaskMapping): RteUsedOsAlarmRef=Os/Rte_Al_TE_Task_2msB_Appl10_0_2ms
        NvmBlock_CDD_CurrMeas_NvmCurrMeasEolGainCalSetABC (RteNvRamAllocation):
          RteNvmRamBlockLocationSymbol = Rte_CDD_CurrMeas_CurrMeasEolGainCalSetABC
          RteNvmRomBlockLocationSymbol = Rte_CurrMeasEolGainCalSetABCDft
          RteNvmBlockRef = Rte_NvmBlock_CDD_CurrMeas_CurrMeasEolGainCalSetABC
        NvmBlock_CDD_CurrMeas_NvmCurrMeasEolOffsCalSetABC (RteNvRamAllocation):
          RteNvmRamBlockLocationSymbol = Rte_CDD_CurrMeas_CurrMeasEolOffsCalSetABC
          RteNvmRomBlockLocationSymbol = Rte_CurrMeasEolOffsCalSetABCDft
          RteNvmBlockRef = Rte_NvmBlock_CDD_CurrMeas_CurrMeasEolOffsCalSetABC
      CDD_CurrMeasArbn_EcuSwComposition
      CDD_DataAndAdrPar_EcuSwComposition
      CDD_DmaCfgAndUse_EcuSwComposition
        TMT_DmaCfgAndUsePer1 (RteEventToTaskMapping): RteUsedOsAlarmRef=Os/Rte_Al_TE_Task_2msA_Appl10_0_2ms
      CDD_EcmOutpAndDiagc_EcuSwComposition
      CDD_ExcpnHndlg_EcuSwComposition
        TMT_ExcpnHndlgPer1 (RteEventToTaskMapping): RteUsedOsAlarmRef=Os/Rte_Al_TE_Task_2msA_Appl10_0_2ms
        NvmBlock_CDD_ExcpnHndlg_NvmMcuDiagcData (RteNvRamAllocation):
          RteNvmRamBlockLocationSymbol = Rte_CDD_ExcpnHndlg_McuDiagcData
          RteNvmRomBlockLocationSymbol = Rte_McuDiagcDataDft
          RteNvmBlockRef = Rte_NvmBlock_ExcpnHndlg_McuDiagcData
      CDD_FlsMem_EcuSwComposition
        TMT_FlsMemPer2 (RteEventToTaskMapping): RteUsedOsEventRef=Rte_Ev_Cyclic_Task_100ms_Appl10_0_100ms, RteUsedOsAlarmRef=Os/Rte_Al_TE_Task_100ms_Appl10_0_100ms
      CDD_GuardCfgAndDiagc_EcuSwComposition
      CDD_HwTq4Meas_EcuSwComposition
        3 x RteEventToTaskMapping:
          TMT_HwTq4MeasPer2: RteUsedOsAlarmRef=Os/Rte_Al_TE_Task_2msA_Appl10_0_2ms
          TMT_HwTq4MeasPer3: RteUsedOsEventRef=Rte_Ev_Cyclic_Task_100ms_Appl10_0_100ms, RteUsedOsAlarmRef=Os/Rte_Al_TE_Task_100ms_Appl10_0_100ms
          TMT_HwTq4MeasPer4: RteUsedOsEventRef=Rte_Ev_Cyclic_Task_100ms_Appl10_0_100ms, RteUsedOsAlarmRef=Os/Rte_Al_TE_Task_100ms_Appl10_0_100ms
        NvmBlock_CDD_HwTq4Meas_NvmHwTq4Offs (RteNvRamAllocation): RteNvmRamBlockLocationSymbol=Rte_CDD_HwTq4Meas_HwTq4Offs, RteNvmBlockRef=Rte_NvmBlock_CDD_HwTq4Meas_HwTq4Offs_MirrorBlock
        NvmBlock_CDD_HwTq4Meas_NvmHwTq4Sca (RteNvRamAllocation): RteNvmRamBlockLocationSymbol=Rte_CDD_HwTq4Meas_HwTq4Sca, RteNvmBlockRef=Rte_NvmBlock_CDD_HwTq4Meas_HwTq4Sca_MirrorBlock
      CDD_HwTq5Meas_EcuSwComposition
        3 x RteEventToTaskMapping:
          TMT_HwTq5MeasPer2: RteUsedOsAlarmRef=Os/Rte_Al_TE_Task_2msA_Appl10_0_2ms
          TMT_HwTq5MeasPer3: RteUsedOsEventRef=Rte_Ev_Cyclic_Task_100ms_Appl10_0_100ms, RteUsedOsAlarmRef=Os/Rte_Al_TE_Task_100ms_Appl10_0_100ms
          TMT_HwTq5MeasPer4: RteUsedOsEventRef=Rte_Ev_Cyclic_Task_100ms_Appl10_0_100ms, RteUsedOsAlarmRef=Os/Rte_Al_TE_Task_100ms_Appl10_0_100ms
        NvmBlock_CDD_HwTq5Meas_NvmHwTq5Offs (RteNvRamAllocation): RteNvmRamBlockLocationSymbol=Rte_CDD_HwTq5Meas_HwTq5Offs, RteNvmBlockRef=Rte_NvmBlock_CDD_HwTq5Meas_HwTq5Offs_MirrorBlock
        NvmBlock_CDD_HwTq5Meas_NvmHwTq5Sca (RteNvRamAllocation): RteNvmRamBlockLocationSymbol=Rte_CDD_HwTq5Meas_HwTq5Sca, RteNvmBlockRef=Rte_NvmBlock_CDD_HwTq5Meas_HwTq5Sca_MirrorBlock
      CDD_McuCoreCfgAndDiagc_EcuSwComposition
      CDD_McuDiagc_EcuSwComposition
        TMT_McuDiagcPer2 (RteEventToTaskMapping): RteUsedOsAlarmRef=Os/Rte_Al_TE_Task_2msA_Appl10_0_2ms
      CDD_MotAg0Meas_EcuSwComposition
        TMT_MotAg0MeasPer2 (RteEventToTaskMapping): RteUsedOsAlarmRef=Os/Rte_Al_TE_Task_2msA_Appl10_0_2ms
        TMT_MotAg0MeasPer3 (RteEventToTaskMapping): RteUsedOsEventRef=Rte_Ev_Cyclic_Task_100ms_Appl10_0_100ms, RteUsedOsAlarmRef=Os/Rte_Al_TE_Task_100ms_Appl10_0_100ms
        NvmBlock_CDD_MotAg0Meas_NvmMotAg0CoeffTbl (RteNvRamAllocation): RteNvmRamBlockLocationSymbol=Rte_CDD_MotAg0Meas_MotAg0CoeffTbl, RteNvmBlockRef=Rte_NvmBlock_CDD_MotAg0Meas_MotAg0CoeffTbl
      CDD_MotAg1Meas_EcuSwComposition
        TMT_MotAg1MeasPer2 (RteEventToTaskMapping): RteUsedOsAlarmRef=Os/Rte_Al_TE_Task_2msA_Appl10_0_2ms
        NvmBlock_CDD_MotAg1Meas_NvmMotAg1CoeffTbl (RteNvRamAllocation): RteNvmRamBlockLocationSymbol=Rte_CDD_MotAg1Meas_MotAg1CoeffTbl, RteNvmBlockRef=Rte_NvmBlock_CDD_MotAg1Meas_MotAg1CoeffTbl
      CDD_MotAg3Meas_EcuSwComposition
      CDD_MotAg4Meas_EcuSwComposition
      CDD_MotAgCmp_EcuSwComposition
        TMT_MotAgCmpPer2 (RteEventToTaskMapping): RteUsedOsAlarmRef=Os/Rte_Al_TE_Task_2msA_Appl10_0_2ms
        NvmBlock_CDD_MotAgCmp_NvmMotAgCmpMotAgBackEmf (RteNvRamAllocation):
          RteNvmRamBlockLocationSymbol = Rte_CDD_MotAgCmp_MotAgCmpMotAgBackEmf
          RteNvmRomBlockLocationSymbol = Rte_MotAgCmpMotAgBackEmfDft
          RteNvmBlockRef = Rte_NvmBlock_CDD_MotAgCmp_MotAgCmpMotAgBackEmf
      CDD_MotCtrlMgr_EcuSwComposition
        TMT_MotCtrlMgrPer1 (RteEventToTaskMapping): RteUsedOsAlarmRef=Os/Rte_Al_TE_Task_2msA_Appl10_0_2ms
        TMT_MotCtrlMgrPer2 (RteEventToTaskMapping): RteUsedOsAlarmRef=Os/Rte_Al_TE_Task_2msB_Appl10_0_2ms
      CDD_MotCurrRegVltgLimr_EcuSwComposition
      CDD_MotVel_EcuSwComposition
        TMT_MotVelPer2 (RteEventToTaskMapping): RteUsedOsAlarmRef=Os/Rte_Al_TE_Task_2msA_Appl10_0_2ms
      CDD_NvMProxy_EcuSwComposition
        NvmBlock_CDD_NvMProxy_ShtdwnClsChkBlk (RteNvRamAllocation): RteNvmRamBlockLocationSymbol=Rte_CDD_NvMProxy_ShtdwnClsChk, RteNvmBlockRef=Rte_NvmBlock_CDD_NvMProxy_ShtdwnClsChk
      CDD_NxtrTi_EcuSwComposition
        TMT_NxtrTiPer1 (RteEventToTaskMapping): RteUsedOsAlarmRef=Os/Rte_Al_TE_Task_2msA_Appl10_0_2ms
      CDD_RamMem_EcuSwComposition
        TMT_RamMemPer1 (RteEventToTaskMapping): RteUsedOsAlarmRef=Os/Rte_Al_TE_Task_2msB_Appl10_0_2ms
      CDD_SinVltgGenn_EcuSwComposition
      CDD_SyncCrc_EcuSwComposition
      CDD_TSG31CfgAndUse_EcuSwComposition
        TMT_TSG31CfgAndUsePer2 (RteEventToTaskMapping): RteUsedOsAlarmRef=Os/Rte_Al_TE_Task_2msB_Appl10_0_2ms
      CDD_Tauj0CfgAndUse_EcuSwComposition
        TMT_Tauj0CfgAndUsePer1 (RteEventToTaskMapping): RteUsedOsAlarmRef=Os/Rte_Al_TE_Task_2msA_Appl10_0_2ms
      CDD_VrfyCritReg_EcuSwComposition
        TMT_VrfyCritRegPer1 (RteEventToTaskMapping): RteUsedOsEventRef=Rte_Ev_Cyclic_Task_10ms_Appl10_0_10ms, RteUsedOsAlarmRef=Os/Rte_Al_TE_Task_10ms_Appl10_0_10ms
        TMT_0_VrfyCritRegPer2 (RteEventToTaskMapping): RteUsedOsEventRef=Rte_Ev_Cyclic_Task_100ms_Appl10_0_100ms, RteUsedOsAlarmRef=Os/Rte_Al_TE_Task_100ms_Appl10_0_100ms
        NvmBlock_CDD_VrfyCritReg_MCalWrVrfyRegFltInfoStorg (RteNvRamAllocation):
          RteNvmRamBlockLocationSymbol = Rte_CDD_VrfyCritReg_MCalReadVrfyCritRegFltNvmInfo
          RteNvmBlockRef = Rte_NvmBlock_CDD_VrfyCritReg_MCalReadVrfyCritRegFltInfo
      CDD_XcpIf_EcuSwComposition
        TMT_CDD_XcpIfPer1 (RteEventToTaskMapping): RteUsedOsEventRef=Rte_Ev_Cyclic_Task_100ms_Appl10_0_100ms, RteUsedOsAlarmRef=Os/Rte_Al_TE_Task_100ms_Appl10_0_100ms
      CDD_XcpIfXcpEve2MilliSecDataAcqn_EcuSwComposition
        TMT_CDD_XcpIfXcpEve2MilliSecDataAcqnPer1 (RteEventToTaskMapping): RteUsedOsAlarmRef=Os/Rte_Al_TE_Task_2msB_Appl10_0_2ms
      ClsdLoopDampg_EcuSwComposition
        TMT_ClsdLoopDampgPer1 (RteEventToTaskMapping): RteUsedOsAlarmRef=Os/Rte_Al_TE_Task_2ms_Appl7_0_2ms
      ClsdLoopHys_EcuSwComposition
        TMT_ClsdLoopHysPer1 (RteEventToTaskMapping): RteUsedOsAlarmRef=Os/Rte_Al_TE_Task_2ms_Appl7_0_2ms
      CmnMfgSrv_EcuSwComposition
        TMT_CmnMfgSrvPer1 (RteEventToTaskMapping): RteUsedOsEventRef=Rte_Ev_Cyclic_Task_10ms_Appl10_0_10ms, RteUsedOsAlarmRef=Os/Rte_Al_TE_Task_10ms_Appl10_0_10ms
        12 x RteNvRamAllocation:
          NvmBlock_CmnMfgSrv_NvmIgnCntr: RteNvmRamBlockLocationSymbol=Rte_CmnMfgSrv_IgnCntr, RteNvmRomBlockLocationSymbol=Rte_NvmIgnCntr_DefaultValue, RteNvmBlockRef=Rte_NvmBlock_CmnMfgSrv_IgnCntr
          NvmBlock_CmnMfgSrv_NvmMfgEnaCntr: RteNvmRamBlockLocationSymbol=Rte_CmnMfgSrv_NxtrMfgEnaCntr, RteNvmRomBlockLocationSymbol=Rte_NvmMfgEnaCntr_DefaultValue, RteNvmBlockRef=Rte_NvmBlock_CmnMfgSrv_NxtrMfgEnaCntr
          NvmBlock_CmnMfgSrv_NvmCcaHwPartNr: RteNvmRamBlockLocationSymbol=Rte_CmnMfgSrv_CcaHwPartNr, RteNvmBlockRef=Rte_NvmBlock_CmnMfgSrv_CcaHwPartNr
          NvmBlock_CmnMfgSrv_NvmCcaSerlNr: RteNvmRamBlockLocationSymbol=Rte_CmnMfgSrv_CcaSerlNr, RteNvmBlockRef=Rte_NvmBlock_CmnMfgSrv_CcaSerlNr
          NvmBlock_CmnMfgSrv_NvmDiRestore: RteNvmRamBlockLocationSymbol=Rte_CmnMfgSrv_DiRestore, RteNvmBlockRef=Rte_NvmBlock_CmnMfgSrv_DiRestore
          NvmBlock_CmnMfgSrv_NvmEpsSysSerlNr: RteNvmRamBlockLocationSymbol=Rte_CmnMfgSrv_EpsSysSerlNr, RteNvmBlockRef=Rte_NvmBlock_CmnMfgSrv_EpsSysSerlNr
          NvmBlock_CmnMfgSrv_NvmMfgTmpBuf{0..4}: RteNvmRamBlockLocationSymbol=Rte_CmnMfgSrv_MfgTmpBuf{0..4}, RteNvmBlockRef=Rte_NvmBlock_CmnMfgSrv_MfgTmpBuf{0..4}
          NvmBlock_CmnMfgSrv_NvmSeedKey: RteNvmRamBlockLocationSymbol=Rte_CmnMfgSrv_SeedKey, RteNvmRomBlockLocationSymbol=Rte_SeedKeyDft, RteNvmBlockRef=Rte_NvmBlock_CmnMfgSrv_SeedKey
      CmnMfgSrvIf_EcuSwComposition
      CmplncErr_EcuSwComposition
        TMT_CmplncErrPer1 (RteEventToTaskMapping): RteUsedOsAlarmRef=Os/Rte_Al_TE_Task_2msA_Appl10_0_2ms
      Coding_EcuSwComposition
        10 x RteEventToTaskMapping:
          E_Coding_TimingEvent: RteUsedOsEventRef=Rte_Ev_Cyclic_Task_100ms_Appl10_0_100ms, RteUsedOsAlarmRef=Os/Rte_Al_TE_Task_100ms_Appl10_0_100ms
          LifeCycleRequest: RteUsedOsEventRef=Rte_Ev_Run_Coding_LifeCycleHandler
          E_CheckNCD: RteUsedOsEventRef=Rte_Ev_Run_Coding_R_CheckNCD
          E_ConditionCheckReadCPS: RteUsedOsEventRef=Rte_Ev_Run_Coding_R_ConditionCheckReadCPS
          E_ReadCPS: RteUsedOsEventRef=Rte_Ev_Run_Coding_R_ReadCPS
          E_ReadNCD: RteUsedOsEventRef=Rte_Ev_Run_Coding_R_ReadNCD
          E_ReadProtocolData: RteUsedOsEventRef=Rte_Ev_Run_Coding_R_ReadProtocolData
          E_WriteNCD: RteUsedOsEventRef=Rte_Ev_Run_Coding_R_WriteNCD
          E_ExitCodingSession: RteUsedOsEventRef=Rte_Ev_Run_Coding_SessionChange
          E_VinReceiveHandler: RteUsedOsEventRef=Rte_Ev_Run_Coding_VinReceiveHandler
      ComM_EcuSwComposition
        Timer_ComM_MainFunction_0 (RteEventToTaskMapping): RteUsedOsEventRef=Rte_Ev_Cyclic2_Task_5msBsw_Appl10_0_5ms, RteUsedOsAlarmRef=Os/Rte_Al_TE2_Task_5msBsw_Appl10_0_5ms
      CtrldVelRtn_EcuSwComposition
        TMT_CtrldVelRtnPer1 (RteEventToTaskMapping): RteUsedOsAlarmRef=Os/Rte_Al_TE_Task_2ms_Appl7_0_2ms
      CurrMeasCorrln_EcuSwComposition
        TMT_CurrMeasCorrlnPer1 (RteEventToTaskMapping): RteUsedOsAlarmRef=Os/Rte_Al_TE_Task_2msB_Appl10_0_2ms
      Darh_EcuSwComposition
        LifeCycleRequest (RteEventToTaskMapping): RteUsedOsEventRef=Rte_Ev_Run_Darh_LifeCycleHandler
        TimingEvent (RteEventToTaskMapping): RteUsedOsEventRef=Rte_Ev_Run1_Darh_QueueHandler, RteUsedOsAlarmRef=Os/Rte_Al_TE_Darh_QueueHandler
      Dcm_EcuSwComposition
        Timer_Dcm_MainFunction (RteEventToTaskMapping): RteUsedOsEventRef=Rte_Ev_Cyclic2_Task_5msBsw_Appl10_0_5ms, RteUsedOsAlarmRef=Os/Rte_Al_TE2_Task_5msBsw_Appl10_0_5ms
      DemMaster_0_EcuSwComposition
        Timer_Dem_MasterMainFunction (RteEventToTaskMapping): RteUsedOsAlarmRef=Os/Rte_Al_TE2_Task_10msBsw_Appl10_0_10ms
      DemSatellite_0_EcuSwComposition
        Timer_Dem_SatelliteMainFunction (RteEventToTaskMapping): RteUsedOsAlarmRef=Os/Rte_Al_TE2_Task_10msBsw_Appl10_0_10ms
      DemWrapper_EcuSwComposition
      Det_EcuSwComposition
      DiagcMgr_EcuSwComposition
        TMT_DiagcMgrPer1 (RteEventToTaskMapping): RteUsedOsAlarmRef=Os/Rte_Al_TE_Task_2msB_Appl10_0_2ms
        TMT_DiagcMgrPer2 (RteEventToTaskMapping): RteUsedOsEventRef=Rte_Ev_Cyclic_Task_100ms_Appl10_0_100ms, RteUsedOsAlarmRef=Os/Rte_Al_TE_Task_100ms_Appl10_0_100ms
        3 x RteNvRamAllocation:
          NvmBlock_DiagcMgr_NvMDiagcMgrApplCrc: RteNvmRamBlockLocationSymbol=Rte_DiagcMgr_DiagcMgrApplCrc, RteNvmRomBlockLocationSymbol=Rte_DiagcMgrApplCrcDft, RteNvmBlockRef=Rte_NvmBlock_DiagcMgr_DiagcMgrApplCrc
          NvmBlock_DiagcMgr_NvmDiagcMgrLtchCntrAry: RteNvmRamBlockLocationSymbol=Rte_DiagcMgr_DiagcMgrLtchCntrAry, RteNvmBlockRef=Rte_NvmBlock_DiagcMgr_DiagcMgrLtchCntrAry
          NvmBlock_DiagcMgr_NvmDiagcMgrNtcFltAry: RteNvmRamBlockLocationSymbol=Rte_DiagcMgr_DiagcMgrNtcFltAry, RteNvmBlockRef=Rte_NvmBlock_DiagcMgr_DiagcMgrNtcFltAry
      DiagcMgrProxyAppl10_EcuSwComposition
        TMT_DiagcMgrProxyAppl10Per1 (RteEventToTaskMapping): RteUsedOsEventRef=Rte_Ev_Cyclic_Task_10ms_Appl10_0_10ms, RteUsedOsAlarmRef=Os/Rte_Al_TE_Task_10ms_Appl10_0_10ms
      DiagcMgrProxyAppl7_EcuSwComposition
        TMT_DiagcMgrProxyAppl7Per1 (RteEventToTaskMapping): RteUsedOsAlarmRef=Os/Rte_Al_TE_Task_10ms_Appl7_0_10ms
      DiagcMgrProxyAppl8_EcuSwComposition
        TMT_DiagcMgrProxyAppl8Per1 (RteEventToTaskMapping): RteUsedOsAlarmRef=Os/Rte_Al_TE_Task_10ms_Appl8_0_10ms
      DiagcMgrProxyAppl9_EcuSwComposition
        TMT_DiagcMgrProxyAppl9Per1 (RteEventToTaskMapping): RteUsedOsAlarmRef=Os/Rte_Al_TE_Task_10ms_Appl9_0_10ms
      DiagcMgrStub_EcuSwComposition
      Dlog_EcuSwComposition
        LifeCycleModeSwitchedAck (RteEventToTaskMapping): RteUsedOsEventRef=Rte_Ev_Run_Dlog_Dlog_ModeSwitchAckLifeCycle
        LifeCycleRequest (RteEventToTaskMapping): RteUsedOsEventRef=Rte_Ev_Run_Dlog_Dlog_ModeSwitchRequestLifeCycle
      DutyCycThermProtn_EcuSwComposition
        TMT_DutyCycThermProtnPer1 (RteEventToTaskMapping): RteUsedOsAlarmRef=Os/Rte_Al_TE_Task_100ms_Appl7_0_100ms
        NvmBlock_DutyCycThermProtn_NvmFilStVal (RteNvRamAllocation): RteNvmRamBlockLocationSymbol=Rte_DutyCycThermProtn_FilStVal, RteNvmBlockRef=Rte_NvmBlock_DutyCycThermProtn_FilStVal
      EcuM_EcuSwComposition
        Timer_EcuM_MainFunction (RteEventToTaskMapping): RteUsedOsAlarmRef=Os/Rte_Al_TE2_Task_10msBsw_Appl10_0_10ms
      EcuTMeas_EcuSwComposition
        TMT_EcuTMeasPer1 (RteEventToTaskMapping): RteUsedOsAlarmRef=Os/Rte_Al_TE_Task_100ms_Appl9_0_100ms
      Effort_EcuSwComposition
        TMT_EffortPer1 (RteEventToTaskMapping): RteUsedOsAlarmRef=Os/Rte_Al_TE_Task_2ms_Appl7_0_2ms
      ElecPwrCns_EcuSwComposition
        TMT_ElecPwrCnsPer1 (RteEventToTaskMapping): RteUsedOsAlarmRef=Os/Rte_Al_TE_Task_10ms_Appl8_0_10ms
      EotProtn_EcuSwComposition
        TMT_EotProtnPer1 (RteEventToTaskMapping): RteUsedOsAlarmRef=Os/Rte_Al_TE_Task_2ms_Appl7_0_2ms
      EpsStEstimn_EcuSwComposition
        TMT_EpsStEstimnPer1 (RteEventToTaskMapping): RteUsedOsAlarmRef=Os/Rte_Al_TE_Task_2ms_Appl7_0_2ms
      FalbckAssi_EcuSwComposition
        TMT_FalbckAssiPer1 (RteEventToTaskMapping): RteUsedOsAlarmRef=Os/Rte_Al_TE_Task_2msB_Appl10_0_2ms
      FltInj_EcuSwComposition
        TMT_FltInjPer1 (RteEventToTaskMapping): RteUsedOsAlarmRef=Os/Rte_Al_TE_Task_2msA_Appl10_0_2ms
      GateDrv0Ctrl_EcuSwComposition
        TMT_GateDrvCtrlPer1 (RteEventToTaskMapping): RteUsedOsAlarmRef=Os/Rte_Al_TE_Task_2msA_Appl10_0_2ms
        TMT_GateDrv0CtrlPer2 (RteEventToTaskMapping): RteUsedOsAlarmRef=Os/Rte_Al_TE_Task_2msB_Appl10_0_2ms
      GlbLimr_EcuSwComposition
        TMT_GlbLimrPer1 (RteEventToTaskMapping): RteUsedOsAlarmRef=Os/Rte_Al_TE_Task_2msB_Appl10_0_2ms
      HiLoadStallLimr_EcuSwComposition
        TMT_HiLoadStallLimrPer1 (RteEventToTaskMapping): RteUsedOsAlarmRef=Os/Rte_Al_TE_Task_2ms_Appl7_0_2ms
      HwRefTqSum_EcuSwComposition
        TMT_HwRefTqSumPer1 (RteEventToTaskMapping): RteUsedOsAlarmRef=Os/Rte_Al_TE_Task_2ms_Appl7_0_2ms
      HwTqArbn_EcuSwComposition
        TMT_HwTqArbnPer1 (RteEventToTaskMapping): RteUsedOsAlarmRef=Os/Rte_Al_TE_Task_2msA_Appl10_0_2ms
      HwTqCorrln_EcuSwComposition
        3 x RteEventToTaskMapping:
          TMT_HwTqCorrlnPer1: RteUsedOsAlarmRef=Os/Rte_Al_TE_Task_2msA_Appl10_0_2ms
          TMT_HwTqCorrlnPer2: RteUsedOsAlarmRef=Os/Rte_Al_TE_Task_4ms_Appl10_0_4ms
          TMT_HwTqCorrlnPer3: RteUsedOsEventRef=Rte_Ev_Cyclic_Task_100ms_Appl10_0_100ms, RteUsedOsAlarmRef=Os/Rte_Al_TE_Task_100ms_Appl10_0_100ms
        NvmBlock_HwTqCorrln_NvmHwTqChACmnModCmpLpFilSt (RteNvRamAllocation):
          RteNvmRamBlockLocationSymbol = Rte_HwTqCorrln_HwTqChACmnModCmpLpFilSt
          RteNvmRomBlockLocationSymbol = Rte_HwTqChACmnModCmpLpFilStDft
          RteNvmBlockRef = Rte_NvmBlock_HwTqCorrln_HwTqChACmnModCmpLpFilSt
      HwTqTrakgCtrl_EcuSwComposition
        TMT_HwTqTrakgCtrlPer1 (RteEventToTaskMapping): RteUsedOsAlarmRef=Os/Rte_Al_TE_Task_2msB_Appl10_0_2ms
      InertiaCmpVel_EcuSwComposition
        TMT_InertiaCmpVelPer1 (RteEventToTaskMapping): RteUsedOsAlarmRef=Os/Rte_Al_TE_Task_2ms_Appl7_0_2ms
      IoHwAb_EcuSwComposition
        Timer_IoHwAb_Per1 (RteEventToTaskMapping): RteUsedOsEventRef=Rte_Ev_Cyclic_Task_100ms_Appl10_0_100ms, RteUsedOsAlarmRef=Os/Rte_Al_TE_Task_100ms_Appl10_0_100ms
      LimrCdng_EcuSwComposition
        TMT_LimrCdngPer1 (RteEventToTaskMapping): RteUsedOsAlarmRef=Os/Rte_Al_TE_Task_2ms_Appl9_0_2ms
      LoaMgr_EcuSwComposition
        TMT_LoaMgrPer1 (RteEventToTaskMapping): RteUsedOsAlarmRef=Os/Rte_Al_TE_Task_4ms_Appl10_0_4ms
      LrnPinionCentr_EcuSwComposition
        TMT_LrnPinionCentrPer1 (RteEventToTaskMapping): RteUsedOsAlarmRef=Os/Rte_Al_TE_Task_2ms_Appl7_0_2ms
      LrndRackCentr_EcuSwComposition
        TMT_LrndRackCentrPer1 (RteEventToTaskMapping): RteUsedOsAlarmRef=Os/Rte_Al_TE_Task_4ms_Appl10_0_4ms
        NvmBlock_LrndRackCentr_NvmLrndRackCentrNvm (RteNvRamAllocation): RteNvmRamBlockLocationSymbol=Rte_LrndRackCentr_LrndRackCentr, RteNvmBlockRef=Rte_NvmBlock_LrndRackCentr_LrndRackCentr
      McalErrHndlg_EcuSwComposition
        TMT_McalErrHndlgPer1 (RteEventToTaskMapping): RteUsedOsEventRef=Rte_Ev_Cyclic_Task_10ms_Appl10_0_10ms, RteUsedOsAlarmRef=Os/Rte_Al_TE_Task_10ms_Appl10_0_10ms
      McuErrInj_EcuSwComposition
        TMT_McuFltInjPer1 (RteEventToTaskMapping): RteUsedOsAlarmRef=Os/Rte_Al_TE_Task_2msA_Appl10_0_2ms
      MotAgCorrln_EcuSwComposition
        TMT_MotAgCorrlnPer1 (RteEventToTaskMapping): RteUsedOsAlarmRef=Os/Rte_Al_TE_Task_2msA_Appl10_0_2ms
      MotCtrlPrmEstimn_EcuSwComposition
        TMT_MotCtrlPrmEstimnPer1 (RteEventToTaskMapping): RteUsedOsAlarmRef=Os/Rte_Al_TE_Task_2msB_Appl10_0_2ms
        TMT_MotCtrlPrmEstimnPer2 (RteEventToTaskMapping): RteUsedOsEventRef=Rte_Ev_Cyclic_Task_100ms_Appl10_0_100ms, RteUsedOsAlarmRef=Os/Rte_Al_TE_Task_100ms_Appl10_0_100ms
      MotCurrPeakEstimn_EcuSwComposition
        TMT_MotCurrPeakEstimnPer1 (RteEventToTaskMapping): RteUsedOsAlarmRef=Os/Rte_Al_TE_Task_2msB_Appl10_0_2ms
        TMT_MotCurrPeakEstimnPer2 (RteEventToTaskMapping): RteUsedOsEventRef=Rte_Ev_Cyclic_Task_100ms_Appl10_0_100ms, RteUsedOsAlarmRef=Os/Rte_Al_TE_Task_100ms_Appl10_0_100ms
      MotCurrRegCfg_EcuSwComposition
        TMT_MotCurrRegCfgPer1 (RteEventToTaskMapping): RteUsedOsAlarmRef=Os/Rte_Al_TE_Task_2msB_Appl10_0_2ms
      MotQuadDetn_EcuSwComposition
        TMT_MotQuadDetnPer1 (RteEventToTaskMapping): RteUsedOsAlarmRef=Os/Rte_Al_TE_Task_2msB_Appl10_0_2ms
      MotRefMdl_EcuSwComposition
        TMT_MotRefMdlPer1 (RteEventToTaskMapping): RteUsedOsAlarmRef=Os/Rte_Al_TE_Task_2msB_Appl10_0_2ms
      MotTqCalcd_EcuSwComposition
        TMT_MotTqCalcdPer1 (RteEventToTaskMapping): RteUsedOsAlarmRef=Os/Rte_Al_TE_Task_2msA_Appl10_0_2ms
      MotTqCmdSca_EcuSwComposition
        TMT_MotTqCmdScaPer1 (RteEventToTaskMapping): RteUsedOsAlarmRef=Os/Rte_Al_TE_Task_2msB_Appl10_0_2ms
        NvmBlock_MotTqCmdSca_NvmMotTqScaFac (RteNvRamAllocation): RteNvmRamBlockLocationSymbol=Rte_MotTqCmdSca_MotTqScaFac, RteNvmBlockRef=Rte_NvmBlock_MotTqCmdSca_MotTqScaFac
      MotTqTranlDampg_EcuSwComposition
        TMT_MotTqTranlDampgPer1 (RteEventToTaskMapping): RteUsedOsAlarmRef=Os/Rte_Al_TE_Task_2msB_Appl10_0_2ms
      MotVelCtrl_EcuSwComposition
        TMT_MotVelCtrlPer1 (RteEventToTaskMapping): RteUsedOsAlarmRef=Os/Rte_Al_TE_Task_2msA_Appl10_0_2ms
      NvM_EcuSwComposition
        Timer_NvM_MainFunction (RteEventToTaskMapping): RteUsedOsAlarmRef=Os/Rte_Al_TE2_Task_10msBsw_Appl10_0_10ms
      NvMProxy_EcuSwComposition
        Timer_NvMProxy_MainFunction (RteEventToTaskMapping): RteUsedOsAlarmRef=Os/Rte_Al_TE2_Task_10msBsw_Appl10_0_10ms
      NxtrCalIds_EcuSwComposition
      NxtrMath_EcuSwComposition
        TMT_NxtrMathPer1 (RteEventToTaskMapping): RteUsedOsEventRef=Rte_Ev_Cyclic_Task_100ms_Appl10_0_100ms, RteUsedOsAlarmRef=Os/Rte_Al_TE_Task_100ms_Appl10_0_100ms
      NxtrSwIds_EcuSwComposition
      Omc_EcuSwComposition
        LifeCycleRequest (RteEventToTaskMapping): RteUsedOsEventRef=Rte_Ev_Run_Omc_LifeCycleHandler
      Os_OsCore_CORE0_swc_EcuSwComposition
      PhaDiscnct_EcuSwComposition
        TMT_PhaDiscnctPer1 (RteEventToTaskMapping): RteUsedOsAlarmRef=Os/Rte_Al_TE_Task_2msA_Appl10_0_2ms
        TMT_PhaDiscnctPer2 (RteEventToTaskMapping): RteUsedOsAlarmRef=Os/Rte_Al_TE_Task_2msA_Appl10_0_2ms
      PolarityCfg_EcuSwComposition
        NvmBlock_PolarityCfg_NvmPolarityCfgSaved (RteNvRamAllocation):
          RteNvmRamBlockLocationSymbol = Rte_PolarityCfg_PolarityCfgSaved
          RteNvmRomBlockLocationSymbol = Rte_PolarityCfgSavedDft
          RteNvmBlockRef = Rte_NvmBlock_PolarityCfg_PolarityCfgSaved
      PosnTrakgServo_EcuSwComposition
        TMT_PosnTrakgServoPer1 (RteEventToTaskMapping): RteUsedOsAlarmRef=Os/Rte_Al_TE_Task_2msB_Appl10_0_2ms
      ProgMfgSrv_EcuSwComposition
      PullCmpActv_EcuSwComposition
        TMT_PullCmpActvPer1 (RteEventToTaskMapping): RteUsedOsAlarmRef=Os/Rte_Al_TE_Task_2msB_Appl10_0_2ms
        TMT_PullCmpActvPer2 (RteEventToTaskMapping): RteUsedOsEventRef=Rte_Ev_Cyclic_Task_100ms_Appl10_0_100ms, RteUsedOsAlarmRef=Os/Rte_Al_TE_Task_100ms_Appl10_0_100ms
        NvmBlock_PullCmpActv_NvmPullCmpLongTerm (RteNvRamAllocation):
          RteNvmRamBlockLocationSymbol = Rte_PullCmpActv_PullCmpLongTerm
          RteNvmRomBlockLocationSymbol = Rte_PullCmpLongTermDft
          RteNvmBlockRef = Rte_NvmBlock_PullCmpActv_PullCmpLongTerm
      PwrDiscnct_EcuSwComposition
        TMT_PwrDiscnctPer1 (RteEventToTaskMapping): RteUsedOsAlarmRef=Os/Rte_Al_TE_Task_2msA_Appl10_0_2ms
      PwrLimr_EcuSwComposition
        TMT_PwrLimrPer1 (RteEventToTaskMapping): RteUsedOsAlarmRef=Os/Rte_Al_TE_Task_2msB_Appl10_0_2ms
        TMT_PwrLimrPer2 (RteEventToTaskMapping): RteUsedOsEventRef=Rte_Ev_Cyclic_Task_10ms_Appl10_0_10ms, RteUsedOsAlarmRef=Os/Rte_Al_TE_Task_10ms_Appl10_0_10ms
      PwrSply_EcuSwComposition
        TMT_PwrSplyPer1 (RteEventToTaskMapping): RteUsedOsAlarmRef=Os/Rte_Al_TE_Task_4ms_Appl10_0_4ms
      PwrUpSeq_EcuSwComposition
        TMT_PwrUpSeqPer1 (RteEventToTaskMapping): RteUsedOsAlarmRef=Os/Rte_Al_TE_Task_2msB_Appl10_0_2ms
      Rmh_EcuSwComposition
        DataReceivedEvent (RteEventToTaskMapping): RteUsedOsEventRef=Rte_Ev_Run_Rmh_RxRequestMsg
      Rmh_Cdd_EcuSwComposition
      RvsBattProtn_EcuSwComposition
        TMT_RvsBattProtnPer1 (RteEventToTaskMapping): RteUsedOsAlarmRef=Os/Rte_Al_TE_Task_10ms_Appl7_0_10ms
      ShtdwnMech_EcuSwComposition
        TMT_ShtdwnMechPer1 (RteEventToTaskMapping): RteUsedOsAlarmRef=Os/Rte_Al_TE_Task_2msB_Appl10_0_2ms
      StOutpCtrl_EcuSwComposition
        TMT_StOutpCtrlPer1 (RteEventToTaskMapping): RteUsedOsAlarmRef=Os/Rte_Al_TE_Task_2msB_Appl10_0_2ms
      StdDiag_EcuSwComposition
        3 x RteEventToTaskMapping:
          LifeCycleRequest: RteUsedOsEventRef=Rte_Ev_Run_StdDiag_LifeCycleHandler
          Event_SessionChange_DefaultSession: RteUsedOsEventRef=Rte_Ev_Run_StdDiag_SessionChange_DefaultSession
          Event_SessionChange_OtherSession: RteUsedOsEventRef=Rte_Ev_Run_StdDiag_SessionChange_OtherSession
      SteerCmdArbnAndLim_EcuSwComposition
        TMT_SteerCmdArbnAndLimPer1 (RteEventToTaskMapping): RteUsedOsAlarmRef=Os/Rte_Al_TE_Task_2msB_Appl10_0_2ms
      Stm_EcuSwComposition
        6 x RteEventToTaskMapping:
          DRET_Runnable_ErrorCentralErrorLock_CentralErrorLockRx_centralErrorLock: RteUsedOsEventRef=Rte_Ev_Run_Stm_Runnable_ErrorCentralErrorLock
          DRET_Runnable_ErrorEnergyMode_EnergyModeRx_energyState: RteUsedOsEventRef=Rte_Ev_Run_Stm_Runnable_ErrorEnergyMode
          MST_Runnable_InitialCELSupervision_0: RteUsedOsEventRef=Rte_Ev_Run1_Stm_Runnable_InitialCELSupervision
          DRT_Runnable_ReceiveCentralErrorLock_CentralErrorLockRx_centralErrorLock: RteUsedOsEventRef=Rte_Ev_Run_Stm_Runnable_ReceiveCentralErrorLock
          DRT_Runnable_ReceiveEnergyMode_EnergyModeRx_energyState: RteUsedOsEventRef=Rte_Ev_Run_Stm_Runnable_ReceiveEnergyMode
          MST_Runnable_StopCentralErrorLockSupervision_0: RteUsedOsEventRef=Rte_Ev_Run1_Stm_Runnable_StopCentralErrorLockSupervision
      Swp_EcuSwComposition
        TMT_SwpPer1 (RteEventToTaskMapping): RteUsedOsAlarmRef=Os/Rte_Al_TE_Task_2msA_Appl10_0_2ms
        TMT_SwpPer2 (RteEventToTaskMapping): RteUsedOsAlarmRef=Os/Rte_Al_TE_Task_2msB_Appl10_0_2ms
      SysFricLrng_EcuSwComposition
        TMT_SysFricLrngPer1 (RteEventToTaskMapping): RteUsedOsEventRef=Rte_Ev_Cyclic_Task_10ms_Appl10_0_10ms, RteUsedOsAlarmRef=Os/Rte_Al_TE_Task_10ms_Appl10_0_10ms
        NvmBlock_SysFricLrng_NvMFricLrngData (RteNvRamAllocation):
          RteNvmRamBlockLocationSymbol = Rte_SysFricLrng_FricLrngData
          RteNvmRomBlockLocationSymbol = Rte_FricLrngDataDft
          RteNvmBlockRef = Rte_NvmBlock_SysFricLrng_FricLrngData
        NvmBlock_SysFricLrng_NvMFricNonLrngData (RteNvRamAllocation):
          RteNvmRamBlockLocationSymbol = Rte_SysFricLrng_FricNonLrngData
          RteNvmRomBlockLocationSymbol = Rte_FricNonLrngDataDft
          RteNvmBlockRef = Rte_NvmBlock_SysFricLrng_FricNonLrngData
      SysKineAndEff_EcuSwComposition
        TMT_SysKineAndEffPer1 (RteEventToTaskMapping): RteUsedOsAlarmRef=Os/Rte_Al_TE_Task_2ms_Appl7_0_2ms
      SysStMod_EcuSwComposition
        TMT_SysStModPer1 (RteEventToTaskMapping): RteUsedOsAlarmRef=Os/Rte_Al_TE_Task_2msB_Appl10_0_2ms
      SysTime_EcuSwComposition
        3 x RteEventToTaskMapping:
          LifeCycleRequest: RteUsedOsEventRef=Rte_Ev_Run_SysTime_LifeCycleHandler
          TimingEvent: RteUsedOsEventRef=Rte_Ev_Cyclic_Task_10ms_Appl10_0_10ms, RteUsedOsAlarmRef=Os/Rte_Al_TE_Task_10ms_Appl10_0_10ms
          SysTimeRx: RteUsedOsEventRef=Rte_Ev_Run1_SysTime_ReceiveSignal
      TEstimn_EcuSwComposition
        TMT_TEstimnPer1 (RteEventToTaskMapping): RteUsedOsAlarmRef=Os/Rte_Al_TE_Task_100ms_Appl9_0_100ms
        NvmBlock_TEstimn_NvmTFilStVal (RteNvRamAllocation): RteNvmRamBlockLocationSymbol=Rte_TEstimn_TFilStVal, RteNvmBlockRef=Rte_NvmBlock_TEstimn_TFilStVal
      TmplMonr_EcuSwComposition
        3 x RteEventToTaskMapping:
          TMT_TmplMonrPer1: RteUsedOsAlarmRef=Os/Rte_Al_TE_Task_2msTmplMonr_Appl10_0_2ms
          TMT_TmplMonrPer2: RteUsedOsAlarmRef=Os/Rte_Al_TE_Task_2msB_Appl10_0_2ms
          TMT_TmplMonrPer2_1: RteUsedOsAlarmRef=Os/Rte_Al_TE_Task_2msTmplMonr_Appl10_0_2ms
      TqOscn_EcuSwComposition
        TMT_TqOscnPer1 (RteEventToTaskMapping): RteUsedOsAlarmRef=Os/Rte_Al_TE_Task_2msB_Appl10_0_2ms
      TunSelnAuthy_EcuSwComposition
      TunSelnMngt_EcuSwComposition
        TMT_TunSelnMngtPer1 (RteEventToTaskMapping): RteUsedOsEventRef=Rte_Ev_Cyclic_Task_10ms_Appl10_0_10ms, RteUsedOsAlarmRef=Os/Rte_Al_TE_Task_10ms_Appl10_0_10ms
      TurnCntrCorrln_EcuSwComposition
        TMT_TurnCntrCorrlnPer1 (RteEventToTaskMapping): RteUsedOsAlarmRef=Os/Rte_Al_TE_Task_2ms_Appl8_0_2ms
      VehSigCdng_EcuSwComposition
        TMT_VehSigCdngPer1 (RteEventToTaskMapping): RteUsedOsAlarmRef=Os/Rte_Al_TE_Task_2ms_Appl9_0_2ms
      VehSpdLimr_EcuSwComposition
        TMT_VehSpdLimrPer1 (RteEventToTaskMapping): RteUsedOsAlarmRef=Os/Rte_Al_TE_Task_2ms_Appl7_0_2ms
      Vin_EcuSwComposition
        LifeCycleRequest (RteEventToTaskMapping): RteUsedOsEventRef=Rte_Ev_Run_Vin_Vin_LifeCycleModeRequest
        VinState (RteExclusiveAreaImplementation): RteExclusiveAreaOsResourceRef=Rte_Res_Vin_VinState
        5 x RteEventToTaskMapping:
          Main: RteUsedOsEventRef=Rte_Ev_Cyclic_Task_100ms_Appl10_0_100ms, RteUsedOsAlarmRef=Os/Rte_Al_TE_Task_100ms_Appl10_0_100ms
          mse_ComOff: RteUsedOsEventRef=Rte_Ev_Run_Vin_Vin_OnComOff
          mse_ComOn: RteUsedOsEventRef=Rte_Ev_Run_Vin_Vin_OnComOn
          msae_VinChangeIndicator: RteUsedOsEventRef=Rte_Ev_Run_Vin_Vin_OnVinChangeIndicatorAck
          dre_ComVin: RteUsedOsEventRef=Rte_Ev_Run_Vin_Vin_ReceiveFromCom
      WdgM_Appl10_EcuSwComposition
        Timer_WdgM_MainFunction (RteEventToTaskMapping): RteUsedOsAlarmRef=Os/Rte_Al_TE2_Task_4msBsw_Appl10_0_4ms
      WdgM_Appl{7..9}_EcuSwComposition
    RteOsInteraction
      21 x RteUsedOsActivation, all with RteExpectedActivationOffset=0:
        Rte_Al_TE_Darh_QueueHandler: RteActivationOsAlarmRef=Os/Rte_Al_TE_Darh_QueueHandler, RteActivationOsTaskRef=Task_100ms_Appl10
        Rte_Al_TE_Task_100ms_Appl10_0_100ms: RteActivationOsAlarmRef=Os/Rte_Al_TE_Task_100ms_Appl10_0_100ms, RteActivationOsTaskRef=Task_100ms_Appl10
        Rte_Al_TE_Task_100ms_Appl7_0_100ms: RteActivationOsAlarmRef=Os/Rte_Al_TE_Task_100ms_Appl7_0_100ms, RteActivationOsTaskRef=Task_100ms_Appl7
        Rte_Al_TE_Task_100ms_Appl9_0_100ms: RteActivationOsAlarmRef=Os/Rte_Al_TE_Task_100ms_Appl9_0_100ms, RteActivationOsTaskRef=Task_100ms_Appl9
        Rte_Al_TE2_Task_10msBsw_Appl10_0_10ms: RteActivationOsAlarmRef=Os/Rte_Al_TE2_Task_10msBsw_Appl10_0_10ms, RteActivationOsTaskRef=Task_10msBsw_Appl10
        Rte_Al_TE_Task_10ms_Appl10_0_10ms: RteActivationOsAlarmRef=Os/Rte_Al_TE_Task_10ms_Appl10_0_10ms, RteActivationOsTaskRef=Task_10ms_Appl10
        Rte_Al_TE_Task_10ms_Appl{7..9}_0_10ms: RteActivationOsAlarmRef=Os/Rte_Al_TE_Task_10ms_Appl{7..9}_0_10ms, RteActivationOsTaskRef=Task_10ms_Appl{7..9}
        Rte_Al_TE_Task_2msA_Appl10_0_2ms: RteActivationOsAlarmRef=Os/Rte_Al_TE_Task_2msA_Appl10_0_2ms, RteActivationOsTaskRef=Task_2msA_Appl10
        Rte_Al_TE_Task_2msB_Appl10_0_2ms: RteActivationOsAlarmRef=Os/Rte_Al_TE_Task_2msB_Appl10_0_2ms, RteActivationOsTaskRef=Task_2msB_Appl10
        Rte_Al_TE_Task_2msTmplMonr_Appl10_0_2ms: RteActivationOsAlarmRef=Os/Rte_Al_TE_Task_2msTmplMonr_Appl10_0_2ms, RteActivationOsTaskRef=Task_2msTmplMonr_Appl10
        Rte_Al_TE_Task_2ms_Appl{7..9}_0_2ms: RteActivationOsAlarmRef=Os/Rte_Al_TE_Task_2ms_Appl{7..9}_0_2ms, RteActivationOsTaskRef=Task_2ms_Appl{7..9}
        Rte_Al_TE2_Task_4msBsw_Appl10_0_4ms: RteActivationOsAlarmRef=Os/Rte_Al_TE2_Task_4msBsw_Appl10_0_4ms, RteActivationOsTaskRef=Task_4msBsw_Appl10
        Rte_Al_TE_Task_4ms_Appl10_0_4ms: RteActivationOsAlarmRef=Os/Rte_Al_TE_Task_4ms_Appl10_0_4ms, RteActivationOsTaskRef=Task_4ms_Appl10
        Rte_Al_TE_Task_4ms_Appl7_0_4ms: RteActivationOsAlarmRef=Os/Rte_Al_TE_Task_4ms_Appl7_0_4ms, RteActivationOsTaskRef=Task_4ms_Appl7
        Rte_Al_TE2_Task_5msBsw_Appl10_0_5ms: RteActivationOsAlarmRef=Os/Rte_Al_TE2_Task_5msBsw_Appl10_0_5ms, RteActivationOsTaskRef=Task_5msBsw_Appl10
        Rte_Al_TE2_Task_ComBsw_Appl10_0_5ms: RteActivationOsAlarmRef=Os/Rte_Al_TE2_Task_ComBsw_Appl10_0_5ms, RteActivationOsTaskRef=Task_ComBsw_Appl10
        Rte_Al_TE_Task_ComBsw_Appl10_0_10ms: RteActivationOsAlarmRef=Os/Rte_Al_TE_Task_ComBsw_Appl10_0_10ms, RteActivationOsTaskRef=Task_ComBsw_Appl10
  module config NvM
    43 x NvMBlockDescriptor:
      Rte_NvmBlock_BmwDiagcSrvHndlg_MilesKmEeprom: NvMNvBlockLength=4, NvMRamBlockDataAddress=Rte_BmwDiagcSrvHndlg_MilesKmEeprom, NvMRomBlockDataAddress=NULL_PTR
      Rte_NvmBlock_BmwDiagcSrvHndlg_ProgCntr: NvMNvBlockLength=2, NvMRamBlockDataAddress=Rte_BmwDiagcSrvHndlg_ProgCntr, NvMRomBlockDataAddress=NULL_PTR
      Rte_NvmBlock_BmwDiagcSrvHndlg_ProgCntrMaxVal: NvMNvBlockLength=2, NvMRamBlockDataAddress=Rte_BmwDiagcSrvHndlg_ProgCntrMaxVal, NvMRomBlockDataAddress=Rte_ProgCntrMaxValDft
      Rte_NvmBlock_BmwDiagcSrvHndlg_TestStamp: NvMNvBlockLength=3, NvMRamBlockDataAddress=Rte_BmwDiagcSrvHndlg_TestStamp, NvMRomBlockDataAddress=NULL_PTR
      Rte_NvmBlock_BmwHwAgArbnAndEotPosn_BmwVehCentrOffs: NvMNvBlockLength=20, NvMRamBlockDataAddress=Rte_BmwHwAgArbnAndEotPosn_BmwVehCentrOffs, NvMRomBlockDataAddress=NULL_PTR
      Rte_NvmBlock_BmwTunSetHndlr_BmwDesIninIdx: NvMNvBlockLength=2, NvMRamBlockDataAddress=Rte_BmwTunSetHndlr_BmwDesIninIdx, NvMRomBlockDataAddress=Rte_BmwDesIninIdxDft
      Rte_NvmBlock_BmwTunSetHndlr_NvmBmwDesIninOptSetAIdx: NvMNvBlockLength=2, NvMRamBlockDataAddress=Rte_BmwTunSetHndlr_BmwDesIninOptSetAIdx, NvMRomBlockDataAddress=Rte_BmwDesIninOptSetAIdxDft
      Rte_NvmBlock_CDD_CurrMeas_CurrMeasEolGainCalSetABC: NvMNvBlockLength=12, NvMRamBlockDataAddress=Rte_CDD_CurrMeas_CurrMeasEolGainCalSetABC, NvMRomBlockDataAddress=Rte_CurrMeasEolGainCalSetABCDft
      Rte_NvmBlock_CDD_CurrMeas_CurrMeasEolOffsCalSetABC: NvMNvBlockLength=28, NvMRamBlockDataAddress=Rte_CDD_CurrMeas_CurrMeasEolOffsCalSetABC, NvMRomBlockDataAddress=Rte_CurrMeasEolOffsCalSetABCDft
      Rte_NvmBlock_ExcpnHndlg_McuDiagcData: NvMNvBlockLength=16, NvMRamBlockDataAddress=Rte_CDD_ExcpnHndlg_McuDiagcData, NvMRomBlockDataAddress=Rte_McuDiagcDataDft
      Rte_NvmBlock_CDD_HwTq4Meas_HwTq4Offs_MirrorBlock: NvMNvBlockLength=8, NvMRamBlockDataAddress=Rte_CDD_HwTq4Meas_HwTq4Offs, NvMRomBlockDataAddress=NULL_PTR
      Rte_NvmBlock_CDD_HwTq4Meas_HwTq4Sca_MirrorBlock: NvMNvBlockLength=8, NvMRamBlockDataAddress=Rte_CDD_HwTq4Meas_HwTq4Sca, NvMRomBlockDataAddress=NULL_PTR
      Rte_NvmBlock_CDD_HwTq5Meas_HwTq5Offs_MirrorBlock: NvMNvBlockLength=8, NvMRamBlockDataAddress=Rte_CDD_HwTq5Meas_HwTq5Offs, NvMRomBlockDataAddress=NULL_PTR
      Rte_NvmBlock_CDD_HwTq5Meas_HwTq5Sca_MirrorBlock: NvMNvBlockLength=8, NvMRamBlockDataAddress=Rte_CDD_HwTq5Meas_HwTq5Sca, NvMRomBlockDataAddress=NULL_PTR
      Rte_NvmBlock_CDD_MotAg0Meas_MotAg0CoeffTbl: NvMNvBlockLength=104, NvMRamBlockDataAddress=Rte_CDD_MotAg0Meas_MotAg0CoeffTbl, NvMRomBlockDataAddress=NULL_PTR
      Rte_NvmBlock_CDD_MotAg1Meas_MotAg1CoeffTbl: NvMNvBlockLength=104, NvMRamBlockDataAddress=Rte_CDD_MotAg1Meas_MotAg1CoeffTbl, NvMRomBlockDataAddress=NULL_PTR
      Rte_NvmBlock_CDD_MotAgCmp_MotAgCmpMotAgBackEmf: NvMNvBlockLength=2, NvMRamBlockDataAddress=Rte_CDD_MotAgCmp_MotAgCmpMotAgBackEmf, NvMRomBlockDataAddress=Rte_MotAgCmpMotAgBackEmfDft
      Rte_NvmBlock_CDD_NvMProxy_ShtdwnClsChk: NvMNvBlockLength=4, NvMRamBlockDataAddress=Rte_CDD_NvMProxy_ShtdwnClsChk, NvMRomBlockDataAddress=NULL_PTR
      Rte_NvmBlock_CDD_VrfyCritReg_MCalReadVrfyCritRegFltInfo: NvMNvBlockLength=4, NvMRamBlockDataAddress=Rte_CDD_VrfyCritReg_MCalReadVrfyCritRegFltNvmInfo, NvMRomBlockDataAddress=NULL_PTR
      Rte_NvmBlock_CmnMfgSrv_IgnCntr: NvMNvBlockLength=4, NvMRamBlockDataAddress=Rte_CmnMfgSrv_IgnCntr, NvMRomBlockDataAddress=Rte_NvmIgnCntr_DefaultValue
      Rte_NvmBlock_CmnMfgSrv_NxtrMfgEnaCntr: NvMNvBlockLength=1, NvMRamBlockDataAddress=Rte_CmnMfgSrv_NxtrMfgEnaCntr, NvMRomBlockDataAddress=Rte_NvmMfgEnaCntr_DefaultValue
      Rte_NvmBlock_CmnMfgSrv_CcaHwPartNr: NvMNvBlockLength=20, NvMRamBlockDataAddress=Rte_CmnMfgSrv_CcaHwPartNr, NvMRomBlockDataAddress=NULL_PTR
      Rte_NvmBlock_CmnMfgSrv_CcaSerlNr: NvMNvBlockLength=20, NvMRamBlockDataAddress=Rte_CmnMfgSrv_CcaSerlNr, NvMRomBlockDataAddress=NULL_PTR
      Rte_NvmBlock_CmnMfgSrv_DiRestore: NvMNvBlockLength=8, NvMRamBlockDataAddress=Rte_CmnMfgSrv_DiRestore, NvMRomBlockDataAddress=NULL_PTR
      Rte_NvmBlock_CmnMfgSrv_EpsSysSerlNr: NvMNvBlockLength=20, NvMRamBlockDataAddress=Rte_CmnMfgSrv_EpsSysSerlNr, NvMRomBlockDataAddress=NULL_PTR
      Rte_NvmBlock_CmnMfgSrv_MfgTmpBuf{0..4}: NvMNvBlockLength=16, NvMRamBlockDataAddress=Rte_CmnMfgSrv_MfgTmpBuf{0..4}, NvMRomBlockDataAddress=NULL_PTR
      Rte_NvmBlock_CmnMfgSrv_SeedKey: NvMNvBlockLength=8, NvMRamBlockDataAddress=Rte_CmnMfgSrv_SeedKey, NvMRomBlockDataAddress=Rte_SeedKeyDft
      Rte_NvmBlock_DiagcMgr_DiagcMgrApplCrc: NvMNvBlockLength=4, NvMRamBlockDataAddress=Rte_DiagcMgr_DiagcMgrApplCrc, NvMRomBlockDataAddress=Rte_DiagcMgrApplCrcDft
      Rte_NvmBlock_DiagcMgr_DiagcMgrLtchCntrAry: NvMNvBlockLength=20, NvMRamBlockDataAddress=Rte_DiagcMgr_DiagcMgrLtchCntrAry, NvMRomBlockDataAddress=NULL_PTR
      Rte_NvmBlock_DiagcMgr_DiagcMgrNtcFltAry: NvMNvBlockLength=80, NvMRamBlockDataAddress=Rte_DiagcMgr_DiagcMgrNtcFltAry, NvMRomBlockDataAddress=NULL_PTR
      Rte_NvmBlock_DutyCycThermProtn_FilStVal: NvMNvBlockLength=4, NvMRamBlockDataAddress=Rte_DutyCycThermProtn_FilStVal, NvMRomBlockDataAddress=NULL_PTR
      Rte_NvmBlock_HwTqCorrln_HwTqChACmnModCmpLpFilSt: NvMNvBlockLength=4, NvMRamBlockDataAddress=Rte_HwTqCorrln_HwTqChACmnModCmpLpFilSt, NvMRomBlockDataAddress=Rte_HwTqChACmnModCmpLpFilStDft
      Rte_NvmBlock_LrndRackCentr_LrndRackCentr: NvMNvBlockLength=12, NvMRamBlockDataAddress=Rte_LrndRackCentr_LrndRackCentr, NvMRomBlockDataAddress=NULL_PTR
      Rte_NvmBlock_MotTqCmdSca_MotTqScaFac: NvMNvBlockLength=4, NvMRamBlockDataAddress=Rte_MotTqCmdSca_MotTqScaFac, NvMRomBlockDataAddress=NULL_PTR
      Rte_NvmBlock_PolarityCfg_PolarityCfgSaved: NvMNvBlockLength=4, NvMRamBlockDataAddress=Rte_PolarityCfg_PolarityCfgSaved, NvMRomBlockDataAddress=Rte_PolarityCfgSavedDft
      Rte_NvmBlock_PullCmpActv_PullCmpLongTerm: NvMNvBlockLength=4, NvMRamBlockDataAddress=Rte_PullCmpActv_PullCmpLongTerm, NvMRomBlockDataAddress=Rte_PullCmpLongTermDft
      Rte_NvmBlock_SysFricLrng_FricLrngData: NvMNvBlockLength=216, NvMRamBlockDataAddress=Rte_SysFricLrng_FricLrngData, NvMRomBlockDataAddress=Rte_FricLrngDataDft
      Rte_NvmBlock_SysFricLrng_FricNonLrngData: NvMNvBlockLength=8, NvMRamBlockDataAddress=Rte_SysFricLrng_FricNonLrngData, NvMRomBlockDataAddress=Rte_FricNonLrngDataDft
      Rte_NvmBlock_TEstimn_TFilStVal: NvMNvBlockLength=32, NvMRamBlockDataAddress=Rte_TEstimn_TFilStVal, NvMRomBlockDataAddress=NULL_PTR
  module config Os
    Task_100ms_Appl10 (OsTask):
      OsTaskActivation = 1
      OsTaskPriority = 39
      OsTaskSchedule = FULL
      OsTaskEventRef = Rte_Ev_Cyclic_Task_100ms_Appl10_0_100ms
      OsTaskEventRef = Rte_Ev_MS_Task_100ms_Appl10
      OsTaskEventRef = Rte_Ev_Run1_Darh_QueueHandler
      OsTaskEventRef = Rte_Ev_Run_BmwMsgSlot121Bas1Repn2BusFrChA_CON_VEH_Missing_Oper
      OsTaskEventRef = Rte_Ev_Run_BmwMsgSlot121Bas1Repn2BusFrChA_CON_VEH_Received_Oper
      OsTaskEventRef = Rte_Ev_Run_BmwMsgSlot55Bas3Repn4BusFrChA_V_VEH_Missing_Oper
      OsTaskEventRef = Rte_Ev_Run_BmwMsgSlot55Bas3Repn4BusFrChA_V_VEH_Received_Oper
      OsTaskEventRef = Rte_Ev_Run_Vin_Vin_LifeCycleModeRequest
      OsTaskEventRef = Rte_Ev_Run_Vin_Vin_OnComOff
      OsTaskEventRef = Rte_Ev_Run_Vin_Vin_OnComOn
      OsTaskEventRef = Rte_Ev_Run_Vin_Vin_OnVinChangeIndicatorAck
      OsTaskEventRef = Rte_Ev_Run_Vin_Vin_ReceiveFromCom
      OsTaskResourceRef = Rte_Res_Vin_VinState
      OsTaskAccessingApplication = Appl{7..9}
    Rte_Al_TE_Darh_QueueHandler (OsAlarm): OsAlarmCounterRef=OsCounter
      OsAlarmAction
        OsAlarmSetEvent: OsAlarmSetEventRef=Rte_Ev_Run1_Darh_QueueHandler, OsAlarmSetEventTaskRef=Task_100ms_Appl10
    Rte_Al_TE_Task_100ms_Appl10_0_100ms (OsAlarm): OsAlarmCounterRef=OsCounter
      OsAlarmAction
        OsAlarmSetEvent: OsAlarmSetEventRef=Rte_Ev_Cyclic_Task_100ms_Appl10_0_100ms, OsAlarmSetEventTaskRef=Task_100ms_Appl10
    Task_100ms_Appl7 (OsTask): OsTaskActivation=1, OsTaskPriority=36, OsTaskSchedule=FULL, OsTaskAccessingApplication=Appl10, OsTaskAccessingApplication=Appl9
    Rte_Al_TE_Task_100ms_Appl7_0_100ms (OsAlarm): OsAlarmCounterRef=OsCounter, OsAlarmAccessingApplication=Appl10
      OsAlarmAction
        OsAlarmActivateTask: OsAlarmActivateTaskRef=Task_100ms_Appl7
    Task_100ms_Appl9 (OsTask): OsTaskActivation=1, OsTaskPriority=38, OsTaskSchedule=FULL, OsTaskAccessingApplication=Appl10, OsTaskAccessingApplication=Appl7
    Rte_Al_TE_Task_100ms_Appl9_0_100ms (OsAlarm): OsAlarmCounterRef=OsCounter, OsAlarmAccessingApplication=Appl10
      OsAlarmAction
        OsAlarmActivateTask: OsAlarmActivateTaskRef=Task_100ms_Appl9
    Task_10msBsw_Appl10 (OsTask):
      OsTaskActivation = 1
      OsTaskPriority = 44
      OsTaskSchedule = FULL
      OsTaskResourceRef = Rte_Res_Vin_VinState
      OsTaskAccessingApplication = Appl7
      OsTaskAccessingApplication = Appl9
    Rte_Al_TE2_Task_10msBsw_Appl10_0_10ms (OsAlarm): OsAlarmCounterRef=OsCounter
      OsAlarmAction
        OsAlarmActivateTask: OsAlarmActivateTaskRef=Task_10msBsw_Appl10
    Task_10ms_Appl10 (OsTask):
      OsTaskActivation = 1
      OsTaskPriority = 49
      OsTaskSchedule = FULL
      OsTaskEventRef = Rte_Ev_Cyclic_Task_10ms_Appl10_0_10ms
      OsTaskEventRef = Rte_Ev_MS_Task_10ms_Appl10
      OsTaskEventRef = Rte_Ev_Run1_Stm_Runnable_InitialCELSupervision
      OsTaskEventRef = Rte_Ev_Run1_Stm_Runnable_StopCentralErrorLockSupervision
      OsTaskEventRef = Rte_Ev_Run1_SysTime_ReceiveSignal
      OsTaskEventRef = Rte_Ev_Run_BmwMsgSlot107Bas0Repn1BusFrChA_OFFS_QUAD_EPS_Missing_Oper
      OsTaskEventRef = Rte_Ev_Run_BmwMsgSlot107Bas0Repn1BusFrChA_OFFS_QUAD_EPS_Received_Oper
      OsTaskEventRef = Rte_Ev_Run_BmwMsgSlot108Bas0Repn2BusFrChA_STEA_OFFS_Missing_Oper
      OsTaskEventRef = Rte_Ev_Run_BmwMsgSlot108Bas0Repn2BusFrChA_STEA_OFFS_Received_Oper
      OsTaskEventRef = Rte_Ev_Run_BmwMsgSlot269Bas2Repn4BusFrChA_CTR_VIB_STW_DISP_EXMI_SP2015_Missing
      OsTaskEventRef = Rte_Ev_Run_BmwMsgSlot269Bas2Repn4BusFrChA_CTR_VIB_STW_DISP_EXMI_SP2015_Received
      OsTaskEventRef = Rte_Ev_Run_BmwMsgSlot276Bas4Repn8BusFrChA_MILE_KM_Missing_Oper
      OsTaskEventRef = Rte_Ev_Run_BmwMsgSlot276Bas4Repn8BusFrChA_MILE_KM_Received_Oper
      OsTaskEventRef = Rte_Ev_Run_BmwMsgSlot53Bas3Repn8BusFrChA_SU_CLE_DRDY_DXP_Miss
      OsTaskEventRef = Rte_Ev_Run_BmwMsgSlot53Bas3Repn8BusFrChA_SU_CLE_DRDY_DXP_Rxd
      OsTaskEventRef = Rte_Ev_Run_BmwMsgSlot55Bas0Repn2BusFrChA_ACLNY_MASSCNTR_Missing_Oper
      OsTaskEventRef = Rte_Ev_Run_BmwMsgSlot55Bas0Repn2BusFrChA_ACLNY_MASSCNTR_Received_Oper
      OsTaskEventRef = Rte_Ev_Run_BmwMsgSlot56Bas0Repn2BusFrChA_VYAW_VEH_Missing_Oper
      OsTaskEventRef = Rte_Ev_Run_BmwMsgSlot56Bas0Repn2BusFrChA_VYAW_VEH_Received_Oper
      OsTaskEventRef = Rte_Ev_Run_BmwMsgSlot68Bas0Repn2BusFrChA_TAR_QTA_STRMOM_DV_Miss
      OsTaskEventRef = Rte_Ev_Run_BmwMsgSlot68Bas0Repn2BusFrChA_TAR_QTA_STRMOM_DV_Rxd
      OsTaskEventRef = Rte_Ev_Run_BmwMsgSlot68Bas0Repn2BusFrChA_TAR_STMOM_DV_ACT_Miss
      OsTaskEventRef = Rte_Ev_Run_BmwMsgSlot68Bas0Repn2BusFrChA_TAR_STMOM_DV_ACT_Rxd
      OsTaskEventRef = Rte_Ev_Run_BmwMsgSlot68Bas1Repn2BusFrChA_ENERG_DGR_DRDY_Missing_Oper
      OsTaskEventRef = Rte_Ev_Run_BmwMsgSlot68Bas1Repn2BusFrChA_ENERG_DGR_DRDY_Received_Oper
      OsTaskEventRef = Rte_Ev_Run_BswM_BswM_Read_StdDiag_ComControlModeRequest
      OsTaskEventRef = Rte_Ev_Run_Coding_LifeCycleHandler
      OsTaskEventRef = Rte_Ev_Run_Coding_SessionChange
      OsTaskEventRef = Rte_Ev_Run_Coding_VinReceiveHandler
      OsTaskEventRef = Rte_Ev_Run_Darh_LifeCycleHandler
      OsTaskEventRef = Rte_Ev_Run_Dlog_Dlog_ModeSwitchAckLifeCycle
      OsTaskEventRef = Rte_Ev_Run_Dlog_Dlog_ModeSwitchRequestLifeCycle
      OsTaskEventRef = Rte_Ev_Run_Omc_LifeCycleHandler
      OsTaskEventRef = Rte_Ev_Run_Rmh_RxRequestMsg
      OsTaskEventRef = Rte_Ev_Run_StdDiag_LifeCycleHandler
      OsTaskEventRef = Rte_Ev_Run_StdDiag_SessionChange_DefaultSession
      OsTaskEventRef = Rte_Ev_Run_StdDiag_SessionChange_OtherSession
      OsTaskEventRef = Rte_Ev_Run_Stm_Runnable_ErrorCentralErrorLock
      OsTaskEventRef = Rte_Ev_Run_Stm_Runnable_ErrorEnergyMode
      OsTaskEventRef = Rte_Ev_Run_Stm_Runnable_ReceiveCentralErrorLock
      OsTaskEventRef = Rte_Ev_Run_Stm_Runnable_ReceiveEnergyMode
      OsTaskEventRef = Rte_Ev_Run_SysTime_LifeCycleHandler
      OsTaskAccessingApplication = Appl{7..9}
    Rte_Al_TE_Task_10ms_Appl10_0_10ms (OsAlarm): OsAlarmCounterRef=OsCounter
      OsAlarmAction
        OsAlarmSetEvent: OsAlarmSetEventRef=Rte_Ev_Cyclic_Task_10ms_Appl10_0_10ms, OsAlarmSetEventTaskRef=Task_10ms_Appl10
    Task_10ms_Appl7 (OsTask): OsTaskActivation=1, OsTaskPriority=45, OsTaskSchedule=FULL, OsTaskAccessingApplication=Appl10
    Rte_Al_TE_Task_10ms_Appl7_0_10ms (OsAlarm): OsAlarmCounterRef=OsCounter, OsAlarmAccessingApplication=Appl10
      OsAlarmAction
        OsAlarmActivateTask: OsAlarmActivateTaskRef=Task_10ms_Appl7
    Task_10ms_Appl8 (OsTask): OsTaskActivation=1, OsTaskPriority=46, OsTaskSchedule=FULL, OsTaskAccessingApplication=Appl10
    Rte_Al_TE_Task_10ms_Appl8_0_10ms (OsAlarm): OsAlarmCounterRef=OsCounter, OsAlarmAccessingApplication=Appl10
      OsAlarmAction
        OsAlarmActivateTask: OsAlarmActivateTaskRef=Task_10ms_Appl8
    Task_10ms_Appl9 (OsTask): OsTaskActivation=1, OsTaskPriority=47, OsTaskSchedule=FULL, OsTaskAccessingApplication=Appl10
    Rte_Al_TE_Task_10ms_Appl9_0_10ms (OsAlarm): OsAlarmCounterRef=OsCounter, OsAlarmAccessingApplication=Appl10
      OsAlarmAction
        OsAlarmActivateTask: OsAlarmActivateTaskRef=Task_10ms_Appl9
    Task_2msA_Appl10 (OsTask):
      OsTaskActivation = 1
      OsTaskPriority = 78
      OsTaskSchedule = FULL
      OsTaskAccessingApplication = Appl{7..9}
    Rte_Al_TE_Task_2msA_Appl10_0_2ms (OsAlarm): OsAlarmCounterRef=OsCounter
      OsAlarmAction
        OsAlarmActivateTask: OsAlarmActivateTaskRef=Task_2msA_Appl10
    Task_2msB_Appl10 (OsTask):
      OsTaskActivation = 1
      OsTaskPriority = 74
      OsTaskSchedule = FULL
      OsTaskAccessingApplication = Appl{7..9}
    Rte_Al_TE_Task_2msB_Appl10_0_2ms (OsAlarm): OsAlarmCounterRef=OsCounter
      OsAlarmAction
        OsAlarmActivateTask: OsAlarmActivateTaskRef=Task_2msB_Appl10
    Task_2msTmplMonr_Appl10 (OsTask): OsTaskActivation=1, OsTaskPriority=79, OsTaskSchedule=FULL
    Rte_Al_TE_Task_2msTmplMonr_Appl10_0_2ms (OsAlarm): OsAlarmCounterRef=OsCounter
      OsAlarmAction
        OsAlarmActivateTask: OsAlarmActivateTaskRef=Task_2msTmplMonr_Appl10
    Task_2ms_Appl7 (OsTask): OsTaskActivation=1, OsTaskPriority=76, OsTaskSchedule=FULL, OsTaskAccessingApplication=Appl10, OsTaskAccessingApplication=Appl9
    Rte_Al_TE_Task_2ms_Appl7_0_2ms (OsAlarm): OsAlarmCounterRef=OsCounter, OsAlarmAccessingApplication=Appl10
      OsAlarmAction
        OsAlarmActivateTask: OsAlarmActivateTaskRef=Task_2ms_Appl7
    Task_2ms_Appl8 (OsTask): OsTaskActivation=1, OsTaskPriority=77, OsTaskSchedule=FULL, OsTaskAccessingApplication=Appl10
    Rte_Al_TE_Task_2ms_Appl8_0_2ms (OsAlarm): OsAlarmCounterRef=OsCounter, OsAlarmAccessingApplication=Appl10
      OsAlarmAction
        OsAlarmActivateTask: OsAlarmActivateTaskRef=Task_2ms_Appl8
    Task_2ms_Appl9 (OsTask): OsTaskActivation=1, OsTaskPriority=75, OsTaskSchedule=FULL, OsTaskAccessingApplication=Appl10, OsTaskAccessingApplication=Appl7
    Rte_Al_TE_Task_2ms_Appl9_0_2ms (OsAlarm): OsAlarmCounterRef=OsCounter, OsAlarmAccessingApplication=Appl10
      OsAlarmAction
        OsAlarmActivateTask: OsAlarmActivateTaskRef=Task_2ms_Appl9
    Task_4msBsw_Appl10 (OsTask): OsTaskActivation=1, OsTaskPriority=80, OsTaskSchedule=FULL
    Rte_Al_TE2_Task_4msBsw_Appl10_0_4ms (OsAlarm): OsAlarmCounterRef=OsCounter
      OsAlarmAction
        OsAlarmActivateTask: OsAlarmActivateTaskRef=Task_4msBsw_Appl10
    Task_4ms_Appl10 (OsTask):
      OsTaskActivation = 1
      OsTaskPriority = 69
      OsTaskSchedule = FULL
      OsTaskAccessingApplication = Appl{7..9}
    Rte_Al_TE_Task_4ms_Appl10_0_4ms (OsAlarm): OsAlarmCounterRef=OsCounter
      OsAlarmAction
        OsAlarmActivateTask: OsAlarmActivateTaskRef=Task_4ms_Appl10
    Task_4ms_Appl7 (OsTask): OsTaskActivation=1, OsTaskPriority=66, OsTaskSchedule=FULL, OsTaskAccessingApplication=Appl10
    Rte_Al_TE_Task_4ms_Appl7_0_4ms (OsAlarm): OsAlarmCounterRef=OsCounter, OsAlarmAccessingApplication=Appl10
      OsAlarmAction
        OsAlarmActivateTask: OsAlarmActivateTaskRef=Task_4ms_Appl7
    Task_5msBsw_Appl10 (OsTask):
      OsTaskActivation = 1
      OsTaskPriority = 59
      OsTaskSchedule = FULL
      OsTaskEventRef = Rte_Ev_Cyclic2_Task_5msBsw_Appl10_0_5ms
      OsTaskEventRef = Rte_Ev_WP_Task_5msBsw_Appl10
    Rte_Al_TE2_Task_5msBsw_Appl10_0_5ms (OsAlarm): OsAlarmCounterRef=OsCounter
      OsAlarmAction
        OsAlarmSetEvent: OsAlarmSetEventRef=Rte_Ev_Cyclic2_Task_5msBsw_Appl10_0_5ms, OsAlarmSetEventTaskRef=Task_5msBsw_Appl10
    Task_Coding_Appl10 (OsTask):
      OsTaskActivation = 1
      OsTaskPriority = 30
      OsTaskSchedule = FULL
      OsTaskEventRef = Rte_Ev_Run_Coding_R_CheckNCD
      OsTaskEventRef = Rte_Ev_Run_Coding_R_ConditionCheckReadCPS
      OsTaskEventRef = Rte_Ev_Run_Coding_R_ReadCPS
      OsTaskEventRef = Rte_Ev_Run_Coding_R_ReadNCD
      OsTaskEventRef = Rte_Ev_Run_Coding_R_ReadProtocolData
      OsTaskEventRef = Rte_Ev_Run_Coding_R_WriteNCD
    Task_ComBsw_Appl10 (OsTask):
      OsTaskActivation = 1
      OsTaskPriority = 60
      OsTaskSchedule = FULL
      OsTaskEventRef = Rte_Ev_Cyclic2_Task_ComBsw_Appl10_0_5ms
      OsTaskEventRef = Rte_Ev_Cyclic_Task_ComBsw_Appl10_0_10ms
      OsTaskAccessingApplication = Appl{7..9}
    Rte_Al_TE2_Task_ComBsw_Appl10_0_5ms (OsAlarm): OsAlarmCounterRef=FrCycleCounter
      OsAlarmAction
        OsAlarmSetEvent: OsAlarmSetEventRef=Rte_Ev_Cyclic2_Task_ComBsw_Appl10_0_5ms, OsAlarmSetEventTaskRef=Task_ComBsw_Appl10
    Rte_Al_TE_Task_ComBsw_Appl10_0_10ms (OsAlarm): OsAlarmCounterRef=FrCycleCounter
      OsAlarmAction
        OsAlarmSetEvent: OsAlarmSetEventRef=Rte_Ev_Cyclic_Task_ComBsw_Appl10_0_10ms, OsAlarmSetEventTaskRef=Task_ComBsw_Appl10
    4 x OsTask, all with OsTaskActivation=1, OsTaskSchedule=FULL:
      Task_Init_Appl10: OsTaskPriority=100, OsTaskAccessingApplication=Appl7, OsTaskAccessingApplication=Appl8, OsTaskAccessingApplication=Appl9
      Task_Init_Appl7: OsTaskPriority=96, OsTaskAccessingApplication=Appl10, OsTaskAccessingApplication=Appl9
      Task_Init_Appl8: OsTaskPriority=97, OsTaskAccessingApplication=Appl10
      Task_Init_Appl9: OsTaskPriority=98, OsTaskAccessingApplication=Appl10, OsTaskAccessingApplication=Appl7
    64 x OsEvent:
      Rte_Ev_Cyclic2_Task_5msBsw_Appl10_0_5ms
      Rte_Ev_Cyclic2_Task_ComBsw_Appl10_0_5ms
      Rte_Ev_Cyclic_Task_100ms_Appl10_0_100ms
      Rte_Ev_Cyclic_Task_10ms_Appl10_0_10ms
      Rte_Ev_Cyclic_Task_ComBsw_Appl10_0_10ms
      Rte_Ev_MS_Task_100ms_Appl10: OsEventMask=4
      Rte_Ev_MS_Task_10ms_Appl10: OsEventMask=4
      Rte_Ev_Run1_Darh_QueueHandler
      Rte_Ev_Run1_Stm_Runnable_InitialCELSupervision
      Rte_Ev_Run1_Stm_Runnable_StopCentralErrorLockSupervision
      Rte_Ev_Run1_SysTime_ReceiveSignal
      Rte_Ev_Run_BmwMsgSlot107Bas0Repn1BusFrChA_OFFS_QUAD_EPS_Missing_Oper
      Rte_Ev_Run_BmwMsgSlot107Bas0Repn1BusFrChA_OFFS_QUAD_EPS_Received_Oper
      Rte_Ev_Run_BmwMsgSlot108Bas0Repn2BusFrChA_STEA_OFFS_Missing_Oper
      Rte_Ev_Run_BmwMsgSlot108Bas0Repn2BusFrChA_STEA_OFFS_Received_Oper
      Rte_Ev_Run_BmwMsgSlot121Bas1Repn2BusFrChA_CON_VEH_Missing_Oper
      Rte_Ev_Run_BmwMsgSlot121Bas1Repn2BusFrChA_CON_VEH_Received_Oper
      Rte_Ev_Run_BmwMsgSlot269Bas2Repn4BusFrChA_CTR_VIB_STW_DISP_EXMI_SP2015_Missing
      Rte_Ev_Run_BmwMsgSlot269Bas2Repn4BusFrChA_CTR_VIB_STW_DISP_EXMI_SP2015_Received
      Rte_Ev_Run_BmwMsgSlot276Bas4Repn8BusFrChA_MILE_KM_Missing_Oper
      Rte_Ev_Run_BmwMsgSlot276Bas4Repn8BusFrChA_MILE_KM_Received_Oper
      Rte_Ev_Run_BmwMsgSlot53Bas3Repn8BusFrChA_SU_CLE_DRDY_DXP_Miss
      Rte_Ev_Run_BmwMsgSlot53Bas3Repn8BusFrChA_SU_CLE_DRDY_DXP_Rxd
      Rte_Ev_Run_BmwMsgSlot55Bas0Repn2BusFrChA_ACLNY_MASSCNTR_Missing_Oper
      Rte_Ev_Run_BmwMsgSlot55Bas0Repn2BusFrChA_ACLNY_MASSCNTR_Received_Oper
      Rte_Ev_Run_BmwMsgSlot55Bas3Repn4BusFrChA_V_VEH_Missing_Oper
      Rte_Ev_Run_BmwMsgSlot55Bas3Repn4BusFrChA_V_VEH_Received_Oper
      Rte_Ev_Run_BmwMsgSlot56Bas0Repn2BusFrChA_VYAW_VEH_Missing_Oper
      Rte_Ev_Run_BmwMsgSlot56Bas0Repn2BusFrChA_VYAW_VEH_Received_Oper
      Rte_Ev_Run_BmwMsgSlot68Bas0Repn2BusFrChA_TAR_QTA_STRMOM_DV_Miss
      Rte_Ev_Run_BmwMsgSlot68Bas0Repn2BusFrChA_TAR_QTA_STRMOM_DV_Rxd
      Rte_Ev_Run_BmwMsgSlot68Bas0Repn2BusFrChA_TAR_STMOM_DV_ACT_Miss
      Rte_Ev_Run_BmwMsgSlot68Bas0Repn2BusFrChA_TAR_STMOM_DV_ACT_Rxd
      Rte_Ev_Run_BmwMsgSlot68Bas1Repn2BusFrChA_ENERG_DGR_DRDY_Missing_Oper
      Rte_Ev_Run_BmwMsgSlot68Bas1Repn2BusFrChA_ENERG_DGR_DRDY_Received_Oper
      Rte_Ev_Run_BswM_BswM_Read_StdDiag_ComControlModeRequest
      Rte_Ev_Run_Coding_LifeCycleHandler
      Rte_Ev_Run_Coding_R_CheckNCD
      Rte_Ev_Run_Coding_R_ConditionCheckReadCPS
      Rte_Ev_Run_Coding_R_ReadCPS
      Rte_Ev_Run_Coding_R_ReadNCD
      Rte_Ev_Run_Coding_R_ReadProtocolData
      Rte_Ev_Run_Coding_R_WriteNCD
      Rte_Ev_Run_Coding_SessionChange
      Rte_Ev_Run_Coding_VinReceiveHandler
      Rte_Ev_Run_Darh_LifeCycleHandler
      Rte_Ev_Run_Dlog_Dlog_ModeSwitchAckLifeCycle
      Rte_Ev_Run_Dlog_Dlog_ModeSwitchRequestLifeCycle
      Rte_Ev_Run_Omc_LifeCycleHandler
      Rte_Ev_Run_Rmh_RxRequestMsg
      Rte_Ev_Run_StdDiag_LifeCycleHandler
      Rte_Ev_Run_StdDiag_SessionChange_DefaultSession
      Rte_Ev_Run_StdDiag_SessionChange_OtherSession
      Rte_Ev_Run_Stm_Runnable_ErrorCentralErrorLock
      Rte_Ev_Run_Stm_Runnable_ErrorEnergyMode
      Rte_Ev_Run_Stm_Runnable_ReceiveCentralErrorLock
      Rte_Ev_Run_Stm_Runnable_ReceiveEnergyMode
      Rte_Ev_Run_SysTime_LifeCycleHandler
      Rte_Ev_Run_Vin_Vin_LifeCycleModeRequest
      Rte_Ev_Run_Vin_Vin_OnComOff
      Rte_Ev_Run_Vin_Vin_OnComOn
      Rte_Ev_Run_Vin_Vin_OnVinChangeIndicatorAck
      Rte_Ev_Run_Vin_Vin_ReceiveFromCom
      Rte_Ev_WP_Task_5msBsw_Appl10: OsEventMask=2
    Rte_Res_Vin_VinState (OsResource): OsResourceProperty=STANDARD, OsResourceAccessingApplication=Appl10
    4 x OsApplication, all with OsTrusted=false:
      Appl10: OsAppTaskRef=Task_100ms_Appl10, OsAppAlarmRef=Os/Rte_Al_TE_Darh_QueueHandler, OsAppAlarmRef=Os/Rte_Al_TE_Task_100ms_Appl10_0_100ms, OsAppTaskRef=Task_10msBsw_Appl10, OsAppAlarmRef=Os/Rte_Al_TE2_Task_10msBsw_Appl10_0_10ms, OsAppTaskRef=Task_10ms_Appl10, OsAppAlarmRef=Os/Rte_Al_TE_Task_10ms_Appl10_0_10ms, OsAppTaskRef=Task_2msA_Appl10, OsAppAlarmRef=Os/Rte_Al_TE_Task_2msA_Appl10_0_2ms, OsAppTaskRef=Task_2msB_Appl10, OsAppAlarmRef=Os/Rte_Al_TE_Task_2msB_Appl10_0_2ms, OsAppTaskRef=Task_2msTmplMonr_Appl10, OsAppAlarmRef=Os/Rte_Al_TE_Task_2msTmplMonr_Appl10_0_2ms, OsAppTaskRef=Task_4msBsw_Appl10, OsAppAlarmRef=Os/Rte_Al_TE2_Task_4msBsw_Appl10_0_4ms, OsAppTaskRef=Task_4ms_Appl10, OsAppAlarmRef=Os/Rte_Al_TE_Task_4ms_Appl10_0_4ms, OsAppTaskRef=Task_5msBsw_Appl10, OsAppAlarmRef=Os/Rte_Al_TE2_Task_5msBsw_Appl10_0_5ms, OsAppTaskRef=Task_Coding_Appl10, OsAppTaskRef=Task_ComBsw_Appl10, OsAppAlarmRef=Os/Rte_Al_TE2_Task_ComBsw_Appl10_0_5ms, OsAppAlarmRef=Os/Rte_Al_TE_Task_ComBsw_Appl10_0_10ms, OsAppTaskRef=Task_Init_Appl10
      Appl7: OsAppTaskRef=Task_100ms_Appl7, OsAppAlarmRef=Os/Rte_Al_TE_Task_100ms_Appl7_0_100ms, OsAppTaskRef=Task_10ms_Appl7, OsAppAlarmRef=Os/Rte_Al_TE_Task_10ms_Appl7_0_10ms, OsAppTaskRef=Task_2ms_Appl7, OsAppAlarmRef=Os/Rte_Al_TE_Task_2ms_Appl7_0_2ms, OsAppTaskRef=Task_4ms_Appl7, OsAppAlarmRef=Os/Rte_Al_TE_Task_4ms_Appl7_0_4ms, OsAppTaskRef=Task_Init_Appl7
      Appl8: OsAppTaskRef=Task_10ms_Appl8, OsAppAlarmRef=Os/Rte_Al_TE_Task_10ms_Appl8_0_10ms, OsAppTaskRef=Task_2ms_Appl8, OsAppAlarmRef=Os/Rte_Al_TE_Task_2ms_Appl8_0_2ms, OsAppTaskRef=Task_Init_Appl8
      Appl9: OsAppTaskRef=Task_100ms_Appl9, OsAppAlarmRef=Os/Rte_Al_TE_Task_100ms_Appl9_0_100ms, OsAppTaskRef=Task_10ms_Appl9, OsAppAlarmRef=Os/Rte_Al_TE_Task_10ms_Appl9_0_10ms, OsAppTaskRef=Task_2ms_Appl9, OsAppAlarmRef=Os/Rte_Al_TE_Task_2ms_Appl9_0_2ms, OsAppTaskRef=Task_Init_Appl9
  ecuc value collection DaVinci_Project: ecuc-values=[Com, Rte, Os, NvM]
