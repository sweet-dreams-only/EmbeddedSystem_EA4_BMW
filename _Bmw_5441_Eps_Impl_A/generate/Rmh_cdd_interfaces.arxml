AUTOSAR XML (schema 4-3-0)
# \copyright BMW AG 2015 - 2017
package /BMW/Platform/Rmh/PortInterfaces
  client server interface Rmh_ComTriggerIPDUSendInterface
    operation Rmh_TriggerComIPDUSend
      arg messageId: type=uint16, direction=IN
