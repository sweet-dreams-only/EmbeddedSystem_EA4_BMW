AUTOSAR XML (schema 4-3-0)
package /BMW_CONF
  module config StdDiagClassic
    StdDiagGeneral: StdDiagClearSecondaryErrorMemory=1
    StdDiagSgbdIndex: SgbdIndex=993488
    StdDiagUserDefinedMemory
