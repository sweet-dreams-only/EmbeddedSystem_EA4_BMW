AUTOSAR XML (schema 4-3-0)
package /BMW_CONF
  module config DarhClassic
    13 x DarhActiveReportedEvent:
      DarhActiveReportedEvent_CodingEventNotCoded: DarhDemEvent=CodingEventNotCoded
      DarhActiveReportedEvent_CodingEventUnqualifiedData: DarhDemEvent=CodingEventUnqualifiedData
      DarhActiveReportedEvent_CodingEventWrongVehicle: DarhDemEvent=CodingEventWrongVehicle
      DarhActiveReportedEvent_DmTestAppl: DarhDemEvent=DmTestAppl
      DarhActiveReportedEvent_DmTestCom: DarhDemEvent=DmTestCom
      DarhActiveReportedEvent_FrsmEClusterSyncLoss: DarhDemEvent=FrsmEClusterSyncLoss
      DarhActiveReportedEvent_FrtrcvEFrBuserrorTrcv0: DarhDemEvent=FrtrcvEFrBuserrorTrcv0
      DarhActiveReportedEvent_GlobalOvervoltageExt: DarhDemEvent=GlobalOvervoltageExt
      DarhActiveReportedEvent_GlobalOvervoltageInt: DarhDemEvent=GlobalOvervoltageInt
      DarhActiveReportedEvent_GlobalUndervoltageExt: DarhDemEvent=GlobalUndervoltageExt
      DarhActiveReportedEvent_GlobalUndervoltageInt: DarhDemEvent=GlobalUndervoltageInt
      DarhActiveReportedEvent_LocalOvervoltage: DarhDemEvent=LocalOvervoltage
      DarhActiveReportedEvent_LocalUndervoltage: DarhDemEvent=LocalUndervoltage
