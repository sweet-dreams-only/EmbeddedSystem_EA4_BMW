AUTOSAR XML (schema 4-3-0)
package /BMW_CONF
  module config DlogShared
    Dlog_MultiConfig: EcuId=48
