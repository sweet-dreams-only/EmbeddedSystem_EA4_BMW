AUTOSAR XML (schema 4-3-0)
package /BMW_CONF
  module config SysTime
    SysTimeGeneral: SysTimeInitialTimeout=5
