AUTOSAR XML (schema 4-3-0)
package /BMW_CONF
  module config Stm
    StmFeatureActivation_0 (StmFeatureActivation): StmCentralErrorLockEnabled=1, StmEnergyStateEnabled=1, StmVehicleStateEnabled=1
    StmGeneral:
      StmCentralErrorLockTimeout = 21
      StmComVariant = STM_COM_CYCLIC_DATAELEMENTS
      StmEnergyStateTimeout = 21
      StmInitialCentralErrorLockTimeout = 6
      StmVehicleStateTimeout = 0.5
