AUTOSAR XML (schema 00044)
package /ActiveEcuC
  module config Coding
    CodingArea_4 (CodingArea): CodingAreaDefVal=AllBitsZero
      72 x CodingFunction:
        CurrentLimit: CodingFunctionApplType=Uint8, CodingFunctionDataCheck=1, CodingFunctionEndByte=1, CodingFunctionLowerLimit=43.0, CodingFunctionMask=255, CodingFunctionStartByte=1, CodingFunctionUpperLimit=120.0
          CodingFunctionNvramType
            Uint8
        NAME00_00_CalculationOfLoadMinusstateMinusdependentSteeringAssistance: CodingFunctionApplType=Bool, CodingFunctionDataCheck=0, CodingFunctionEndByte=0, CodingFunctionMask=1, CodingFunctionStartByte=0
          CodingFunctionNvramType
            Bool
        NAME00_01_CalculationOfActiveReturn: CodingFunctionApplType=Bool, CodingFunctionDataCheck=0, CodingFunctionEndByte=0, CodingFunctionMask=2, CodingFunctionStartByte=0
          CodingFunctionNvramType
            Bool
        NAME00_02_reserved: CodingFunctionApplType=Bool, CodingFunctionDataCheck=0, CodingFunctionEndByte=0, CodingFunctionMask=4, CodingFunctionStartByte=0
          CodingFunctionNvramType
            Bool
        NAME00_03_ActiveInfluenceOnTheSteeringHysterisis: CodingFunctionApplType=Bool, CodingFunctionDataCheck=0, CodingFunctionEndByte=0, CodingFunctionMask=8, CodingFunctionStartByte=0
          CodingFunctionNvramType
            Bool
        NAME00_04_reserved: CodingFunctionApplType=Bool, CodingFunctionDataCheck=0, CodingFunctionEndByte=0, CodingFunctionMask=16, CodingFunctionStartByte=0
          CodingFunctionNvramType
            Bool
        NAME00_05_reserved: CodingFunctionApplType=Bool, CodingFunctionDataCheck=0, CodingFunctionEndByte=0, CodingFunctionMask=32, CodingFunctionStartByte=0
          CodingFunctionNvramType
            Bool
        NAME00_06_reserved: CodingFunctionApplType=Bool, CodingFunctionDataCheck=0, CodingFunctionEndByte=0, CodingFunctionMask=64, CodingFunctionStartByte=0
          CodingFunctionNvramType
            Bool
        NAME00_07_reserved: CodingFunctionApplType=Bool, CodingFunctionDataCheck=0, CodingFunctionEndByte=0, CodingFunctionMask=128, CodingFunctionStartByte=0
          CodingFunctionNvramType
            Bool
        NAME01_00_reserved: CodingFunctionApplType=Bool, CodingFunctionDataCheck=0, CodingFunctionEndByte=24, CodingFunctionMask=1, CodingFunctionStartByte=24
          CodingFunctionNvramType
            Bool
        NAME01_01_reserved: CodingFunctionApplType=Bool, CodingFunctionDataCheck=0, CodingFunctionEndByte=24, CodingFunctionMask=2, CodingFunctionStartByte=24
          CodingFunctionNvramType
            Bool
        NAME01_02_reserved: CodingFunctionApplType=Bool, CodingFunctionDataCheck=0, CodingFunctionEndByte=24, CodingFunctionMask=4, CodingFunctionStartByte=24
          CodingFunctionNvramType
            Bool
        NAME01_03_ParkingPowerDamping: CodingFunctionApplType=Bool, CodingFunctionDataCheck=0, CodingFunctionEndByte=24, CodingFunctionMask=8, CodingFunctionStartByte=24
          CodingFunctionNvramType
            Bool
        NAME01_04_reserved: CodingFunctionApplType=Bool, CodingFunctionDataCheck=0, CodingFunctionEndByte=24, CodingFunctionMask=16, CodingFunctionStartByte=24
          CodingFunctionNvramType
            Bool
        NAME01_05_reserved: CodingFunctionApplType=Bool, CodingFunctionDataCheck=0, CodingFunctionEndByte=24, CodingFunctionMask=32, CodingFunctionStartByte=24
          CodingFunctionNvramType
            Bool
        NAME01_06_reserved: CodingFunctionApplType=Bool, CodingFunctionDataCheck=0, CodingFunctionEndByte=24, CodingFunctionMask=64, CodingFunctionStartByte=24
          CodingFunctionNvramType
            Bool
        NAME01_07_reserved: CodingFunctionApplType=Bool, CodingFunctionDataCheck=0, CodingFunctionEndByte=24, CodingFunctionMask=128, CodingFunctionStartByte=24
          CodingFunctionNvramType
            Bool
        NAME02_00_CompensationOfFriction: CodingFunctionApplType=Bool, CodingFunctionDataCheck=0, CodingFunctionEndByte=25, CodingFunctionMask=1, CodingFunctionStartByte=25
          CodingFunctionNvramType
            Bool
        NAME02_01_CompensationOfConstantSteeringPullAndLateralInclinationPull: CodingFunctionApplType=Bool, CodingFunctionDataCheck=0, CodingFunctionEndByte=25, CodingFunctionMask=2, CodingFunctionStartByte=25
          CodingFunctionNvramType
            Bool
        NAME02_02: CodingFunctionApplType=Bool, CodingFunctionDataCheck=0, CodingFunctionEndByte=25, CodingFunctionMask=4, CodingFunctionStartByte=25
          CodingFunctionNvramType
            Bool
        NAME02_03: CodingFunctionApplType=Bool, CodingFunctionDataCheck=0, CodingFunctionEndByte=25, CodingFunctionMask=8, CodingFunctionStartByte=25
          CodingFunctionNvramType
            Bool
        NAME02_04_CompensationOfInertiaOfTheSteeringGear: CodingFunctionApplType=Bool, CodingFunctionDataCheck=0, CodingFunctionEndByte=25, CodingFunctionMask=16, CodingFunctionStartByte=25
          CodingFunctionNvramType
            Bool
        NAME02_05_CompensationOfInertiaOfTheSteeringWheel: CodingFunctionApplType=Bool, CodingFunctionDataCheck=0, CodingFunctionEndByte=25, CodingFunctionMask=32, CodingFunctionStartByte=25
          CodingFunctionNvramType
            Bool
        NAME02_06: CodingFunctionApplType=Bool, CodingFunctionDataCheck=0, CodingFunctionEndByte=25, CodingFunctionMask=64, CodingFunctionStartByte=25
          CodingFunctionNvramType
            Bool
        NAME02_07: CodingFunctionApplType=Bool, CodingFunctionDataCheck=0, CodingFunctionEndByte=25, CodingFunctionMask=128, CodingFunctionStartByte=25
          CodingFunctionNvramType
            Bool
        NAME03_00_reserved: CodingFunctionApplType=Bool, CodingFunctionDataCheck=0, CodingFunctionEndByte=26, CodingFunctionMask=1, CodingFunctionStartByte=26
          CodingFunctionNvramType
            Bool
        NAME03_01_VoltageDependantDegredation: CodingFunctionApplType=Bool, CodingFunctionDataCheck=0, CodingFunctionEndByte=26, CodingFunctionMask=2, CodingFunctionStartByte=26
          CodingFunctionNvramType
            Bool
        NAME03_02_SpeedDependantDegredation: CodingFunctionApplType=Bool, CodingFunctionDataCheck=0, CodingFunctionEndByte=26, CodingFunctionMask=4, CodingFunctionStartByte=26
          CodingFunctionNvramType
            Bool
        NAME03_03_reserved: CodingFunctionApplType=Bool, CodingFunctionDataCheck=0, CodingFunctionEndByte=26, CodingFunctionMask=8, CodingFunctionStartByte=26
          CodingFunctionNvramType
            Bool
        NAME03_04_reserved: CodingFunctionApplType=Bool, CodingFunctionDataCheck=0, CodingFunctionEndByte=26, CodingFunctionMask=16, CodingFunctionStartByte=26
          CodingFunctionNvramType
            Bool
        NAME03_05_reserved: CodingFunctionApplType=Bool, CodingFunctionDataCheck=0, CodingFunctionEndByte=26, CodingFunctionMask=32, CodingFunctionStartByte=26
          CodingFunctionNvramType
            Bool
        NAME03_06_reserved: CodingFunctionApplType=Bool, CodingFunctionDataCheck=0, CodingFunctionEndByte=26, CodingFunctionMask=64, CodingFunctionStartByte=26
          CodingFunctionNvramType
            Bool
        NAME03_07_reserved: CodingFunctionApplType=Bool, CodingFunctionDataCheck=0, CodingFunctionEndByte=26, CodingFunctionMask=128, CodingFunctionStartByte=26
          CodingFunctionNvramType
            Bool
        NAME04_00_DrivingDynamicsInterfaceMinusDriversTorque: CodingFunctionApplType=Bool, CodingFunctionDataCheck=0, CodingFunctionEndByte=27, CodingFunctionMask=1, CodingFunctionStartByte=27
          CodingFunctionNvramType
            Bool
        NAME04_00_DrivingDynamicsInterfaceMinusMotorTorque: CodingFunctionApplType=Bool, CodingFunctionDataCheck=0, CodingFunctionEndByte=27, CodingFunctionMask=2, CodingFunctionStartByte=27
          CodingFunctionNvramType
            Bool
        NAME04_02_DrivingDynamicsInterfaceMinusFactors: CodingFunctionApplType=Bool, CodingFunctionDataCheck=0, CodingFunctionEndByte=27, CodingFunctionMask=4, CodingFunctionStartByte=27
          CodingFunctionNvramType
            Bool
        NAME04_03_DrivingDynamicsInterfaceMinusAdditionalDamping: CodingFunctionApplType=Bool, CodingFunctionDataCheck=0, CodingFunctionEndByte=27, CodingFunctionMask=8, CodingFunctionStartByte=27
          CodingFunctionNvramType
            Bool
        NAME04_04_EPSVibration: CodingFunctionApplType=Bool, CodingFunctionDataCheck=0, CodingFunctionEndByte=27, CodingFunctionMask=16, CodingFunctionStartByte=27
          CodingFunctionNvramType
            Bool
        NAME04_05_DrivingExperienceSwitch: CodingFunctionApplType=Bool, CodingFunctionDataCheck=0, CodingFunctionEndByte=27, CodingFunctionMask=32, CodingFunctionStartByte=27
          CodingFunctionNvramType
            Bool
        NAME04_06_reserved: CodingFunctionApplType=Bool, CodingFunctionDataCheck=0, CodingFunctionEndByte=27, CodingFunctionMask=64, CodingFunctionStartByte=27
          CodingFunctionNvramType
            Bool
        NAME04_07_automaticEngineStartStopFunction: CodingFunctionApplType=Bool, CodingFunctionDataCheck=0, CodingFunctionEndByte=27, CodingFunctionMask=128, CodingFunctionStartByte=27
          CodingFunctionNvramType
            Bool
        NAME05_00_ActiveFanActuation: CodingFunctionApplType=Bool, CodingFunctionDataCheck=0, CodingFunctionEndByte=28, CodingFunctionMask=1, CodingFunctionStartByte=28
          CodingFunctionNvramType
            Bool
        NAME05_01_reserved: CodingFunctionApplType=Bool, CodingFunctionDataCheck=0, CodingFunctionEndByte=28, CodingFunctionMask=2, CodingFunctionStartByte=28
          CodingFunctionNvramType
            Bool
        NAME05_02_reserved: CodingFunctionApplType=Bool, CodingFunctionDataCheck=0, CodingFunctionEndByte=28, CodingFunctionMask=4, CodingFunctionStartByte=28
          CodingFunctionNvramType
            Bool
        NAME05_03_reserved: CodingFunctionApplType=Bool, CodingFunctionDataCheck=0, CodingFunctionEndByte=28, CodingFunctionMask=8, CodingFunctionStartByte=28
          CodingFunctionNvramType
            Bool
        NAME05_04_reserved: CodingFunctionApplType=Bool, CodingFunctionDataCheck=0, CodingFunctionEndByte=28, CodingFunctionMask=16, CodingFunctionStartByte=28
          CodingFunctionNvramType
            Bool
        NAME05_05_reserved: CodingFunctionApplType=Bool, CodingFunctionDataCheck=0, CodingFunctionEndByte=28, CodingFunctionMask=32, CodingFunctionStartByte=28
          CodingFunctionNvramType
            Bool
        NAME05_06_reserved: CodingFunctionApplType=Bool, CodingFunctionDataCheck=0, CodingFunctionEndByte=28, CodingFunctionMask=64, CodingFunctionStartByte=28
          CodingFunctionNvramType
            Bool
        NAME05_07_reserved: CodingFunctionApplType=Bool, CodingFunctionDataCheck=0, CodingFunctionEndByte=28, CodingFunctionMask=128, CodingFunctionStartByte=28
          CodingFunctionNvramType
            Bool
        NAME08_reserved: CodingFunctionApplType=Uint8, CodingFunctionDataCheck=0, CodingFunctionEndByte=3, CodingFunctionMask=255, CodingFunctionStartByte=3
          CodingFunctionNvramType
            Uint8
        NAME09_reserved: CodingFunctionApplType=Uint8, CodingFunctionDataCheck=0, CodingFunctionEndByte=4, CodingFunctionMask=255, CodingFunctionStartByte=4
          CodingFunctionNvramType
            Uint8
        NAME10_reserved: CodingFunctionApplType=Uint8, CodingFunctionDataCheck=0, CodingFunctionEndByte=5, CodingFunctionMask=255, CodingFunctionStartByte=5
          CodingFunctionNvramType
            Uint8
        NAME11_reserved: CodingFunctionApplType=Uint8, CodingFunctionDataCheck=0, CodingFunctionEndByte=6, CodingFunctionMask=255, CodingFunctionStartByte=6
          CodingFunctionNvramType
            Uint8
        NAME12_reserved: CodingFunctionApplType=Uint8, CodingFunctionDataCheck=0, CodingFunctionEndByte=7, CodingFunctionMask=255, CodingFunctionStartByte=7
          CodingFunctionNvramType
            Uint8
        NAME13_reserved: CodingFunctionApplType=Uint8, CodingFunctionDataCheck=0, CodingFunctionEndByte=8, CodingFunctionMask=255, CodingFunctionStartByte=8
          CodingFunctionNvramType
            Uint8
        NAME14_reserved: CodingFunctionApplType=Uint8, CodingFunctionDataCheck=0, CodingFunctionEndByte=9, CodingFunctionMask=255, CodingFunctionStartByte=9
          CodingFunctionNvramType
            Uint8
        NAME15_reserved: CodingFunctionApplType=Uint8, CodingFunctionDataCheck=0, CodingFunctionEndByte=10, CodingFunctionMask=255, CodingFunctionStartByte=10
          CodingFunctionNvramType
            Uint8
        NAME16_reserved: CodingFunctionApplType=Uint8, CodingFunctionDataCheck=0, CodingFunctionEndByte=11, CodingFunctionMask=255, CodingFunctionStartByte=11
          CodingFunctionNvramType
            Uint8
        NAME17_reserved: CodingFunctionApplType=Uint8, CodingFunctionDataCheck=0, CodingFunctionEndByte=12, CodingFunctionMask=255, CodingFunctionStartByte=12
          CodingFunctionNvramType
            Uint8
        NAME18_reserved: CodingFunctionApplType=Uint8, CodingFunctionDataCheck=0, CodingFunctionEndByte=13, CodingFunctionMask=255, CodingFunctionStartByte=13
          CodingFunctionNvramType
            Uint8
        NAME19_reserved: CodingFunctionApplType=Uint8, CodingFunctionDataCheck=0, CodingFunctionEndByte=14, CodingFunctionMask=255, CodingFunctionStartByte=14
          CodingFunctionNvramType
            Uint8
        NAME20_reserved: CodingFunctionApplType=Uint8, CodingFunctionDataCheck=0, CodingFunctionEndByte=15, CodingFunctionMask=255, CodingFunctionStartByte=15
          CodingFunctionNvramType
            Uint8
        NAME21_reserved: CodingFunctionApplType=Uint8, CodingFunctionDataCheck=0, CodingFunctionEndByte=16, CodingFunctionMask=255, CodingFunctionStartByte=16
          CodingFunctionNvramType
            Uint8
        NAME22_reserved: CodingFunctionApplType=Uint8, CodingFunctionDataCheck=0, CodingFunctionEndByte=17, CodingFunctionMask=255, CodingFunctionStartByte=17
          CodingFunctionNvramType
            Uint8
        NAME23_reserved: CodingFunctionApplType=Uint8, CodingFunctionDataCheck=0, CodingFunctionEndByte=18, CodingFunctionMask=255, CodingFunctionStartByte=18
          CodingFunctionNvramType
            Uint8
        NAME24_reserved: CodingFunctionApplType=Uint8, CodingFunctionDataCheck=0, CodingFunctionEndByte=19, CodingFunctionMask=255, CodingFunctionStartByte=19
          CodingFunctionNvramType
            Uint8
        NAME25_reserved: CodingFunctionApplType=Uint8, CodingFunctionDataCheck=0, CodingFunctionEndByte=20, CodingFunctionMask=255, CodingFunctionStartByte=20
          CodingFunctionNvramType
            Uint8
        NAME26_reserved: CodingFunctionApplType=Uint8, CodingFunctionDataCheck=0, CodingFunctionEndByte=21, CodingFunctionMask=255, CodingFunctionStartByte=21
          CodingFunctionNvramType
            Uint8
        NAME27_reserved: CodingFunctionApplType=Uint8, CodingFunctionDataCheck=0, CodingFunctionEndByte=22, CodingFunctionMask=255, CodingFunctionStartByte=22
          CodingFunctionNvramType
            Uint8
        NAME28_reserved: CodingFunctionApplType=Uint8, CodingFunctionDataCheck=0, CodingFunctionEndByte=23, CodingFunctionMask=255, CodingFunctionStartByte=23
          CodingFunctionNvramType
            Uint8
        NAME29_reserved: CodingFunctionApplType=Uint8, CodingFunctionDataCheck=0, CodingFunctionEndByte=29, CodingFunctionMask=255, CodingFunctionStartByte=29
          CodingFunctionNvramType
            Uint8
        SpeedMinuslimitForMaxCurrent: CodingFunctionApplType=Uint8, CodingFunctionDataCheck=0, CodingFunctionEndByte=2, CodingFunctionMask=255, CodingFunctionStartByte=2
          CodingFunctionNvramType
            Uint8
    CodingGeneral: CodingProdErrorCEUDDetection=1, CodingSignatureSize=SIGNATURE_RSA_256_BYTE_2048_BIT
