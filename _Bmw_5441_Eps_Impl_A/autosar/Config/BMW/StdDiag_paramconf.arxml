AUTOSAR XML (schema 4-3-0)
package /BMW_CONF
  module config StdDiag
    StdDiagGeneral: StdDiagUserActiveSessionState=1
