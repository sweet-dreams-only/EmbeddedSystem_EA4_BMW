AUTOSAR XML (schema 4-3-0)
package /BMW_CONF
  module config DlogClassic
    Dlog_Features: EnableMemSegTableRead=0, EnableNvMemory=1, EnableTimingParameters=1
    Dlog_General: DlogUseCoding=1
