AUTOSAR XML (schema 4-3-0)
package /BMW_CONF
  module config Dlog
    Features: EnableEcu=1, EnableSvkCurrent=0
