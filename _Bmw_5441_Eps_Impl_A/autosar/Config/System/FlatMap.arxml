AUTOSAR XML (schema 4-3-0)
package /COM/VECTOR/CFG/WORKFLOW/SYSDESC/SYNC
  flat map FLATMAP
    357 x flat instance descriptor:
      McalErrHndlg: upstream-reference=SystemComponentPrototype.McalErrHndlg, ecu-extract-reference=COMPOSITIONTYPE.McalErrHndlg
      CDD_NxtrTi: upstream-reference=SystemComponentPrototype.CDD_NxtrTi, ecu-extract-reference=COMPOSITIONTYPE.CDD_NxtrTi
      NxtrMath: upstream-reference=SystemComponentPrototype.NxtrMath, ecu-extract-reference=COMPOSITIONTYPE.NxtrMath
      McuErrInj: upstream-reference=SystemComponentPrototype.McuErrInj, ecu-extract-reference=COMPOSITIONTYPE.McuErrInj
      CDD_ExcpnHndlg: upstream-reference=SystemComponentPrototype.CDD_ExcpnHndlg, ecu-extract-reference=COMPOSITIONTYPE.CDD_ExcpnHndlg
      DiagcMgr: upstream-reference=SystemComponentPrototype.DiagcMgr, ecu-extract-reference=COMPOSITIONTYPE.DiagcMgr
      DiagcMgrProxyAppl10: upstream-reference=SystemComponentPrototype.DiagcMgrProxyAppl10, ecu-extract-reference=COMPOSITIONTYPE.DiagcMgrProxyAppl10
      DiagcMgrStub: upstream-reference=SystemComponentPrototype.DiagcMgrStub, ecu-extract-reference=COMPOSITIONTYPE.DiagcMgrStub
      SysStMod: upstream-reference=SystemComponentPrototype.SysStMod, ecu-extract-reference=COMPOSITIONTYPE.SysStMod
      CDD_NvMProxy: upstream-reference=SystemComponentPrototype.CDD_NvMProxy, ecu-extract-reference=COMPOSITIONTYPE.CDD_NvMProxy
      CDD_EcmOutpAndDiagc: upstream-reference=SystemComponentPrototype.CDD_EcmOutpAndDiagc, ecu-extract-reference=COMPOSITIONTYPE.CDD_EcmOutpAndDiagc
      CDD_GuardCfgAndDiagc: upstream-reference=SystemComponentPrototype.CDD_GuardCfgAndDiagc, ecu-extract-reference=COMPOSITIONTYPE.CDD_GuardCfgAndDiagc
      CDD_SyncCrc: upstream-reference=SystemComponentPrototype.CDD_SyncCrc, ecu-extract-reference=COMPOSITIONTYPE.CDD_SyncCrc
      FltInj: upstream-reference=SystemComponentPrototype.FltInj, ecu-extract-reference=COMPOSITIONTYPE.FltInj
      CDD_Adc0CfgAndUse: upstream-reference=SystemComponentPrototype.CDD_Adc0CfgAndUse, ecu-extract-reference=COMPOSITIONTYPE.CDD_Adc0CfgAndUse
      CDD_Adc1CfgAndUse: upstream-reference=SystemComponentPrototype.CDD_Adc1CfgAndUse, ecu-extract-reference=COMPOSITIONTYPE.CDD_Adc1CfgAndUse
      CDD_AdcDiagc: upstream-reference=SystemComponentPrototype.CDD_AdcDiagc, ecu-extract-reference=COMPOSITIONTYPE.CDD_AdcDiagc
      CDD_DmaCfgAndUse: upstream-reference=SystemComponentPrototype.CDD_DmaCfgAndUse, ecu-extract-reference=COMPOSITIONTYPE.CDD_DmaCfgAndUse
      CDD_MotAg0Meas: upstream-reference=SystemComponentPrototype.CDD_MotAg0Meas, ecu-extract-reference=COMPOSITIONTYPE.CDD_MotAg0Meas
      CDD_MotAg1Meas: upstream-reference=SystemComponentPrototype.CDD_MotAg1Meas, ecu-extract-reference=COMPOSITIONTYPE.CDD_MotAg1Meas
      CDD_Tauj0CfgAndUse: upstream-reference=SystemComponentPrototype.CDD_Tauj0CfgAndUse, ecu-extract-reference=COMPOSITIONTYPE.CDD_Tauj0CfgAndUse
      CDD_TSG31CfgAndUse: upstream-reference=SystemComponentPrototype.CDD_TSG31CfgAndUse, ecu-extract-reference=COMPOSITIONTYPE.CDD_TSG31CfgAndUse
      CDD_MotCtrlMgr: upstream-reference=SystemComponentPrototype.CDD_MotCtrlMgr, ecu-extract-reference=COMPOSITIONTYPE.CDD_MotCtrlMgr
      IoHwAb: upstream-reference=SystemComponentPrototype.IoHwAb, ecu-extract-reference=COMPOSITIONTYPE.IoHwAb
      CDD_CurrMeas: upstream-reference=SystemComponentPrototype.CDD_CurrMeas, ecu-extract-reference=COMPOSITIONTYPE.CDD_CurrMeas
      MotAgCorrln: upstream-reference=SystemComponentPrototype.MotAgCorrln, ecu-extract-reference=COMPOSITIONTYPE.MotAgCorrln
      CDD_Bmw5441McuCfg: upstream-reference=SystemComponentPrototype.CDD_Bmw5441McuCfg, ecu-extract-reference=COMPOSITIONTYPE.CDD_Bmw5441McuCfg
      BattVltg: upstream-reference=SystemComponentPrototype.BattVltg, ecu-extract-reference=COMPOSITIONTYPE.BattVltg
      BattVltgCorrln: upstream-reference=SystemComponentPrototype.BattVltgCorrln, ecu-extract-reference=COMPOSITIONTYPE.BattVltgCorrln
      EcuTMeas: upstream-reference=SystemComponentPrototype.EcuTMeas, ecu-extract-reference=COMPOSITIONTYPE.EcuTMeas
      CDD_FlsMem: upstream-reference=SystemComponentPrototype.CDD_FlsMem, ecu-extract-reference=COMPOSITIONTYPE.CDD_FlsMem
      CDD_RamMem: upstream-reference=SystemComponentPrototype.CDD_RamMem, ecu-extract-reference=COMPOSITIONTYPE.CDD_RamMem
      CDD_ChkPtAppl10: upstream-reference=SystemComponentPrototype.CDD_ChkPtAppl10, ecu-extract-reference=COMPOSITIONTYPE.CDD_ChkPtAppl10
      Vin: upstream-reference=SystemComponentPrototype.Vin, ecu-extract-reference=COMPOSITIONTYPE.Vin
      ST_ENERG_FZM: upstream-reference=SystemComponentPrototype.ST_ENERG_FZM.energyState, ecu-extract-reference=COMPOSITIONTYPE.ST_ENERG_FZM.energyState
      ST_ILK_ERRM_FZM: upstream-reference=SystemComponentPrototype.ST_ILK_ERRM_FZM.centralErrorLock, ecu-extract-reference=COMPOSITIONTYPE.ST_ILK_ERRM_FZM.centralErrorLock
      T_SEC_COU_REL: upstream-reference=SystemComponentPrototype.T_SEC_COU_REL.timeSignal, ecu-extract-reference=COMPOSITIONTYPE.T_SEC_COU_REL.timeSignal
      CmnMfgSrv: upstream-reference=SystemComponentPrototype.CmnMfgSrv, ecu-extract-reference=COMPOSITIONTYPE.CmnMfgSrv
      NxtrSwIds: upstream-reference=SystemComponentPrototype.NxtrSwIds, ecu-extract-reference=COMPOSITIONTYPE.NxtrSwIds
      CDD_MotAgCmp: upstream-reference=SystemComponentPrototype.CDD_MotAgCmp, ecu-extract-reference=COMPOSITIONTYPE.CDD_MotAgCmp
      CDD_SinVltgGenn: upstream-reference=SystemComponentPrototype.CDD_SinVltgGenn, ecu-extract-reference=COMPOSITIONTYPE.CDD_SinVltgGenn
      GateDrv0Ctrl: upstream-reference=SystemComponentPrototype.GateDrv0Ctrl, ecu-extract-reference=COMPOSITIONTYPE.GateDrv0Ctrl
      PolarityCfg: upstream-reference=SystemComponentPrototype.PolarityCfg, ecu-extract-reference=COMPOSITIONTYPE.PolarityCfg
      PwrDiscnct: upstream-reference=SystemComponentPrototype.PwrDiscnct, ecu-extract-reference=COMPOSITIONTYPE.PwrDiscnct
      PwrSply: upstream-reference=SystemComponentPrototype.PwrSply, ecu-extract-reference=COMPOSITIONTYPE.PwrSply
      PwrUpSeq: upstream-reference=SystemComponentPrototype.PwrUpSeq, ecu-extract-reference=COMPOSITIONTYPE.PwrUpSeq
      ShtdwnMech: upstream-reference=SystemComponentPrototype.ShtdwnMech, ecu-extract-reference=COMPOSITIONTYPE.ShtdwnMech
      TmplMonr: upstream-reference=SystemComponentPrototype.TmplMonr, ecu-extract-reference=COMPOSITIONTYPE.TmplMonr
      CDD_HwTq4Meas: upstream-reference=SystemComponentPrototype.CDD_HwTq4Meas, ecu-extract-reference=COMPOSITIONTYPE.CDD_HwTq4Meas
      CDD_HwTq5Meas: upstream-reference=SystemComponentPrototype.CDD_HwTq5Meas, ecu-extract-reference=COMPOSITIONTYPE.CDD_HwTq5Meas
      HwTqArbn: upstream-reference=SystemComponentPrototype.HwTqArbn, ecu-extract-reference=COMPOSITIONTYPE.HwTqArbn
      HwTqCorrln: upstream-reference=SystemComponentPrototype.HwTqCorrln, ecu-extract-reference=COMPOSITIONTYPE.HwTqCorrln
      CDD_MotCurrRegVltgLimr: upstream-reference=SystemComponentPrototype.CDD_MotCurrRegVltgLimr, ecu-extract-reference=COMPOSITIONTYPE.CDD_MotCurrRegVltgLimr
      CDD_MotVel: upstream-reference=SystemComponentPrototype.CDD_MotVel, ecu-extract-reference=COMPOSITIONTYPE.CDD_MotVel
      DutyCycThermProtn: upstream-reference=SystemComponentPrototype.DutyCycThermProtn, ecu-extract-reference=COMPOSITIONTYPE.DutyCycThermProtn
      ElecPwrCns: upstream-reference=SystemComponentPrototype.ElecPwrCns, ecu-extract-reference=COMPOSITIONTYPE.ElecPwrCns
      HiLoadStallLimr: upstream-reference=SystemComponentPrototype.HiLoadStallLimr, ecu-extract-reference=COMPOSITIONTYPE.HiLoadStallLimr
      MotCtrlPrmEstimn: upstream-reference=SystemComponentPrototype.MotCtrlPrmEstimn, ecu-extract-reference=COMPOSITIONTYPE.MotCtrlPrmEstimn
      MotCurrPeakEstimn: upstream-reference=SystemComponentPrototype.MotCurrPeakEstimn, ecu-extract-reference=COMPOSITIONTYPE.MotCurrPeakEstimn
      MotCurrRegCfg: upstream-reference=SystemComponentPrototype.MotCurrRegCfg, ecu-extract-reference=COMPOSITIONTYPE.MotCurrRegCfg
      MotQuadDetn: upstream-reference=SystemComponentPrototype.MotQuadDetn, ecu-extract-reference=COMPOSITIONTYPE.MotQuadDetn
      MotRefMdl: upstream-reference=SystemComponentPrototype.MotRefMdl, ecu-extract-reference=COMPOSITIONTYPE.MotRefMdl
      PwrLimr: upstream-reference=SystemComponentPrototype.PwrLimr, ecu-extract-reference=COMPOSITIONTYPE.PwrLimr
      TEstimn: upstream-reference=SystemComponentPrototype.TEstimn, ecu-extract-reference=COMPOSITIONTYPE.TEstimn
      MotTqCmdSca: upstream-reference=SystemComponentPrototype.MotTqCmdSca, ecu-extract-reference=COMPOSITIONTYPE.MotTqCmdSca
      MotTqTranlDampg: upstream-reference=SystemComponentPrototype.MotTqTranlDampg, ecu-extract-reference=COMPOSITIONTYPE.MotTqTranlDampg
      Swp: upstream-reference=SystemComponentPrototype.Swp, ecu-extract-reference=COMPOSITIONTYPE.Swp
      ANFRAGE_ID2: upstream-reference=SystemComponentPrototype.ANFRAGE_ID2.requestedMsgID, ecu-extract-reference=COMPOSITIONTYPE.ANFRAGE_ID2.requestedMsgID
      NO_VECH_1: upstream-reference=SystemComponentPrototype.NO_VECH_1.NO_VECH_1, ecu-extract-reference=COMPOSITIONTYPE.NO_VECH_1.NO_VECH_1
      NO_VECH_2: upstream-reference=SystemComponentPrototype.NO_VECH_1, ecu-extract-reference=COMPOSITIONTYPE.NO_VECH_1
      NO_VECH_3: upstream-reference=SystemComponentPrototype.NO_VECH_2.NO_VECH_2, ecu-extract-reference=COMPOSITIONTYPE.NO_VECH_2.NO_VECH_2
      NO_VECH_4: upstream-reference=SystemComponentPrototype.NO_VECH_2, ecu-extract-reference=COMPOSITIONTYPE.NO_VECH_2
      NO_VECH_5: upstream-reference=SystemComponentPrototype.NO_VECH_3.NO_VECH_3, ecu-extract-reference=COMPOSITIONTYPE.NO_VECH_3.NO_VECH_3
      NO_VECH_6: upstream-reference=SystemComponentPrototype.NO_VECH_3, ecu-extract-reference=COMPOSITIONTYPE.NO_VECH_3
      NO_VECH_7: upstream-reference=SystemComponentPrototype.NO_VECH_4.NO_VECH_4, ecu-extract-reference=COMPOSITIONTYPE.NO_VECH_4.NO_VECH_4
      NO_VECH_8: upstream-reference=SystemComponentPrototype.NO_VECH_4, ecu-extract-reference=COMPOSITIONTYPE.NO_VECH_4
      NO_VECH_9: upstream-reference=SystemComponentPrototype.NO_VECH_5.NO_VECH_5, ecu-extract-reference=COMPOSITIONTYPE.NO_VECH_5.NO_VECH_5
      NO_VECH_10: upstream-reference=SystemComponentPrototype.NO_VECH_5, ecu-extract-reference=COMPOSITIONTYPE.NO_VECH_5
      NO_VECH_11: upstream-reference=SystemComponentPrototype.NO_VECH_6.NO_VECH_6, ecu-extract-reference=COMPOSITIONTYPE.NO_VECH_6.NO_VECH_6
      NO_VECH_12: upstream-reference=SystemComponentPrototype.NO_VECH_6, ecu-extract-reference=COMPOSITIONTYPE.NO_VECH_6
      NO_VECH_13: upstream-reference=SystemComponentPrototype.NO_VECH_7.NO_VECH_7, ecu-extract-reference=COMPOSITIONTYPE.NO_VECH_7.NO_VECH_7
      NO_VECH_14: upstream-reference=SystemComponentPrototype.NO_VECH_7, ecu-extract-reference=COMPOSITIONTYPE.NO_VECH_7
      sigGroup_CON_VEH: upstream-reference=SystemComponentPrototype.sigGroup_CON_VEH.sigGroup_CON_VEH, ecu-extract-reference=COMPOSITIONTYPE.sigGroup_CON_VEH.sigGroup_CON_VEH
      BacComIf: upstream-reference=SystemComponentPrototype.BacComIf, ecu-extract-reference=COMPOSITIONTYPE.BacComIf
      ANFRAGE_ID2_001: upstream-reference=SystemComponentPrototype.ANFRAGE_ID2, ecu-extract-reference=COMPOSITIONTYPE.ANFRAGE_ID2
      ST_ENERG_FZM_001: upstream-reference=SystemComponentPrototype.ST_ENERG_FZM, ecu-extract-reference=COMPOSITIONTYPE.ST_ENERG_FZM
      ST_ILK_ERRM_FZM_001: upstream-reference=SystemComponentPrototype.ST_ILK_ERRM_FZM, ecu-extract-reference=COMPOSITIONTYPE.ST_ILK_ERRM_FZM
      T_SEC_COU_REL_001: upstream-reference=SystemComponentPrototype.T_SEC_COU_REL, ecu-extract-reference=COMPOSITIONTYPE.T_SEC_COU_REL
      CDD_ChkPtAppl{7..9}: upstream-reference=SystemComponentPrototype.CDD_ChkPtAppl{7..9}, ecu-extract-reference=COMPOSITIONTYPE.CDD_ChkPtAppl{7..9}
      EotProtn: upstream-reference=SystemComponentPrototype.EotProtn, ecu-extract-reference=COMPOSITIONTYPE.EotProtn
      PosnTrakgServo: upstream-reference=SystemComponentPrototype.PosnTrakgServo, ecu-extract-reference=COMPOSITIONTYPE.PosnTrakgServo
      StOutpCtrl: upstream-reference=SystemComponentPrototype.StOutpCtrl, ecu-extract-reference=COMPOSITIONTYPE.StOutpCtrl
      SysFricLrng: upstream-reference=SystemComponentPrototype.SysFricLrng, ecu-extract-reference=COMPOSITIONTYPE.SysFricLrng
      VehSpdLimr: upstream-reference=SystemComponentPrototype.VehSpdLimr, ecu-extract-reference=COMPOSITIONTYPE.VehSpdLimr
      VehSigCdng: upstream-reference=SystemComponentPrototype.VehSigCdng, ecu-extract-reference=COMPOSITIONTYPE.VehSigCdng
      CmplncErr: upstream-reference=SystemComponentPrototype.CmplncErr, ecu-extract-reference=COMPOSITIONTYPE.CmplncErr
      LimrCdng: upstream-reference=SystemComponentPrototype.LimrCdng, ecu-extract-reference=COMPOSITIONTYPE.LimrCdng
      TunSelnAuthy: upstream-reference=SystemComponentPrototype.TunSelnAuthy, ecu-extract-reference=COMPOSITIONTYPE.TunSelnAuthy
      CDD_CurrMeasArbn: upstream-reference=SystemComponentPrototype.CDD_CurrMeasArbn, ecu-extract-reference=COMPOSITIONTYPE.CDD_CurrMeasArbn
      CurrMeasCorrln: upstream-reference=SystemComponentPrototype.CurrMeasCorrln, ecu-extract-reference=COMPOSITIONTYPE.CurrMeasCorrln
      TurnCntrCorrln: upstream-reference=SystemComponentPrototype.TurnCntrCorrln, ecu-extract-reference=COMPOSITIONTYPE.TurnCntrCorrln
      CDD_McuDiagc: upstream-reference=SystemComponentPrototype.CDD_McuDiagc, ecu-extract-reference=COMPOSITIONTYPE.CDD_McuDiagc
      MotVelCtrl: upstream-reference=SystemComponentPrototype.MotVelCtrl, ecu-extract-reference=COMPOSITIONTYPE.MotVelCtrl
      CDD_CoreVltgMonr: upstream-reference=SystemComponentPrototype.CDD_CoreVltgMonr, ecu-extract-reference=COMPOSITIONTYPE.CDD_CoreVltgMonr
      CDD_McuCoreCfgAndDiagc: upstream-reference=SystemComponentPrototype.CDD_McuCoreCfgAndDiagc, ecu-extract-reference=COMPOSITIONTYPE.CDD_McuCoreCfgAndDiagc
      CDD_VrfyCritReg: upstream-reference=SystemComponentPrototype.CDD_VrfyCritReg, ecu-extract-reference=COMPOSITIONTYPE.CDD_VrfyCritReg
      CDD_DataAndAdrPar: upstream-reference=SystemComponentPrototype.CDD_DataAndAdrPar, ecu-extract-reference=COMPOSITIONTYPE.CDD_DataAndAdrPar
      sigGroup_OFFS_QUAD_EPS: upstream-reference=SystemComponentPrototype.sigGroup_OFFS_QUAD_EPS.sigGroup_OFFS_QUAD_EPS, ecu-extract-reference=COMPOSITIONTYPE.sigGroup_OFFS_QUAD_EPS.sigGroup_OFFS_QUAD_EPS
      sigGroup_V_VEH: upstream-reference=SystemComponentPrototype.sigGroup_V_VEH.sigGroup_V_VEH, ecu-extract-reference=COMPOSITIONTYPE.sigGroup_V_VEH.sigGroup_V_VEH
      BmwMsgSlot107Bas0Repn1BusFrChA: upstream-reference=SystemComponentPrototype.BmwMsgSlot107Bas0Repn1BusFrChA, ecu-extract-reference=COMPOSITIONTYPE.BmwMsgSlot107Bas0Repn1BusFrChA
      BmwMsgSlot121Bas1Repn2BusFrChA: upstream-reference=SystemComponentPrototype.BmwMsgSlot121Bas1Repn2BusFrChA, ecu-extract-reference=COMPOSITIONTYPE.BmwMsgSlot121Bas1Repn2BusFrChA
      BmwMsgSlot55Bas3Repn4BusFrChA: upstream-reference=SystemComponentPrototype.BmwMsgSlot55Bas3Repn4BusFrChA, ecu-extract-reference=COMPOSITIONTYPE.BmwMsgSlot55Bas3Repn4BusFrChA
      sigGroup_CON_VEH_001: upstream-reference=SystemComponentPrototype.sigGroup_CON_VEH, ecu-extract-reference=COMPOSITIONTYPE.sigGroup_CON_VEH
      sigGroup_OFFS_QUAD_EPS_001: upstream-reference=SystemComponentPrototype.sigGroup_OFFS_QUAD_EPS, ecu-extract-reference=COMPOSITIONTYPE.sigGroup_OFFS_QUAD_EPS
      sigGroup_V_VEH_001: upstream-reference=SystemComponentPrototype.sigGroup_V_VEH, ecu-extract-reference=COMPOSITIONTYPE.sigGroup_V_VEH
      DiagcMgrProxyAppl7: upstream-reference=SystemComponentPrototype.DiagcMgrProxyAppl7, ecu-extract-reference=COMPOSITIONTYPE.DiagcMgrProxyAppl7
      BmwHwAgArbnAndEotPosn: upstream-reference=SystemComponentPrototype.BmwHwAgArbnAndEotPosn, ecu-extract-reference=COMPOSITIONTYPE.BmwHwAgArbnAndEotPosn
      LrndRackCentr: upstream-reference=SystemComponentPrototype.LrndRackCentr, ecu-extract-reference=COMPOSITIONTYPE.LrndRackCentr
      LrnPinionCentr: upstream-reference=SystemComponentPrototype.LrnPinionCentr, ecu-extract-reference=COMPOSITIONTYPE.LrnPinionCentr
      BmwMsgSlot274Bas2Repn4BusFrChA: upstream-reference=SystemComponentPrototype.BmwMsgSlot274Bas2Repn4BusFrChA, ecu-extract-reference=COMPOSITIONTYPE.BmwMsgSlot274Bas2Repn4BusFrChA
      BmwMsgSlot51Bas0Repn2BusFrChA: upstream-reference=SystemComponentPrototype.BmwMsgSlot51Bas0Repn2BusFrChA, ecu-extract-reference=COMPOSITIONTYPE.BmwMsgSlot51Bas0Repn2BusFrChA
      sigGroup_DISP_CC_EPS: upstream-reference=SystemComponentPrototype.sigGroup_DISP_CC_EPS.sigGroup_DISP_CC_EPS, ecu-extract-reference=COMPOSITIONTYPE.sigGroup_DISP_CC_EPS.sigGroup_DISP_CC_EPS
      sigGroup_DISP_CC_EPS_001: upstream-reference=SystemComponentPrototype.sigGroup_DISP_CC_EPS, ecu-extract-reference=COMPOSITIONTYPE.sigGroup_DISP_CC_EPS
      sigGroup_AVL_PO_EPS: upstream-reference=SystemComponentPrototype.sigGroup_AVL_PO_EPS.sigGroup_AVL_PO_EPS, ecu-extract-reference=COMPOSITIONTYPE.sigGroup_AVL_PO_EPS.sigGroup_AVL_PO_EPS
      sigGroup_AVL_PO_EPS_001: upstream-reference=SystemComponentPrototype.sigGroup_AVL_PO_EPS, ecu-extract-reference=COMPOSITIONTYPE.sigGroup_AVL_PO_EPS
      TRGG_ENGTORQ_EPS: upstream-reference=SystemComponentPrototype.TRGG_ENGTORQ_EPS.TRGG_ENGTORQ_EPS, ecu-extract-reference=COMPOSITIONTYPE.TRGG_ENGTORQ_EPS.TRGG_ENGTORQ_EPS
      BmwFltHndlg: upstream-reference=SystemComponentPrototype.BmwFltHndlg, ecu-extract-reference=COMPOSITIONTYPE.BmwFltHndlg
      BmwStReqMgr: upstream-reference=SystemComponentPrototype.BmwStReqMgr, ecu-extract-reference=COMPOSITIONTYPE.BmwStReqMgr
      CtrldVelRtn: upstream-reference=SystemComponentPrototype.CtrldVelRtn, ecu-extract-reference=COMPOSITIONTYPE.CtrldVelRtn
      DiagcMgrProxyAppl8: upstream-reference=SystemComponentPrototype.DiagcMgrProxyAppl8, ecu-extract-reference=COMPOSITIONTYPE.DiagcMgrProxyAppl8
      DiagcMgrProxyAppl9: upstream-reference=SystemComponentPrototype.DiagcMgrProxyAppl9, ecu-extract-reference=COMPOSITIONTYPE.DiagcMgrProxyAppl9
      BmwDiagcSrvHndlg: upstream-reference=SystemComponentPrototype.BmwDiagcSrvHndlg, ecu-extract-reference=COMPOSITIONTYPE.BmwDiagcSrvHndlg
      CDD_XcpIf: upstream-reference=SystemComponentPrototype.CDD_XcpIf, ecu-extract-reference=COMPOSITIONTYPE.CDD_XcpIf
      TunSelnMngt: upstream-reference=SystemComponentPrototype.TunSelnMngt, ecu-extract-reference=COMPOSITIONTYPE.TunSelnMngt
      CDD_XcpIfXcpEve2MilliSecDataAcqn: upstream-reference=SystemComponentPrototype.CDD_XcpIfXcpEve2MilliSecDataAcqn, ecu-extract-reference=COMPOSITIONTYPE.CDD_XcpIfXcpEve2MilliSecDataAcqn
      PhaDiscnct: upstream-reference=SystemComponentPrototype.PhaDiscnct, ecu-extract-reference=COMPOSITIONTYPE.PhaDiscnct
      RvsBattProtn: upstream-reference=SystemComponentPrototype.RvsBattProtn, ecu-extract-reference=COMPOSITIONTYPE.RvsBattProtn
      LoaMgr: upstream-reference=SystemComponentPrototype.LoaMgr, ecu-extract-reference=COMPOSITIONTYPE.LoaMgr
      CDD_BattRtnCurr: upstream-reference=SystemComponentPrototype.CDD_BattRtnCurr, ecu-extract-reference=COMPOSITIONTYPE.CDD_BattRtnCurr
      BmwVehSpd: upstream-reference=SystemComponentPrototype.BmwVehSpd, ecu-extract-reference=COMPOSITIONTYPE.BmwVehSpd
      Dlog: upstream-reference=SystemComponentPrototype.Dlog, ecu-extract-reference=COMPOSITIONTYPE.Dlog
      StdDiag: upstream-reference=SystemComponentPrototype.StdDiag, ecu-extract-reference=COMPOSITIONTYPE.StdDiag
      Omc: upstream-reference=SystemComponentPrototype.Omc, ecu-extract-reference=COMPOSITIONTYPE.Omc
      Darh: upstream-reference=SystemComponentPrototype.Darh, ecu-extract-reference=COMPOSITIONTYPE.Darh
      Stm: upstream-reference=SystemComponentPrototype.Stm, ecu-extract-reference=COMPOSITIONTYPE.Stm
      Coding: upstream-reference=SystemComponentPrototype.Coding, ecu-extract-reference=COMPOSITIONTYPE.Coding
      Rmh: upstream-reference=SystemComponentPrototype.Rmh, ecu-extract-reference=COMPOSITIONTYPE.Rmh
      Rmh_Cdd: upstream-reference=SystemComponentPrototype.Rmh_Cdd, ecu-extract-reference=COMPOSITIONTYPE.Rmh_Cdd
      SysTime: upstream-reference=SystemComponentPrototype.SysTime, ecu-extract-reference=COMPOSITIONTYPE.SysTime
      CmnMfgSrvIf: upstream-reference=SystemComponentPrototype.CmnMfgSrvIf, ecu-extract-reference=COMPOSITIONTYPE.CmnMfgSrvIf
      DemWrapper: upstream-reference=SystemComponentPrototype.DemWrapper, ecu-extract-reference=COMPOSITIONTYPE.DemWrapper
      BmwTunSetHndlr: upstream-reference=SystemComponentPrototype.BmwTunSetHndlr, ecu-extract-reference=COMPOSITIONTYPE.BmwTunSetHndlr
      ProgMfgSrv: upstream-reference=SystemComponentPrototype.ProgMfgSrv, ecu-extract-reference=COMPOSITIONTYPE.ProgMfgSrv
      CDD_MotAg3Meas: upstream-reference=SystemComponentPrototype.CDD_MotAg3Meas, ecu-extract-reference=COMPOSITIONTYPE.CDD_MotAg3Meas
      CDD_MotAg4Meas: upstream-reference=SystemComponentPrototype.CDD_MotAg4Meas, ecu-extract-reference=COMPOSITIONTYPE.CDD_MotAg4Meas
      ClsdLoopDampg: upstream-reference=SystemComponentPrototype.ClsdLoopDampg, ecu-extract-reference=COMPOSITIONTYPE.ClsdLoopDampg
      Effort: upstream-reference=SystemComponentPrototype.Effort, ecu-extract-reference=COMPOSITIONTYPE.Effort
      HwRefTqSum: upstream-reference=SystemComponentPrototype.HwRefTqSum, ecu-extract-reference=COMPOSITIONTYPE.HwRefTqSum
      HwTqTrakgCtrl: upstream-reference=SystemComponentPrototype.HwTqTrakgCtrl, ecu-extract-reference=COMPOSITIONTYPE.HwTqTrakgCtrl
      MotTqCalcd: upstream-reference=SystemComponentPrototype.MotTqCalcd, ecu-extract-reference=COMPOSITIONTYPE.MotTqCalcd
      SysKineAndEff: upstream-reference=SystemComponentPrototype.SysKineAndEff, ecu-extract-reference=COMPOSITIONTYPE.SysKineAndEff
      TqOscn: upstream-reference=SystemComponentPrototype.TqOscn, ecu-extract-reference=COMPOSITIONTYPE.TqOscn
      EpsStEstimn: upstream-reference=SystemComponentPrototype.EpsStEstimn, ecu-extract-reference=COMPOSITIONTYPE.EpsStEstimn
      sigGroup_ST_EST: upstream-reference=SystemComponentPrototype.sigGroup_ST_EST.sigGroup_ST_EST, ecu-extract-reference=COMPOSITIONTYPE.sigGroup_ST_EST.sigGroup_ST_EST
      sigGroup_SU_EPS: upstream-reference=SystemComponentPrototype.sigGroup_SU_EPS.sigGroup_SU_EPS, ecu-extract-reference=COMPOSITIONTYPE.sigGroup_SU_EPS.sigGroup_SU_EPS
      TRGG_ENGTORQ_EPS_001: upstream-reference=SystemComponentPrototype.TRGG_ENGTORQ_EPS, ecu-extract-reference=COMPOSITIONTYPE.TRGG_ENGTORQ_EPS
      FACT_MO_STE_SO_DXP: upstream-reference=SystemComponentPrototype.FACT_MO_STE_SO_DXP.FACT_MO_STE_SO_DXP, ecu-extract-reference=COMPOSITIONTYPE.FACT_MO_STE_SO_DXP.FACT_MO_STE_SO_DXP
      FACT_MO_STE_SO_DXP_001: upstream-reference=SystemComponentPrototype.FACT_MO_STE_SO_DXP, ecu-extract-reference=COMPOSITIONTYPE.FACT_MO_STE_SO_DXP
      MILE_KM: upstream-reference=SystemComponentPrototype.MILE_KM.MILE_KM, ecu-extract-reference=COMPOSITIONTYPE.MILE_KM.MILE_KM
      sigGroup_ACLNY_MASSCNTR: upstream-reference=SystemComponentPrototype.sigGroup_ACLNY_MASSCNTR.sigGroup_ACLNY_MASSCNTR, ecu-extract-reference=COMPOSITIONTYPE.sigGroup_ACLNY_MASSCNTR.sigGroup_ACLNY_MASSCNTR
      sigGroup_TAR_QTA_STRMOM_DV: upstream-reference=SystemComponentPrototype.sigGroup_TAR_QTA_STRMOM_DV.sigGroup_TAR_QTA_STRMOM_DV, ecu-extract-reference=COMPOSITIONTYPE.sigGroup_TAR_QTA_STRMOM_DV.sigGroup_TAR_QTA_STRMOM_DV
      sigGroup_TAR_STMOM_DV_ACT: upstream-reference=SystemComponentPrototype.sigGroup_TAR_STMOM_DV_ACT.sigGroup_TAR_STMOM_DV_ACT, ecu-extract-reference=COMPOSITIONTYPE.sigGroup_TAR_STMOM_DV_ACT.sigGroup_TAR_STMOM_DV_ACT
      sigGroup_VYAW_VEH: upstream-reference=SystemComponentPrototype.sigGroup_VYAW_VEH.sigGroup_VYAW_VEH, ecu-extract-reference=COMPOSITIONTYPE.sigGroup_VYAW_VEH.sigGroup_VYAW_VEH
      SU_CLU_STMOM_SFE_DXP: upstream-reference=SystemComponentPrototype.SU_CLU_STMOM_SFE_DXP.SU_CLU_STMOM_SFE_DXP, ecu-extract-reference=COMPOSITIONTYPE.SU_CLU_STMOM_SFE_DXP.SU_CLU_STMOM_SFE_DXP
      SU_CLU_STMOM_SFE_DXP_001: upstream-reference=SystemComponentPrototype.SU_CLU_STMOM_SFE_DXP, ecu-extract-reference=COMPOSITIONTYPE.SU_CLU_STMOM_SFE_DXP
      BmwMsgSlot234Bas1Repn2BusFrChA: upstream-reference=SystemComponentPrototype.BmwMsgSlot234Bas1Repn2BusFrChA, ecu-extract-reference=COMPOSITIONTYPE.BmwMsgSlot234Bas1Repn2BusFrChA
      BmwMsgSlot274Bas0Repn8BusFrChA: upstream-reference=SystemComponentPrototype.BmwMsgSlot274Bas0Repn8BusFrChA, ecu-extract-reference=COMPOSITIONTYPE.BmwMsgSlot274Bas0Repn8BusFrChA
      BmwMsgSlot276Bas4Repn8BusFrChA: upstream-reference=SystemComponentPrototype.BmwMsgSlot276Bas4Repn8BusFrChA, ecu-extract-reference=COMPOSITIONTYPE.BmwMsgSlot276Bas4Repn8BusFrChA
      BmwMsgSlot53Bas3Repn8BusFrChA: upstream-reference=SystemComponentPrototype.BmwMsgSlot53Bas3Repn8BusFrChA, ecu-extract-reference=COMPOSITIONTYPE.BmwMsgSlot53Bas3Repn8BusFrChA
      BmwMsgSlot55Bas0Repn2BusFrChA: upstream-reference=SystemComponentPrototype.BmwMsgSlot55Bas0Repn2BusFrChA, ecu-extract-reference=COMPOSITIONTYPE.BmwMsgSlot55Bas0Repn2BusFrChA
      BmwMsgSlot56Bas0Repn2BusFrChA: upstream-reference=SystemComponentPrototype.BmwMsgSlot56Bas0Repn2BusFrChA, ecu-extract-reference=COMPOSITIONTYPE.BmwMsgSlot56Bas0Repn2BusFrChA
      BmwMsgSlot68Bas0Repn2BusFrChA: upstream-reference=SystemComponentPrototype.BmwMsgSlot68Bas0Repn2BusFrChA, ecu-extract-reference=COMPOSITIONTYPE.BmwMsgSlot68Bas0Repn2BusFrChA
      sigGroup_ST_EST_001: upstream-reference=SystemComponentPrototype.sigGroup_ST_EST, ecu-extract-reference=COMPOSITIONTYPE.sigGroup_ST_EST
      sigGroup_SU_EPS_001: upstream-reference=SystemComponentPrototype.sigGroup_SU_EPS, ecu-extract-reference=COMPOSITIONTYPE.sigGroup_SU_EPS
      sigGroup_ACLNY_MASSCNTR_001: upstream-reference=SystemComponentPrototype.sigGroup_ACLNY_MASSCNTR, ecu-extract-reference=COMPOSITIONTYPE.sigGroup_ACLNY_MASSCNTR
      sigGroup_TAR_QTA_STRMOM_DV_001: upstream-reference=SystemComponentPrototype.sigGroup_TAR_QTA_STRMOM_DV, ecu-extract-reference=COMPOSITIONTYPE.sigGroup_TAR_QTA_STRMOM_DV
      sigGroup_TAR_STMOM_DV_ACT_001: upstream-reference=SystemComponentPrototype.sigGroup_TAR_STMOM_DV_ACT, ecu-extract-reference=COMPOSITIONTYPE.sigGroup_TAR_STMOM_DV_ACT
      sigGroup_VYAW_VEH_001: upstream-reference=SystemComponentPrototype.sigGroup_VYAW_VEH, ecu-extract-reference=COMPOSITIONTYPE.sigGroup_VYAW_VEH
      AVL_STEA_PNI_OFFS: upstream-reference=SystemComponentPrototype.AVL_STEA_PNI_OFFS.AVL_STEA_PNI_OFFS, ecu-extract-reference=COMPOSITIONTYPE.AVL_STEA_PNI_OFFS.AVL_STEA_PNI_OFFS
      BmwMsgSlot108Bas0Repn2BusFrChA: upstream-reference=SystemComponentPrototype.BmwMsgSlot108Bas0Repn2BusFrChA, ecu-extract-reference=COMPOSITIONTYPE.BmwMsgSlot108Bas0Repn2BusFrChA
      GlbLimr: upstream-reference=SystemComponentPrototype.GlbLimr, ecu-extract-reference=COMPOSITIONTYPE.GlbLimr
      sigGroup_DT_EST: upstream-reference=SystemComponentPrototype.sigGroup_DT_EST.sigGroup_DT_EST, ecu-extract-reference=COMPOSITIONTYPE.sigGroup_DT_EST.sigGroup_DT_EST
      CTR_WARN_DIR_VIB_EPS: upstream-reference=SystemComponentPrototype.CTR_WARN_DIR_VIB_EPS.CTR_WARN_DIR_VIB_EPS, ecu-extract-reference=COMPOSITIONTYPE.CTR_WARN_DIR_VIB_EPS.CTR_WARN_DIR_VIB_EPS
      CTR_WARN_ILVL_VIB_EPS: upstream-reference=SystemComponentPrototype.CTR_WARN_ILVL_VIB_EPS.CTR_WARN_ILVL_VIB_EPS, ecu-extract-reference=COMPOSITIONTYPE.CTR_WARN_ILVL_VIB_EPS.CTR_WARN_ILVL_VIB_EPS
      CTR_WARN_PTRN_VIB_EPS: upstream-reference=SystemComponentPrototype.CTR_WARN_PTRN_VIB_EPS.CTR_WARN_PTRN_VIB_EPS, ecu-extract-reference=COMPOSITIONTYPE.CTR_WARN_PTRN_VIB_EPS.CTR_WARN_PTRN_VIB_EPS
      sigGroup_ENERG_DGR_DRDY: upstream-reference=SystemComponentPrototype.sigGroup_ENERG_DGR_DRDY.sigGroup_ENERG_DGR_DRDY, ecu-extract-reference=COMPOSITIONTYPE.sigGroup_ENERG_DGR_DRDY.sigGroup_ENERG_DGR_DRDY
      BmwMsgSlot269Bas2Repn4BusFrChA: upstream-reference=SystemComponentPrototype.BmwMsgSlot269Bas2Repn4BusFrChA, ecu-extract-reference=COMPOSITIONTYPE.BmwMsgSlot269Bas2Repn4BusFrChA
      BmwMsgSlot49Bas1Repn2BusFrChA: upstream-reference=SystemComponentPrototype.BmwMsgSlot49Bas1Repn2BusFrChA, ecu-extract-reference=COMPOSITIONTYPE.BmwMsgSlot49Bas1Repn2BusFrChA
      BmwMsgSlot68Bas1Repn2BusFrChA: upstream-reference=SystemComponentPrototype.BmwMsgSlot68Bas1Repn2BusFrChA, ecu-extract-reference=COMPOSITIONTYPE.BmwMsgSlot68Bas1Repn2BusFrChA
      sigGroup_DT_EST_001: upstream-reference=SystemComponentPrototype.sigGroup_DT_EST, ecu-extract-reference=COMPOSITIONTYPE.sigGroup_DT_EST
      AVL_STEA_PNI_OFFS_001: upstream-reference=SystemComponentPrototype.AVL_STEA_PNI_OFFS, ecu-extract-reference=COMPOSITIONTYPE.AVL_STEA_PNI_OFFS
      CTR_WARN_DIR_VIB_EPS_001: upstream-reference=SystemComponentPrototype.CTR_WARN_DIR_VIB_EPS, ecu-extract-reference=COMPOSITIONTYPE.CTR_WARN_DIR_VIB_EPS
      CTR_WARN_ILVL_VIB_EPS_001: upstream-reference=SystemComponentPrototype.CTR_WARN_ILVL_VIB_EPS, ecu-extract-reference=COMPOSITIONTYPE.CTR_WARN_ILVL_VIB_EPS
      CTR_WARN_PTRN_VIB_EPS_001: upstream-reference=SystemComponentPrototype.CTR_WARN_PTRN_VIB_EPS, ecu-extract-reference=COMPOSITIONTYPE.CTR_WARN_PTRN_VIB_EPS
      MILE_KM_001: upstream-reference=SystemComponentPrototype.MILE_KM, ecu-extract-reference=COMPOSITIONTYPE.MILE_KM
      sigGroup_ENERG_DGR_DRDY_001: upstream-reference=SystemComponentPrototype.sigGroup_ENERG_DGR_DRDY, ecu-extract-reference=COMPOSITIONTYPE.sigGroup_ENERG_DGR_DRDY
      sigGroup_AVL_FORC_GRD: upstream-reference=SystemComponentPrototype.sigGroup_AVL_FORC_GRD.sigGroup_AVL_FORC_GRD, ecu-extract-reference=COMPOSITIONTYPE.sigGroup_AVL_FORC_GRD.sigGroup_AVL_FORC_GRD
      sigGroup_AVL_FORC_GRD_001: upstream-reference=SystemComponentPrototype.sigGroup_AVL_FORC_GRD, ecu-extract-reference=COMPOSITIONTYPE.sigGroup_AVL_FORC_GRD
      sigGroup_AVL_STMOM_DV_ACT: upstream-reference=SystemComponentPrototype.sigGroup_AVL_STMOM_DV_ACT.sigGroup_AVL_STMOM_DV_ACT, ecu-extract-reference=COMPOSITIONTYPE.sigGroup_AVL_STMOM_DV_ACT.sigGroup_AVL_STMOM_DV_ACT
      sigGroup_AVL_STMOM_DV_ACT_001: upstream-reference=SystemComponentPrototype.sigGroup_AVL_STMOM_DV_ACT, ecu-extract-reference=COMPOSITIONTYPE.sigGroup_AVL_STMOM_DV_ACT
      BmwDrvgDynStMac: upstream-reference=SystemComponentPrototype.BmwDrvgDynStMac, ecu-extract-reference=COMPOSITIONTYPE.BmwDrvgDynStMac
      BmwHwTqOvrlArbn: upstream-reference=SystemComponentPrototype.BmwHwTqOvrlArbn, ecu-extract-reference=COMPOSITIONTYPE.BmwHwTqOvrlArbn
      BmwMotTqOvrlArbn: upstream-reference=SystemComponentPrototype.BmwMotTqOvrlArbn, ecu-extract-reference=COMPOSITIONTYPE.BmwMotTqOvrlArbn
      BmwMsgSlot49Bas0Repn2BusFrChA: upstream-reference=SystemComponentPrototype.BmwMsgSlot49Bas0Repn2BusFrChA, ecu-extract-reference=COMPOSITIONTYPE.BmwMsgSlot49Bas0Repn2BusFrChA
      BmwTqOvrlCdngAndDrvgDynFac: upstream-reference=SystemComponentPrototype.BmwTqOvrlCdngAndDrvgDynFac, ecu-extract-reference=COMPOSITIONTYPE.BmwTqOvrlCdngAndDrvgDynFac
      BmwTrfcJamAssiDampg: upstream-reference=SystemComponentPrototype.BmwTrfcJamAssiDampg, ecu-extract-reference=COMPOSITIONTYPE.BmwTrfcJamAssiDampg
      FalbckAssi: upstream-reference=SystemComponentPrototype.FalbckAssi, ecu-extract-reference=COMPOSITIONTYPE.FalbckAssi
      SteerCmdArbnAndLim: upstream-reference=SystemComponentPrototype.SteerCmdArbnAndLim, ecu-extract-reference=COMPOSITIONTYPE.SteerCmdArbnAndLim
      ClsdLoopHys: upstream-reference=SystemComponentPrototype.ClsdLoopHys, ecu-extract-reference=COMPOSITIONTYPE.ClsdLoopHys
      AAACalRegn01IninOptSetA{00..03}_Dummy: upstream-reference=SystemComponentPrototype.AAACalRegn01IninOptSetA{00..03}_Dummy, ecu-extract-reference=COMPOSITIONTYPE.AAACalRegn01IninOptSetA{00..03}_Dummy
      AAACalRegn02Rt00_Dummy: upstream-reference=SystemComponentPrototype.AAACalRegn02Rt00_Dummy, ecu-extract-reference=COMPOSITIONTYPE.AAACalRegn02Rt00_Dummy
      AAACalRegn02Rt00GroupA_Dummy: upstream-reference=SystemComponentPrototype.AAACalRegn02Rt00GroupA_Dummy, ecu-extract-reference=COMPOSITIONTYPE.AAACalRegn02Rt00GroupA_Dummy
      AAACalRegn02Rt00GroupC_Dummy: upstream-reference=SystemComponentPrototype.AAACalRegn02Rt00GroupC_Dummy, ecu-extract-reference=COMPOSITIONTYPE.AAACalRegn02Rt00GroupC_Dummy
      AAACalRegn02Rt01_Dummy: upstream-reference=SystemComponentPrototype.AAACalRegn02Rt01_Dummy, ecu-extract-reference=COMPOSITIONTYPE.AAACalRegn02Rt01_Dummy
      AAACalRegn02Rt01GroupA_Dummy: upstream-reference=SystemComponentPrototype.AAACalRegn02Rt01GroupA_Dummy, ecu-extract-reference=COMPOSITIONTYPE.AAACalRegn02Rt01GroupA_Dummy
      AAACalRegn02Rt01GroupC_Dummy: upstream-reference=SystemComponentPrototype.AAACalRegn02Rt01GroupC_Dummy, ecu-extract-reference=COMPOSITIONTYPE.AAACalRegn02Rt01GroupC_Dummy
      AAACalRegn02Rt02_Dummy: upstream-reference=SystemComponentPrototype.AAACalRegn02Rt02_Dummy, ecu-extract-reference=COMPOSITIONTYPE.AAACalRegn02Rt02_Dummy
      AAACalRegn02Rt02GroupA_Dummy: upstream-reference=SystemComponentPrototype.AAACalRegn02Rt02GroupA_Dummy, ecu-extract-reference=COMPOSITIONTYPE.AAACalRegn02Rt02GroupA_Dummy
      AAACalRegn02Rt02GroupC_Dummy: upstream-reference=SystemComponentPrototype.AAACalRegn02Rt02GroupC_Dummy, ecu-extract-reference=COMPOSITIONTYPE.AAACalRegn02Rt02GroupC_Dummy
      AAACalRegn02Rt03_Dummy: upstream-reference=SystemComponentPrototype.AAACalRegn02Rt03_Dummy, ecu-extract-reference=COMPOSITIONTYPE.AAACalRegn02Rt03_Dummy
      AAACalRegn02Rt03GroupA_Dummy: upstream-reference=SystemComponentPrototype.AAACalRegn02Rt03GroupA_Dummy, ecu-extract-reference=COMPOSITIONTYPE.AAACalRegn02Rt03GroupA_Dummy
      AAACalRegn02Rt03GroupC_Dummy: upstream-reference=SystemComponentPrototype.AAACalRegn02Rt03GroupC_Dummy, ecu-extract-reference=COMPOSITIONTYPE.AAACalRegn02Rt03GroupC_Dummy
      CalRegn01Cmn: upstream-reference=SystemComponentPrototype.CalRegn01Cmn, ecu-extract-reference=COMPOSITIONTYPE.CalRegn01Cmn
      CalRegn01CmnGroupA: upstream-reference=SystemComponentPrototype.CalRegn01CmnGroupA, ecu-extract-reference=COMPOSITIONTYPE.CalRegn01CmnGroupA
      CalRegn01CmnGroupC: upstream-reference=SystemComponentPrototype.CalRegn01CmnGroupC, ecu-extract-reference=COMPOSITIONTYPE.CalRegn01CmnGroupC
      CalRegn01CmnGroupD: upstream-reference=SystemComponentPrototype.CalRegn01CmnGroupD, ecu-extract-reference=COMPOSITIONTYPE.CalRegn01CmnGroupD
      CalRegn01IninOptSetA{00..03}: upstream-reference=SystemComponentPrototype.CalRegn01IninOptSetA{00..03}, ecu-extract-reference=COMPOSITIONTYPE.CalRegn01IninOptSetA{00..03}
      CalRegn02Rt00: upstream-reference=SystemComponentPrototype.CalRegn02Rt00, ecu-extract-reference=COMPOSITIONTYPE.CalRegn02Rt00
      CalRegn02Rt00GroupA: upstream-reference=SystemComponentPrototype.CalRegn02Rt00GroupA, ecu-extract-reference=COMPOSITIONTYPE.CalRegn02Rt00GroupA
      CalRegn02Rt00GroupC: upstream-reference=SystemComponentPrototype.CalRegn02Rt00GroupC, ecu-extract-reference=COMPOSITIONTYPE.CalRegn02Rt00GroupC
      CalRegn02Rt01: upstream-reference=SystemComponentPrototype.CalRegn02Rt01, ecu-extract-reference=COMPOSITIONTYPE.CalRegn02Rt01
      CalRegn02Rt01GroupA: upstream-reference=SystemComponentPrototype.CalRegn02Rt01GroupA, ecu-extract-reference=COMPOSITIONTYPE.CalRegn02Rt01GroupA
      CalRegn02Rt01GroupC: upstream-reference=SystemComponentPrototype.CalRegn02Rt01GroupC, ecu-extract-reference=COMPOSITIONTYPE.CalRegn02Rt01GroupC
      CalRegn02Rt02: upstream-reference=SystemComponentPrototype.CalRegn02Rt02, ecu-extract-reference=COMPOSITIONTYPE.CalRegn02Rt02
      CalRegn02Rt02GroupA: upstream-reference=SystemComponentPrototype.CalRegn02Rt02GroupA, ecu-extract-reference=COMPOSITIONTYPE.CalRegn02Rt02GroupA
      CalRegn02Rt02GroupC: upstream-reference=SystemComponentPrototype.CalRegn02Rt02GroupC, ecu-extract-reference=COMPOSITIONTYPE.CalRegn02Rt02GroupC
      CalRegn02Rt03: upstream-reference=SystemComponentPrototype.CalRegn02Rt03, ecu-extract-reference=COMPOSITIONTYPE.CalRegn02Rt03
      CalRegn02Rt03GroupA: upstream-reference=SystemComponentPrototype.CalRegn02Rt03GroupA, ecu-extract-reference=COMPOSITIONTYPE.CalRegn02Rt03GroupA
      CalRegn02Rt03GroupC: upstream-reference=SystemComponentPrototype.CalRegn02Rt03GroupC, ecu-extract-reference=COMPOSITIONTYPE.CalRegn02Rt03GroupC
      BATT_VLTG_EPS: upstream-reference=SystemComponentPrototype.BATT_VLTG_EPS.BATT_VLTG_EPS, ecu-extract-reference=COMPOSITIONTYPE.BATT_VLTG_EPS.BATT_VLTG_EPS
      DBG_EPS_BS_MOD_58_BYTE_ID2: upstream-reference=SystemComponentPrototype.DBG_EPS_BS_MOD_58_BYTE_ID2.DBG_EPS_BS_MOD_58_BYTE_ID2, ecu-extract-reference=COMPOSITIONTYPE.DBG_EPS_BS_MOD_58_BYTE_ID2.DBG_EPS_BS_MOD_58_BYTE_ID2
      ECU_TEMP_EPS: upstream-reference=SystemComponentPrototype.ECU_TEMP_EPS.ECU_TEMP_EPS, ecu-extract-reference=COMPOSITIONTYPE.ECU_TEMP_EPS.ECU_TEMP_EPS
      ESTIMD_PEAK_MOT_CURR_EPS: upstream-reference=SystemComponentPrototype.ESTIMD_PEAK_MOT_CURR_EPS, ecu-extract-reference=COMPOSITIONTYPE.ESTIMD_PEAK_MOT_CURR_EPS
      MOT_FET_TEMP_EPS: upstream-reference=SystemComponentPrototype.MOT_FET_TEMP_EPS.MOT_FET_TEMP_EPS, ecu-extract-reference=COMPOSITIONTYPE.MOT_FET_TEMP_EPS.MOT_FET_TEMP_EPS
      MOT_MAG_TEMP_EPS: upstream-reference=SystemComponentPrototype.MOT_MAG_TEMP_EPS.MOT_MAG_TEMP_EPS, ecu-extract-reference=COMPOSITIONTYPE.MOT_MAG_TEMP_EPS.MOT_MAG_TEMP_EPS
      MOT_TQ_CMD_EPS: upstream-reference=SystemComponentPrototype.MOT_TQ_CMD_EPS.MOT_TQ_CMD_EPS, ecu-extract-reference=COMPOSITIONTYPE.MOT_TQ_CMD_EPS.MOT_TQ_CMD_EPS
      MOT_TQ_CMD_LIMD_EPS: upstream-reference=SystemComponentPrototype.MOT_TQ_CMD_LIMD_EPS.MOT_TQ_CMD_LIMD_EPS, ecu-extract-reference=COMPOSITIONTYPE.MOT_TQ_CMD_LIMD_EPS.MOT_TQ_CMD_LIMD_EPS
      MOT_VEL_EPS: upstream-reference=SystemComponentPrototype.MOT_VEL_EPS.MOT_VEL_EPS, ecu-extract-reference=COMPOSITIONTYPE.MOT_VEL_EPS.MOT_VEL_EPS
      MOT_WIDG_TEMP_EPS: upstream-reference=SystemComponentPrototype.MOT_WIDG_TEMP_EPS.MOT_WIDG_TEMP_EPS, ecu-extract-reference=COMPOSITIONTYPE.MOT_WIDG_TEMP_EPS.MOT_WIDG_TEMP_EPS
      PRIM_HW_TQ_SNSR_VLTG_EPS: upstream-reference=SystemComponentPrototype.PRIM_HW_TQ_SNSR_VLTG_EPS.PRIM_HW_TQ_SNSR_VLTG_EPS, ecu-extract-reference=COMPOSITIONTYPE.PRIM_HW_TQ_SNSR_VLTG_EPS.PRIM_HW_TQ_SNSR_VLTG_EPS
      SECDRY_HW_TQ_SNSR_VLTG_EPS: upstream-reference=SystemComponentPrototype.SECDRY_HW_TQ_SNSR_VLTG_EPS.SECDRY_HW_TQ_SNSR_VLTG_EPS, ecu-extract-reference=COMPOSITIONTYPE.SECDRY_HW_TQ_SNSR_VLTG_EPS.SECDRY_HW_TQ_SNSR_VLTG_EPS
      ST_CON_VEH_EPS: upstream-reference=SystemComponentPrototype.ST_CON_VEH_EPS, ecu-extract-reference=COMPOSITIONTYPE.ST_CON_VEH_EPS
      SYS_ST_EPS: upstream-reference=SystemComponentPrototype.SYS_ST_EPS, ecu-extract-reference=COMPOSITIONTYPE.SYS_ST_EPS
      VEH_SPD_EPS: upstream-reference=SystemComponentPrototype.VEH_SPD_EPS.VEH_SPD_EPS, ecu-extract-reference=COMPOSITIONTYPE.VEH_SPD_EPS.VEH_SPD_EPS
      BmwMsgSlot315Bas0Repn1BusFrChA: upstream-reference=SystemComponentPrototype.BmwMsgSlot315Bas0Repn1BusFrChA, ecu-extract-reference=COMPOSITIONTYPE.BmwMsgSlot315Bas0Repn1BusFrChA
      BATT_VLTG_EPS_001: upstream-reference=SystemComponentPrototype.BATT_VLTG_EPS, ecu-extract-reference=COMPOSITIONTYPE.BATT_VLTG_EPS
      DBG_EPS_BS_MOD_58_BYTE_ID2_001: upstream-reference=SystemComponentPrototype.DBG_EPS_BS_MOD_58_BYTE_ID2, ecu-extract-reference=COMPOSITIONTYPE.DBG_EPS_BS_MOD_58_BYTE_ID2
      ECU_TEMP_EPS_001: upstream-reference=SystemComponentPrototype.ECU_TEMP_EPS, ecu-extract-reference=COMPOSITIONTYPE.ECU_TEMP_EPS
      MOT_FET_TEMP_EPS_001: upstream-reference=SystemComponentPrototype.MOT_FET_TEMP_EPS, ecu-extract-reference=COMPOSITIONTYPE.MOT_FET_TEMP_EPS
      MOT_MAG_TEMP_EPS_001: upstream-reference=SystemComponentPrototype.MOT_MAG_TEMP_EPS, ecu-extract-reference=COMPOSITIONTYPE.MOT_MAG_TEMP_EPS
      MOT_TQ_CMD_EPS_001: upstream-reference=SystemComponentPrototype.MOT_TQ_CMD_EPS, ecu-extract-reference=COMPOSITIONTYPE.MOT_TQ_CMD_EPS
      MOT_TQ_CMD_LIMD_EPS_001: upstream-reference=SystemComponentPrototype.MOT_TQ_CMD_LIMD_EPS, ecu-extract-reference=COMPOSITIONTYPE.MOT_TQ_CMD_LIMD_EPS
      MOT_VEL_EPS_001: upstream-reference=SystemComponentPrototype.MOT_VEL_EPS, ecu-extract-reference=COMPOSITIONTYPE.MOT_VEL_EPS
      MOT_WIDG_TEMP_EPS_001: upstream-reference=SystemComponentPrototype.MOT_WIDG_TEMP_EPS, ecu-extract-reference=COMPOSITIONTYPE.MOT_WIDG_TEMP_EPS
      PRIM_HW_TQ_SNSR_VLTG_EPS_001: upstream-reference=SystemComponentPrototype.PRIM_HW_TQ_SNSR_VLTG_EPS, ecu-extract-reference=COMPOSITIONTYPE.PRIM_HW_TQ_SNSR_VLTG_EPS
      SECDRY_HW_TQ_SNSR_VLTG_EPS_001: upstream-reference=SystemComponentPrototype.SECDRY_HW_TQ_SNSR_VLTG_EPS, ecu-extract-reference=COMPOSITIONTYPE.SECDRY_HW_TQ_SNSR_VLTG_EPS
      VEH_SPD_EPS_001: upstream-reference=SystemComponentPrototype.VEH_SPD_EPS, ecu-extract-reference=COMPOSITIONTYPE.VEH_SPD_EPS
      BmwHaptcFb: upstream-reference=SystemComponentPrototype.BmwHaptcFb, ecu-extract-reference=COMPOSITIONTYPE.BmwHaptcFb
      BmwSplyCurrLim: upstream-reference=SystemComponentPrototype.BmwSplyCurrLim, ecu-extract-reference=COMPOSITIONTYPE.BmwSplyCurrLim
      NxtrCalIds: upstream-reference=SystemComponentPrototype.NxtrCalIds, ecu-extract-reference=COMPOSITIONTYPE.NxtrCalIds
      CalRegn01CmnGroupB: upstream-reference=SystemComponentPrototype.CalRegn01CmnGroupB, ecu-extract-reference=COMPOSITIONTYPE.CalRegn01CmnGroupB
      BmwPwrPrkgDampg: upstream-reference=SystemComponentPrototype.BmwPwrPrkgDampg, ecu-extract-reference=COMPOSITIONTYPE.BmwPwrPrkgDampg
      InertiaCmpVel: upstream-reference=SystemComponentPrototype.InertiaCmpVel, ecu-extract-reference=COMPOSITIONTYPE.InertiaCmpVel
      PullCmpActv: upstream-reference=SystemComponentPrototype.PullCmpActv, ecu-extract-reference=COMPOSITIONTYPE.PullCmpActv
      AAACalRegn01Inin00_Dummy: upstream-reference=SystemComponentPrototype.AAACalRegn01Inin00_Dummy, ecu-extract-reference=COMPOSITIONTYPE.AAACalRegn01Inin00_Dummy
      AAACalRegn01Inin00GroupA_Dummy: upstream-reference=SystemComponentPrototype.AAACalRegn01Inin00GroupA_Dummy, ecu-extract-reference=COMPOSITIONTYPE.AAACalRegn01Inin00GroupA_Dummy
      AAACalRegn01Inin00GroupC_Dummy: upstream-reference=SystemComponentPrototype.AAACalRegn01Inin00GroupC_Dummy, ecu-extract-reference=COMPOSITIONTYPE.AAACalRegn01Inin00GroupC_Dummy
      AAACalRegn01Inin00GroupD_Dummy: upstream-reference=SystemComponentPrototype.AAACalRegn01Inin00GroupD_Dummy, ecu-extract-reference=COMPOSITIONTYPE.AAACalRegn01Inin00GroupD_Dummy
      AAACalRegn01Inin01_Dummy: upstream-reference=SystemComponentPrototype.AAACalRegn01Inin01_Dummy, ecu-extract-reference=COMPOSITIONTYPE.AAACalRegn01Inin01_Dummy
      AAACalRegn01Inin01GroupA_Dummy: upstream-reference=SystemComponentPrototype.AAACalRegn01Inin01GroupA_Dummy, ecu-extract-reference=COMPOSITIONTYPE.AAACalRegn01Inin01GroupA_Dummy
      AAACalRegn01Inin01GroupC_Dummy: upstream-reference=SystemComponentPrototype.AAACalRegn01Inin01GroupC_Dummy, ecu-extract-reference=COMPOSITIONTYPE.AAACalRegn01Inin01GroupC_Dummy
      AAACalRegn01Inin01GroupD_Dummy: upstream-reference=SystemComponentPrototype.AAACalRegn01Inin01GroupD_Dummy, ecu-extract-reference=COMPOSITIONTYPE.AAACalRegn01Inin01GroupD_Dummy
      AAACalRegn01Inin02_Dummy: upstream-reference=SystemComponentPrototype.AAACalRegn01Inin02_Dummy, ecu-extract-reference=COMPOSITIONTYPE.AAACalRegn01Inin02_Dummy
      AAACalRegn01Inin02GroupA_Dummy: upstream-reference=SystemComponentPrototype.AAACalRegn01Inin02GroupA_Dummy, ecu-extract-reference=COMPOSITIONTYPE.AAACalRegn01Inin02GroupA_Dummy
      AAACalRegn01Inin02GroupC_Dummy: upstream-reference=SystemComponentPrototype.AAACalRegn01Inin02GroupC_Dummy, ecu-extract-reference=COMPOSITIONTYPE.AAACalRegn01Inin02GroupC_Dummy
      AAACalRegn01Inin02GroupD_Dummy: upstream-reference=SystemComponentPrototype.AAACalRegn01Inin02GroupD_Dummy, ecu-extract-reference=COMPOSITIONTYPE.AAACalRegn01Inin02GroupD_Dummy
      AAACalRegn01Inin03_Dummy: upstream-reference=SystemComponentPrototype.AAACalRegn01Inin03_Dummy, ecu-extract-reference=COMPOSITIONTYPE.AAACalRegn01Inin03_Dummy
      AAACalRegn01Inin03GroupA_Dummy: upstream-reference=SystemComponentPrototype.AAACalRegn01Inin03GroupA_Dummy, ecu-extract-reference=COMPOSITIONTYPE.AAACalRegn01Inin03GroupA_Dummy
      AAACalRegn01Inin03GroupC_Dummy: upstream-reference=SystemComponentPrototype.AAACalRegn01Inin03GroupC_Dummy, ecu-extract-reference=COMPOSITIONTYPE.AAACalRegn01Inin03GroupC_Dummy
      AAACalRegn01Inin03GroupD_Dummy: upstream-reference=SystemComponentPrototype.AAACalRegn01Inin03GroupD_Dummy, ecu-extract-reference=COMPOSITIONTYPE.AAACalRegn01Inin03GroupD_Dummy
      AAACalRegn01Inin04_Dummy: upstream-reference=SystemComponentPrototype.AAACalRegn01Inin04_Dummy, ecu-extract-reference=COMPOSITIONTYPE.AAACalRegn01Inin04_Dummy
      AAACalRegn01Inin04GroupA_Dummy: upstream-reference=SystemComponentPrototype.AAACalRegn01Inin04GroupA_Dummy, ecu-extract-reference=COMPOSITIONTYPE.AAACalRegn01Inin04GroupA_Dummy
      AAACalRegn01Inin04GroupC_Dummy: upstream-reference=SystemComponentPrototype.AAACalRegn01Inin04GroupC_Dummy, ecu-extract-reference=COMPOSITIONTYPE.AAACalRegn01Inin04GroupC_Dummy
      AAACalRegn01Inin04GroupD_Dummy: upstream-reference=SystemComponentPrototype.AAACalRegn01Inin04GroupD_Dummy, ecu-extract-reference=COMPOSITIONTYPE.AAACalRegn01Inin04GroupD_Dummy
      AAACalRegn01Inin05_Dummy: upstream-reference=SystemComponentPrototype.AAACalRegn01Inin05_Dummy, ecu-extract-reference=COMPOSITIONTYPE.AAACalRegn01Inin05_Dummy
      AAACalRegn01Inin05GroupA_Dummy: upstream-reference=SystemComponentPrototype.AAACalRegn01Inin05GroupA_Dummy, ecu-extract-reference=COMPOSITIONTYPE.AAACalRegn01Inin05GroupA_Dummy
      AAACalRegn01Inin05GroupC_Dummy: upstream-reference=SystemComponentPrototype.AAACalRegn01Inin05GroupC_Dummy, ecu-extract-reference=COMPOSITIONTYPE.AAACalRegn01Inin05GroupC_Dummy
      AAACalRegn01Inin05GroupD_Dummy: upstream-reference=SystemComponentPrototype.AAACalRegn01Inin05GroupD_Dummy, ecu-extract-reference=COMPOSITIONTYPE.AAACalRegn01Inin05GroupD_Dummy
      AAACalRegn01Inin06_Dummy: upstream-reference=SystemComponentPrototype.AAACalRegn01Inin06_Dummy, ecu-extract-reference=COMPOSITIONTYPE.AAACalRegn01Inin06_Dummy
      AAACalRegn01Inin06GroupA_Dummy: upstream-reference=SystemComponentPrototype.AAACalRegn01Inin06GroupA_Dummy, ecu-extract-reference=COMPOSITIONTYPE.AAACalRegn01Inin06GroupA_Dummy
      AAACalRegn01Inin06GroupC_Dummy: upstream-reference=SystemComponentPrototype.AAACalRegn01Inin06GroupC_Dummy, ecu-extract-reference=COMPOSITIONTYPE.AAACalRegn01Inin06GroupC_Dummy
      AAACalRegn01Inin06GroupD_Dummy: upstream-reference=SystemComponentPrototype.AAACalRegn01Inin06GroupD_Dummy, ecu-extract-reference=COMPOSITIONTYPE.AAACalRegn01Inin06GroupD_Dummy
      AAACalRegn02Rt{00..03}GroupD_Dummy: upstream-reference=SystemComponentPrototype.AAACalRegn02Rt{00..03}GroupD_Dummy, ecu-extract-reference=COMPOSITIONTYPE.AAACalRegn02Rt{00..03}GroupD_Dummy
      BmwSwFctDi: upstream-reference=SystemComponentPrototype.BmwSwFctDi, ecu-extract-reference=COMPOSITIONTYPE.BmwSwFctDi
      CalRegn01Inin00: upstream-reference=SystemComponentPrototype.CalRegn01Inin00, ecu-extract-reference=COMPOSITIONTYPE.CalRegn01Inin00
      CalRegn01Inin00GroupA: upstream-reference=SystemComponentPrototype.CalRegn01Inin00GroupA, ecu-extract-reference=COMPOSITIONTYPE.CalRegn01Inin00GroupA
      CalRegn01Inin00GroupC: upstream-reference=SystemComponentPrototype.CalRegn01Inin00GroupC, ecu-extract-reference=COMPOSITIONTYPE.CalRegn01Inin00GroupC
      CalRegn01Inin00GroupD: upstream-reference=SystemComponentPrototype.CalRegn01Inin00GroupD, ecu-extract-reference=COMPOSITIONTYPE.CalRegn01Inin00GroupD
      CalRegn01Inin01: upstream-reference=SystemComponentPrototype.CalRegn01Inin01, ecu-extract-reference=COMPOSITIONTYPE.CalRegn01Inin01
      CalRegn01Inin01GroupA: upstream-reference=SystemComponentPrototype.CalRegn01Inin01GroupA, ecu-extract-reference=COMPOSITIONTYPE.CalRegn01Inin01GroupA
      CalRegn01Inin01GroupC: upstream-reference=SystemComponentPrototype.CalRegn01Inin01GroupC, ecu-extract-reference=COMPOSITIONTYPE.CalRegn01Inin01GroupC
      CalRegn01Inin01GroupD: upstream-reference=SystemComponentPrototype.CalRegn01Inin01GroupD, ecu-extract-reference=COMPOSITIONTYPE.CalRegn01Inin01GroupD
      CalRegn01Inin02: upstream-reference=SystemComponentPrototype.CalRegn01Inin02, ecu-extract-reference=COMPOSITIONTYPE.CalRegn01Inin02
      CalRegn01Inin02GroupA: upstream-reference=SystemComponentPrototype.CalRegn01Inin02GroupA, ecu-extract-reference=COMPOSITIONTYPE.CalRegn01Inin02GroupA
      CalRegn01Inin02GroupC: upstream-reference=SystemComponentPrototype.CalRegn01Inin02GroupC, ecu-extract-reference=COMPOSITIONTYPE.CalRegn01Inin02GroupC
      CalRegn01Inin02GroupD: upstream-reference=SystemComponentPrototype.CalRegn01Inin02GroupD, ecu-extract-reference=COMPOSITIONTYPE.CalRegn01Inin02GroupD
      CalRegn01Inin03: upstream-reference=SystemComponentPrototype.CalRegn01Inin03, ecu-extract-reference=COMPOSITIONTYPE.CalRegn01Inin03
      CalRegn01Inin03GroupA: upstream-reference=SystemComponentPrototype.CalRegn01Inin03GroupA, ecu-extract-reference=COMPOSITIONTYPE.CalRegn01Inin03GroupA
      CalRegn01Inin03GroupC: upstream-reference=SystemComponentPrototype.CalRegn01Inin03GroupC, ecu-extract-reference=COMPOSITIONTYPE.CalRegn01Inin03GroupC
      CalRegn01Inin03GroupD: upstream-reference=SystemComponentPrototype.CalRegn01Inin03GroupD, ecu-extract-reference=COMPOSITIONTYPE.CalRegn01Inin03GroupD
      CalRegn01Inin04: upstream-reference=SystemComponentPrototype.CalRegn01Inin04, ecu-extract-reference=COMPOSITIONTYPE.CalRegn01Inin04
      CalRegn01Inin04GroupA: upstream-reference=SystemComponentPrototype.CalRegn01Inin04GroupA, ecu-extract-reference=COMPOSITIONTYPE.CalRegn01Inin04GroupA
      CalRegn01Inin04GroupC: upstream-reference=SystemComponentPrototype.CalRegn01Inin04GroupC, ecu-extract-reference=COMPOSITIONTYPE.CalRegn01Inin04GroupC
      CalRegn01Inin04GroupD: upstream-reference=SystemComponentPrototype.CalRegn01Inin04GroupD, ecu-extract-reference=COMPOSITIONTYPE.CalRegn01Inin04GroupD
      CalRegn01Inin05: upstream-reference=SystemComponentPrototype.CalRegn01Inin05, ecu-extract-reference=COMPOSITIONTYPE.CalRegn01Inin05
      CalRegn01Inin05GroupA: upstream-reference=SystemComponentPrototype.CalRegn01Inin05GroupA, ecu-extract-reference=COMPOSITIONTYPE.CalRegn01Inin05GroupA
      CalRegn01Inin05GroupC: upstream-reference=SystemComponentPrototype.CalRegn01Inin05GroupC, ecu-extract-reference=COMPOSITIONTYPE.CalRegn01Inin05GroupC
      CalRegn01Inin05GroupD: upstream-reference=SystemComponentPrototype.CalRegn01Inin05GroupD, ecu-extract-reference=COMPOSITIONTYPE.CalRegn01Inin05GroupD
      CalRegn01Inin06: upstream-reference=SystemComponentPrototype.CalRegn01Inin06, ecu-extract-reference=COMPOSITIONTYPE.CalRegn01Inin06
      CalRegn01Inin06GroupA: upstream-reference=SystemComponentPrototype.CalRegn01Inin06GroupA, ecu-extract-reference=COMPOSITIONTYPE.CalRegn01Inin06GroupA
      CalRegn01Inin06GroupC: upstream-reference=SystemComponentPrototype.CalRegn01Inin06GroupC, ecu-extract-reference=COMPOSITIONTYPE.CalRegn01Inin06GroupC
      CalRegn01Inin06GroupD: upstream-reference=SystemComponentPrototype.CalRegn01Inin06GroupD, ecu-extract-reference=COMPOSITIONTYPE.CalRegn01Inin06GroupD
      CalRegn02Rt{00..03}GroupD: upstream-reference=SystemComponentPrototype.CalRegn02Rt{00..03}GroupD, ecu-extract-reference=COMPOSITIONTYPE.CalRegn02Rt{00..03}GroupD
