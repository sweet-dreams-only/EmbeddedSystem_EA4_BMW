[part 2 of 2]
AUTOSAR XML (schema 4-3-0)
package /BMW/Boardnet/Ecus/EcuInstances
  ecu instance EPS: client-id-range={lower-limit=12288, upper-limit=12543}, diagnostic-address=48, sleep-mode-supported=false, wake-up-over-bus-supported=false  # Electrical Power - Assist - Steering | Achsparalleles EPS (electrical power-assist steering): System steuert unmittelbar Lenkschenkel an | MCV 0.98.217
    flexray communication controller EPS_A_FlexRay:  # component: Electrical Power - Assist - Steering, bus: A-FlexRay / component: , bus: A-FlexRay
      accepted-startup-range=212
      allow-halt-due-to-clock=true
      allow-passive-to-active=0
      cluster-drift-damping=2
      decoding-correction=48
      delay-compensation-a=1
      delay-compensation-b=1
      extern-offset-correction=0
      extern-rate-correction=0
      key-slot-id=0
      key-slot-only-enabled=false
      key-slot-used-for-start-up=false
      key-slot-used-for-sync=false
      latest-tx=269
      listen-timeout=400242
      macro-initial-offset-a=3
      macro-initial-offset-b=3
      maximum-dynamic-payload-length=60
      micro-initial-offset-a=6
      micro-initial-offset-b=6
      micro-per-cycle=200000
      microtick-duration=2.5E-8
      offset-correction-out=126
      rate-correction-out=121
      samples-per-microtick=2
      wake-up-pattern=33
    flexray communication connector con_EPS_FibexID_0b7e5e09c061465d913e8968ece3cded: comm-controller=EPS_A_FlexRay, wake-up-channel=true
package /BMW/Boardnet/Pdus/ISignalGroups
  18 x i signal group:
    sigGroup_ACLNY_MASSCNTR: i-signal=[ACLNY_COG, ACLNY_COG_ERR_AMP, ACLNY_MASSCNTR_dummy_12_15, ALIV_ACLNY_COG, CRC_ACLNY_COG, QU_ACLNY_COG], system-signal-group=sigGroup_ACLNY_MASSCNTR
    sigGroup_AVL_FORC_GRD: i-signal=[ALIV_AVL_FORC_GRD, AVL_FORC_GRD, AVL_FORC_GRD_dummy_12_15, AVL_PWR_EL_EPS_COOD, CRC_AVL_FORC_GRD, QU_AVL_FORC_GRD], system-signal-group=sigGroup_AVL_FORC_GRD
    sigGroup_AVL_PO_EPS: i-signal=[ALIV_AVL_PO_EPS, AVL_PO_EPS, AVL_PO_IDX_EPS, CRC_AVL_PO_EPS, IDX_TORQ_SEN, OFFS_GRD_MID_EPS, QU_AVL_PO_EPS, UN_PO_EPS], system-signal-group=sigGroup_AVL_PO_EPS
    sigGroup_AVL_RPM_WHL: i-signal=[ALIV_AVL_RPM_WHL, AVL_RPM_WHL_FLH, AVL_RPM_WHL_FRH, AVL_RPM_WHL_RLH, AVL_RPM_WHL_RRH, AVL_RPM_WHL_dummy_12_15, CRC_AVL_RPM_WHL, QU_AVL_RPM_WHL_FLH, QU_AVL_RPM_WHL_FRH, QU_AVL_RPM_WHL_RLH, QU_AVL_RPM_WHL_RRH], system-signal-group=sigGroup_AVL_RPM_WHL
    sigGroup_AVL_STMOM_DV_ACT: i-signal=[ALIV_AVL_STMOM_DV_ACT, AVL_STMOM_DV_ACT, AVL_STMOM_DV_ACT_dummy_12_15, CRC_AVL_STMOM_DV_ACT, QU_AVL_STMOM_DV_ACT], system-signal-group=sigGroup_AVL_STMOM_DV_ACT
    sigGroup_CON_VEH: i-signal=[ALIV_CON_VEH, CON_VEH_dummy_56_63, CRC_CON_VEH, CTR_BS_PRTNT, CTR_FKTN_PRTNT, QU_ST_CON_VEH, ST_CON_VEH], system-signal-group=sigGroup_CON_VEH
    sigGroup_DISP_CC_EPS: i-signal=[ALIV_DISP_CC_EPS, CHL_DISP_CC_EPS, CRC_DISP_CC_EPS, NO_CC_EPS, ST_CC_EPS, ST_IDC_CC_EPS, TRANF_CC_EPS], system-signal-group=sigGroup_DISP_CC_EPS
    sigGroup_DT_EST: i-signal=[ALIV_DT_EST, AVL_I_ACT_EST, CRC_DT_EST, DT_EST_dummy_12_15, DT_EST_dummy_16_47, DT_EST_dummy_64_95, DT_EST_dummy_96_127, QU_AVL_I_ACT_EST, ST_CULI_EST], system-signal-group=sigGroup_DT_EST
    sigGroup_ENERG_DGR_DRDY: i-signal=[ALIV_ENERG_DGR_DRDY, CRC_ENERG_DGR_DRDY, ENERG_AVAI_ARS, ENERG_DGR_DRDY_dummy_12_15, MAX_I_LD_SPEC_ARS, MAX_I_RECUP_SPEC_ARS, MAX_I_SPEC_BAX_STE, MAX_I_SPEC_EPS, QU_DGR_AISP_ENERG, RQ_CULI_EST_SFY], system-signal-group=sigGroup_ENERG_DGR_DRDY
    sigGroup_ENSU_SFY: i-signal=[ALIV_ENSU_SFY, CHL_ENSU_SFY, CRC_ENSU_SFY, ENSU_SFY_dummy_28_31, ENSU_SFY_dummy_32_63, QU_FN_ENSU_SFY, RQ_CULI], system-signal-group=sigGroup_ENSU_SFY
    sigGroup_OFFS_QUAD_EPS: i-signal=[ALIV_OFFS_QUAD_EPS, AVL_PO_IDX_ICM, CRC_OFFS_QUAD_EPS, OFFS_QUAD_RTR_EPS, ST_OFFS_QUAD_EPS], system-signal-group=sigGroup_OFFS_QUAD_EPS
    sigGroup_ST_EST: i-signal=[ALIV_ST_EST_FTAX, CRC_ST_EST_FTAX, QU_FN_EST, QU_FN_VIB_EPS, QU_SER_STMOM_DV_ACT, ST_EST_dummy_16_23], system-signal-group=sigGroup_ST_EST
    sigGroup_SU_EPS: i-signal=[ALIV_SU_EPS, CRC_SU_EPS, SU_EPS_dummy_14_19, SU_EPS_dummy_20_51, TOT_STR_EPS, UN_TOT_STR_EPS], system-signal-group=sigGroup_SU_EPS
    sigGroup_TAR_ESTP_VIRT_FTAX: i-signal=[ACTVN_FN_ESTP_VIRT_FTAX, ALIV_TAR_ESTP_VIRT_FTAX, CRC_TAR_ESTP_VIRT_FTAX, TAR_ESTP_VIRT_FTAX_dummy_12_31, TAR_ESTP_VIRT_FTAX_dummy_36_63], system-signal-group=sigGroup_TAR_ESTP_VIRT_FTAX
    sigGroup_TAR_QTA_STRMOM_DV: i-signal=[ALIV_TAR_QTA_STMOM_DV, CRC_TAR_QTA_STMOM_DV, CTR_DEAC_EPS_FNS, FACT_ASS_STMOM_FTAX, FACT_CTRR_STMOM_FTAX, FACT_DMPNG_STMOM_FTAX, QU_TAR_FACT_STMOM_FTAX, QU_TAR_QTA_STMOM_DV, TAR_QTA_STMOM_DV, TAR_QTA_STRMOM_DV_dummy_12_15], system-signal-group=sigGroup_TAR_QTA_STRMOM_DV
    sigGroup_TAR_STMOM_DV_ACT: i-signal=[ALIV_TAR_STMOM_DV_ACT, CRC_TAR_STMOM_DV_ACT, FACT_DMPNG_ADDON_STMOM_FTAX, QU_TAR_DMPNG_ADDON_STMOM_FTAX, QU_TAR_STMOM_DV_ACT, TAR_STMOM_DV_ACT, TAR_STMOM_DV_ACT_dummy_12_15, TAR_STMOM_DV_ACT_dummy_32_51], system-signal-group=sigGroup_TAR_STMOM_DV_ACT
    sigGroup_VYAW_VEH: i-signal=[ALIV_VYAW_VEH, CRC_VYAW_VEH, QU_VYAW_VEH, VYAW_VEH, VYAW_VEH_ERR_AMP, VYAW_VEH_dummy_12_15], system-signal-group=sigGroup_VYAW_VEH
    sigGroup_V_VEH: i-signal=[ALIV_V_VEH, CRC_V_VEH, DVCO_VEH, QU_V_VEH_COG, ST_V_VEH_NSS, V_VEH_COG, V_VEH_dummy_39_39], system-signal-group=sigGroup_V_VEH
package /BMW/Boardnet/Pdus/PDUs
  pdu ANFRAGE: length=8, minimum-delay=0.5, transmission-mode-true-timing=event-controlled-timing=number-of-repetitions=0, unused-bit-pattern=255  # Anfrage / Inquiry | Diese PDU löst die bis einschließlich SP2015 gültige Version der gleichnamigen PDU ab. Ab SP2018 darf nur noch diese Version der PDU verwendet werden. Mit dem Anfrage-Dienst kann eine Nachricht, die als anfragbar definiert ist, angefragt werden.
    signal ANFRAGE_ID2: start 0, 8 bit, little-endian, init-value=SWITCH_CODE:1, base-type=uint8, transfer-property=PENDING, to EPS
    signal ID_FN_INQY: start 8, 16 bit, little-endian, base-type=uint16, invalid-value=value_65535Dot0:65535, compu-method=ID_FN_INQY, to EPS  # ID_Funktion_Anfrage / ID_function_inquiry | LogicalInterface:BMW.INFRASTRUCTURE.COMMUNICATION.InquiryService[external]@Infrastruktur; Dieses Signal löst die bis einschließlich SP2015 gültige Version des gleichnamigen Signales ab. Ab SP2018 darf nur noch diese Version des Signals verwendet werden. Damit wird die in der alten Signalversion existierende Ausnahme bezüglich der Byteorder aufgelöst. Die Darstellung der Signal-Inhalte auf dem Bus wird dadurch jedoch nicht verändert – um dies zu erreichen wurden High-Byte und Low-Byte der Kodierungen vertauscht. Achtung: Sollte es sich sender- oder empfängerseitig um ein reines SP2015-Gleichteil handeln, das demnach die Versendung oder den Empfang des Signals ID_Funktion_Anfrage unverändert zu SP2015 umsetzt, so ist die hier spezifizierte Version des Signals ungültig! Für diese Gleichteile ist die für SP2015 spezifizierte Version dieses Signals gültig. Dieses Signal enthält in der Regel den 11-Bit CAN-Identifier der angefragten Nachricht. Es kann allerdings Abweichungen von dieser Regel geben, z.B. - im Fall von Zuordnungen mehrerer anfragbarer Frames zu einer CAN-ID - im Fall busspezifischer unterschiedlicher CAN-IDs des angefragten Frames - im Fall von Anfragen auf Nicht-CAN Bussen (z.B. FlexRay) - im Fall von 29-Bit CAN-IDs der angefragten Frames Es sind nur die Codierungen erlaubt, zu denen anfragbare PDUs definiert sind. / This signal contains the identifier of the message inquired. Only the identifiers are allowed which are defined as addressable messages. N.B. As regards byte orderings, this signal constitutes an exception because the inquired identifier must be transmitted in Engineola format. In the definite case this means that Byte 1 contains the high byte and Byte 2 the low byte of the desired identifiers [Byte 1, Bit 0: 2^8, Byte 1, Bit 7: 2^15 (= MSEC.B) and Byte 2, Bit 0: 2^0 (= LSB), Byte 2, Bit 7: 2^7]
  pdu DBG_EPS_BS_MOD_58_BYTE: length=58, transmission-mode-true-timing=cyclic-timing=time-period={tolerance=absolute-tolerance=0.004, value=0.02}, unused-bit-pattern=255  # Debug EPS Modus Basis 58 Byte | Diese PDU enthält die 57-Byte langen Debug Information. Die Signale in dieser PDU können durch den Fachbereich eigenständig angepasst werden.
    signal DBG_EPS_BS_MOD_58_BYTE_ID2: start 0, 8 bit, little-endian, init-value=SWITCH_CODE:1, base-type=uint8, transfer-property=PENDING
    signal SYS_ST_EPS: start 8, 4 bit, little-endian, base-type=uint8, compu-method=DBG_8Bit, data-constr=DBG_8Bit  # LogicalInterface:BMW.INFRASTRUCTURE.DIAGNOSIS.Debug[internal]@Infrastruktur; Dummy-Signal. Kann beliebig geändert werden.
    signal ST_CON_VEH_EPS: start 12, 4 bit, little-endian, base-type=uint8, compu-method=DBG_8Bit, data-constr=DBG_8Bit  # LogicalInterface:BMW.INFRASTRUCTURE.DIAGNOSIS.Debug[internal]@Infrastruktur; Dummy-Signal. Kann beliebig geändert werden.
    signal VEH_SPD_EPS: start 16, 16 bit, little-endian, base-type=uint16, compu-method=DBG_16Bit, data-constr=DBG_16Bit  # LogicalInterface:BMW.INFRASTRUCTURE.DIAGNOSIS.Debug[internal]@Infrastruktur; Dummy-Signal. Kann beliebig geändert werden.
    signal BATT_VLTG_EPS: start 32, 16 bit, little-endian, base-type=uint16, compu-method=DBG_16Bit, data-constr=DBG_16Bit  # LogicalInterface:BMW.INFRASTRUCTURE.DIAGNOSIS.Debug[internal]@Infrastruktur; Dummy-Signal. Kann beliebig geändert werden.
    signal ESTIMD_PEAK_MOT_CURR_EPS: start 48, 24 bit, little-endian, base-type=uint32, compu-method=DBG_32Bit, data-constr=DBG_32Bit  # LogicalInterface:BMW.INFRASTRUCTURE.DIAGNOSIS.Debug[internal]@Infrastruktur; Dummy-Signal. Kann beliebig geändert werden.
    signal MOT_VEL_EPS: start 72, 16 bit, little-endian, base-type=uint16, compu-method=DBG_16Bit, data-constr=DBG_16Bit  # LogicalInterface:BMW.INFRASTRUCTURE.DIAGNOSIS.Debug[internal]@Infrastruktur; Dummy-Signal. Kann beliebig geändert werden.
    signal MOT_TQ_CMD_LIMD_EPS: start 88, 16 bit, little-endian, base-type=uint16, compu-method=DBG_16Bit, data-constr=DBG_16Bit  # LogicalInterface:BMW.INFRASTRUCTURE.DIAGNOSIS.Debug[internal]@Infrastruktur; Dummy-Signal. Kann beliebig geändert werden.
    signal PRIM_HW_TQ_SNSR_VLTG_EPS: start 104, 8 bit, little-endian, base-type=uint8, compu-method=DBG_8Bit, data-constr=DBG_8Bit  # LogicalInterface:BMW.INFRASTRUCTURE.DIAGNOSIS.Debug[internal]@Infrastruktur; Dummy-Signal. Kann beliebig geändert werden.
    signal SECDRY_HW_TQ_SNSR_VLTG_EPS: start 112, 8 bit, little-endian, base-type=uint8, compu-method=DBG_8Bit, data-constr=DBG_8Bit  # LogicalInterface:BMW.INFRASTRUCTURE.DIAGNOSIS.Debug[internal]@Infrastruktur; Dummy-Signal. Kann beliebig geändert werden.
    signal ECU_TEMP_EPS: start 120, 8 bit, little-endian, base-type=uint8, compu-method=DBG_8Bit, data-constr=DBG_8Bit  # LogicalInterface:BMW.INFRASTRUCTURE.DIAGNOSIS.Debug[internal]@Infrastruktur; Dummy-Signal. Kann beliebig geändert werden.
    signal MOT_FET_TEMP_EPS: start 128, 8 bit, little-endian, base-type=uint8, compu-method=DBG_8Bit, data-constr=DBG_8Bit  # LogicalInterface:BMW.INFRASTRUCTURE.DIAGNOSIS.Debug[internal]@Infrastruktur; Dummy-Signal. Kann beliebig geändert werden.
    signal MOT_MAG_TEMP_EPS: start 136, 8 bit, little-endian, base-type=uint8, compu-method=DBG_8Bit, data-constr=DBG_8Bit  # LogicalInterface:BMW.INFRASTRUCTURE.DIAGNOSIS.Debug[internal]@Infrastruktur; Dummy-Signal. Kann beliebig geändert werden.
    signal MOT_WIDG_TEMP_EPS: start 144, 16 bit, little-endian, base-type=uint16, compu-method=DBG_16Bit, data-constr=DBG_16Bit  # LogicalInterface:BMW.INFRASTRUCTURE.DIAGNOSIS.Debug[internal]@Infrastruktur; Dummy-Signal. Kann beliebig geändert werden.
    signal MOT_TQ_CMD_EPS: start 160, 16 bit, little-endian, base-type=uint16, compu-method=DBG_16Bit, data-constr=DBG_16Bit  # LogicalInterface:BMW.INFRASTRUCTURE.DIAGNOSIS.Debug[internal]@Infrastruktur; Dummy-Signal. Kann beliebig geändert werden.
  pdu DBG_EPS_MOD_EXT_120_BYTE: length=58, transmission-mode-true-timing=cyclic-timing=time-period={tolerance=absolute-tolerance=0.001, value=0.005}, unused-bit-pattern=255  # Debug EPS Modus Erweitert 120 Byte | Diese PDU enthält die 119-Byte langen Debug Information. Bei Verwendung dieses Modes muss die Frame Länge vom Fachbereich auf 120-Bytes angepasst werden. Die Signale in dieser PDU können durch den Fachbereich eigenständig angepasst werden.
    signal DBG_EPS_MOD_EXT_120_BYTE: start 8, 8 bit, little-endian, base-type=uint8, compu-method=DBG_8Bit, data-constr=DBG_8Bit  # Debug_EPS_Modus_Erweitert_120_Byte / debug_EPS_mode_extended_120_byte | LogicalInterface:BMW.INFRASTRUCTURE.DIAGNOSIS.Debug[internal]@Infrastruktur; Dummy-Signal. Kann beliebig geändert werden.
    signal DBG_EPS_MOD_EXT_120_BYTE_ID2: start 0, 8 bit, little-endian, init-value=SWITCH_CODE:2, base-type=uint8, transfer-property=PENDING
  pdu RQ_STG_EFAN:  # Anforderung Wärmemanagement / Request Stage Electric-Fan
    length=8
    transmission-mode-true-timing=cyclic-timing={time-period={tolerance=absolute-tolerance=0.2, value=1}, "Um sicherzustellen, dass das Ende der zyklischen Versendung erkannt wird, muss die Versendung der Stoppnachricht (Signal Anforderung_Steuerung_Elektrolüfter = 0) insgesamt 3-mal mit einem Wiederholzyklus von t=160 ms erfolgen (Details in der Spezifikation: Erweiterung der ereignisgesteuerten Auslösebedingungen). Zusätzlich erfolgt eine zyklische Versendung der Nachricht, wenn die Signale Temperatur_Komponente_Wärmemanagement und ID_Temperatur_Komponente_Wärmemanagement befüllt sind."}
    unused-bit-pattern=255
    signal ID_FN_RQ_STG_EFAN: start 8, 8 bit, little-endian, base-type=uint8, invalid-value=value_255Dot0:255, compu-method=ID_FN_RQ_STG_EFAN  # ID_Funktion_Anforderung_Stufe_Elektrolüfter / ID_function_request_stage_electric-fan | LogicalInterface:BMW.POWERTRAIN.ENGINE.COMBUSTION.HeatManagement[internal]@Fahren; Dieses Signal gibt den Anforderer der gewünschten Elektrolüfterstufe an.
    signal ID_TEMP_CPO_HET_MNG: start 20, 4 bit, little-endian, base-type=uint8, invalid-value=value_15Dot0:15, compu-method=ID_TEMP_CPO_HET_MNG  # ID_Temperatur_Komponente_Wärme_Management / ID_temperature_component_heat_management | LogicalInterface:BMW.POWERTRAIN.ENGINE.COMBUSTION.HeatManagement[internal]@Fahren; Dieses Signal gibt die Komponente für das Temperatursignal für das Motorwärmemanagement an. Dieses Signal wird in 444, F15-F16, F25 und F25_ab_PU12-07 nicht ausgewertet.
    signal RQ_STG_EFAN: start 16, 4 bit, little-endian, base-type=uint8, invalid-value=value_15Dot0:15, compu-method=RQ_STG_EFAN  # Anforderung_Stufe_Elektrolüfter / request_stage_electric-fan | LogicalInterface:BMW.POWERTRAIN.ENGINE.COMBUSTION.HeatManagement[internal]@Fahren; Die Stufen werden als Luftmassenstrom interpretiert. Die Stufe 14 entspricht der maximalen Luftmassenstromanforderung.
    signal RQ_STG_EFAN_ID2: start 0, 8 bit, little-endian, init-value=SWITCH_CODE:21, base-type=uint8, transfer-property=PENDING
    signal TEMP_CPO_HET_MNG: start 24, 8 bit, little-endian, base-type=uint8, invalid-value=value_255Dot0:255, compu-method=TEMP_CPO_HET_MNG, data-constr=TEMP_CPO_HET_MNG  # Temperatur_Komponente_Wärme_Management / temperature_component_heat_management | LogicalInterface:BMW.POWERTRAIN.ENGINE.COMBUSTION.HeatManagement[internal]@Fahren; Komponententemperatur für das Motorwärmemanagement Dieses Signal wird in 444, F15-F16, F25 und F25_ab_PU12-07 nicht ausgewertet.
  pdu SECU_CHAL: length=8, minimum-delay=0.05, transmission-mode-true-timing=event-controlled-timing=number-of-repetitions=0, unused-bit-pattern=255  # Sicher Challenge | $(AUTOSAR; SIGNALGROUP)
    signal SECU_CHAL: start 24, 40 bit, little-endian, base-type=uint64, invalid-value=value_1Dot099511627775E12:1099511627775, compu-method=SECU_CHAL, data-constr=SECU_CHAL  # Sicher_Challenge / secure_challenge | LogicalInterface:BMW.INFRASTRUCTURE.COMMUNICATION.SecureChallengeResponse[internal]@Infrastruktur;
    signal SECU_CHAL_ID2: start 0, 8 bit, little-endian, init-value=SWITCH_CODE:248, base-type=uint8, transfer-property=PENDING
    signal SSS_IDENT_CHAL: start 16, 8 bit, little-endian, base-type=uint8, invalid-value=value_255Dot0:255, compu-method=SSS_IDENT  # SSS_Identifikation_Challenge / SSS_identification_challenge | LogicalInterface:BMW.INFRASTRUCTURE.COMMUNICATION.SecureChallengeResponse[internal]@Infrastruktur;
    signal SSV_IDENT_CHAL: start 8, 8 bit, little-endian, base-type=uint8, invalid-value=value_255Dot0:255, compu-method=SSV_IDENT  # SSV_Identifikation_Challenge / SSV_identification_challenge | LogicalInterface:BMW.INFRASTRUCTURE.COMMUNICATION.SecureChallengeResponse[internal]@Infrastruktur;
  pdu SECU_RESP: length=8, minimum-delay=0.05, transmission-mode-true-timing=event-controlled-timing=number-of-repetitions=0, unused-bit-pattern=255  # Sicher Response | $(AUTOSAR; SIGNALGROUP)
    signal COU_BS_RESP: start 16, 24 bit, little-endian, base-type=uint32, invalid-value=value_1Dot6777215E7:16777215, compu-method=COU_BS_RESP, data-constr=COU_BS_RESP, to EPS  # Zähler_Basis_Response / counter_base_response | LogicalInterface:BMW.INFRASTRUCTURE.COMMUNICATION.SecureChallengeResponse[internal]@Infrastruktur;
    signal SECU_RESP_ID2: start 0, 8 bit, little-endian, init-value=SWITCH_CODE:247, base-type=uint8, transfer-property=PENDING, to EPS
    signal SSV_IDENT_RESP: start 8, 8 bit, little-endian, base-type=uint8, invalid-value=value_255Dot0:255, compu-method=SSV_IDENT, to EPS  # SSV_Identifikation_Response / SSV_identification_response | LogicalInterface:BMW.INFRASTRUCTURE.COMMUNICATION.SecureChallengeResponse[internal]@Infrastruktur;
    signal STU_RESP: start 40, 24 bit, little-endian, base-type=uint32, invalid-value=value_1Dot6777215E7:16777215, compu-method=STU_RESP, data-constr=STU_RESP, to EPS  # Signatur_Response / signature_response | LogicalInterface:BMW.INFRASTRUCTURE.COMMUNICATION.SecureChallengeResponse[internal]@Infrastruktur;
package /BMW/Diagnostics/ComponentsWithoutQualifiedName/DiagnosticAccessPermissions
  diagnostic access permission RDBI_Readhwmodificationindex_AccessPermission: diagnostic-session=[DEFAULT_SESSION, EXTENDED_DIAGNOSTIC_SESSION, PROGRAMMING_SESSION]
package /BMW/Diagnostics/ComponentsWithoutQualifiedName/DiagnosticDataIdentifiers
  diagnostic data identifier Did_Readhwmodificationindex: id=61778
    diagnostic-parameter bit-offset=0:
      diagnostic data element Readhwmodificationindex: array-size-semantics=VARIABLE-SIZE, max-number-of-elements=2, base-type=UINT8
package /BMW/Diagnostics/ComponentsWithoutQualifiedName/DiagnosticServiceInstances
  diagnostic read data by identifier RDBI_Readhwmodificationindex: access-permission=RDBI_Readhwmodificationindex_AccessPermission, data-identifier=Did_Readhwmodificationindex, read-class=ReadDataByIdentifier
package /BMW/Diagnostics/Ecus/DiagnosticAccessPermissions
  37 x diagnostic access permission:
    ClearDiagnosticInformation_AccessPermission: diagnostic-session=[DEFAULT_SESSION, EXTENDED_DIAGNOSTIC_SESSION, GarageMode]
    CommunicationControl_0x{00..03}_AccessPermission: diagnostic-session=EXTENDED_DIAGNOSTIC_SESSION
    CommunicationControl_AccessPermission: diagnostic-session=EXTENDED_DIAGNOSTIC_SESSION
    ControlDtcSetting_0x01_AccessPermission: diagnostic-session=EXTENDED_DIAGNOSTIC_SESSION
    ControlDtcSetting_0x02_AccessPermission: diagnostic-session=EXTENDED_DIAGNOSTIC_SESSION
    ControlDtcSetting_AccessPermission: diagnostic-session=EXTENDED_DIAGNOSTIC_SESSION
    DiagnosticSessionControl_0x01_AccessPermission: diagnostic-session=[DEFAULT_SESSION, DEVELOPMENT_SESSION, EXTENDED_DIAGNOSTIC_SESSION]
    DiagnosticSessionControl_0x02_AccessPermission: diagnostic-session=[EXTENDED_DIAGNOSTIC_SESSION, PROGRAMMING_SESSION]
    DiagnosticSessionControl_0x03_AccessPermission: diagnostic-session=[DEFAULT_SESSION, EXTENDED_DIAGNOSTIC_SESSION, GarageMode]
    DiagnosticSessionControl_0x41_AccessPermission: diagnostic-session=[CODING_SESSION, EXTENDED_DIAGNOSTIC_SESSION]
    DiagnosticSessionControl_0x44_AccessPermission: diagnostic-session=[EXTENDED_DIAGNOSTIC_SESSION, RSU_SESSION]
    DiagnosticSessionControl_0x5F_AccessPermission: diagnostic-session=GarageMode
    DiagnosticSessionControl_AccessPermission: diagnostic-session=[CODING_SESSION, DEFAULT_SESSION, DEVELOPMENT_SESSION, EXTENDED_DIAGNOSTIC_SESSION, GarageMode, PROGRAMMING_SESSION, RSU_SESSION]
    EcuReset_0x01_AccessPermission: diagnostic-session=[DEFAULT_SESSION, EXTENDED_DIAGNOSTIC_SESSION]
    EcuReset_AccessPermission: diagnostic-session=[DEFAULT_SESSION, EXTENDED_DIAGNOSTIC_SESSION]
    ReadDataByIdentifier_AccessPermission: diagnostic-session=[CODING_SESSION, DEFAULT_SESSION, EXTENDED_DIAGNOSTIC_SESSION, GarageMode, PROGRAMMING_SESSION]
    ReadDtcInformation_0x02_AccessPermission: diagnostic-session=[DEFAULT_SESSION, EXTENDED_DIAGNOSTIC_SESSION]
    ReadDtcInformation_0x04_AccessPermission: diagnostic-session=[DEFAULT_SESSION, EXTENDED_DIAGNOSTIC_SESSION]
    ReadDtcInformation_0x06_AccessPermission: diagnostic-session=[DEFAULT_SESSION, EXTENDED_DIAGNOSTIC_SESSION]
    ReadDtcInformation_0x0A_AccessPermission: diagnostic-session=[CODING_SESSION, DEFAULT_SESSION, EXTENDED_DIAGNOSTIC_SESSION]
    ReadDtcInformation_0x{17..19}_AccessPermission: diagnostic-session=[DEFAULT_SESSION, EXTENDED_DIAGNOSTIC_SESSION]
    ReadDtcInformation_AccessPermission: diagnostic-session=[CODING_SESSION, DEFAULT_SESSION, EXTENDED_DIAGNOSTIC_SESSION]
    RequestDownload_AccessPermission: diagnostic-session=PROGRAMMING_SESSION
    RequestTransferExit_AccessPermission: diagnostic-session=PROGRAMMING_SESSION
    ResponseOnEvent_0x04_AccessPermission: diagnostic-session=[DEFAULT_SESSION, EXTENDED_DIAGNOSTIC_SESSION]
    ResponseOnEvent_0x40_AccessPermission: diagnostic-session=[DEFAULT_SESSION, EXTENDED_DIAGNOSTIC_SESSION]
    ResponseOnEvent_0x45_AccessPermission: diagnostic-session=[DEFAULT_SESSION, EXTENDED_DIAGNOSTIC_SESSION]
    ResponseOnEvent_AccessPermission: diagnostic-session=[DEFAULT_SESSION, EXTENDED_DIAGNOSTIC_SESSION]
    RoutineControl_AccessPermission: diagnostic-session=[CODING_SESSION, DEFAULT_SESSION, EXTENDED_DIAGNOSTIC_SESSION, GarageMode, PROGRAMMING_SESSION, SYSTEM_SUPPLIER_SPECIFIC_61]
    SecurityAccess_AccessPermission: diagnostic-session=PROGRAMMING_SESSION
    TransferData_AccessPermission: diagnostic-session=PROGRAMMING_SESSION
    WriteDataByIdentifier_AccessPermission: diagnostic-session=[DEFAULT_SESSION, EXTENDED_DIAGNOSTIC_SESSION, GarageMode, PROGRAMMING_SESSION]
package /BMW/Diagnostics/Ecus/DiagnosticEcuInstancePropss
  diagnostic ecu instance props EPS: ecu-instance=EPS, obd-support=SECONDARY-ECU
package /BMW/Diagnostics/Ecus/DiagnosticExtendedDataRecords
  diagnostic extended data record ConditionByte: record-number=1, update=true
    diagnostic-parameter bit-offset=0:
      diagnostic data element ConditionByte: base-type=uint8
  diagnostic extended data record HealingCounter: record-number=3, update=true
    diagnostic-parameter bit-offset=0:
      diagnostic data element HealingCounter: base-type=uint8
  diagnostic extended data record OccurrenceCounter: record-number=2, update=true
    diagnostic-parameter bit-offset=0:
      diagnostic data element OccurrenceCounter: base-type=uint8
package /BMW/Diagnostics/Ecus/DiagnosticMemoryDestinations
  diagnostic memory destination primary PrimaryMemoryDestination_EPS_DiagnosticsInterface
package /BMW/Diagnostics/Ecus/DiagnosticProtocols
  14 x diagnostic connection:
    DiagnosticConnection_0xF{0..9}
    DiagnosticConnection_0xFA
    DiagnosticConnection_0xFB
    DiagnosticConnection_0xFC
    DiagnosticConnection_0xFD
package /BMW/Diagnostics/Ecus/DiagnosticServiceClasses
  diagnostic clear diagnostic information class ClearDiagnosticInformation: access-permission=ClearDiagnosticInformation_AccessPermission, access-permission-validity=ACCESS-PERMISSION-INSTANCE-OVERRIDES-CLASS
  diagnostic com control class CommunicationControl: access-permission=CommunicationControl_AccessPermission, access-permission-validity=ACCESS-PERMISSION-INSTANCE-OVERRIDES-CLASS
  diagnostic control dtc setting class ControlDtcSetting: access-permission=ControlDtcSetting_AccessPermission, access-permission-validity=ACCESS-PERMISSION-INSTANCE-OVERRIDES-CLASS
  diagnostic session control class DiagnosticSessionControl: access-permission=DiagnosticSessionControl_AccessPermission, access-permission-validity=ACCESS-PERMISSION-INSTANCE-OVERRIDES-CLASS
  diagnostic ecu reset class EcuReset: access-permission=EcuReset_AccessPermission, access-permission-validity=ACCESS-PERMISSION-INSTANCE-OVERRIDES-CLASS
  diagnostic read data by identifier class ReadDataByIdentifier: access-permission=ReadDataByIdentifier_AccessPermission, access-permission-validity=ACCESS-PERMISSION-INSTANCE-OVERRIDES-CLASS, max-did-to-read=1
  diagnostic read dtc information class ReadDtcInformation: access-permission=ReadDtcInformation_AccessPermission, access-permission-validity=ACCESS-PERMISSION-INSTANCE-OVERRIDES-CLASS
  diagnostic request download class RequestDownload: access-permission=RequestDownload_AccessPermission, access-permission-validity=ACCESS-PERMISSION-INSTANCE-OVERRIDES-CLASS
  diagnostic transfer exit class RequestTransferExit: access-permission=RequestTransferExit_AccessPermission, access-permission-validity=ACCESS-PERMISSION-INSTANCE-OVERRIDES-CLASS
  diagnostic response on event class ResponseOnEvent: access-permission=ResponseOnEvent_AccessPermission, access-permission-validity=ACCESS-PERMISSION-INSTANCE-OVERRIDES-CLASS
  diagnostic routine control class RoutineControl: access-permission=RoutineControl_AccessPermission, access-permission-validity=ACCESS-PERMISSION-INSTANCE-OVERRIDES-CLASS
  diagnostic security access class SecurityAccess: access-permission=SecurityAccess_AccessPermission, access-permission-validity=ACCESS-PERMISSION-INSTANCE-OVERRIDES-CLASS
  diagnostic data transfer class TransferData: access-permission=TransferData_AccessPermission, access-permission-validity=ACCESS-PERMISSION-INSTANCE-OVERRIDES-CLASS
  diagnostic write data by identifier class WriteDataByIdentifier: access-permission=WriteDataByIdentifier_AccessPermission, access-permission-validity=ACCESS-PERMISSION-INSTANCE-OVERRIDES-CLASS
package /BMW/Diagnostics/Ecus/DiagnosticServiceInstances
  diagnostic clear diagnostic information ClearDiagnosticInformation: access-permission=ClearDiagnosticInformation_AccessPermission, clear-diagnostic-information-class=ClearDiagnosticInformation
  4 x diagnostic com control, all with com-control-class=CommunicationControl:
    CommunicationControl_0x00: category=ENABLE_RX_AND_TX, access-permission=CommunicationControl_0x00_AccessPermission
    CommunicationControl_0x01: category=DISABLE_RX_AND_TX, access-permission=CommunicationControl_0x01_AccessPermission
    CommunicationControl_0x02: category=ENABLE_RX_AND_DISABLE_TX, access-permission=CommunicationControl_0x02_AccessPermission
    CommunicationControl_0x03: category=DISABLE_RX_AND_ENABLE_TX, access-permission=CommunicationControl_0x03_AccessPermission
  diagnostic control dtc setting ControlDtcSetting_0x01: category=BMW_ON, access-permission=ControlDtcSetting_0x01_AccessPermission, dtc-setting-class=ControlDtcSetting, dtc-setting-parameter=1
  diagnostic control dtc setting ControlDtcSetting_0x02: category=BMW_OFF, access-permission=ControlDtcSetting_0x02_AccessPermission, dtc-setting-class=ControlDtcSetting, dtc-setting-parameter=2
  6 x diagnostic session control, all with session-control-class=DiagnosticSessionControl:
    DiagnosticSessionControl_0x01: access-permission=DiagnosticSessionControl_0x01_AccessPermission, diagnostic-session=DEFAULT_SESSION
    DiagnosticSessionControl_0x02: access-permission=DiagnosticSessionControl_0x02_AccessPermission, diagnostic-session=PROGRAMMING_SESSION
    DiagnosticSessionControl_0x03: access-permission=DiagnosticSessionControl_0x03_AccessPermission, diagnostic-session=EXTENDED_DIAGNOSTIC_SESSION
    DiagnosticSessionControl_0x41: access-permission=DiagnosticSessionControl_0x41_AccessPermission, diagnostic-session=CODING_SESSION
    DiagnosticSessionControl_0x44: access-permission=DiagnosticSessionControl_0x44_AccessPermission, diagnostic-session=RSU_SESSION
    DiagnosticSessionControl_0x5F: access-permission=DiagnosticSessionControl_0x5F_AccessPermission, diagnostic-session=GarageMode
  diagnostic ecu reset EcuReset_0x01: category=HARD_RESET, access-permission=EcuReset_0x01_AccessPermission, ecu-reset-class=EcuReset, respond-to-reset=RESPOND-BEFORE-RESET
  7 x diagnostic read dtc information, all with read-dtc-information-class=ReadDtcInformation:
    ReadDtcInformation_0x02: category=REPORT_DTC_BY_STATUS_MASK, access-permission=ReadDtcInformation_0x02_AccessPermission
    ReadDtcInformation_0x04: category=REPORT_DTC_SNAPSHOT_RECORD_BY_DTC_NUMBER, access-permission=ReadDtcInformation_0x04_AccessPermission
    ReadDtcInformation_0x06: category=REPORT_DTC_EXT_DATA_RECORD_BY_DTC_NUMBER, access-permission=ReadDtcInformation_0x06_AccessPermission
    ReadDtcInformation_0x0A: category=REPORT_SUPPORTED_DTC, access-permission=ReadDtcInformation_0x0A_AccessPermission
    ReadDtcInformation_0x17: category=REPORT_USER_DEF_MEMORY_DTC_BY_STATUS_MASK, access-permission=ReadDtcInformation_0x17_AccessPermission
    ReadDtcInformation_0x18: category=REPORT_USER_DEF_MEMORY_DTC_SNAPSHOT_RECORD_BY_DTC_NUMBER, access-permission=ReadDtcInformation_0x18_AccessPermission
    ReadDtcInformation_0x19: category=REPORT_USER_DEF_MEMORY_DTC_EXT_DATA_RECORD_BY_DTC_NUMBER, access-permission=ReadDtcInformation_0x19_AccessPermission
  diagnostic request download RequestDownload: access-permission=RequestDownload_AccessPermission, request-download-class=RequestDownload
  diagnostic transfer exit RequestTransferExit: access-permission=RequestTransferExit_AccessPermission, transfer-exit-class=RequestTransferExit
  diagnostic response on event ResponseOnEvent_0x04: access-permission=ResponseOnEvent_0x04_AccessPermission, response-on-event-class=ResponseOnEvent
  diagnostic response on event ResponseOnEvent_0x40: access-permission=ResponseOnEvent_0x40_AccessPermission, response-on-event-class=ResponseOnEvent
  diagnostic response on event ResponseOnEvent_0x45: access-permission=ResponseOnEvent_0x45_AccessPermission, response-on-event-class=ResponseOnEvent
  diagnostic data transfer TransferData: access-permission=TransferData_AccessPermission, data-transfer-class=TransferData
package /BMW/Diagnostics/Ecus/DiagnosticServiceTables
  diagnostic service table EPS_DCM_UDS_ON_FLEXRAY:
    ecu-instance=EPS
    protocol-kind=DCM_UDS_ON_FLEXRAY
    service-instance=[CheckNcd, ClearDiagnosticInformation, CommunicationControl_0x00, CommunicationControl_0x01, CommunicationControl_0x02, CommunicationControl_0x03, ControlDtcSetting_0x01, ControlDtcSetting_0x02, ControlExtendedEnergySavingState, DeleteSwPackage, DiagCommLoopback, DiagnosticSessionControl_0x01, DiagnosticSessionControl_0x02, DiagnosticSessionControl_0x03, DiagnosticSessionControl_0x41, DiagnosticSessionControl_0x44, DiagnosticSessionControl_0x5F, DmClientTriggerDtcEntry, EcuReset_0x01, Energiesparmode, EpsInitialisierungService, EpsInitialisierungWerk, EpsLenkwinkelsensorKalibrierungReset, EpsPendeln, EpsVerfahren, EpsZahnstangenmitteReset, IsLoeschen, RDBI_ActiveDiagnosticSession, RDBI_Cps, RDBI_DmDtcAktiveMeldung, RDBI_DmIsDtcActiveResponse, RDBI_EcuSerialNumber, RDBI_EnergySavingState, RDBI_EpsLenkwinkelsensorKalibrierung, RDBI_EpsMomentensensor, RDBI_EpsRitzelwinkelsensor, RDBI_EpsZahnstangenmitte, RDBI_ExtendedEnergySavingState, RDBI_FlashTimingParameter, RDBI_GelernterZahnstangenweg, RDBI_Herstelldatum, RDBI_MileKmEeprom, RDBI_ProgrammingCounter, RDBI_ProgrammingCounterMaxValue, RDBI_Pruefstempel, RDBI_ReadActiveSessionState, RDBI_ReadProtocolData, RDBI_ReadSwRevision, RDBI_Readhwmodificationindex, RDBI_SgbdIdx, RDBI_StatusCalcvn, RDBI_StatusFzgBordnetz, RDBI_SvkAktuell, RDBI_SvkSysSupplier, RDBI_SvkWerk, RDBI_SwfkDeleteSupported, RDBI_SystemSupplierIdentifier, RDBI_Systemzeit, RcCm, RcCpd, RcCppc, RcEm, RcRswedi, ReadDtcInformation_0x02, ReadDtcInformation_0x04, ReadDtcInformation_0x06, ReadDtcInformation_0x0A, ReadDtcInformation_0x17, ReadDtcInformation_0x18, ReadDtcInformation_0x19, ReadNcd, RequestDownload, RequestTransferExit, ResponseOnEvent_0x04, ResponseOnEvent_0x40, ResponseOnEvent_0x45, SteuernEpsMultiturnwertReset, SteuernEpsPulldriftOffsetReset, TransferData, WBDI_EpsLenkwinkelsensorKalibrierung, WBDI_Pruefstempel, WBDI_WdbiFp, WriteNcd]
    diagnostic-connections:
      DiagnosticConnection_0xF{0..9}
      DiagnosticConnection_0xFA
      DiagnosticConnection_0xFB
      DiagnosticConnection_0xFC
      DiagnosticConnection_0xFD
package /BMW/Diagnostics/Sessions/Application
  8 x diagnostic session, all with category=BMW_APPLICATION, p-2-server-max=0.05, p-2-star-server-max=5:
    CODING_SESSION: id=65, jump-to-boot-loader=NO-BOOT
    DEFAULT_SESSION: id=1, jump-to-boot-loader=NO-BOOT
    DEVELOPMENT_SESSION: id=79, jump-to-boot-loader=NO-BOOT
    EXTENDED_DIAGNOSTIC_SESSION: id=3, jump-to-boot-loader=NO-BOOT
    GarageMode: id=95, jump-to-boot-loader=NO-BOOT
    PROGRAMMING_SESSION: id=2, jump-to-boot-loader=NO-BOOT
    RSU_SESSION: id=68, jump-to-boot-loader=NO-BOOT
    SYSTEM_SUPPLIER_SPECIFIC_61: id=97
package /BMW/Diagnostics/TroubleCodes/DiagnosticTroubleCodeProps
  14 x diagnostic trouble code props, all with immediate-nv-data-storage=false, max-number-freeze-frame-records=2, memory-destination=PrimaryMemoryDestination_EPS_DiagnosticsInterface:
    DTC_023000_Props: extended-data-records=[ConditionByte, OccurrenceCounter], freeze-frames=[KmStand, FUwBn, Systemzeit], freeze-frame-content=DiagnosticDataIdentifiers/DemFreezeFrames_83016745, significance=FAULT
    DTC_023008_Props: extended-data-records=[ConditionByte, OccurrenceCounter], freeze-frames=[KmStand, FUwBn, Systemzeit], freeze-frame-content=DiagnosticDataIdentifiers/DemFreezeFrames_83016745, significance=FAULT
    DTC_023009_Props: extended-data-records=[ConditionByte, OccurrenceCounter], freeze-frames=[KmStand, FUwBn, Systemzeit], freeze-frame-content=DiagnosticDataIdentifiers/DemFreezeFrames_83016745, significance=FAULT
    DTC_02300A_Props: extended-data-records=[ConditionByte, OccurrenceCounter], freeze-frames=[KmStand, FUwBn, Systemzeit], freeze-frame-content=DiagnosticDataIdentifiers/DemFreezeFrames_83016745, significance=FAULT
    DTC_023040_Props: extended-data-records=[ConditionByte, OccurrenceCounter], freeze-frames=[KmStand, FUwBn, Systemzeit, Fahrzeuggeschwindigkeit, Betriebsspannung, Aussentemperatur], freeze-frame-content=DemFreezeFrames_293b5c37, significance=FAULT
    DTC_023041_Props: extended-data-records=[ConditionByte, OccurrenceCounter], freeze-frames=[KmStand, FUwBn, Systemzeit, Fahrzeuggeschwindigkeit, Betriebsspannung, Aussentemperatur], freeze-frame-content=DemFreezeFrames_293b5c37, significance=FAULT
    DTC_{023042..023045}_Props: extended-data-records=[ConditionByte, OccurrenceCounter], freeze-frames=[KmStand, FUwBn, Systemzeit, Fahrzeuggeschwindigkeit, Betriebsspannung, Aussentemperatur], freeze-frame-content=DemFreezeFrames_293b5c37, significance=OCCURENCE
    DTC_02FF30_Props: extended-data-records=[ConditionByte, OccurrenceCounter], freeze-frames=[KmStand, FUwBn, Systemzeit], freeze-frame-content=DiagnosticDataIdentifiers/DemFreezeFrames_83016745, significance=OCCURENCE
    DTC_D5041F_Props: extended-data-records=[ConditionByte, OccurrenceCounter, HealingCounter], freeze-frames=[KmStand, FUwBn, Systemzeit], freeze-frame-content=DiagnosticDataIdentifiers/DemFreezeFrames_83016745, significance=FAULT
    DTC_D50420_Props: extended-data-records=[ConditionByte, OccurrenceCounter, HealingCounter], freeze-frames=[KmStand, FUwBn, Systemzeit], freeze-frame-content=DiagnosticDataIdentifiers/DemFreezeFrames_83016745, significance=FAULT
    DTC_D50BFF_Props: extended-data-records=[ConditionByte, OccurrenceCounter], freeze-frames=[KmStand, FUwBn, Systemzeit], freeze-frame-content=DiagnosticDataIdentifiers/DemFreezeFrames_83016745, significance=OCCURENCE
package /BMW/Diagnostics/TroubleCodes/DiagnosticTroubleCodes
  14 x diagnostic trouble code uds:
    DTC_023000: dtc-props=DTC_023000_Props, uds-dtc-value=143360
    DTC_023008: dtc-props=DTC_023008_Props, uds-dtc-value=143368
    DTC_023009: dtc-props=DTC_023009_Props, uds-dtc-value=143369
    DTC_02300A: dtc-props=DTC_02300A_Props, uds-dtc-value=143370
    DTC_023040: dtc-props=DTC_023040_Props, uds-dtc-value=143424
    DTC_023041: dtc-props=DTC_023041_Props, uds-dtc-value=143425
    DTC_023042: dtc-props=DTC_023042_Props, uds-dtc-value=143426
    DTC_023043: dtc-props=DTC_023043_Props, uds-dtc-value=143427
    DTC_023044: dtc-props=DTC_023044_Props, uds-dtc-value=143428
    DTC_023045: dtc-props=DTC_023045_Props, uds-dtc-value=143429
    DTC_02FF30: dtc-props=DTC_02FF30_Props, uds-dtc-value=196400
    DTC_D5041F: dtc-props=DTC_D5041F_Props, uds-dtc-value=13960223
    DTC_D50420: dtc-props=DTC_D50420_Props, uds-dtc-value=13960224
    DTC_D50BFF: dtc-props=DTC_D50BFF_Props, uds-dtc-value=13962239
package /BMW/Diagnostics/UnmappedZedisContent/DiagnosticAccessPermissions
  29 x diagnostic access permission:
    CheckNcd_AccessPermission: diagnostic-session=CODING_SESSION
    EpsInitialisierungService_AccessPermission: diagnostic-session=[DEFAULT_SESSION, EXTENDED_DIAGNOSTIC_SESSION, GarageMode]
    EpsInitialisierungWerk_AccessPermission: diagnostic-session=GarageMode
    EpsLenkwinkelsensorKalibrierungReset_AccessPermission: diagnostic-session=GarageMode
    EpsPendeln_AccessPermission: diagnostic-session=GarageMode
    EpsVerfahren_AccessPermission: diagnostic-session=GarageMode
    EpsZahnstangenmitteReset_AccessPermission: diagnostic-session=SYSTEM_SUPPLIER_SPECIFIC_61
    RDBI_EpsLenkwinkelsensorKalibrierung_AccessPermission: diagnostic-session=[DEFAULT_SESSION, EXTENDED_DIAGNOSTIC_SESSION, GarageMode]
    RDBI_EpsMomentensensor_AccessPermission: diagnostic-session=[DEFAULT_SESSION, EXTENDED_DIAGNOSTIC_SESSION, GarageMode]
    RDBI_EpsRitzelwinkelsensor_AccessPermission: diagnostic-session=[DEFAULT_SESSION, EXTENDED_DIAGNOSTIC_SESSION, GarageMode]
    RDBI_EpsZahnstangenmitte_AccessPermission: diagnostic-session=[CODING_SESSION, DEFAULT_SESSION, EXTENDED_DIAGNOSTIC_SESSION, PROGRAMMING_SESSION]
    RDBI_GelernterZahnstangenweg_AccessPermission: diagnostic-session=[DEFAULT_SESSION, EXTENDED_DIAGNOSTIC_SESSION]
    RDBI_MileKmEeprom_AccessPermission: diagnostic-session=[DEFAULT_SESSION, EXTENDED_DIAGNOSTIC_SESSION]
    RDBI_Pruefstempel_AccessPermission: diagnostic-session=[DEFAULT_SESSION, EXTENDED_DIAGNOSTIC_SESSION]
    RDBI_ReadActiveSessionState_AccessPermission: diagnostic-session=[DEFAULT_SESSION, EXTENDED_DIAGNOSTIC_SESSION, PROGRAMMING_SESSION]
    RDBI_ReadProtocolData_AccessPermission: diagnostic-session=[CODING_SESSION, DEFAULT_SESSION, EXTENDED_DIAGNOSTIC_SESSION]
    RDBI_ReadSwRevision_AccessPermission: diagnostic-session=[DEFAULT_SESSION, EXTENDED_DIAGNOSTIC_SESSION, PROGRAMMING_SESSION]
    RDBI_StatusCalcvn_AccessPermission: diagnostic-session=[DEFAULT_SESSION, EXTENDED_DIAGNOSTIC_SESSION]
    RDBI_StatusFzgBordnetz_AccessPermission: diagnostic-session=[DEFAULT_SESSION, EXTENDED_DIAGNOSTIC_SESSION]
    RDBI_SystemSupplierIdentifier_AccessPermission: diagnostic-session=[DEFAULT_SESSION, EXTENDED_DIAGNOSTIC_SESSION]
    RcCm_AccessPermission: diagnostic-session=PROGRAMMING_SESSION
    RcCpd_AccessPermission: diagnostic-session=PROGRAMMING_SESSION
    RcEm_AccessPermission: diagnostic-session=PROGRAMMING_SESSION
    ReadNcd_AccessPermission: diagnostic-session=[CODING_SESSION, DEFAULT_SESSION, EXTENDED_DIAGNOSTIC_SESSION]
    SteuernEpsMultiturnwertReset_AccessPermission: diagnostic-session=[DEFAULT_SESSION, EXTENDED_DIAGNOSTIC_SESSION, GarageMode]
    SteuernEpsPulldriftOffsetReset_AccessPermission: diagnostic-session=GarageMode
    WBDI_EpsLenkwinkelsensorKalibrierung_AccessPermission: diagnostic-session=[DEFAULT_SESSION, EXTENDED_DIAGNOSTIC_SESSION, GarageMode]
    WBDI_Pruefstempel_AccessPermission: diagnostic-session=[DEFAULT_SESSION, EXTENDED_DIAGNOSTIC_SESSION]
    WriteNcd_AccessPermission: diagnostic-session=CODING_SESSION
package /BMW/Diagnostics/UnmappedZedisContent/DiagnosticDataIdentifiers
  diagnostic data identifier Aussentemperatur: id=10245
    diagnostic-parameter bit-offset=0:
      diagnostic data element Aussentemperatur: base-type=SINT8_BE
  diagnostic data identifier Betriebsspannung: id=10342
    diagnostic-parameter bit-offset=0:
      diagnostic data element Betriebsspannung: base-type=uint8
  diagnostic data identifier set DemFreezeFrames_293b5c37: data-identifier=[Aussentemperatur, Betriebsspannung, FUwBn, Fahrzeuggeschwindigkeit, KmStand, Systemzeit]
  diagnostic data identifier set DemFreezeFrames_83016745: data-identifier=[FUwBn, KmStand, Systemzeit]
  17 x diagnostic data identifier:
    Did_EpsLenkwinkelsensorKalibrierung: id=56154
      diagnostic-parameter bit-offset=0:
        diagnostic data element EpsLenkwinkelsensorKalibrierung: array-size-semantics=VARIABLE-SIZE, max-number-of-elements=2, base-type=UINT8
    Did_EpsMomentensensor: id=56217
      diagnostic-parameter bit-offset=0:
        diagnostic data element EpsMomentensensor: array-size-semantics=VARIABLE-SIZE, max-number-of-elements=3, base-type=UINT8
    Did_EpsRitzelwinkelsensor: id=56151
      diagnostic-parameter bit-offset=0:
        diagnostic data element EpsRitzelwinkelsensor: array-size-semantics=VARIABLE-SIZE, max-number-of-elements=7, base-type=UINT8
    Did_EpsZahnstangenmitte: id=56439
      diagnostic-parameter bit-offset=0:
        diagnostic data element EpsZahnstangenmitte: array-size-semantics=VARIABLE-SIZE, max-number-of-elements=1, base-type=UINT8
    Did_GelernterZahnstangenweg: id=57309
      diagnostic-parameter bit-offset=0:
        diagnostic data element GelernterZahnstangenweg: array-size-semantics=VARIABLE-SIZE, max-number-of-elements=8, base-type=UINT8
    Did_MileKmEeprom: id=9536
      diagnostic-parameter bit-offset=0:
        diagnostic data element MileKmEeprom: array-size-semantics=VARIABLE-SIZE, max-number-of-elements=3, base-type=UINT8
    Did_Pruefstempel: id=4096
      diagnostic-parameter bit-offset=0:
        diagnostic data element Pruefstempel: array-size-semantics=VARIABLE-SIZE, max-number-of-elements=3, base-type=UINT8
    Did_ReadActiveSessionState: id=61696
      diagnostic-parameter bit-offset=0:
        diagnostic data element ReadActiveSessionState: array-size-semantics=VARIABLE-SIZE, base-type=UINT8
    Did_ReadProtocolData: id=14335
      diagnostic-parameter bit-offset=0:
        diagnostic data element ReadProtocolData: array-size-semantics=VARIABLE-SIZE, base-type=UINT8
    Did_ReadSwRevision: id=9483
      diagnostic-parameter bit-offset=0:
        diagnostic data element ReadSwRevision: array-size-semantics=VARIABLE-SIZE, base-type=UINT8
    Did_StatusCalcvn: id=9537
      diagnostic-parameter bit-offset=0:
        diagnostic data element StatusCalcvn: array-size-semantics=VARIABLE-SIZE, base-type=UINT8
    Did_StatusFzgBordnetz: id=56124
      diagnostic-parameter bit-offset=0:
        diagnostic data element StatusFzgBordnetz: array-size-semantics=VARIABLE-SIZE, max-number-of-elements=15, base-type=UINT8
    Did_SystemSupplierIdentifier: id=61834
      diagnostic-parameter bit-offset=0:
        diagnostic data element SystemSupplierIdentifier: array-size-semantics=VARIABLE-SIZE, max-number-of-elements=3, base-type=UINT8
    FUwBn: id=5968
      diagnostic-parameter bit-offset=0:
        diagnostic data element FUwBn: base-type=uint8
    Fahrzeuggeschwindigkeit: id=10343
      diagnostic-parameter bit-offset=0:
        diagnostic data element Fahrzeuggeschwindigkeit: base-type=uint8
    KmStand: id=5888
      diagnostic-parameter bit-offset=0:
        diagnostic data element KmStand: array-size-semantics=VARIABLE-SIZE, max-number-of-elements=3, base-type=UINT8_BE
    Systemzeit: id=5889
      diagnostic-parameter bit-offset=0:
        diagnostic data element Systemzeit: base-type=SINT32_BE
package /BMW/Diagnostics/UnmappedZedisContent/DiagnosticEvents
  8 x diagnostic event, all with event-kind=SWC:
    FrsmEClusterSyncLoss: aging-allowed=true
    FrtrcvEFrBuserrorTrcv0: aging-allowed=true, event-failure-cycle-counter-threshold=1
    GlobalOvervoltageExt: aging-allowed=false, event-failure-cycle-counter-threshold=1
    GlobalOvervoltageInt: aging-allowed=false, event-failure-cycle-counter-threshold=1
    GlobalUndervoltageExt: aging-allowed=false, event-failure-cycle-counter-threshold=1
    GlobalUndervoltageInt: aging-allowed=false, event-failure-cycle-counter-threshold=1
    LocalOvervoltage: aging-allowed=false, event-failure-cycle-counter-threshold=1
    LocalUndervoltage: aging-allowed=false, event-failure-cycle-counter-threshold=1
package /BMW/Diagnostics/UnmappedZedisContent/DiagnosticFreezeFrames
  6 x diagnostic freeze frame:
    Aussentemperatur
    Betriebsspannung
    FUwBn
    Fahrzeuggeschwindigkeit
    KmStand
    Systemzeit
package /BMW/Diagnostics/UnmappedZedisContent/DiagnosticMappings
  diagnostic event to debounce algorithm mapping FRSM_E_CLUSTER_SYNC_LOSSToDebounceAlgorithmMapping: debounce-algorithm=DebounceMonitorInternal, diagnostic-event=FrsmEClusterSyncLoss
  diagnostic event to trouble code uds mapping FRSM_E_CLUSTER_SYNC_LOSSToTroubleCodeUdsMapping: diagnostic-event=FrsmEClusterSyncLoss, trouble-code-uds=DTC_D50420
  diagnostic event to debounce algorithm mapping FRTRCV_E_FR_BUSERROR_TRCV0ToDebounceAlgorithmMapping: debounce-algorithm=DebounceMonitorInternal, diagnostic-event=FrtrcvEFrBuserrorTrcv0
  diagnostic event to trouble code uds mapping FRTRCV_E_FR_BUSERROR_TRCV0ToTroubleCodeUdsMapping: diagnostic-event=FrtrcvEFrBuserrorTrcv0, trouble-code-uds=DTC_D5041F
  diagnostic event to debounce algorithm mapping GLOBAL_OVERVOLTAGE_EXTToDebounceAlgorithmMapping: debounce-algorithm=DebounceMonitorInternal, diagnostic-event=GlobalOvervoltageExt
  diagnostic event to trouble code uds mapping GLOBAL_OVERVOLTAGE_EXTToTroubleCodeUdsMapping: diagnostic-event=GlobalOvervoltageExt, trouble-code-uds=DTC_023043
  diagnostic event to debounce algorithm mapping GLOBAL_OVERVOLTAGE_INTToDebounceAlgorithmMapping: debounce-algorithm=DebounceMonitorInternal, diagnostic-event=GlobalOvervoltageInt
  diagnostic event to trouble code uds mapping GLOBAL_OVERVOLTAGE_INTToTroubleCodeUdsMapping: diagnostic-event=GlobalOvervoltageInt, trouble-code-uds=DTC_023042
  diagnostic event to debounce algorithm mapping GLOBAL_UNDERVOLTAGE_EXTToDebounceAlgorithmMapping: debounce-algorithm=DebounceMonitorInternal, diagnostic-event=GlobalUndervoltageExt
  diagnostic event to trouble code uds mapping GLOBAL_UNDERVOLTAGE_EXTToTroubleCodeUdsMapping: diagnostic-event=GlobalUndervoltageExt, trouble-code-uds=DTC_023045
  diagnostic event to debounce algorithm mapping GLOBAL_UNDERVOLTAGE_INTToDebounceAlgorithmMapping: debounce-algorithm=DebounceMonitorInternal, diagnostic-event=GlobalUndervoltageInt
  diagnostic event to trouble code uds mapping GLOBAL_UNDERVOLTAGE_INTToTroubleCodeUdsMapping: diagnostic-event=GlobalUndervoltageInt, trouble-code-uds=DTC_023044
  diagnostic event to debounce algorithm mapping LOCAL_OVERVOLTAGEToDebounceAlgorithmMapping: debounce-algorithm=DebounceMonitorInternal, diagnostic-event=LocalOvervoltage
  diagnostic event to trouble code uds mapping LOCAL_OVERVOLTAGEToTroubleCodeUdsMapping: diagnostic-event=LocalOvervoltage, trouble-code-uds=DTC_023040
  diagnostic event to debounce algorithm mapping LOCAL_UNDERVOLTAGEToDebounceAlgorithmMapping: debounce-algorithm=DebounceMonitorInternal, diagnostic-event=LocalUndervoltage
  diagnostic event to trouble code uds mapping LOCAL_UNDERVOLTAGEToTroubleCodeUdsMapping: diagnostic-event=LocalUndervoltage, trouble-code-uds=DTC_023041
package /BMW/Diagnostics/UnmappedZedisContent/DiagnosticRoutines
  14 x diagnostic routine:
    CheckNcd_Routine: id=14334
      start START_CheckNcd
        diagnostic-parameter bit-offset=0:
          diagnostic data element Cps: array-size-semantics=VARIABLE-SIZE, max-number-of-elements=18, base-type=UINT8_BE
        diagnostic-parameter bit-offset=0:
          diagnostic data element StatCheckNcdResult: base-type=uint8
    EpsInitialisierungService_Routine: id=43884
      request result RESULT_EpsInitialisierungService
        diagnostic-parameter bit-offset=0:
          diagnostic data element StatRoutineStatus: base-type=uint8
        diagnostic-parameter bit-offset=8:
          diagnostic data element StatLenkradwinkelWert: base-type=SINT16
        diagnostic-parameter bit-offset=24:
          diagnostic data element StatSensorZustandNr: base-type=uint8
      start START_EpsInitialisierungService
      stop STOP_EpsInitialisierungService
    EpsInitialisierungWerk_Routine: id=43890
      request result RESULT_EpsInitialisierungWerk
        diagnostic-parameter bit-offset=0:
          diagnostic data element StatRoutineStatus: base-type=uint8
      start START_EpsInitialisierungWerk
        diagnostic-parameter bit-offset=0:
          diagnostic data element Winkel: base-type=uint8
        diagnostic-parameter bit-offset=8:
          diagnostic data element Winkelgeschwindigkeit: base-type=uint8
        diagnostic-parameter bit-offset=16:
          diagnostic data element Winkelbeschleunigung: base-type=uint8
    EpsLenkwinkelsensorKalibrierungReset_Routine: id=43881
      start START_EpsLenkwinkelsensorKalibrierungReset
    EpsPendeln_Routine: id=43862
      request result RESULT_EpsPendeln
        diagnostic-parameter bit-offset=0:
          diagnostic data element StatEpsPendelnAktivNr: base-type=uint8
      start START_EpsPendeln
        diagnostic-parameter bit-offset=0:
          diagnostic data element Frequenz: base-type=uint8
        diagnostic-parameter bit-offset=8:
          diagnostic data element MaxAmplitude: base-type=uint8
        diagnostic-parameter bit-offset=16:
          diagnostic data element NumberOfCycles: base-type=uint8
    EpsVerfahren_Routine: id=43889
      request result RESULT_EpsVerfahren
        diagnostic-parameter bit-offset=0:
          diagnostic data element StatEpsVerfahrenAktivNr: base-type=uint8
      start START_EpsVerfahren
        diagnostic-parameter bit-offset=0:
          diagnostic data element Winkel: base-type=SINT16
        diagnostic-parameter bit-offset=16:
          diagnostic data element Winkelgeschwindigkeit: base-type=uint8
        diagnostic-parameter bit-offset=24:
          diagnostic data element Winkelbeschleunigung: base-type=uint8
        diagnostic-parameter bit-offset=32:
          diagnostic data element AbsolutEin: base-type=uint8
    EpsZahnstangenmitteReset_Routine: id=43900
      start START_EpsZahnstangenmitteReset
    RcCm_Routine: id=514
      start START_RcCm
        diagnostic-parameter bit-offset=0:
          diagnostic data element RcCmIcvRcoStruct
        diagnostic-parameter bit-offset=0:
          diagnostic data element StatRoutineStatus: base-type=uint8
    RcCpd_Routine: id=65281
      start START_RcCpd
        diagnostic-parameter bit-offset=0:
          diagnostic data element StatRoutineStatus: base-type=uint8
    RcEm_Routine: id=65280
      start START_RcEm
        diagnostic-parameter bit-offset=0:
          diagnostic data element RcEmIeRco
        diagnostic-parameter bit-offset=0:
          diagnostic data element StatRoutineStatus: base-type=uint8
    ReadNcd_Routine: id=14332
      start START_ReadNcd
        diagnostic-parameter bit-offset=0:
          diagnostic data element ArgCodingArea: array-size-semantics=VARIABLE-SIZE, max-number-of-elements=6, base-type=UINT8_BE
        diagnostic-parameter bit-offset=0:
          diagnostic data element StatCodingArea: array-size-semantics=VARIABLE-SIZE, max-number-of-elements=1, base-type=UINT8_BE
    SteuernEpsMultiturnwertReset_Routine: id=43901
      start START_SteuernEpsMultiturnwertReset
    SteuernEpsPulldriftOffsetReset_Routine: id=41659
      start START_SteuernEpsPulldriftOffsetReset
    WriteNcd_Routine: id=14333
      start START_WriteNcd
        diagnostic-parameter bit-offset=0:
          diagnostic data element ArgCodingArea: array-size-semantics=VARIABLE-SIZE, max-number-of-elements=1, base-type=UINT8_BE
package /BMW/Diagnostics/UnmappedZedisContent/DiagnosticServiceInstances
  7 x diagnostic routine control, all with routine-control-class=RoutineControl:
    CheckNcd: access-permission=CheckNcd_AccessPermission, routine=CheckNcd_Routine
    EpsInitialisierungService: access-permission=EpsInitialisierungService_AccessPermission, routine=EpsInitialisierungService_Routine
    EpsInitialisierungWerk: access-permission=EpsInitialisierungWerk_AccessPermission, routine=EpsInitialisierungWerk_Routine
    EpsLenkwinkelsensorKalibrierungReset: access-permission=EpsLenkwinkelsensorKalibrierungReset_AccessPermission, routine=EpsLenkwinkelsensorKalibrierungReset_Routine
    EpsPendeln: access-permission=EpsPendeln_AccessPermission, routine=EpsPendeln_Routine
    EpsVerfahren: access-permission=EpsVerfahren_AccessPermission, routine=EpsVerfahren_Routine
    EpsZahnstangenmitteReset: access-permission=EpsZahnstangenmitteReset_AccessPermission, routine=EpsZahnstangenmitteReset_Routine
  13 x diagnostic read data by identifier, all with read-class=ReadDataByIdentifier:
    RDBI_EpsLenkwinkelsensorKalibrierung: access-permission=RDBI_EpsLenkwinkelsensorKalibrierung_AccessPermission, data-identifier=Did_EpsLenkwinkelsensorKalibrierung
    RDBI_EpsMomentensensor: access-permission=RDBI_EpsMomentensensor_AccessPermission, data-identifier=Did_EpsMomentensensor
    RDBI_EpsRitzelwinkelsensor: access-permission=RDBI_EpsRitzelwinkelsensor_AccessPermission, data-identifier=Did_EpsRitzelwinkelsensor
    RDBI_EpsZahnstangenmitte: access-permission=RDBI_EpsZahnstangenmitte_AccessPermission, data-identifier=Did_EpsZahnstangenmitte
    RDBI_GelernterZahnstangenweg: access-permission=RDBI_GelernterZahnstangenweg_AccessPermission, data-identifier=Did_GelernterZahnstangenweg
    RDBI_MileKmEeprom: access-permission=RDBI_MileKmEeprom_AccessPermission, data-identifier=Did_MileKmEeprom
    RDBI_Pruefstempel: access-permission=RDBI_Pruefstempel_AccessPermission, data-identifier=Did_Pruefstempel
    RDBI_ReadActiveSessionState: access-permission=RDBI_ReadActiveSessionState_AccessPermission, data-identifier=Did_ReadActiveSessionState
    RDBI_ReadProtocolData: access-permission=RDBI_ReadProtocolData_AccessPermission, data-identifier=Did_ReadProtocolData
    RDBI_ReadSwRevision: access-permission=RDBI_ReadSwRevision_AccessPermission, data-identifier=Did_ReadSwRevision
    RDBI_StatusCalcvn: access-permission=RDBI_StatusCalcvn_AccessPermission, data-identifier=Did_StatusCalcvn
    RDBI_StatusFzgBordnetz: access-permission=RDBI_StatusFzgBordnetz_AccessPermission, data-identifier=Did_StatusFzgBordnetz
    RDBI_SystemSupplierIdentifier: access-permission=RDBI_SystemSupplierIdentifier_AccessPermission, data-identifier=Did_SystemSupplierIdentifier
  6 x diagnostic routine control, all with routine-control-class=RoutineControl:
    RcCm: access-permission=RcCm_AccessPermission, routine=RcCm_Routine
    RcCpd: access-permission=RcCpd_AccessPermission, routine=RcCpd_Routine
    RcEm: access-permission=RcEm_AccessPermission, routine=RcEm_Routine
    ReadNcd: access-permission=ReadNcd_AccessPermission, routine=ReadNcd_Routine
    SteuernEpsMultiturnwertReset: access-permission=SteuernEpsMultiturnwertReset_AccessPermission, routine=SteuernEpsMultiturnwertReset_Routine
    SteuernEpsPulldriftOffsetReset: access-permission=SteuernEpsPulldriftOffsetReset_AccessPermission, routine=SteuernEpsPulldriftOffsetReset_Routine
  diagnostic write data by identifier WBDI_EpsLenkwinkelsensorKalibrierung: access-permission=WBDI_EpsLenkwinkelsensorKalibrierung_AccessPermission, data-identifier=Did_EpsLenkwinkelsensorKalibrierung, write-class=WriteDataByIdentifier
  diagnostic write data by identifier WBDI_Pruefstempel: access-permission=WBDI_Pruefstempel_AccessPermission, data-identifier=Did_Pruefstempel, write-class=WriteDataByIdentifier
  diagnostic routine control WriteNcd: access-permission=WriteNcd_AccessPermission, routine-control-class=RoutineControl, routine=WriteNcd_Routine
package /BMW/Platform/Coding/SwComponentTypes/DiagnosticAccessPermissions
  diagnostic access permission RDBI_Cps_AccessPermission: diagnostic-session=[CODING_SESSION, DEFAULT_SESSION, EXTENDED_DIAGNOSTIC_SESSION]
package /BMW/Platform/Coding/SwComponentTypes/DiagnosticDataIdentifiers
  diagnostic data identifier set DemFreezeFrames_83016745: data-identifier=[FUwBn, KmStand, Systemzeit]
  diagnostic data identifier Did_Cps: id=14334
    diagnostic-parameter bit-offset=0:
      diagnostic data element Cps: array-size-semantics=VARIABLE-SIZE, max-number-of-elements=18, base-type=UINT8
package /BMW/Platform/Coding/SwComponentTypes/DiagnosticEvents
  diagnostic event CodingEventNotCoded: aging-allowed=false, clear-event-behavior=NO-STATUS-BYTE-CHANGE, event-failure-cycle-counter-threshold=1, event-kind=SWC
  diagnostic event CodingEventUnqualifiedData: aging-allowed=false, event-failure-cycle-counter-threshold=1, event-kind=SWC
  diagnostic event CodingEventWrongVehicle: aging-allowed=false, event-failure-cycle-counter-threshold=1, event-kind=SWC
package /BMW/Platform/Coding/SwComponentTypes/DiagnosticMappings
  diagnostic event to debounce algorithm mapping CODING_EVENT_NOT_CODEDToDebounceAlgorithmMapping: debounce-algorithm=DebounceMonitorInternal, diagnostic-event=CodingEventNotCoded
  diagnostic event to trouble code uds mapping CODING_EVENT_NOT_CODEDToTroubleCodeUdsMapping: diagnostic-event=CodingEventNotCoded, trouble-code-uds=DTC_023008
  diagnostic event to debounce algorithm mapping CODING_EVENT_UNQUALIFIED_DATAToDebounceAlgorithmMapping: debounce-algorithm=DebounceMonitorInternal, diagnostic-event=CodingEventUnqualifiedData
  diagnostic event to trouble code uds mapping CODING_EVENT_UNQUALIFIED_DATAToTroubleCodeUdsMapping: diagnostic-event=CodingEventUnqualifiedData, trouble-code-uds=DTC_02300A
  diagnostic event to debounce algorithm mapping CODING_EVENT_WRONG_VEHICLEToDebounceAlgorithmMapping: debounce-algorithm=DebounceMonitorInternal, diagnostic-event=CodingEventWrongVehicle
  diagnostic event to trouble code uds mapping CODING_EVENT_WRONG_VEHICLEToTroubleCodeUdsMapping: diagnostic-event=CodingEventWrongVehicle, trouble-code-uds=DTC_023009
package /BMW/Platform/Coding/SwComponentTypes/DiagnosticServiceInstances
  diagnostic read data by identifier RDBI_Cps: access-permission=RDBI_Cps_AccessPermission, data-identifier=Did_Cps, read-class=ReadDataByIdentifier
package /BMW/Platform/Darh/SwComponentTypes/DiagnosticAccessPermissions
  diagnostic access permission DmClientTriggerDtcEntry_AccessPermission: diagnostic-session=[DEFAULT_SESSION, EXTENDED_DIAGNOSTIC_SESSION]
  diagnostic access permission RDBI_DmDtcAktiveMeldung_AccessPermission: diagnostic-session=[DEFAULT_SESSION, EXTENDED_DIAGNOSTIC_SESSION]
  diagnostic access permission RDBI_DmIsDtcActiveResponse_AccessPermission: diagnostic-session=[DEFAULT_SESSION, EXTENDED_DIAGNOSTIC_SESSION]
package /BMW/Platform/Darh/SwComponentTypes/DiagnosticDataIdentifiers
  diagnostic data identifier set DemFreezeFrames_83016745: data-identifier=[FUwBn, KmStand, Systemzeit]
  diagnostic data identifier Did_DmDtcAktiveMeldung: id=5892
    diagnostic-parameter bit-offset=0:
      diagnostic data element DmDtcAktiveMeldung: array-size-semantics=VARIABLE-SIZE, base-type=UINT8
  diagnostic data identifier Did_DmIsDtcActiveResponse: id=5923
    diagnostic-parameter bit-offset=0:
      diagnostic data element DmIsDtcActiveResponse: array-size-semantics=VARIABLE-SIZE, base-type=UINT8
package /BMW/Platform/Darh/SwComponentTypes/DiagnosticEvents
  diagnostic event DmTestAppl: aging-allowed=false, event-failure-cycle-counter-threshold=1, event-kind=SWC
  diagnostic event DmTestCom: aging-allowed=false, event-failure-cycle-counter-threshold=1, event-kind=SWC
package /BMW/Platform/Darh/SwComponentTypes/DiagnosticMappings
  diagnostic event to debounce algorithm mapping DM_TEST_APPLToDebounceAlgorithmMapping: debounce-algorithm=DebounceMonitorInternal, diagnostic-event=DmTestAppl
  diagnostic event to trouble code uds mapping DM_TEST_APPLToTroubleCodeUdsMapping: diagnostic-event=DmTestAppl, trouble-code-uds=DTC_02FF30
  diagnostic event to debounce algorithm mapping DM_TEST_COMToDebounceAlgorithmMapping: debounce-algorithm=DebounceMonitorInternal, diagnostic-event=DmTestCom
  diagnostic event to trouble code uds mapping DM_TEST_COMToTroubleCodeUdsMapping: diagnostic-event=DmTestCom, trouble-code-uds=DTC_D50BFF
package /BMW/Platform/Darh/SwComponentTypes/DiagnosticRoutines
  diagnostic routine DmClientTriggerDtcEntry_Routine: id=772
    start START_DmClientTriggerDtcEntry
      diagnostic-parameter bit-offset=0:
        diagnostic data element DTCType: base-type=uint8
      diagnostic-parameter bit-offset=0:
        diagnostic data element DTCTypeOut: base-type=uint8
      diagnostic-parameter bit-offset=8:
        diagnostic data element DTCByte1: base-type=uint8
      diagnostic-parameter bit-offset=16:
        diagnostic data element DTCByte2: base-type=uint8
      diagnostic-parameter bit-offset=24:
        diagnostic data element DTCByte3: base-type=uint8
package /BMW/Platform/Darh/SwComponentTypes/DiagnosticServiceInstances
  diagnostic routine control DmClientTriggerDtcEntry: access-permission=DmClientTriggerDtcEntry_AccessPermission, routine-control-class=RoutineControl, routine=DmClientTriggerDtcEntry_Routine
  diagnostic read data by identifier RDBI_DmDtcAktiveMeldung: access-permission=RDBI_DmDtcAktiveMeldung_AccessPermission, data-identifier=Did_DmDtcAktiveMeldung, read-class=ReadDataByIdentifier
  diagnostic read data by identifier RDBI_DmIsDtcActiveResponse: access-permission=RDBI_DmIsDtcActiveResponse_AccessPermission, data-identifier=Did_DmIsDtcActiveResponse, read-class=ReadDataByIdentifier
package /BMW/Platform/Dlog/SwComponentTypes/DiagnosticAccessPermissions
  12 x diagnostic access permission:
    RDBI_EcuSerialNumber_AccessPermission: diagnostic-session=[DEFAULT_SESSION, EXTENDED_DIAGNOSTIC_SESSION, PROGRAMMING_SESSION]
    RDBI_FlashTimingParameter_AccessPermission: diagnostic-session=[DEFAULT_SESSION, EXTENDED_DIAGNOSTIC_SESSION, PROGRAMMING_SESSION]
    RDBI_Herstelldatum_AccessPermission: diagnostic-session=[DEFAULT_SESSION, EXTENDED_DIAGNOSTIC_SESSION, PROGRAMMING_SESSION]
    RDBI_ProgrammingCounterMaxValue_AccessPermission: diagnostic-session=[DEFAULT_SESSION, EXTENDED_DIAGNOSTIC_SESSION, PROGRAMMING_SESSION]
    RDBI_ProgrammingCounter_AccessPermission: diagnostic-session=[DEFAULT_SESSION, EXTENDED_DIAGNOSTIC_SESSION, PROGRAMMING_SESSION]
    RDBI_SgbdIdx_AccessPermission: diagnostic-session=[DEFAULT_SESSION, EXTENDED_DIAGNOSTIC_SESSION]
    RDBI_SvkAktuell_AccessPermission: diagnostic-session=[DEFAULT_SESSION, EXTENDED_DIAGNOSTIC_SESSION, GarageMode, PROGRAMMING_SESSION]
    RDBI_SvkSysSupplier_AccessPermission: diagnostic-session=[DEFAULT_SESSION, EXTENDED_DIAGNOSTIC_SESSION, PROGRAMMING_SESSION]
    RDBI_SvkWerk_AccessPermission: diagnostic-session=[DEFAULT_SESSION, EXTENDED_DIAGNOSTIC_SESSION, PROGRAMMING_SESSION]
    RDBI_SwfkDeleteSupported_AccessPermission: diagnostic-session=[DEFAULT_SESSION, EXTENDED_DIAGNOSTIC_SESSION, PROGRAMMING_SESSION]
    RcRswedi_AccessPermission: diagnostic-session=[DEFAULT_SESSION, EXTENDED_DIAGNOSTIC_SESSION]
    WBDI_WdbiFp_AccessPermission: diagnostic-session=PROGRAMMING_SESSION
package /BMW/Platform/Dlog/SwComponentTypes/DiagnosticDataIdentifiers
  11 x diagnostic data identifier:
    Did_EcuSerialNumber: id=61836
      diagnostic-parameter bit-offset=0:
        diagnostic data element EcuSerialNumber: array-size-semantics=VARIABLE-SIZE, max-number-of-elements=10, base-type=UINT8
    Did_FlashTimingParameter: id=9476
      diagnostic-parameter bit-offset=0:
        diagnostic data element FlashTimingParameter: array-size-semantics=VARIABLE-SIZE, max-number-of-elements=12, base-type=UINT8
    Did_Herstelldatum: id=61835
      diagnostic-parameter bit-offset=0:
        diagnostic data element Herstelldatum: array-size-semantics=VARIABLE-SIZE, max-number-of-elements=3, base-type=UINT8
    Did_ProgrammingCounter: id=9474
      diagnostic-parameter bit-offset=0:
        diagnostic data element ProgrammingCounter: array-size-semantics=VARIABLE-SIZE, max-number-of-elements=4, base-type=UINT8
    Did_ProgrammingCounterMaxValue: id=9475
      diagnostic-parameter bit-offset=0:
        diagnostic data element ProgrammingCounterMaxValue: array-size-semantics=VARIABLE-SIZE, max-number-of-elements=2, base-type=UINT8
    Did_SgbdIdx: id=61776
      diagnostic-parameter bit-offset=0:
        diagnostic data element SgbdIdx: array-size-semantics=VARIABLE-SIZE, max-number-of-elements=3, base-type=UINT8
    Did_SvkAktuell: id=61697
      diagnostic-parameter bit-offset=0:
        diagnostic data element SvkAktuell: array-size-semantics=VARIABLE-SIZE, base-type=UINT8
    Did_SvkSysSupplier: id=61698
      diagnostic-parameter bit-offset=0:
        diagnostic data element SvkSysSupplier: array-size-semantics=VARIABLE-SIZE, base-type=UINT8
    Did_SvkWerk: id=61699
      diagnostic-parameter bit-offset=0:
        diagnostic data element SvkWerk: array-size-semantics=VARIABLE-SIZE, base-type=UINT8
    Did_SwfkDeleteSupported: id=9479
      diagnostic-parameter bit-offset=0:
        diagnostic data element SwfkDeleteSupported: array-size-semantics=VARIABLE-SIZE, max-number-of-elements=1, base-type=UINT8
    Did_WdbiFp: id=61786
      diagnostic-parameter bit-offset=0:
        diagnostic data element WdbiFp: array-size-semantics=VARIABLE-SIZE, base-type=UINT8
package /BMW/Platform/Dlog/SwComponentTypes/DiagnosticRoutines
  diagnostic routine RcRswedi_Routine: id=517
    start START_RcRswedi
      diagnostic-parameter bit-offset=0:
        diagnostic data element DataIn: array-size-semantics=VARIABLE-SIZE, max-number-of-elements=8
      diagnostic-parameter bit-offset=0:
        diagnostic data element DataOut: array-size-semantics=VARIABLE-SIZE, max-number-of-elements=128
package /BMW/Platform/Dlog/SwComponentTypes/DiagnosticServiceInstances
  10 x diagnostic read data by identifier, all with read-class=ReadDataByIdentifier:
    RDBI_EcuSerialNumber: access-permission=RDBI_EcuSerialNumber_AccessPermission, data-identifier=Did_EcuSerialNumber
    RDBI_FlashTimingParameter: access-permission=RDBI_FlashTimingParameter_AccessPermission, data-identifier=Did_FlashTimingParameter
    RDBI_Herstelldatum: access-permission=RDBI_Herstelldatum_AccessPermission, data-identifier=Did_Herstelldatum
    RDBI_ProgrammingCounter: access-permission=RDBI_ProgrammingCounter_AccessPermission, data-identifier=Did_ProgrammingCounter
    RDBI_ProgrammingCounterMaxValue: access-permission=RDBI_ProgrammingCounterMaxValue_AccessPermission, data-identifier=Did_ProgrammingCounterMaxValue
    RDBI_SgbdIdx: access-permission=RDBI_SgbdIdx_AccessPermission, data-identifier=Did_SgbdIdx
    RDBI_SvkAktuell: access-permission=RDBI_SvkAktuell_AccessPermission, data-identifier=Did_SvkAktuell
    RDBI_SvkSysSupplier: access-permission=RDBI_SvkSysSupplier_AccessPermission, data-identifier=Did_SvkSysSupplier
    RDBI_SvkWerk: access-permission=RDBI_SvkWerk_AccessPermission, data-identifier=Did_SvkWerk
    RDBI_SwfkDeleteSupported: access-permission=RDBI_SwfkDeleteSupported_AccessPermission, data-identifier=Did_SwfkDeleteSupported
  diagnostic routine control RcRswedi: access-permission=RcRswedi_AccessPermission, routine-control-class=RoutineControl, routine=RcRswedi_Routine
  diagnostic write data by identifier WBDI_WdbiFp: access-permission=WBDI_WdbiFp_AccessPermission, data-identifier=Did_WdbiFp, write-class=WriteDataByIdentifier
package /BMW/Platform/Omc/SwComponentTypes/DiagnosticAccessPermissions
  4 x diagnostic access permission:
    ControlExtendedEnergySavingState_AccessPermission: diagnostic-session=[DEFAULT_SESSION, EXTENDED_DIAGNOSTIC_SESSION]
    Energiesparmode_AccessPermission: diagnostic-session=[DEFAULT_SESSION, EXTENDED_DIAGNOSTIC_SESSION]
    RDBI_EnergySavingState_AccessPermission: diagnostic-session=[DEFAULT_SESSION, EXTENDED_DIAGNOSTIC_SESSION, PROGRAMMING_SESSION]
    RDBI_ExtendedEnergySavingState_AccessPermission: diagnostic-session=[DEFAULT_SESSION, EXTENDED_DIAGNOSTIC_SESSION, PROGRAMMING_SESSION]
package /BMW/Platform/Omc/SwComponentTypes/DiagnosticDataIdentifiers
  diagnostic data identifier set DemFreezeFrames_83016745: data-identifier=[FUwBn, KmStand, Systemzeit]
  diagnostic data identifier Did_EnergySavingState: id=4106
    diagnostic-parameter bit-offset=0:
      diagnostic data element EnergySavingState: array-size-semantics=VARIABLE-SIZE, max-number-of-elements=1, base-type=UINT8
  diagnostic data identifier Did_ExtendedEnergySavingState: id=4110
    diagnostic-parameter bit-offset=0:
      diagnostic data element ExtendedEnergySavingState: array-size-semantics=VARIABLE-SIZE, max-number-of-elements=1, base-type=UINT8
package /BMW/Platform/Omc/SwComponentTypes/DiagnosticEvents
  diagnostic event VsmEventOpmode: aging-allowed=false, clear-event-behavior=NO-STATUS-BYTE-CHANGE, event-failure-cycle-counter-threshold=1, event-kind=SWC
package /BMW/Platform/Omc/SwComponentTypes/DiagnosticMappings
  diagnostic event to debounce algorithm mapping VSM_EVENT_OPMODEToDebounceAlgorithmMapping: debounce-algorithm=DebounceMonitorInternal, diagnostic-event=VsmEventOpmode
  diagnostic event to trouble code uds mapping VSM_EVENT_OPMODEToTroubleCodeUdsMapping: diagnostic-event=VsmEventOpmode, trouble-code-uds=DTC_023000
package /BMW/Platform/Omc/SwComponentTypes/DiagnosticRoutines
  diagnostic routine ControlExtendedEnergySavingState_Routine: id=4099
    start START_ControlExtendedEnergySavingState
      diagnostic-parameter bit-offset=0:
        diagnostic data element dataIn: base-type=uint8
  diagnostic routine Energiesparmode_Routine: id=3852
    start START_Energiesparmode
      diagnostic-parameter bit-offset=0:
        diagnostic data element dataIn: base-type=uint8
package /BMW/Platform/Omc/SwComponentTypes/DiagnosticServiceInstances
  diagnostic routine control ControlExtendedEnergySavingState: access-permission=ControlExtendedEnergySavingState_AccessPermission, routine-control-class=RoutineControl, routine=ControlExtendedEnergySavingState_Routine
  diagnostic routine control Energiesparmode: access-permission=Energiesparmode_AccessPermission, routine-control-class=RoutineControl, routine=Energiesparmode_Routine
  diagnostic read data by identifier RDBI_EnergySavingState: access-permission=RDBI_EnergySavingState_AccessPermission, data-identifier=Did_EnergySavingState, read-class=ReadDataByIdentifier
  diagnostic read data by identifier RDBI_ExtendedEnergySavingState: access-permission=RDBI_ExtendedEnergySavingState_AccessPermission, data-identifier=Did_ExtendedEnergySavingState, read-class=ReadDataByIdentifier
package /BMW/Platform/Prog/SwComponentTypes/DiagnosticAccessPermissions
  diagnostic access permission DeleteSwPackage_AccessPermission: diagnostic-session=PROGRAMMING_SESSION
package /BMW/Platform/Prog/SwComponentTypes/DiagnosticRoutines
  diagnostic routine DeleteSwPackage_Routine: id=544
    start START_DeleteSwPackage
package /BMW/Platform/Prog/SwComponentTypes/DiagnosticServiceInstances
  diagnostic routine control DeleteSwPackage: access-permission=DeleteSwPackage_AccessPermission, routine-control-class=RoutineControl, routine=DeleteSwPackage_Routine
package /BMW/Platform/StdDiag/SwComponentTypes/DiagnosticAccessPermissions
  4 x diagnostic access permission:
    DiagCommLoopback_AccessPermission: diagnostic-session=[DEFAULT_SESSION, EXTENDED_DIAGNOSTIC_SESSION]
    IsLoeschen_AccessPermission: diagnostic-session=[DEFAULT_SESSION, EXTENDED_DIAGNOSTIC_SESSION, GarageMode]
    RDBI_ActiveDiagnosticSession_AccessPermission: diagnostic-session=[DEFAULT_SESSION, EXTENDED_DIAGNOSTIC_SESSION, GarageMode, PROGRAMMING_SESSION]
    RcCppc_AccessPermission: diagnostic-session=[DEFAULT_SESSION, EXTENDED_DIAGNOSTIC_SESSION]
package /BMW/Platform/StdDiag/SwComponentTypes/DiagnosticDataIdentifiers
  diagnostic data identifier Did_ActiveDiagnosticSession: id=61830
    diagnostic-parameter bit-offset=0:
      diagnostic data element ActiveDiagnosticSession: array-size-semantics=VARIABLE-SIZE, max-number-of-elements=1, base-type=UINT8
package /BMW/Platform/StdDiag/SwComponentTypes/DiagnosticRoutines
  diagnostic routine DiagCommLoopback_Routine: id=771
    start START_DiagCommLoopback
      diagnostic-parameter bit-offset=0:
        diagnostic data element dataIn: array-size-semantics=VARIABLE-SIZE
      diagnostic-parameter bit-offset=0:
        diagnostic data element dataOut: array-size-semantics=VARIABLE-SIZE
  diagnostic routine IsLoeschen_Routine: id=3846
    start START_IsLoeschen
  diagnostic routine RcCppc_Routine: id=515
    start START_RcCppc
      diagnostic-parameter bit-offset=0:
        diagnostic data element dataOut: array-size-semantics=VARIABLE-SIZE
package /BMW/Platform/StdDiag/SwComponentTypes/DiagnosticServiceInstances
  diagnostic routine control DiagCommLoopback: access-permission=DiagCommLoopback_AccessPermission, routine-control-class=RoutineControl, routine=DiagCommLoopback_Routine
  diagnostic routine control IsLoeschen: access-permission=IsLoeschen_AccessPermission, routine-control-class=RoutineControl, routine=IsLoeschen_Routine
  diagnostic read data by identifier RDBI_ActiveDiagnosticSession: access-permission=RDBI_ActiveDiagnosticSession_AccessPermission, data-identifier=Did_ActiveDiagnosticSession, read-class=ReadDataByIdentifier
  diagnostic routine control RcCppc: access-permission=RcCppc_AccessPermission, routine-control-class=RoutineControl, routine=RcCppc_Routine
package /BMW/Platform/SysTime/SwComponentTypes/DiagnosticAccessPermissions
  diagnostic access permission RDBI_Systemzeit_AccessPermission: diagnostic-session=[DEFAULT_SESSION, EXTENDED_DIAGNOSTIC_SESSION]
package /BMW/Platform/SysTime/SwComponentTypes/DiagnosticDataIdentifiers
  diagnostic data identifier Did_Systemzeit: id=5889
    diagnostic-parameter bit-offset=0:
      diagnostic data element Systemzeit: array-size-semantics=VARIABLE-SIZE, max-number-of-elements=4, base-type=UINT8
package /BMW/Platform/SysTime/SwComponentTypes/DiagnosticServiceInstances
  diagnostic read data by identifier RDBI_Systemzeit: access-permission=RDBI_Systemzeit_AccessPermission, data-identifier=Did_Systemzeit, read-class=ReadDataByIdentifier
