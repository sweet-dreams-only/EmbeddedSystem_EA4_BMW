AUTOSAR XML (schema 4-2-2)
package /BMW/SystemComposition
  composition sw component type SystemComponent
    component EPSInstance: type=EPSComponent
