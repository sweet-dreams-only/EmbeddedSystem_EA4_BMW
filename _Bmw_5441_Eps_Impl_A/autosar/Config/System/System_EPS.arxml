AUTOSAR XML (schema 4-2-2)
package /Systems
  system EPS: category=ECU_SYSTEM_DESCRIPTION, pnc-vector-length=6, pnc-vector-offset=2, system-version=0.0.1
