AUTOSAR XML (schema 4-3-0)
standard types defined: SINT16, UINT8
package /Systems/DiagnosticSwBaseTypes
  base type SINT32_BE: category=FIXED_LENGTH, base-type-size=32, base-type-encoding=2C, byte-order=big-endian
  base type SINT8_BE: category=FIXED_LENGTH, base-type-size=8, base-type-encoding=2C, byte-order=big-endian
  base type UINT8_BE: category=FIXED_LENGTH, base-type-size=8, base-type-encoding=NONE, byte-order=big-endian
