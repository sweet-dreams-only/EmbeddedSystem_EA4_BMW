AUTOSAR XML (schema 4-3-0)
package /BMW/Diagnostics/ComponentsWithoutQualifiedName/DiagnosticAccessPermissions
  diagnostic access permission RDBI_Readhwmodificationindex_AccessPermission: diagnostic-session=[DEFAULT_SESSION, EXTENDED_DIAGNOSTIC_SESSION, PROGRAMMING_SESSION]
package /BMW/Diagnostics/ComponentsWithoutQualifiedName/DiagnosticDataIdentifiers
  diagnostic data identifier Did_Readhwmodificationindex: id=61778
    diagnostic-parameter bit-offset=0:
      diagnostic data element Readhwmodificationindex: array-size-semantics=VARIABLE-SIZE, max-number-of-elements=2, base-type=UINT8
package /BMW/Diagnostics/ComponentsWithoutQualifiedName/DiagnosticServiceInstances
  diagnostic read data by identifier RDBI_Readhwmodificationindex: access-permission=RDBI_Readhwmodificationindex_AccessPermission, data-identifier=Did_Readhwmodificationindex, read-class=ReadDataByIdentifier
package /BMW/Diagnostics/Ecus/DiagnosticAccessPermissions
  37 x diagnostic access permission:
    ClearDiagnosticInformation_AccessPermission: diagnostic-session=[DEFAULT_SESSION, EXTENDED_DIAGNOSTIC_SESSION, GarageMode]
    CommunicationControl_0x{00..03}_AccessPermission: diagnostic-session=EXTENDED_DIAGNOSTIC_SESSION
    CommunicationControl_AccessPermission: diagnostic-session=EXTENDED_DIAGNOSTIC_SESSION
    ControlDtcSetting_0x01_AccessPermission: diagnostic-session=EXTENDED_DIAGNOSTIC_SESSION
    ControlDtcSetting_0x02_AccessPermission: diagnostic-session=EXTENDED_DIAGNOSTIC_SESSION
    ControlDtcSetting_AccessPermission: diagnostic-session=EXTENDED_DIAGNOSTIC_SESSION
    DiagnosticSessionControl_0x01_AccessPermission: diagnostic-session=[DEFAULT_SESSION, DEVELOPMENT_SESSION, EXTENDED_DIAGNOSTIC_SESSION]
    DiagnosticSessionControl_0x02_AccessPermission: diagnostic-session=[EXTENDED_DIAGNOSTIC_SESSION, PROGRAMMING_SESSION]
    DiagnosticSessionControl_0x03_AccessPermission: diagnostic-session=[DEFAULT_SESSION, EXTENDED_DIAGNOSTIC_SESSION, GarageMode]
    DiagnosticSessionControl_0x41_AccessPermission: diagnostic-session=[CODING_SESSION, EXTENDED_DIAGNOSTIC_SESSION]
    DiagnosticSessionControl_0x44_AccessPermission: diagnostic-session=[EXTENDED_DIAGNOSTIC_SESSION, RSU_SESSION]
    DiagnosticSessionControl_0x5F_AccessPermission: diagnostic-session=GarageMode
    DiagnosticSessionControl_AccessPermission: diagnostic-session=[CODING_SESSION, DEFAULT_SESSION, DEVELOPMENT_SESSION, EXTENDED_DIAGNOSTIC_SESSION, GarageMode, PROGRAMMING_SESSION, RSU_SESSION]
    EcuReset_0x01_AccessPermission: diagnostic-session=[DEFAULT_SESSION, EXTENDED_DIAGNOSTIC_SESSION]
    EcuReset_AccessPermission: diagnostic-session=[DEFAULT_SESSION, EXTENDED_DIAGNOSTIC_SESSION]
    ReadDataByIdentifier_AccessPermission: diagnostic-session=[CODING_SESSION, DEFAULT_SESSION, EXTENDED_DIAGNOSTIC_SESSION, GarageMode, PROGRAMMING_SESSION]
    ReadDtcInformation_0x02_AccessPermission: diagnostic-session=[DEFAULT_SESSION, EXTENDED_DIAGNOSTIC_SESSION]
    ReadDtcInformation_0x04_AccessPermission: diagnostic-session=[DEFAULT_SESSION, EXTENDED_DIAGNOSTIC_SESSION]
    ReadDtcInformation_0x06_AccessPermission: diagnostic-session=[DEFAULT_SESSION, EXTENDED_DIAGNOSTIC_SESSION]
    ReadDtcInformation_0x0A_AccessPermission: diagnostic-session=[CODING_SESSION, DEFAULT_SESSION, EXTENDED_DIAGNOSTIC_SESSION]
    ReadDtcInformation_0x{17..19}_AccessPermission: diagnostic-session=[DEFAULT_SESSION, EXTENDED_DIAGNOSTIC_SESSION]
    ReadDtcInformation_AccessPermission: diagnostic-session=[CODING_SESSION, DEFAULT_SESSION, EXTENDED_DIAGNOSTIC_SESSION]
    RequestDownload_AccessPermission: diagnostic-session=PROGRAMMING_SESSION
    RequestTransferExit_AccessPermission: diagnostic-session=PROGRAMMING_SESSION
    ResponseOnEvent_0x04_AccessPermission: diagnostic-session=[DEFAULT_SESSION, EXTENDED_DIAGNOSTIC_SESSION]
    ResponseOnEvent_0x40_AccessPermission: diagnostic-session=[DEFAULT_SESSION, EXTENDED_DIAGNOSTIC_SESSION]
    ResponseOnEvent_0x45_AccessPermission: diagnostic-session=[DEFAULT_SESSION, EXTENDED_DIAGNOSTIC_SESSION]
    ResponseOnEvent_AccessPermission: diagnostic-session=[DEFAULT_SESSION, EXTENDED_DIAGNOSTIC_SESSION]
    RoutineControl_AccessPermission: diagnostic-session=[CODING_SESSION, DEFAULT_SESSION, EXTENDED_DIAGNOSTIC_SESSION, GarageMode, PROGRAMMING_SESSION, SYSTEM_SUPPLIER_SPECIFIC_61]
    SecurityAccess_AccessPermission: diagnostic-session=PROGRAMMING_SESSION
    TransferData_AccessPermission: diagnostic-session=PROGRAMMING_SESSION
    WriteDataByIdentifier_AccessPermission: diagnostic-session=[DEFAULT_SESSION, EXTENDED_DIAGNOSTIC_SESSION, GarageMode, PROGRAMMING_SESSION]
package /BMW/Diagnostics/Ecus/DiagnosticContributionSets
  diagnostic contribution set EPS_DiagnosticsInterface: category=DIAGNOSTICS_ECU_EXTRACT, service-tables=EPS_DCM_UDS_ON_FLEXRAY
    common-properties aging-requires-tested-cycle=true, clear-dtc-limitation=ALL-SUPPORTED-DTCS, default-endianness=big-endian, event-displacement-strategy=FULL, max-number-of-request-correctly-received-response-pending=2, memory-entry-storage-trigger=TEST-FAILED, occurrence-counter-processing=TEST-FAILED-BIT, reset-confirmed-bit-on-overflow=true, response-on-all-request-sids=false, response-on-second-declined-request=true, security-delay-time-on-boot=0.0, status-bit-handling-test-failed-since-last-clear=STATUS-BIT-AGING-AND-DISPLACEMENT, status-bit-storage-test-failed=true, type-of-dtc-supported=ISO-14229--1, type-of-freeze-frame-record-numeration=CALCULATED:
      diagnostic debounce algorithm props DebounceMonitorInternal
        debounce-algorithm:
          diag event debounce monitor internal DebounceMonitorInternal
    elements:
      EPS_DCM_UDS_ON_FLEXRAY
      Did_Readhwmodificationindex
      RDBI_Readhwmodificationindex_AccessPermission
      DEFAULT_SESSION
      PROGRAMMING_SESSION
      EXTENDED_DIAGNOSTIC_SESSION
      ReadDataByIdentifier_AccessPermission
      CODING_SESSION
      GarageMode
      RDBI_Readhwmodificationindex
      ClearDiagnosticInformation_AccessPermission
      ClearDiagnosticInformation
      ClearDiagnosticInformation
      CommunicationControl_AccessPermission
      CommunicationControl
      CommunicationControl_0x00_AccessPermission
      CommunicationControl_0x00
      CommunicationControl_0x01_AccessPermission
      CommunicationControl_0x01
      CommunicationControl_0x02_AccessPermission
      CommunicationControl_0x02
      CommunicationControl_0x03_AccessPermission
      CommunicationControl_0x03
      ControlDtcSetting_AccessPermission
      ControlDtcSetting
      ControlDtcSetting_0x01_AccessPermission
      ControlDtcSetting_0x01
      ControlDtcSetting_0x02_AccessPermission
      ControlDtcSetting_0x02
      DiagnosticSessionControl_AccessPermission
      DEVELOPMENT_SESSION
      RSU_SESSION
      DiagnosticSessionControl
      DiagnosticSessionControl_0x01_AccessPermission
      DiagnosticSessionControl_0x01
      DiagnosticSessionControl_0x02_AccessPermission
      DiagnosticSessionControl_0x02
      DiagnosticSessionControl_0x03_AccessPermission
      DiagnosticSessionControl_0x03
      DiagnosticSessionControl_0x41_AccessPermission
      DiagnosticSessionControl_0x41
      DiagnosticSessionControl_0x44_AccessPermission
      DiagnosticSessionControl_0x44
      DiagnosticSessionControl_0x5F_AccessPermission
      DiagnosticSessionControl_0x5F
      EcuReset_AccessPermission
      EcuReset
      EcuReset_0x01_AccessPermission
      EcuReset_0x01
      ReadDataByIdentifier
      ReadDtcInformation_AccessPermission
      ReadDtcInformation
      ReadDtcInformation_0x0A_AccessPermission
      ReadDtcInformation_0x0A
      ReadDtcInformation_0x02_AccessPermission
      ReadDtcInformation_0x02
      ReadDtcInformation_0x17_AccessPermission
      ReadDtcInformation_0x17
      ReadDtcInformation_0x18_AccessPermission
      ReadDtcInformation_0x18
      ReadDtcInformation_0x19_AccessPermission
      ReadDtcInformation_0x19
      ReadDtcInformation_0x04_AccessPermission
      ReadDtcInformation_0x04
      ReadDtcInformation_0x06_AccessPermission
      ReadDtcInformation_0x06
      RequestDownload_AccessPermission
      RequestDownload
      RequestDownload
      RequestTransferExit_AccessPermission
      RequestTransferExit
      RequestTransferExit
      ResponseOnEvent_AccessPermission
      ResponseOnEvent
      ResponseOnEvent_0x04_AccessPermission
      ResponseOnEvent_0x04
      ResponseOnEvent_0x40_AccessPermission
      ResponseOnEvent_0x40
      ResponseOnEvent_0x45_AccessPermission
      ResponseOnEvent_0x45
      RoutineControl_AccessPermission
      SYSTEM_SUPPLIER_SPECIFIC_61
      RoutineControl
      SecurityAccess_AccessPermission
      SecurityAccess
      TransferData_AccessPermission
      TransferData
      TransferData
      WriteDataByIdentifier_AccessPermission
      WriteDataByIdentifier
      EPS
      CheckNcd_AccessPermission
      CheckNcd
      CheckNcd_Routine
      EpsInitialisierungService_AccessPermission
      EpsInitialisierungService
      EpsInitialisierungService_Routine
      EpsInitialisierungWerk_AccessPermission
      EpsInitialisierungWerk
      EpsInitialisierungWerk_Routine
      EpsLenkwinkelsensorKalibrierungReset_AccessPermission
      EpsLenkwinkelsensorKalibrierungReset
      EpsLenkwinkelsensorKalibrierungReset_Routine
      EpsPendeln_AccessPermission
      EpsPendeln
      EpsPendeln_Routine
      EpsVerfahren_AccessPermission
      EpsVerfahren
      EpsVerfahren_Routine
      EpsZahnstangenmitteReset_AccessPermission
      EpsZahnstangenmitteReset
      EpsZahnstangenmitteReset_Routine
      RcCm_AccessPermission
      RcCm
      RcCm_Routine
      RcCpd_AccessPermission
      RcCpd
      RcCpd_Routine
      RcEm_AccessPermission
      RcEm
      RcEm_Routine
      ReadNcd_AccessPermission
      ReadNcd
      ReadNcd_Routine
      SteuernEpsMultiturnwertReset_AccessPermission
      SteuernEpsMultiturnwertReset
      SteuernEpsMultiturnwertReset_Routine
      SteuernEpsPulldriftOffsetReset_AccessPermission
      SteuernEpsPulldriftOffsetReset
      SteuernEpsPulldriftOffsetReset_Routine
      WriteNcd_AccessPermission
      WriteNcd
      WriteNcd_Routine
      Did_EpsLenkwinkelsensorKalibrierung
      RDBI_EpsLenkwinkelsensorKalibrierung_AccessPermission
      RDBI_EpsLenkwinkelsensorKalibrierung
      WBDI_EpsLenkwinkelsensorKalibrierung_AccessPermission
      WBDI_EpsLenkwinkelsensorKalibrierung
      Did_EpsMomentensensor
      RDBI_EpsMomentensensor_AccessPermission
      RDBI_EpsMomentensensor
      Did_EpsRitzelwinkelsensor
      RDBI_EpsRitzelwinkelsensor_AccessPermission
      RDBI_EpsRitzelwinkelsensor
      Did_EpsZahnstangenmitte
      RDBI_EpsZahnstangenmitte_AccessPermission
      RDBI_EpsZahnstangenmitte
      Did_GelernterZahnstangenweg
      RDBI_GelernterZahnstangenweg_AccessPermission
      RDBI_GelernterZahnstangenweg
      Did_MileKmEeprom
      RDBI_MileKmEeprom_AccessPermission
      RDBI_MileKmEeprom
      Did_Pruefstempel
      RDBI_Pruefstempel_AccessPermission
      RDBI_Pruefstempel
      WBDI_Pruefstempel_AccessPermission
      WBDI_Pruefstempel
      Did_ReadActiveSessionState
      RDBI_ReadActiveSessionState_AccessPermission
      RDBI_ReadActiveSessionState
      Did_ReadProtocolData
      RDBI_ReadProtocolData_AccessPermission
      RDBI_ReadProtocolData
      Did_ReadSwRevision
      RDBI_ReadSwRevision_AccessPermission
      RDBI_ReadSwRevision
      Did_StatusCalcvn
      RDBI_StatusCalcvn_AccessPermission
      RDBI_StatusCalcvn
      Did_StatusFzgBordnetz
      RDBI_StatusFzgBordnetz_AccessPermission
      RDBI_StatusFzgBordnetz
      Did_SystemSupplierIdentifier
      RDBI_SystemSupplierIdentifier_AccessPermission
      RDBI_SystemSupplierIdentifier
      FrsmEClusterSyncLoss
      DTC_D50420
      DTC_D50420_Props
      ConditionByte
      OccurrenceCounter
      HealingCounter
      KmStand
      FUwBn
      Systemzeit
      DiagnosticDataIdentifiers/DemFreezeFrames_83016745
      PrimaryMemoryDestination_EPS_DiagnosticsInterface
      FRSM_E_CLUSTER_SYNC_LOSSToTroubleCodeUdsMapping
      FRSM_E_CLUSTER_SYNC_LOSSToDebounceAlgorithmMapping
      FrtrcvEFrBuserrorTrcv0
      DTC_D5041F
      DTC_D5041F_Props
      FRTRCV_E_FR_BUSERROR_TRCV0ToTroubleCodeUdsMapping
      FRTRCV_E_FR_BUSERROR_TRCV0ToDebounceAlgorithmMapping
      GlobalOvervoltageExt
      DTC_023043
      DTC_023043_Props
      Fahrzeuggeschwindigkeit
      Betriebsspannung
      Aussentemperatur
      DemFreezeFrames_293b5c37
      GLOBAL_OVERVOLTAGE_EXTToTroubleCodeUdsMapping
      GLOBAL_OVERVOLTAGE_EXTToDebounceAlgorithmMapping
      GlobalOvervoltageInt
      DTC_023042
      DTC_023042_Props
      GLOBAL_OVERVOLTAGE_INTToTroubleCodeUdsMapping
      GLOBAL_OVERVOLTAGE_INTToDebounceAlgorithmMapping
      GlobalUndervoltageExt
      DTC_023045
      DTC_023045_Props
      GLOBAL_UNDERVOLTAGE_EXTToTroubleCodeUdsMapping
      GLOBAL_UNDERVOLTAGE_EXTToDebounceAlgorithmMapping
      GlobalUndervoltageInt
      DTC_023044
      DTC_023044_Props
      GLOBAL_UNDERVOLTAGE_INTToTroubleCodeUdsMapping
      GLOBAL_UNDERVOLTAGE_INTToDebounceAlgorithmMapping
      LocalOvervoltage
      DTC_023040
      DTC_023040_Props
      LOCAL_OVERVOLTAGEToTroubleCodeUdsMapping
      LOCAL_OVERVOLTAGEToDebounceAlgorithmMapping
      LocalUndervoltage
      DTC_023041
      DTC_023041_Props
      LOCAL_UNDERVOLTAGEToTroubleCodeUdsMapping
      LOCAL_UNDERVOLTAGEToDebounceAlgorithmMapping
      Aussentemperatur
      Betriebsspannung
      FUwBn
      Fahrzeuggeschwindigkeit
      KmStand
      Systemzeit
      Did_Cps
      RDBI_Cps_AccessPermission
      RDBI_Cps
      CodingEventNotCoded
      DTC_023008
      DTC_023008_Props
      DiagnosticDataIdentifiers/DemFreezeFrames_83016745
      CODING_EVENT_NOT_CODEDToTroubleCodeUdsMapping
      CODING_EVENT_NOT_CODEDToDebounceAlgorithmMapping
      CodingEventUnqualifiedData
      DTC_02300A
      DTC_02300A_Props
      CODING_EVENT_UNQUALIFIED_DATAToTroubleCodeUdsMapping
      CODING_EVENT_UNQUALIFIED_DATAToDebounceAlgorithmMapping
      CodingEventWrongVehicle
      DTC_023009
      DTC_023009_Props
      CODING_EVENT_WRONG_VEHICLEToTroubleCodeUdsMapping
      CODING_EVENT_WRONG_VEHICLEToDebounceAlgorithmMapping
      DmClientTriggerDtcEntry_AccessPermission
      DmClientTriggerDtcEntry
      DmClientTriggerDtcEntry_Routine
      Did_DmDtcAktiveMeldung
      RDBI_DmDtcAktiveMeldung_AccessPermission
      RDBI_DmDtcAktiveMeldung
      Did_DmIsDtcActiveResponse
      RDBI_DmIsDtcActiveResponse_AccessPermission
      RDBI_DmIsDtcActiveResponse
      DmTestAppl
      DTC_02FF30
      DTC_02FF30_Props
      DiagnosticDataIdentifiers/DemFreezeFrames_83016745
      DM_TEST_APPLToTroubleCodeUdsMapping
      DM_TEST_APPLToDebounceAlgorithmMapping
      DmTestCom
      DTC_D50BFF
      DTC_D50BFF_Props
      DM_TEST_COMToTroubleCodeUdsMapping
      DM_TEST_COMToDebounceAlgorithmMapping
      RcRswedi_AccessPermission
      RcRswedi
      RcRswedi_Routine
      Did_EcuSerialNumber
      RDBI_EcuSerialNumber_AccessPermission
      RDBI_EcuSerialNumber
      Did_FlashTimingParameter
      RDBI_FlashTimingParameter_AccessPermission
      RDBI_FlashTimingParameter
      Did_Herstelldatum
      RDBI_Herstelldatum_AccessPermission
      RDBI_Herstelldatum
      Did_ProgrammingCounter
      RDBI_ProgrammingCounter_AccessPermission
      RDBI_ProgrammingCounter
      Did_ProgrammingCounterMaxValue
      RDBI_ProgrammingCounterMaxValue_AccessPermission
      RDBI_ProgrammingCounterMaxValue
      Did_SgbdIdx
      RDBI_SgbdIdx_AccessPermission
      RDBI_SgbdIdx
      Did_SvkAktuell
      RDBI_SvkAktuell_AccessPermission
      RDBI_SvkAktuell
      Did_SvkSysSupplier
      RDBI_SvkSysSupplier_AccessPermission
      RDBI_SvkSysSupplier
      Did_SvkWerk
      RDBI_SvkWerk_AccessPermission
      RDBI_SvkWerk
      Did_SwfkDeleteSupported
      RDBI_SwfkDeleteSupported_AccessPermission
      RDBI_SwfkDeleteSupported
      Did_WdbiFp
      WBDI_WdbiFp_AccessPermission
      WBDI_WdbiFp
      ControlExtendedEnergySavingState_AccessPermission
      ControlExtendedEnergySavingState
      ControlExtendedEnergySavingState_Routine
      Energiesparmode_AccessPermission
      Energiesparmode
      Energiesparmode_Routine
      Did_EnergySavingState
      RDBI_EnergySavingState_AccessPermission
      RDBI_EnergySavingState
      Did_ExtendedEnergySavingState
      RDBI_ExtendedEnergySavingState_AccessPermission
      RDBI_ExtendedEnergySavingState
      VsmEventOpmode
      DTC_023000
      DTC_023000_Props
      DiagnosticDataIdentifiers/DemFreezeFrames_83016745
      VSM_EVENT_OPMODEToTroubleCodeUdsMapping
      VSM_EVENT_OPMODEToDebounceAlgorithmMapping
      DeleteSwPackage_AccessPermission
      DeleteSwPackage
      DeleteSwPackage_Routine
      DiagCommLoopback_AccessPermission
      DiagCommLoopback
      DiagCommLoopback_Routine
      IsLoeschen_AccessPermission
      IsLoeschen
      IsLoeschen_Routine
      RcCppc_AccessPermission
      RcCppc
      RcCppc_Routine
      Did_ActiveDiagnosticSession
      RDBI_ActiveDiagnosticSession_AccessPermission
      RDBI_ActiveDiagnosticSession
      Did_Systemzeit
      RDBI_Systemzeit_AccessPermission
      RDBI_Systemzeit
package /BMW/Diagnostics/Ecus/DiagnosticEcuInstancePropss
  diagnostic ecu instance props EPS: ecu-instance=EPS, obd-support=SECONDARY-ECU
package /BMW/Diagnostics/Ecus/DiagnosticExtendedDataRecords
  diagnostic extended data record ConditionByte: record-number=1, update=true
    diagnostic-parameter bit-offset=0:
      diagnostic data element ConditionByte: base-type=uint8
  diagnostic extended data record HealingCounter: record-number=3, update=true
    diagnostic-parameter bit-offset=0:
      diagnostic data element HealingCounter: base-type=uint8
  diagnostic extended data record OccurrenceCounter: record-number=2, update=true
    diagnostic-parameter bit-offset=0:
      diagnostic data element OccurrenceCounter: base-type=uint8
package /BMW/Diagnostics/Ecus/DiagnosticMemoryDestinations
  diagnostic memory destination primary PrimaryMemoryDestination_EPS_DiagnosticsInterface
package /BMW/Diagnostics/Ecus/DiagnosticProtocols
  14 x diagnostic connection:
    DiagnosticConnection_0xF{0..9}
    DiagnosticConnection_0xFA
    DiagnosticConnection_0xFB
    DiagnosticConnection_0xFC
    DiagnosticConnection_0xFD
package /BMW/Diagnostics/Ecus/DiagnosticServiceClasses
  diagnostic clear diagnostic information class ClearDiagnosticInformation: access-permission=ClearDiagnosticInformation_AccessPermission, access-permission-validity=ACCESS-PERMISSION-INSTANCE-OVERRIDES-CLASS
  diagnostic com control class CommunicationControl: access-permission=CommunicationControl_AccessPermission, access-permission-validity=ACCESS-PERMISSION-INSTANCE-OVERRIDES-CLASS
  diagnostic control dtc setting class ControlDtcSetting: access-permission=ControlDtcSetting_AccessPermission, access-permission-validity=ACCESS-PERMISSION-INSTANCE-OVERRIDES-CLASS
  diagnostic session control class DiagnosticSessionControl: access-permission=DiagnosticSessionControl_AccessPermission, access-permission-validity=ACCESS-PERMISSION-INSTANCE-OVERRIDES-CLASS
  diagnostic ecu reset class EcuReset: access-permission=EcuReset_AccessPermission, access-permission-validity=ACCESS-PERMISSION-INSTANCE-OVERRIDES-CLASS
  diagnostic read data by identifier class ReadDataByIdentifier: access-permission=ReadDataByIdentifier_AccessPermission, access-permission-validity=ACCESS-PERMISSION-INSTANCE-OVERRIDES-CLASS, max-did-to-read=1
  diagnostic read dtc information class ReadDtcInformation: access-permission=ReadDtcInformation_AccessPermission, access-permission-validity=ACCESS-PERMISSION-INSTANCE-OVERRIDES-CLASS
  diagnostic request download class RequestDownload: access-permission=RequestDownload_AccessPermission, access-permission-validity=ACCESS-PERMISSION-INSTANCE-OVERRIDES-CLASS
  diagnostic transfer exit class RequestTransferExit: access-permission=RequestTransferExit_AccessPermission, access-permission-validity=ACCESS-PERMISSION-INSTANCE-OVERRIDES-CLASS
  diagnostic response on event class ResponseOnEvent: access-permission=ResponseOnEvent_AccessPermission, access-permission-validity=ACCESS-PERMISSION-INSTANCE-OVERRIDES-CLASS
  diagnostic routine control class RoutineControl: access-permission=RoutineControl_AccessPermission, access-permission-validity=ACCESS-PERMISSION-INSTANCE-OVERRIDES-CLASS
  diagnostic security access class SecurityAccess: access-permission=SecurityAccess_AccessPermission, access-permission-validity=ACCESS-PERMISSION-INSTANCE-OVERRIDES-CLASS
  diagnostic data transfer class TransferData: access-permission=TransferData_AccessPermission, access-permission-validity=ACCESS-PERMISSION-INSTANCE-OVERRIDES-CLASS
  diagnostic write data by identifier class WriteDataByIdentifier: access-permission=WriteDataByIdentifier_AccessPermission, access-permission-validity=ACCESS-PERMISSION-INSTANCE-OVERRIDES-CLASS
package /BMW/Diagnostics/Ecus/DiagnosticServiceInstances
  diagnostic clear diagnostic information ClearDiagnosticInformation: access-permission=ClearDiagnosticInformation_AccessPermission, clear-diagnostic-information-class=ClearDiagnosticInformation
  4 x diagnostic com control, all with com-control-class=CommunicationControl:
    CommunicationControl_0x00: category=ENABLE_RX_AND_TX, access-permission=CommunicationControl_0x00_AccessPermission
    CommunicationControl_0x01: category=DISABLE_RX_AND_TX, access-permission=CommunicationControl_0x01_AccessPermission
    CommunicationControl_0x02: category=ENABLE_RX_AND_DISABLE_TX, access-permission=CommunicationControl_0x02_AccessPermission
    CommunicationControl_0x03: category=DISABLE_RX_AND_ENABLE_TX, access-permission=CommunicationControl_0x03_AccessPermission
  diagnostic control dtc setting ControlDtcSetting_0x01: category=BMW_ON, access-permission=ControlDtcSetting_0x01_AccessPermission, dtc-setting-class=ControlDtcSetting, dtc-setting-parameter=1
  diagnostic control dtc setting ControlDtcSetting_0x02: category=BMW_OFF, access-permission=ControlDtcSetting_0x02_AccessPermission, dtc-setting-class=ControlDtcSetting, dtc-setting-parameter=2
  6 x diagnostic session control, all with session-control-class=DiagnosticSessionControl:
    DiagnosticSessionControl_0x01: access-permission=DiagnosticSessionControl_0x01_AccessPermission, diagnostic-session=DEFAULT_SESSION
    DiagnosticSessionControl_0x02: access-permission=DiagnosticSessionControl_0x02_AccessPermission, diagnostic-session=PROGRAMMING_SESSION
    DiagnosticSessionControl_0x03: access-permission=DiagnosticSessionControl_0x03_AccessPermission, diagnostic-session=EXTENDED_DIAGNOSTIC_SESSION
    DiagnosticSessionControl_0x41: access-permission=DiagnosticSessionControl_0x41_AccessPermission, diagnostic-session=CODING_SESSION
    DiagnosticSessionControl_0x44: access-permission=DiagnosticSessionControl_0x44_AccessPermission, diagnostic-session=RSU_SESSION
    DiagnosticSessionControl_0x5F: access-permission=DiagnosticSessionControl_0x5F_AccessPermission, diagnostic-session=GarageMode
  diagnostic ecu reset EcuReset_0x01: category=HARD_RESET, access-permission=EcuReset_0x01_AccessPermission, ecu-reset-class=EcuReset, respond-to-reset=RESPOND-BEFORE-RESET
  7 x diagnostic read dtc information, all with read-dtc-information-class=ReadDtcInformation:
    ReadDtcInformation_0x02: category=REPORT_DTC_BY_STATUS_MASK, access-permission=ReadDtcInformation_0x02_AccessPermission
    ReadDtcInformation_0x04: category=REPORT_DTC_SNAPSHOT_RECORD_BY_DTC_NUMBER, access-permission=ReadDtcInformation_0x04_AccessPermission
    ReadDtcInformation_0x06: category=REPORT_DTC_EXT_DATA_RECORD_BY_DTC_NUMBER, access-permission=ReadDtcInformation_0x06_AccessPermission
    ReadDtcInformation_0x0A: category=REPORT_SUPPORTED_DTC, access-permission=ReadDtcInformation_0x0A_AccessPermission
    ReadDtcInformation_0x17: category=REPORT_USER_DEF_MEMORY_DTC_BY_STATUS_MASK, access-permission=ReadDtcInformation_0x17_AccessPermission
    ReadDtcInformation_0x18: category=REPORT_USER_DEF_MEMORY_DTC_SNAPSHOT_RECORD_BY_DTC_NUMBER, access-permission=ReadDtcInformation_0x18_AccessPermission
    ReadDtcInformation_0x19: category=REPORT_USER_DEF_MEMORY_DTC_EXT_DATA_RECORD_BY_DTC_NUMBER, access-permission=ReadDtcInformation_0x19_AccessPermission
  diagnostic request download RequestDownload: access-permission=RequestDownload_AccessPermission, request-download-class=RequestDownload
  diagnostic transfer exit RequestTransferExit: access-permission=RequestTransferExit_AccessPermission, transfer-exit-class=RequestTransferExit
  diagnostic response on event ResponseOnEvent_0x04: access-permission=ResponseOnEvent_0x04_AccessPermission, response-on-event-class=ResponseOnEvent
  diagnostic response on event ResponseOnEvent_0x40: access-permission=ResponseOnEvent_0x40_AccessPermission, response-on-event-class=ResponseOnEvent
  diagnostic response on event ResponseOnEvent_0x45: access-permission=ResponseOnEvent_0x45_AccessPermission, response-on-event-class=ResponseOnEvent
  diagnostic data transfer TransferData: access-permission=TransferData_AccessPermission, data-transfer-class=TransferData
package /BMW/Diagnostics/Ecus/DiagnosticServiceTables
  diagnostic service table EPS_DCM_UDS_ON_FLEXRAY:
    ecu-instance=EPS
    protocol-kind=DCM_UDS_ON_FLEXRAY
    service-instance=[CheckNcd, ClearDiagnosticInformation, CommunicationControl_0x00, CommunicationControl_0x01, CommunicationControl_0x02, CommunicationControl_0x03, ControlDtcSetting_0x01, ControlDtcSetting_0x02, ControlExtendedEnergySavingState, DeleteSwPackage, DiagCommLoopback, DiagnosticSessionControl_0x01, DiagnosticSessionControl_0x02, DiagnosticSessionControl_0x03, DiagnosticSessionControl_0x41, DiagnosticSessionControl_0x44, DiagnosticSessionControl_0x5F, DmClientTriggerDtcEntry, EcuReset_0x01, Energiesparmode, EpsInitialisierungService, EpsInitialisierungWerk, EpsLenkwinkelsensorKalibrierungReset, EpsPendeln, EpsVerfahren, EpsZahnstangenmitteReset, IsLoeschen, RDBI_ActiveDiagnosticSession, RDBI_Cps, RDBI_DmDtcAktiveMeldung, RDBI_DmIsDtcActiveResponse, RDBI_EcuSerialNumber, RDBI_EnergySavingState, RDBI_EpsLenkwinkelsensorKalibrierung, RDBI_EpsMomentensensor, RDBI_EpsRitzelwinkelsensor, RDBI_EpsZahnstangenmitte, RDBI_ExtendedEnergySavingState, RDBI_FlashTimingParameter, RDBI_GelernterZahnstangenweg, RDBI_Herstelldatum, RDBI_MileKmEeprom, RDBI_ProgrammingCounter, RDBI_ProgrammingCounterMaxValue, RDBI_Pruefstempel, RDBI_ReadActiveSessionState, RDBI_ReadProtocolData, RDBI_ReadSwRevision, RDBI_Readhwmodificationindex, RDBI_SgbdIdx, RDBI_StatusCalcvn, RDBI_StatusFzgBordnetz, RDBI_SvkAktuell, RDBI_SvkSysSupplier, RDBI_SvkWerk, RDBI_SwfkDeleteSupported, RDBI_SystemSupplierIdentifier, RDBI_Systemzeit, RcCm, RcCpd, RcCppc, RcEm, RcRswedi, ReadDtcInformation_0x02, ReadDtcInformation_0x04, ReadDtcInformation_0x06, ReadDtcInformation_0x0A, ReadDtcInformation_0x17, ReadDtcInformation_0x18, ReadDtcInformation_0x19, ReadNcd, RequestDownload, RequestTransferExit, ResponseOnEvent_0x04, ResponseOnEvent_0x40, ResponseOnEvent_0x45, SteuernEpsMultiturnwertReset, SteuernEpsPulldriftOffsetReset, TransferData, WBDI_EpsLenkwinkelsensorKalibrierung, WBDI_Pruefstempel, WBDI_WdbiFp, WriteNcd]
    diagnostic-connections:
      DiagnosticConnection_0xF{0..9}
      DiagnosticConnection_0xFA
      DiagnosticConnection_0xFB
      DiagnosticConnection_0xFC
      DiagnosticConnection_0xFD
package /BMW/Diagnostics/Sessions/Application
  8 x diagnostic session, all with category=BMW_APPLICATION, p-2-server-max=0.05, p-2-star-server-max=5.0:
    CODING_SESSION: id=65, jump-to-boot-loader=NO-BOOT
    DEFAULT_SESSION: id=1, jump-to-boot-loader=NO-BOOT
    DEVELOPMENT_SESSION: id=79, jump-to-boot-loader=NO-BOOT
    EXTENDED_DIAGNOSTIC_SESSION: id=3, jump-to-boot-loader=NO-BOOT
    GarageMode: id=95, jump-to-boot-loader=NO-BOOT
    PROGRAMMING_SESSION: id=2, jump-to-boot-loader=NO-BOOT
    RSU_SESSION: id=68, jump-to-boot-loader=NO-BOOT
    SYSTEM_SUPPLIER_SPECIFIC_61: id=97
package /BMW/Diagnostics/TroubleCodes/DiagnosticTroubleCodeProps
  14 x diagnostic trouble code props, all with immediate-nv-data-storage=false, max-number-freeze-frame-records=2, memory-destination=PrimaryMemoryDestination_EPS_DiagnosticsInterface:
    DTC_023000_Props: extended-data-records=[ConditionByte, OccurrenceCounter], freeze-frames=[KmStand, FUwBn, Systemzeit], freeze-frame-content=DiagnosticDataIdentifiers/DemFreezeFrames_83016745, significance=FAULT
    DTC_023008_Props: extended-data-records=[ConditionByte, OccurrenceCounter], freeze-frames=[KmStand, FUwBn, Systemzeit], freeze-frame-content=DiagnosticDataIdentifiers/DemFreezeFrames_83016745, significance=FAULT
    DTC_023009_Props: extended-data-records=[ConditionByte, OccurrenceCounter], freeze-frames=[KmStand, FUwBn, Systemzeit], freeze-frame-content=DiagnosticDataIdentifiers/DemFreezeFrames_83016745, significance=FAULT
    DTC_02300A_Props: extended-data-records=[ConditionByte, OccurrenceCounter], freeze-frames=[KmStand, FUwBn, Systemzeit], freeze-frame-content=DiagnosticDataIdentifiers/DemFreezeFrames_83016745, significance=FAULT
    DTC_023040_Props: extended-data-records=[ConditionByte, OccurrenceCounter], freeze-frames=[KmStand, FUwBn, Systemzeit, Fahrzeuggeschwindigkeit, Betriebsspannung, Aussentemperatur], freeze-frame-content=DemFreezeFrames_293b5c37, significance=FAULT
    DTC_023041_Props: extended-data-records=[ConditionByte, OccurrenceCounter], freeze-frames=[KmStand, FUwBn, Systemzeit, Fahrzeuggeschwindigkeit, Betriebsspannung, Aussentemperatur], freeze-frame-content=DemFreezeFrames_293b5c37, significance=FAULT
    DTC_{023042..023045}_Props: extended-data-records=[ConditionByte, OccurrenceCounter], freeze-frames=[KmStand, FUwBn, Systemzeit, Fahrzeuggeschwindigkeit, Betriebsspannung, Aussentemperatur], freeze-frame-content=DemFreezeFrames_293b5c37, significance=OCCURENCE
    DTC_02FF30_Props: extended-data-records=[ConditionByte, OccurrenceCounter], freeze-frames=[KmStand, FUwBn, Systemzeit], freeze-frame-content=DiagnosticDataIdentifiers/DemFreezeFrames_83016745, significance=OCCURENCE
    DTC_D5041F_Props: extended-data-records=[ConditionByte, OccurrenceCounter, HealingCounter], freeze-frames=[KmStand, FUwBn, Systemzeit], freeze-frame-content=DiagnosticDataIdentifiers/DemFreezeFrames_83016745, significance=FAULT
    DTC_D50420_Props: extended-data-records=[ConditionByte, OccurrenceCounter, HealingCounter], freeze-frames=[KmStand, FUwBn, Systemzeit], freeze-frame-content=DiagnosticDataIdentifiers/DemFreezeFrames_83016745, significance=FAULT
    DTC_D50BFF_Props: extended-data-records=[ConditionByte, OccurrenceCounter], freeze-frames=[KmStand, FUwBn, Systemzeit], freeze-frame-content=DiagnosticDataIdentifiers/DemFreezeFrames_83016745, significance=OCCURENCE
package /BMW/Diagnostics/TroubleCodes/DiagnosticTroubleCodes
  14 x diagnostic trouble code uds:
    DTC_023000: dtc-props=DTC_023000_Props, uds-dtc-value=143360
    DTC_023008: dtc-props=DTC_023008_Props, uds-dtc-value=143368
    DTC_023009: dtc-props=DTC_023009_Props, uds-dtc-value=143369
    DTC_02300A: dtc-props=DTC_02300A_Props, uds-dtc-value=143370
    DTC_023040: dtc-props=DTC_023040_Props, uds-dtc-value=143424
    DTC_023041: dtc-props=DTC_023041_Props, uds-dtc-value=143425
    DTC_023042: dtc-props=DTC_023042_Props, uds-dtc-value=143426
    DTC_023043: dtc-props=DTC_023043_Props, uds-dtc-value=143427
    DTC_023044: dtc-props=DTC_023044_Props, uds-dtc-value=143428
    DTC_023045: dtc-props=DTC_023045_Props, uds-dtc-value=143429
    DTC_02FF30: dtc-props=DTC_02FF30_Props, uds-dtc-value=196400
    DTC_D5041F: dtc-props=DTC_D5041F_Props, uds-dtc-value=13960223
    DTC_D50420: dtc-props=DTC_D50420_Props, uds-dtc-value=13960224
    DTC_D50BFF: dtc-props=DTC_D50BFF_Props, uds-dtc-value=13962239
package /BMW/Diagnostics/UnmappedZedisContent/DiagnosticAccessPermissions
  29 x diagnostic access permission:
    CheckNcd_AccessPermission: diagnostic-session=CODING_SESSION
    EpsInitialisierungService_AccessPermission: diagnostic-session=[DEFAULT_SESSION, EXTENDED_DIAGNOSTIC_SESSION, GarageMode]
    EpsInitialisierungWerk_AccessPermission: diagnostic-session=GarageMode
    EpsLenkwinkelsensorKalibrierungReset_AccessPermission: diagnostic-session=GarageMode
    EpsPendeln_AccessPermission: diagnostic-session=GarageMode
    EpsVerfahren_AccessPermission: diagnostic-session=GarageMode
    EpsZahnstangenmitteReset_AccessPermission: diagnostic-session=SYSTEM_SUPPLIER_SPECIFIC_61
    RDBI_EpsLenkwinkelsensorKalibrierung_AccessPermission: diagnostic-session=[DEFAULT_SESSION, EXTENDED_DIAGNOSTIC_SESSION, GarageMode]
    RDBI_EpsMomentensensor_AccessPermission: diagnostic-session=[DEFAULT_SESSION, EXTENDED_DIAGNOSTIC_SESSION, GarageMode]
    RDBI_EpsRitzelwinkelsensor_AccessPermission: diagnostic-session=[DEFAULT_SESSION, EXTENDED_DIAGNOSTIC_SESSION, GarageMode]
    RDBI_EpsZahnstangenmitte_AccessPermission: diagnostic-session=[CODING_SESSION, DEFAULT_SESSION, EXTENDED_DIAGNOSTIC_SESSION, PROGRAMMING_SESSION]
    RDBI_GelernterZahnstangenweg_AccessPermission: diagnostic-session=[DEFAULT_SESSION, EXTENDED_DIAGNOSTIC_SESSION]
    RDBI_MileKmEeprom_AccessPermission: diagnostic-session=[DEFAULT_SESSION, EXTENDED_DIAGNOSTIC_SESSION]
    RDBI_Pruefstempel_AccessPermission: diagnostic-session=[DEFAULT_SESSION, EXTENDED_DIAGNOSTIC_SESSION]
    RDBI_ReadActiveSessionState_AccessPermission: diagnostic-session=[DEFAULT_SESSION, EXTENDED_DIAGNOSTIC_SESSION, PROGRAMMING_SESSION]
    RDBI_ReadProtocolData_AccessPermission: diagnostic-session=[CODING_SESSION, DEFAULT_SESSION, EXTENDED_DIAGNOSTIC_SESSION]
    RDBI_ReadSwRevision_AccessPermission: diagnostic-session=[DEFAULT_SESSION, EXTENDED_DIAGNOSTIC_SESSION, PROGRAMMING_SESSION]
    RDBI_StatusCalcvn_AccessPermission: diagnostic-session=[DEFAULT_SESSION, EXTENDED_DIAGNOSTIC_SESSION]
    RDBI_StatusFzgBordnetz_AccessPermission: diagnostic-session=[DEFAULT_SESSION, EXTENDED_DIAGNOSTIC_SESSION]
    RDBI_SystemSupplierIdentifier_AccessPermission: diagnostic-session=[DEFAULT_SESSION, EXTENDED_DIAGNOSTIC_SESSION]
    RcCm_AccessPermission: diagnostic-session=PROGRAMMING_SESSION
    RcCpd_AccessPermission: diagnostic-session=PROGRAMMING_SESSION
    RcEm_AccessPermission: diagnostic-session=PROGRAMMING_SESSION
    ReadNcd_AccessPermission: diagnostic-session=[CODING_SESSION, DEFAULT_SESSION, EXTENDED_DIAGNOSTIC_SESSION]
    SteuernEpsMultiturnwertReset_AccessPermission: diagnostic-session=[DEFAULT_SESSION, EXTENDED_DIAGNOSTIC_SESSION, GarageMode]
    SteuernEpsPulldriftOffsetReset_AccessPermission: diagnostic-session=GarageMode
    WBDI_EpsLenkwinkelsensorKalibrierung_AccessPermission: diagnostic-session=[DEFAULT_SESSION, EXTENDED_DIAGNOSTIC_SESSION, GarageMode]
    WBDI_Pruefstempel_AccessPermission: diagnostic-session=[DEFAULT_SESSION, EXTENDED_DIAGNOSTIC_SESSION]
    WriteNcd_AccessPermission: diagnostic-session=CODING_SESSION
package /BMW/Diagnostics/UnmappedZedisContent/DiagnosticDataIdentifiers
  diagnostic data identifier Aussentemperatur: id=10245
    diagnostic-parameter bit-offset=0:
      diagnostic data element Aussentemperatur: base-type=SINT8_BE
  diagnostic data identifier Betriebsspannung: id=10342
    diagnostic-parameter bit-offset=0:
      diagnostic data element Betriebsspannung: base-type=uint8
  diagnostic data identifier set DemFreezeFrames_293b5c37: data-identifier=[Aussentemperatur, Betriebsspannung, FUwBn, Fahrzeuggeschwindigkeit, KmStand, Systemzeit]
  diagnostic data identifier set DemFreezeFrames_83016745: data-identifier=[FUwBn, KmStand, Systemzeit]
  17 x diagnostic data identifier:
    Did_EpsLenkwinkelsensorKalibrierung: id=56154
      diagnostic-parameter bit-offset=0:
        diagnostic data element EpsLenkwinkelsensorKalibrierung: array-size-semantics=VARIABLE-SIZE, max-number-of-elements=2, base-type=UINT8
    Did_EpsMomentensensor: id=56217
      diagnostic-parameter bit-offset=0:
        diagnostic data element EpsMomentensensor: array-size-semantics=VARIABLE-SIZE, max-number-of-elements=3, base-type=UINT8
    Did_EpsRitzelwinkelsensor: id=56151
      diagnostic-parameter bit-offset=0:
        diagnostic data element EpsRitzelwinkelsensor: array-size-semantics=VARIABLE-SIZE, max-number-of-elements=7, base-type=UINT8
    Did_EpsZahnstangenmitte: id=56439
      diagnostic-parameter bit-offset=0:
        diagnostic data element EpsZahnstangenmitte: array-size-semantics=VARIABLE-SIZE, max-number-of-elements=1, base-type=UINT8
    Did_GelernterZahnstangenweg: id=57309
      diagnostic-parameter bit-offset=0:
        diagnostic data element GelernterZahnstangenweg: array-size-semantics=VARIABLE-SIZE, max-number-of-elements=8, base-type=UINT8
    Did_MileKmEeprom: id=9536
      diagnostic-parameter bit-offset=0:
        diagnostic data element MileKmEeprom: array-size-semantics=VARIABLE-SIZE, max-number-of-elements=3, base-type=UINT8
    Did_Pruefstempel: id=4096
      diagnostic-parameter bit-offset=0:
        diagnostic data element Pruefstempel: array-size-semantics=VARIABLE-SIZE, max-number-of-elements=3, base-type=UINT8
    Did_ReadActiveSessionState: id=61696
      diagnostic-parameter bit-offset=0:
        diagnostic data element ReadActiveSessionState: array-size-semantics=VARIABLE-SIZE, base-type=UINT8
    Did_ReadProtocolData: id=14335
      diagnostic-parameter bit-offset=0:
        diagnostic data element ReadProtocolData: array-size-semantics=VARIABLE-SIZE, base-type=UINT8
    Did_ReadSwRevision: id=9483
      diagnostic-parameter bit-offset=0:
        diagnostic data element ReadSwRevision: array-size-semantics=VARIABLE-SIZE, base-type=UINT8
    Did_StatusCalcvn: id=9537
      diagnostic-parameter bit-offset=0:
        diagnostic data element StatusCalcvn: array-size-semantics=VARIABLE-SIZE, base-type=UINT8
    Did_StatusFzgBordnetz: id=56124
      diagnostic-parameter bit-offset=0:
        diagnostic data element StatusFzgBordnetz: array-size-semantics=VARIABLE-SIZE, max-number-of-elements=15, base-type=UINT8
    Did_SystemSupplierIdentifier: id=61834
      diagnostic-parameter bit-offset=0:
        diagnostic data element SystemSupplierIdentifier: array-size-semantics=VARIABLE-SIZE, max-number-of-elements=3, base-type=UINT8
    FUwBn: id=5968
      diagnostic-parameter bit-offset=0:
        diagnostic data element FUwBn: base-type=uint8
    Fahrzeuggeschwindigkeit: id=10343
      diagnostic-parameter bit-offset=0:
        diagnostic data element Fahrzeuggeschwindigkeit: base-type=uint8
    KmStand: id=5888
      diagnostic-parameter bit-offset=0:
        diagnostic data element KmStand: array-size-semantics=VARIABLE-SIZE, max-number-of-elements=3, base-type=UINT8_BE
    Systemzeit: id=5889
      diagnostic-parameter bit-offset=0:
        diagnostic data element Systemzeit: base-type=SINT32_BE
package /BMW/Diagnostics/UnmappedZedisContent/DiagnosticEvents
  8 x diagnostic event, all with event-kind=SWC:
    FrsmEClusterSyncLoss: aging-allowed=true
    FrtrcvEFrBuserrorTrcv0: aging-allowed=true, event-failure-cycle-counter-threshold=1
    GlobalOvervoltageExt: aging-allowed=false, event-failure-cycle-counter-threshold=1
    GlobalOvervoltageInt: aging-allowed=false, event-failure-cycle-counter-threshold=1
    GlobalUndervoltageExt: aging-allowed=false, event-failure-cycle-counter-threshold=1
    GlobalUndervoltageInt: aging-allowed=false, event-failure-cycle-counter-threshold=1
    LocalOvervoltage: aging-allowed=false, event-failure-cycle-counter-threshold=1
    LocalUndervoltage: aging-allowed=false, event-failure-cycle-counter-threshold=1
package /BMW/Diagnostics/UnmappedZedisContent/DiagnosticFreezeFrames
  6 x diagnostic freeze frame:
    Aussentemperatur
    Betriebsspannung
    FUwBn
    Fahrzeuggeschwindigkeit
    KmStand
    Systemzeit
package /BMW/Diagnostics/UnmappedZedisContent/DiagnosticMappings
  diagnostic event to debounce algorithm mapping FRSM_E_CLUSTER_SYNC_LOSSToDebounceAlgorithmMapping: debounce-algorithm=DebounceMonitorInternal, diagnostic-event=FrsmEClusterSyncLoss
  diagnostic event to trouble code uds mapping FRSM_E_CLUSTER_SYNC_LOSSToTroubleCodeUdsMapping: diagnostic-event=FrsmEClusterSyncLoss, trouble-code-uds=DTC_D50420
  diagnostic event to debounce algorithm mapping FRTRCV_E_FR_BUSERROR_TRCV0ToDebounceAlgorithmMapping: debounce-algorithm=DebounceMonitorInternal, diagnostic-event=FrtrcvEFrBuserrorTrcv0
  diagnostic event to trouble code uds mapping FRTRCV_E_FR_BUSERROR_TRCV0ToTroubleCodeUdsMapping: diagnostic-event=FrtrcvEFrBuserrorTrcv0, trouble-code-uds=DTC_D5041F
  diagnostic event to debounce algorithm mapping GLOBAL_OVERVOLTAGE_EXTToDebounceAlgorithmMapping: debounce-algorithm=DebounceMonitorInternal, diagnostic-event=GlobalOvervoltageExt
  diagnostic event to trouble code uds mapping GLOBAL_OVERVOLTAGE_EXTToTroubleCodeUdsMapping: diagnostic-event=GlobalOvervoltageExt, trouble-code-uds=DTC_023043
  diagnostic event to debounce algorithm mapping GLOBAL_OVERVOLTAGE_INTToDebounceAlgorithmMapping: debounce-algorithm=DebounceMonitorInternal, diagnostic-event=GlobalOvervoltageInt
  diagnostic event to trouble code uds mapping GLOBAL_OVERVOLTAGE_INTToTroubleCodeUdsMapping: diagnostic-event=GlobalOvervoltageInt, trouble-code-uds=DTC_023042
  diagnostic event to debounce algorithm mapping GLOBAL_UNDERVOLTAGE_EXTToDebounceAlgorithmMapping: debounce-algorithm=DebounceMonitorInternal, diagnostic-event=GlobalUndervoltageExt
  diagnostic event to trouble code uds mapping GLOBAL_UNDERVOLTAGE_EXTToTroubleCodeUdsMapping: diagnostic-event=GlobalUndervoltageExt, trouble-code-uds=DTC_023045
  diagnostic event to debounce algorithm mapping GLOBAL_UNDERVOLTAGE_INTToDebounceAlgorithmMapping: debounce-algorithm=DebounceMonitorInternal, diagnostic-event=GlobalUndervoltageInt
  diagnostic event to trouble code uds mapping GLOBAL_UNDERVOLTAGE_INTToTroubleCodeUdsMapping: diagnostic-event=GlobalUndervoltageInt, trouble-code-uds=DTC_023044
  diagnostic event to debounce algorithm mapping LOCAL_OVERVOLTAGEToDebounceAlgorithmMapping: debounce-algorithm=DebounceMonitorInternal, diagnostic-event=LocalOvervoltage
  diagnostic event to trouble code uds mapping LOCAL_OVERVOLTAGEToTroubleCodeUdsMapping: diagnostic-event=LocalOvervoltage, trouble-code-uds=DTC_023040
  diagnostic event to debounce algorithm mapping LOCAL_UNDERVOLTAGEToDebounceAlgorithmMapping: debounce-algorithm=DebounceMonitorInternal, diagnostic-event=LocalUndervoltage
  diagnostic event to trouble code uds mapping LOCAL_UNDERVOLTAGEToTroubleCodeUdsMapping: diagnostic-event=LocalUndervoltage, trouble-code-uds=DTC_023041
package /BMW/Diagnostics/UnmappedZedisContent/DiagnosticRoutines
  14 x diagnostic routine:
    CheckNcd_Routine: id=14334
      start START_CheckNcd
        diagnostic-parameter bit-offset=0:
          diagnostic data element Cps: array-size-semantics=VARIABLE-SIZE, max-number-of-elements=18, base-type=UINT8_BE
        diagnostic-parameter bit-offset=0:
          diagnostic data element StatCheckNcdResult: base-type=uint8
    EpsInitialisierungService_Routine: id=43884
      request result RESULT_EpsInitialisierungService
        diagnostic-parameter bit-offset=0:
          diagnostic data element StatRoutineStatus: base-type=uint8
        diagnostic-parameter bit-offset=8:
          diagnostic data element StatLenkradwinkelWert: base-type=SINT16
        diagnostic-parameter bit-offset=24:
          diagnostic data element StatSensorZustandNr: base-type=uint8
      start START_EpsInitialisierungService
      stop STOP_EpsInitialisierungService
    EpsInitialisierungWerk_Routine: id=43890
      request result RESULT_EpsInitialisierungWerk
        diagnostic-parameter bit-offset=0:
          diagnostic data element StatRoutineStatus: base-type=uint8
      start START_EpsInitialisierungWerk
        diagnostic-parameter bit-offset=0:
          diagnostic data element Winkel: base-type=uint8
        diagnostic-parameter bit-offset=8:
          diagnostic data element Winkelgeschwindigkeit: base-type=uint8
        diagnostic-parameter bit-offset=16:
          diagnostic data element Winkelbeschleunigung: base-type=uint8
    EpsLenkwinkelsensorKalibrierungReset_Routine: id=43881
      start START_EpsLenkwinkelsensorKalibrierungReset
    EpsPendeln_Routine: id=43862
      request result RESULT_EpsPendeln
        diagnostic-parameter bit-offset=0:
          diagnostic data element StatEpsPendelnAktivNr: base-type=uint8
      start START_EpsPendeln
        diagnostic-parameter bit-offset=0:
          diagnostic data element Frequenz: base-type=uint8
        diagnostic-parameter bit-offset=8:
          diagnostic data element MaxAmplitude: base-type=uint8
        diagnostic-parameter bit-offset=16:
          diagnostic data element NumberOfCycles: base-type=uint8
    EpsVerfahren_Routine: id=43889
      request result RESULT_EpsVerfahren
        diagnostic-parameter bit-offset=0:
          diagnostic data element StatEpsVerfahrenAktivNr: base-type=uint8
      start START_EpsVerfahren
        diagnostic-parameter bit-offset=0:
          diagnostic data element Winkel: base-type=SINT16
        diagnostic-parameter bit-offset=16:
          diagnostic data element Winkelgeschwindigkeit: base-type=uint8
        diagnostic-parameter bit-offset=24:
          diagnostic data element Winkelbeschleunigung: base-type=uint8
        diagnostic-parameter bit-offset=32:
          diagnostic data element AbsolutEin: base-type=uint8
    EpsZahnstangenmitteReset_Routine: id=43900
      start START_EpsZahnstangenmitteReset
    RcCm_Routine: id=514
      start START_RcCm
        diagnostic-parameter bit-offset=0:
          diagnostic data element RcCmIcvRcoStruct
        diagnostic-parameter bit-offset=0:
          diagnostic data element StatRoutineStatus: base-type=uint8
    RcCpd_Routine: id=65281
      start START_RcCpd
        diagnostic-parameter bit-offset=0:
          diagnostic data element StatRoutineStatus: base-type=uint8
    RcEm_Routine: id=65280
      start START_RcEm
        diagnostic-parameter bit-offset=0:
          diagnostic data element RcEmIeRco
        diagnostic-parameter bit-offset=0:
          diagnostic data element StatRoutineStatus: base-type=uint8
    ReadNcd_Routine: id=14332
      start START_ReadNcd
        diagnostic-parameter bit-offset=0:
          diagnostic data element ArgCodingArea: array-size-semantics=VARIABLE-SIZE, max-number-of-elements=6, base-type=UINT8_BE
        diagnostic-parameter bit-offset=0:
          diagnostic data element StatCodingArea: array-size-semantics=VARIABLE-SIZE, max-number-of-elements=1, base-type=UINT8_BE
    SteuernEpsMultiturnwertReset_Routine: id=43901
      start START_SteuernEpsMultiturnwertReset
    SteuernEpsPulldriftOffsetReset_Routine: id=41659
      start START_SteuernEpsPulldriftOffsetReset
    WriteNcd_Routine: id=14333
      start START_WriteNcd
        diagnostic-parameter bit-offset=0:
          diagnostic data element ArgCodingArea: array-size-semantics=VARIABLE-SIZE, max-number-of-elements=1, base-type=UINT8_BE
package /BMW/Diagnostics/UnmappedZedisContent/DiagnosticServiceInstances
  7 x diagnostic routine control, all with routine-control-class=RoutineControl:
    CheckNcd: access-permission=CheckNcd_AccessPermission, routine=CheckNcd_Routine
    EpsInitialisierungService: access-permission=EpsInitialisierungService_AccessPermission, routine=EpsInitialisierungService_Routine
    EpsInitialisierungWerk: access-permission=EpsInitialisierungWerk_AccessPermission, routine=EpsInitialisierungWerk_Routine
    EpsLenkwinkelsensorKalibrierungReset: access-permission=EpsLenkwinkelsensorKalibrierungReset_AccessPermission, routine=EpsLenkwinkelsensorKalibrierungReset_Routine
    EpsPendeln: access-permission=EpsPendeln_AccessPermission, routine=EpsPendeln_Routine
    EpsVerfahren: access-permission=EpsVerfahren_AccessPermission, routine=EpsVerfahren_Routine
    EpsZahnstangenmitteReset: access-permission=EpsZahnstangenmitteReset_AccessPermission, routine=EpsZahnstangenmitteReset_Routine
  13 x diagnostic read data by identifier, all with read-class=ReadDataByIdentifier:
    RDBI_EpsLenkwinkelsensorKalibrierung: access-permission=RDBI_EpsLenkwinkelsensorKalibrierung_AccessPermission, data-identifier=Did_EpsLenkwinkelsensorKalibrierung
    RDBI_EpsMomentensensor: access-permission=RDBI_EpsMomentensensor_AccessPermission, data-identifier=Did_EpsMomentensensor
    RDBI_EpsRitzelwinkelsensor: access-permission=RDBI_EpsRitzelwinkelsensor_AccessPermission, data-identifier=Did_EpsRitzelwinkelsensor
    RDBI_EpsZahnstangenmitte: access-permission=RDBI_EpsZahnstangenmitte_AccessPermission, data-identifier=Did_EpsZahnstangenmitte
    RDBI_GelernterZahnstangenweg: access-permission=RDBI_GelernterZahnstangenweg_AccessPermission, data-identifier=Did_GelernterZahnstangenweg
    RDBI_MileKmEeprom: access-permission=RDBI_MileKmEeprom_AccessPermission, data-identifier=Did_MileKmEeprom
    RDBI_Pruefstempel: access-permission=RDBI_Pruefstempel_AccessPermission, data-identifier=Did_Pruefstempel
    RDBI_ReadActiveSessionState: access-permission=RDBI_ReadActiveSessionState_AccessPermission, data-identifier=Did_ReadActiveSessionState
    RDBI_ReadProtocolData: access-permission=RDBI_ReadProtocolData_AccessPermission, data-identifier=Did_ReadProtocolData
    RDBI_ReadSwRevision: access-permission=RDBI_ReadSwRevision_AccessPermission, data-identifier=Did_ReadSwRevision
    RDBI_StatusCalcvn: access-permission=RDBI_StatusCalcvn_AccessPermission, data-identifier=Did_StatusCalcvn
    RDBI_StatusFzgBordnetz: access-permission=RDBI_StatusFzgBordnetz_AccessPermission, data-identifier=Did_StatusFzgBordnetz
    RDBI_SystemSupplierIdentifier: access-permission=RDBI_SystemSupplierIdentifier_AccessPermission, data-identifier=Did_SystemSupplierIdentifier
  6 x diagnostic routine control, all with routine-control-class=RoutineControl:
    RcCm: access-permission=RcCm_AccessPermission, routine=RcCm_Routine
    RcCpd: access-permission=RcCpd_AccessPermission, routine=RcCpd_Routine
    RcEm: access-permission=RcEm_AccessPermission, routine=RcEm_Routine
    ReadNcd: access-permission=ReadNcd_AccessPermission, routine=ReadNcd_Routine
    SteuernEpsMultiturnwertReset: access-permission=SteuernEpsMultiturnwertReset_AccessPermission, routine=SteuernEpsMultiturnwertReset_Routine
    SteuernEpsPulldriftOffsetReset: access-permission=SteuernEpsPulldriftOffsetReset_AccessPermission, routine=SteuernEpsPulldriftOffsetReset_Routine
  diagnostic write data by identifier WBDI_EpsLenkwinkelsensorKalibrierung: access-permission=WBDI_EpsLenkwinkelsensorKalibrierung_AccessPermission, data-identifier=Did_EpsLenkwinkelsensorKalibrierung, write-class=WriteDataByIdentifier
  diagnostic write data by identifier WBDI_Pruefstempel: access-permission=WBDI_Pruefstempel_AccessPermission, data-identifier=Did_Pruefstempel, write-class=WriteDataByIdentifier
  diagnostic routine control WriteNcd: access-permission=WriteNcd_AccessPermission, routine-control-class=RoutineControl, routine=WriteNcd_Routine
package /BMW/Platform/Coding/SwComponentTypes/DiagnosticAccessPermissions
  diagnostic access permission RDBI_Cps_AccessPermission: diagnostic-session=[CODING_SESSION, DEFAULT_SESSION, EXTENDED_DIAGNOSTIC_SESSION]
package /BMW/Platform/Coding/SwComponentTypes/DiagnosticDataIdentifiers
  diagnostic data identifier set DemFreezeFrames_83016745: data-identifier=[FUwBn, KmStand, Systemzeit]
  diagnostic data identifier Did_Cps: id=14334
    diagnostic-parameter bit-offset=0:
      diagnostic data element Cps: array-size-semantics=VARIABLE-SIZE, max-number-of-elements=18, base-type=UINT8
package /BMW/Platform/Coding/SwComponentTypes/DiagnosticEvents
  diagnostic event CodingEventNotCoded: aging-allowed=false, clear-event-behavior=NO-STATUS-BYTE-CHANGE, event-failure-cycle-counter-threshold=1, event-kind=SWC
  diagnostic event CodingEventUnqualifiedData: aging-allowed=false, event-failure-cycle-counter-threshold=1, event-kind=SWC
  diagnostic event CodingEventWrongVehicle: aging-allowed=false, event-failure-cycle-counter-threshold=1, event-kind=SWC
package /BMW/Platform/Coding/SwComponentTypes/DiagnosticMappings
  diagnostic event to debounce algorithm mapping CODING_EVENT_NOT_CODEDToDebounceAlgorithmMapping: debounce-algorithm=DebounceMonitorInternal, diagnostic-event=CodingEventNotCoded
  diagnostic event to trouble code uds mapping CODING_EVENT_NOT_CODEDToTroubleCodeUdsMapping: diagnostic-event=CodingEventNotCoded, trouble-code-uds=DTC_023008
  diagnostic event to debounce algorithm mapping CODING_EVENT_UNQUALIFIED_DATAToDebounceAlgorithmMapping: debounce-algorithm=DebounceMonitorInternal, diagnostic-event=CodingEventUnqualifiedData
  diagnostic event to trouble code uds mapping CODING_EVENT_UNQUALIFIED_DATAToTroubleCodeUdsMapping: diagnostic-event=CodingEventUnqualifiedData, trouble-code-uds=DTC_02300A
  diagnostic event to debounce algorithm mapping CODING_EVENT_WRONG_VEHICLEToDebounceAlgorithmMapping: debounce-algorithm=DebounceMonitorInternal, diagnostic-event=CodingEventWrongVehicle
  diagnostic event to trouble code uds mapping CODING_EVENT_WRONG_VEHICLEToTroubleCodeUdsMapping: diagnostic-event=CodingEventWrongVehicle, trouble-code-uds=DTC_023009
package /BMW/Platform/Coding/SwComponentTypes/DiagnosticServiceInstances
  diagnostic read data by identifier RDBI_Cps: access-permission=RDBI_Cps_AccessPermission, data-identifier=Did_Cps, read-class=ReadDataByIdentifier
package /BMW/Platform/Darh/SwComponentTypes/DiagnosticAccessPermissions
  diagnostic access permission DmClientTriggerDtcEntry_AccessPermission: diagnostic-session=[DEFAULT_SESSION, EXTENDED_DIAGNOSTIC_SESSION]
  diagnostic access permission RDBI_DmDtcAktiveMeldung_AccessPermission: diagnostic-session=[DEFAULT_SESSION, EXTENDED_DIAGNOSTIC_SESSION]
  diagnostic access permission RDBI_DmIsDtcActiveResponse_AccessPermission: diagnostic-session=[DEFAULT_SESSION, EXTENDED_DIAGNOSTIC_SESSION]
package /BMW/Platform/Darh/SwComponentTypes/DiagnosticDataIdentifiers
  diagnostic data identifier set DemFreezeFrames_83016745: data-identifier=[FUwBn, KmStand, Systemzeit]
  diagnostic data identifier Did_DmDtcAktiveMeldung: id=5892
    diagnostic-parameter bit-offset=0:
      diagnostic data element DmDtcAktiveMeldung: array-size-semantics=VARIABLE-SIZE, base-type=UINT8
  diagnostic data identifier Did_DmIsDtcActiveResponse: id=5923
    diagnostic-parameter bit-offset=0:
      diagnostic data element DmIsDtcActiveResponse: array-size-semantics=VARIABLE-SIZE, base-type=UINT8
package /BMW/Platform/Darh/SwComponentTypes/DiagnosticEvents
  diagnostic event DmTestAppl: aging-allowed=false, event-failure-cycle-counter-threshold=1, event-kind=SWC
  diagnostic event DmTestCom: aging-allowed=false, event-failure-cycle-counter-threshold=1, event-kind=SWC
package /BMW/Platform/Darh/SwComponentTypes/DiagnosticMappings
  diagnostic event to debounce algorithm mapping DM_TEST_APPLToDebounceAlgorithmMapping: debounce-algorithm=DebounceMonitorInternal, diagnostic-event=DmTestAppl
  diagnostic event to trouble code uds mapping DM_TEST_APPLToTroubleCodeUdsMapping: diagnostic-event=DmTestAppl, trouble-code-uds=DTC_02FF30
  diagnostic event to debounce algorithm mapping DM_TEST_COMToDebounceAlgorithmMapping: debounce-algorithm=DebounceMonitorInternal, diagnostic-event=DmTestCom
  diagnostic event to trouble code uds mapping DM_TEST_COMToTroubleCodeUdsMapping: diagnostic-event=DmTestCom, trouble-code-uds=DTC_D50BFF
package /BMW/Platform/Darh/SwComponentTypes/DiagnosticRoutines
  diagnostic routine DmClientTriggerDtcEntry_Routine: id=772
    start START_DmClientTriggerDtcEntry
      diagnostic-parameter bit-offset=0:
        diagnostic data element DTCType: base-type=uint8
      diagnostic-parameter bit-offset=0:
        diagnostic data element DTCTypeOut: base-type=uint8
      diagnostic-parameter bit-offset=8:
        diagnostic data element DTCByte1: base-type=uint8
      diagnostic-parameter bit-offset=16:
        diagnostic data element DTCByte2: base-type=uint8
      diagnostic-parameter bit-offset=24:
        diagnostic data element DTCByte3: base-type=uint8
package /BMW/Platform/Darh/SwComponentTypes/DiagnosticServiceInstances
  diagnostic routine control DmClientTriggerDtcEntry: access-permission=DmClientTriggerDtcEntry_AccessPermission, routine-control-class=RoutineControl, routine=DmClientTriggerDtcEntry_Routine
  diagnostic read data by identifier RDBI_DmDtcAktiveMeldung: access-permission=RDBI_DmDtcAktiveMeldung_AccessPermission, data-identifier=Did_DmDtcAktiveMeldung, read-class=ReadDataByIdentifier
  diagnostic read data by identifier RDBI_DmIsDtcActiveResponse: access-permission=RDBI_DmIsDtcActiveResponse_AccessPermission, data-identifier=Did_DmIsDtcActiveResponse, read-class=ReadDataByIdentifier
package /BMW/Platform/Dlog/SwComponentTypes/DiagnosticAccessPermissions
  12 x diagnostic access permission:
    RDBI_EcuSerialNumber_AccessPermission: diagnostic-session=[DEFAULT_SESSION, EXTENDED_DIAGNOSTIC_SESSION, PROGRAMMING_SESSION]
    RDBI_FlashTimingParameter_AccessPermission: diagnostic-session=[DEFAULT_SESSION, EXTENDED_DIAGNOSTIC_SESSION, PROGRAMMING_SESSION]
    RDBI_Herstelldatum_AccessPermission: diagnostic-session=[DEFAULT_SESSION, EXTENDED_DIAGNOSTIC_SESSION, PROGRAMMING_SESSION]
    RDBI_ProgrammingCounterMaxValue_AccessPermission: diagnostic-session=[DEFAULT_SESSION, EXTENDED_DIAGNOSTIC_SESSION, PROGRAMMING_SESSION]
    RDBI_ProgrammingCounter_AccessPermission: diagnostic-session=[DEFAULT_SESSION, EXTENDED_DIAGNOSTIC_SESSION, PROGRAMMING_SESSION]
    RDBI_SgbdIdx_AccessPermission: diagnostic-session=[DEFAULT_SESSION, EXTENDED_DIAGNOSTIC_SESSION]
    RDBI_SvkAktuell_AccessPermission: diagnostic-session=[DEFAULT_SESSION, EXTENDED_DIAGNOSTIC_SESSION, GarageMode, PROGRAMMING_SESSION]
    RDBI_SvkSysSupplier_AccessPermission: diagnostic-session=[DEFAULT_SESSION, EXTENDED_DIAGNOSTIC_SESSION, PROGRAMMING_SESSION]
    RDBI_SvkWerk_AccessPermission: diagnostic-session=[DEFAULT_SESSION, EXTENDED_DIAGNOSTIC_SESSION, PROGRAMMING_SESSION]
    RDBI_SwfkDeleteSupported_AccessPermission: diagnostic-session=[DEFAULT_SESSION, EXTENDED_DIAGNOSTIC_SESSION, PROGRAMMING_SESSION]
    RcRswedi_AccessPermission: diagnostic-session=[DEFAULT_SESSION, EXTENDED_DIAGNOSTIC_SESSION]
    WBDI_WdbiFp_AccessPermission: diagnostic-session=PROGRAMMING_SESSION
package /BMW/Platform/Dlog/SwComponentTypes/DiagnosticDataIdentifiers
  11 x diagnostic data identifier:
    Did_EcuSerialNumber: id=61836
      diagnostic-parameter bit-offset=0:
        diagnostic data element EcuSerialNumber: array-size-semantics=VARIABLE-SIZE, max-number-of-elements=10, base-type=UINT8
    Did_FlashTimingParameter: id=9476
      diagnostic-parameter bit-offset=0:
        diagnostic data element FlashTimingParameter: array-size-semantics=VARIABLE-SIZE, max-number-of-elements=12, base-type=UINT8
    Did_Herstelldatum: id=61835
      diagnostic-parameter bit-offset=0:
        diagnostic data element Herstelldatum: array-size-semantics=VARIABLE-SIZE, max-number-of-elements=3, base-type=UINT8
    Did_ProgrammingCounter: id=9474
      diagnostic-parameter bit-offset=0:
        diagnostic data element ProgrammingCounter: array-size-semantics=VARIABLE-SIZE, max-number-of-elements=4, base-type=UINT8
    Did_ProgrammingCounterMaxValue: id=9475
      diagnostic-parameter bit-offset=0:
        diagnostic data element ProgrammingCounterMaxValue: array-size-semantics=VARIABLE-SIZE, max-number-of-elements=2, base-type=UINT8
    Did_SgbdIdx: id=61776
      diagnostic-parameter bit-offset=0:
        diagnostic data element SgbdIdx: array-size-semantics=VARIABLE-SIZE, max-number-of-elements=3, base-type=UINT8
    Did_SvkAktuell: id=61697
      diagnostic-parameter bit-offset=0:
        diagnostic data element SvkAktuell: array-size-semantics=VARIABLE-SIZE, base-type=UINT8
    Did_SvkSysSupplier: id=61698
      diagnostic-parameter bit-offset=0:
        diagnostic data element SvkSysSupplier: array-size-semantics=VARIABLE-SIZE, base-type=UINT8
    Did_SvkWerk: id=61699
      diagnostic-parameter bit-offset=0:
        diagnostic data element SvkWerk: array-size-semantics=VARIABLE-SIZE, base-type=UINT8
    Did_SwfkDeleteSupported: id=9479
      diagnostic-parameter bit-offset=0:
        diagnostic data element SwfkDeleteSupported: array-size-semantics=VARIABLE-SIZE, max-number-of-elements=1, base-type=UINT8
    Did_WdbiFp: id=61786
      diagnostic-parameter bit-offset=0:
        diagnostic data element WdbiFp: array-size-semantics=VARIABLE-SIZE, base-type=UINT8
package /BMW/Platform/Dlog/SwComponentTypes/DiagnosticRoutines
  diagnostic routine RcRswedi_Routine: id=517
    start START_RcRswedi
      diagnostic-parameter bit-offset=0:
        diagnostic data element DataIn: array-size-semantics=VARIABLE-SIZE, max-number-of-elements=8
      diagnostic-parameter bit-offset=0:
        diagnostic data element DataOut: array-size-semantics=VARIABLE-SIZE, max-number-of-elements=128
package /BMW/Platform/Dlog/SwComponentTypes/DiagnosticServiceInstances
  10 x diagnostic read data by identifier, all with read-class=ReadDataByIdentifier:
    RDBI_EcuSerialNumber: access-permission=RDBI_EcuSerialNumber_AccessPermission, data-identifier=Did_EcuSerialNumber
    RDBI_FlashTimingParameter: access-permission=RDBI_FlashTimingParameter_AccessPermission, data-identifier=Did_FlashTimingParameter
    RDBI_Herstelldatum: access-permission=RDBI_Herstelldatum_AccessPermission, data-identifier=Did_Herstelldatum
    RDBI_ProgrammingCounter: access-permission=RDBI_ProgrammingCounter_AccessPermission, data-identifier=Did_ProgrammingCounter
    RDBI_ProgrammingCounterMaxValue: access-permission=RDBI_ProgrammingCounterMaxValue_AccessPermission, data-identifier=Did_ProgrammingCounterMaxValue
    RDBI_SgbdIdx: access-permission=RDBI_SgbdIdx_AccessPermission, data-identifier=Did_SgbdIdx
    RDBI_SvkAktuell: access-permission=RDBI_SvkAktuell_AccessPermission, data-identifier=Did_SvkAktuell
    RDBI_SvkSysSupplier: access-permission=RDBI_SvkSysSupplier_AccessPermission, data-identifier=Did_SvkSysSupplier
    RDBI_SvkWerk: access-permission=RDBI_SvkWerk_AccessPermission, data-identifier=Did_SvkWerk
    RDBI_SwfkDeleteSupported: access-permission=RDBI_SwfkDeleteSupported_AccessPermission, data-identifier=Did_SwfkDeleteSupported
  diagnostic routine control RcRswedi: access-permission=RcRswedi_AccessPermission, routine-control-class=RoutineControl, routine=RcRswedi_Routine
  diagnostic write data by identifier WBDI_WdbiFp: access-permission=WBDI_WdbiFp_AccessPermission, data-identifier=Did_WdbiFp, write-class=WriteDataByIdentifier
package /BMW/Platform/Omc/SwComponentTypes/DiagnosticAccessPermissions
  4 x diagnostic access permission:
    ControlExtendedEnergySavingState_AccessPermission: diagnostic-session=[DEFAULT_SESSION, EXTENDED_DIAGNOSTIC_SESSION]
    Energiesparmode_AccessPermission: diagnostic-session=[DEFAULT_SESSION, EXTENDED_DIAGNOSTIC_SESSION]
    RDBI_EnergySavingState_AccessPermission: diagnostic-session=[DEFAULT_SESSION, EXTENDED_DIAGNOSTIC_SESSION, PROGRAMMING_SESSION]
    RDBI_ExtendedEnergySavingState_AccessPermission: diagnostic-session=[DEFAULT_SESSION, EXTENDED_DIAGNOSTIC_SESSION, PROGRAMMING_SESSION]
package /BMW/Platform/Omc/SwComponentTypes/DiagnosticDataIdentifiers
  diagnostic data identifier set DemFreezeFrames_83016745: data-identifier=[FUwBn, KmStand, Systemzeit]
  diagnostic data identifier Did_EnergySavingState: id=4106
    diagnostic-parameter bit-offset=0:
      diagnostic data element EnergySavingState: array-size-semantics=VARIABLE-SIZE, max-number-of-elements=1, base-type=UINT8
  diagnostic data identifier Did_ExtendedEnergySavingState: id=4110
    diagnostic-parameter bit-offset=0:
      diagnostic data element ExtendedEnergySavingState: array-size-semantics=VARIABLE-SIZE, max-number-of-elements=1, base-type=UINT8
package /BMW/Platform/Omc/SwComponentTypes/DiagnosticEvents
  diagnostic event VsmEventOpmode: aging-allowed=false, clear-event-behavior=NO-STATUS-BYTE-CHANGE, event-failure-cycle-counter-threshold=1, event-kind=SWC
package /BMW/Platform/Omc/SwComponentTypes/DiagnosticMappings
  diagnostic event to debounce algorithm mapping VSM_EVENT_OPMODEToDebounceAlgorithmMapping: debounce-algorithm=DebounceMonitorInternal, diagnostic-event=VsmEventOpmode
  diagnostic event to trouble code uds mapping VSM_EVENT_OPMODEToTroubleCodeUdsMapping: diagnostic-event=VsmEventOpmode, trouble-code-uds=DTC_023000
package /BMW/Platform/Omc/SwComponentTypes/DiagnosticRoutines
  diagnostic routine ControlExtendedEnergySavingState_Routine: id=4099
    start START_ControlExtendedEnergySavingState
      diagnostic-parameter bit-offset=0:
        diagnostic data element dataIn: base-type=uint8
  diagnostic routine Energiesparmode_Routine: id=3852
    start START_Energiesparmode
      diagnostic-parameter bit-offset=0:
        diagnostic data element dataIn: base-type=uint8
package /BMW/Platform/Omc/SwComponentTypes/DiagnosticServiceInstances
  diagnostic routine control ControlExtendedEnergySavingState: access-permission=ControlExtendedEnergySavingState_AccessPermission, routine-control-class=RoutineControl, routine=ControlExtendedEnergySavingState_Routine
  diagnostic routine control Energiesparmode: access-permission=Energiesparmode_AccessPermission, routine-control-class=RoutineControl, routine=Energiesparmode_Routine
  diagnostic read data by identifier RDBI_EnergySavingState: access-permission=RDBI_EnergySavingState_AccessPermission, data-identifier=Did_EnergySavingState, read-class=ReadDataByIdentifier
  diagnostic read data by identifier RDBI_ExtendedEnergySavingState: access-permission=RDBI_ExtendedEnergySavingState_AccessPermission, data-identifier=Did_ExtendedEnergySavingState, read-class=ReadDataByIdentifier
package /BMW/Platform/Prog/SwComponentTypes/DiagnosticAccessPermissions
  diagnostic access permission DeleteSwPackage_AccessPermission: diagnostic-session=PROGRAMMING_SESSION
package /BMW/Platform/Prog/SwComponentTypes/DiagnosticRoutines
  diagnostic routine DeleteSwPackage_Routine: id=544
    start START_DeleteSwPackage
package /BMW/Platform/Prog/SwComponentTypes/DiagnosticServiceInstances
  diagnostic routine control DeleteSwPackage: access-permission=DeleteSwPackage_AccessPermission, routine-control-class=RoutineControl, routine=DeleteSwPackage_Routine
package /BMW/Platform/StdDiag/SwComponentTypes/DiagnosticAccessPermissions
  4 x diagnostic access permission:
    DiagCommLoopback_AccessPermission: diagnostic-session=[DEFAULT_SESSION, EXTENDED_DIAGNOSTIC_SESSION]
    IsLoeschen_AccessPermission: diagnostic-session=[DEFAULT_SESSION, EXTENDED_DIAGNOSTIC_SESSION, GarageMode]
    RDBI_ActiveDiagnosticSession_AccessPermission: diagnostic-session=[DEFAULT_SESSION, EXTENDED_DIAGNOSTIC_SESSION, GarageMode, PROGRAMMING_SESSION]
    RcCppc_AccessPermission: diagnostic-session=[DEFAULT_SESSION, EXTENDED_DIAGNOSTIC_SESSION]
package /BMW/Platform/StdDiag/SwComponentTypes/DiagnosticDataIdentifiers
  diagnostic data identifier Did_ActiveDiagnosticSession: id=61830
    diagnostic-parameter bit-offset=0:
      diagnostic data element ActiveDiagnosticSession: array-size-semantics=VARIABLE-SIZE, max-number-of-elements=1, base-type=UINT8
package /BMW/Platform/StdDiag/SwComponentTypes/DiagnosticRoutines
  diagnostic routine DiagCommLoopback_Routine: id=771
    start START_DiagCommLoopback
      diagnostic-parameter bit-offset=0:
        diagnostic data element dataIn: array-size-semantics=VARIABLE-SIZE
      diagnostic-parameter bit-offset=0:
        diagnostic data element dataOut: array-size-semantics=VARIABLE-SIZE
  diagnostic routine IsLoeschen_Routine: id=3846
    start START_IsLoeschen
  diagnostic routine RcCppc_Routine: id=515
    start START_RcCppc
      diagnostic-parameter bit-offset=0:
        diagnostic data element dataOut: array-size-semantics=VARIABLE-SIZE
package /BMW/Platform/StdDiag/SwComponentTypes/DiagnosticServiceInstances
  diagnostic routine control DiagCommLoopback: access-permission=DiagCommLoopback_AccessPermission, routine-control-class=RoutineControl, routine=DiagCommLoopback_Routine
  diagnostic routine control IsLoeschen: access-permission=IsLoeschen_AccessPermission, routine-control-class=RoutineControl, routine=IsLoeschen_Routine
  diagnostic read data by identifier RDBI_ActiveDiagnosticSession: access-permission=RDBI_ActiveDiagnosticSession_AccessPermission, data-identifier=Did_ActiveDiagnosticSession, read-class=ReadDataByIdentifier
  diagnostic routine control RcCppc: access-permission=RcCppc_AccessPermission, routine-control-class=RoutineControl, routine=RcCppc_Routine
package /BMW/Platform/SysTime/SwComponentTypes/DiagnosticAccessPermissions
  diagnostic access permission RDBI_Systemzeit_AccessPermission: diagnostic-session=[DEFAULT_SESSION, EXTENDED_DIAGNOSTIC_SESSION]
package /BMW/Platform/SysTime/SwComponentTypes/DiagnosticDataIdentifiers
  diagnostic data identifier Did_Systemzeit: id=5889
    diagnostic-parameter bit-offset=0:
      diagnostic data element Systemzeit: array-size-semantics=VARIABLE-SIZE, max-number-of-elements=4, base-type=UINT8
package /BMW/Platform/SysTime/SwComponentTypes/DiagnosticServiceInstances
  diagnostic read data by identifier RDBI_Systemzeit: access-permission=RDBI_Systemzeit_AccessPermission, data-identifier=Did_Systemzeit, read-class=ReadDataByIdentifier
