AUTOSAR XML (schema 4-2-2)
package /ComponentTypes
  application sw component type XcpAppl
    behavior XcpAppl_InternalBehavior
      timing event TMT_Runnable: start-on-event=XcpApplPer1, period=0.002
      runnable XcpApplPer1
  swc implementation XcpAppl_Implementation: behavior=XcpAppl_InternalBehavior
    code-descriptors:
      code Default: artifact-descriptors=autosar-engineering-object={short-label=Default, category=SWSRC}
