AUTOSAR XML (schema 4-2-2)
package /MICROSAR
  bsw implementation FrIf_Impl: programming-language=C, sw-version=5.01.00, used-code-generator=cMSR, vendor-id=30, ar-release-version=4.00.03
package /MICROSAR/FrIf_ib_bswmd/BswModuleDescriptions
  bsw module description FrIf: provided-entrys=FrIf_MainFunction_0
    bsw internal behavior FrIfBehavior
      exclusive area FRIF_EXCLUSIVE_AREA_{0..2}
      bsw schedulable entity FrIf_MainFunction_0: implemented-entry=FrIf_MainFunction_0
      bsw timing event FrIf_MainFunction_0TimingEvent0: starts-on-event=FrIf_MainFunction_0, period=0.005
  bsw module entry FrIf_MainFunction_0: call-type=SCHEDULED, execution-context=TASK
