AUTOSAR XML (schema 4-2-2)
package /MICROSAR
  bsw implementation IpduM_Impl: programming-language=C, sw-version=6.05.01, used-code-generator=DaVinci Configurator, vendor-id=30, ar-release-version=4.00.03
package /MICROSAR/IpduM_ib_bswmd/BswModuleDescriptions
  bsw module description IpduM: provided-entrys=[IpduM_MainFunctionRx, IpduM_MainFunctionTx]
    bsw internal behavior IpduMBehavior
      exclusive area IPDUM_EXCLUSIVE_AREA_0  # Set SchMExclusiveAreaImplementation to AUTO to lock all interrupts.
      bsw schedulable entity IpduM_MainFunctionRx: implemented-entry=IpduM_MainFunctionRx
      bsw schedulable entity IpduM_MainFunctionTx: implemented-entry=IpduM_MainFunctionTx
      bsw timing event IpduM_MainFunctionRxTimingEvent0: starts-on-event=IpduM_MainFunctionRx, period=0.005
      bsw timing event IpduM_MainFunctionTxTimingEvent0: starts-on-event=IpduM_MainFunctionTx, period=0.005
  bsw module entry IpduM_MainFunctionRx: call-type=SCHEDULED, execution-context=TASK
  bsw module entry IpduM_MainFunctionTx: call-type=SCHEDULED, execution-context=TASK
