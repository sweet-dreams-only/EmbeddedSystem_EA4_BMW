AUTOSAR XML (schema 4-3-0)
package /MICROSAR/Dem_ib_bswmd/BswModuleDescriptions
  bsw module description Dem: provided-entrys=[Dem_MainFunction, Dem_MasterMainFunction, Dem_SatelliteMainFunction]
    bsw internal behavior DemBehavior
      4 x exclusive area:
        DEM_EXCLUSIVE_AREA_{0..3}
      bsw schedulable entity Dem_MasterMainFunction: implemented-entry=Dem_MasterMainFunction
      bsw schedulable entity Dem_SatelliteMainFunction: implemented-entry=Dem_SatelliteMainFunction
      bsw timing event Dem_MasterMainFunctionTimingEvent0: starts-on-event=Dem_MasterMainFunction, period=0.01
      bsw timing event Dem_SatelliteMainFunctionTimingEvent0: starts-on-event=Dem_SatelliteMainFunction, period=0.01
  bsw module entry Dem_MainFunction: call-type=SCHEDULED, execution-context=TASK
  bsw module entry Dem_MasterMainFunction: call-type=SCHEDULED, execution-context=TASK
  bsw module entry Dem_SatelliteMainFunction: call-type=SCHEDULED, execution-context=TASK
