AUTOSAR XML (schema 4-0-3)
package /Renesas/Fls_ib_bswmd/BswModuleDescriptions
  bsw module description Fls: provided-entrys=Fls_MainFunction
    bsw internal behavior FlsBehavior
      exclusive area FLS_DRIVERSTATE_DATA_PROTECTION
      exclusive area FLS_REGISTER_PROTECTION
      exclusive area FLS_CODE_FLASH_DISABLED
      bsw schedulable entity Fls_MainFunction: implemented-entry=Fls_MainFunction
      bsw timing event Fls_MainFunctionTimingEvent0: starts-on-event=Fls_MainFunction, period=0.01
  bsw module entry Fls_MainFunction: call-type=SCHEDULED, execution-context=TASK
