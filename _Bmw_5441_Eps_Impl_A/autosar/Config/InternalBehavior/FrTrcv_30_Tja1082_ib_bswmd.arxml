AUTOSAR XML (schema 4-2-2)
package /MICROSAR/FrTrcv_30_Tja1082_ib_bswmd/BswModuleDescriptions
  bsw module description FrTrcv: provided-entrys=FrTrcv_30_Tja1082_MainFunction
    bsw internal behavior FrTrcvBehavior
      exclusive area FRTRCV_30_TJA1082_EXCLUSIVE_AREA_0
      bsw schedulable entity FrTrcv_30_Tja1082_MainFunction: implemented-entry=FrTrcv_30_Tja1082_MainFunction
      bsw timing event FrTrcv_30_Tja1082_MainFunctionTimingEvent0: starts-on-event=FrTrcv_30_Tja1082_MainFunction, period=0.005
  bsw module entry FrTrcv_30_Tja1082_MainFunction: call-type=SCHEDULED, execution-context=TASK
