AUTOSAR XML (schema 4-3-0)
package /ActiveEcuC
  module config Vin: implementation-config-variant=VARIANT-PRE-COMPILE
    CommonPublishedInformation: SwMajorVersion=3, SwMinorVersion=5, SwPatchVersion=0
    VinGeneral:
      VinDevErrorDetect = false
      VinRequestMessageIdentifier = 32771
      TimeoutInitialVinRequest = 0.3
      TimeoutSubsequentVinRequests = 1
      MaxNumberVinRequests = 4
      EnableSIAdapter = false
    MultiConfig: SSVId=0
