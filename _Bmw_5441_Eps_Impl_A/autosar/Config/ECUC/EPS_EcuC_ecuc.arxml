AUTOSAR XML (schema 4-3-0)
package /ActiveEcuC
  module config EcuC: implementation-config-variant=VARIANT-PRE-COMPILE, module-description=EcuC_Impl
    EcucGeneral:
      CPUType = CPU32Bit
      SizeOfInt = Size32Bit
      ByteOrder = LITTLE_ENDIAN
      BitOrder = LSB_to_MSB
      AtomicBitAccessInBitfield = false
      AtomicVariableAccess = Atomic32BitAccess
      SizeOfEnum = Size32Bit
      SizeOfROMPointer = Size32Bit
      SizeOfRAMPointer = Size32Bit
      BitFieldDataType = INT
      StructAlignment = Auto
      ArrayAlignment = Auto
      StructInArrayAlignment = Auto
      DummyFunction = false
      EcuCSafeBswChecks = true
      DummyStatement = false
      DummyStatementKind = None
      ConditionalGenerating = true
      EcucBswImplementationCodeType = EcuCSourceCode
      EcuCUseStdReturnTypeForRte = false
      BswInitialization
        43 x InitFunction:
          BswM_InitMemory: Header=BswM.h, InitPhase=INIT_MEMORY, ModuleRef=BswM
          BswM_Init: Header=BswM.h, InitPhase=NO_INIT, ConfigType=BswM_ConfigType, ConfigPtrName=BswM_Config_Ptr, ConfigPtrClass=BSWM_INIT_DATA, ModuleRef=BswM
          Det_InitMemory: Header=Det.h, InitPhase=INIT_MEMORY, ModuleRef=Det
          Det_Init: Header=Det.h, InitPhase=INIT_ZERO, ConfigType=Det_ConfigType, ConfigPtrName=Det_Config_Ptr, ConfigPtrClass=DET_INIT_DATA, ModuleRef=Det
          EcuM_Init: Header=EcuM.h, InitPhase=NO_INIT, ConfigType=EcuM_PbConfigType, ConfigPtrName=EcuM_Config_Ptr, ConfigPtrClass=ECUM_INIT_DATA, ModuleRef=EcuM
          SchM_Init: Header=Rte_Main.h, InitPhase=NO_INIT, ModuleRef=Rte
          Rte_InitMemory: Header=Rte_Main.h, InitPhase=INIT_MEMORY, ModuleRef=Rte
          Fee_30_SmallSector_Init: Header=Fee_30_SmallSector.h, InitPhase=INIT_TWO_IF, ModuleRef=Fee
          NvM_Init: Header=NvM.h, InitPhase=INIT_TWO_SYS, ModuleRef=NvM
          WdgM_Init: Header=WdgM.h, InitPhase=INIT_TWO_IF, ConfigType=WdgM_ConfigType, ConfigPtrName=&WdgMConfig_Mode0_core0, ConfigPtrClass=WDGM_APPL_CONST, ModuleRef=WdgM
          Com_InitMemory: Header=Com.h, InitPhase=INIT_MEMORY, ModuleRef=Com
          Com_Init: Header=Com.h, InitPhase=INIT_TWO_COM, ConfigType=Com_ConfigType, ConfigPtrName=Com_Config_Ptr, ConfigPtrClass=COM_INIT_DATA, ModuleRef=Com
          FrIf_InitMemory: Header=FrIf.h, InitPhase=INIT_MEMORY, ModuleRef=FrIf
          FrIf_Init: Header=FrIf.h, InitPhase=INIT_TWO_IF, ConfigType=FrIf_ConfigType, ConfigPtrName=&FrIf_Config, ConfigPtrClass=FRIF_CONST, ModuleRef=FrIf
          FrSM_Init: Header=FrSM.h, InitPhase=INIT_TWO_SM, ConfigType=FrSM_ConfigType, ConfigPtrName=FrSM_Config_Ptr, ConfigPtrClass=FRSM_INIT_DATA, ModuleRef=FrSM
          FrSM_InitMemory: Header=FrSM.h, InitPhase=INIT_MEMORY, ModuleRef=FrSM
          FrTrcv_30_Tja1082_InitMemory: Header=FrTrcv_30_Tja1082.h, InitPhase=INIT_MEMORY, ModuleRef=FrTrcv
          FrTrcv_30_Tja1082_Init: Header=FrTrcv_30_Tja1082.h, InitPhase=INIT_TWO_TRCV, ModuleRef=FrTrcv
          Fr_InitMemory: Header=Fr.h, InitPhase=INIT_MEMORY, ModuleRef=Fr
          Fr_Init: Header=Fr.h, InitPhase=INIT_TWO_DRV, ConfigType=Fr_ConfigType, ConfigPtrName=&Fr_Config, ConfigPtrClass=FR_CONST, ModuleRef=Fr
          IpduM_Init: Header=IpduM.h, InitPhase=INIT_TWO_COM, ConfigType=IpduM_ConfigType, ConfigPtrName=IpduM_Config_Ptr, ConfigPtrClass=IPDUM_INIT_DATA, ModuleRef=IpduM
          IpduM_InitMemory: Header=IpduM.h, InitPhase=INIT_MEMORY, ModuleRef=IpduM
          PduR_Init: Header=PduR.h, InitPhase=INIT_TWO_COM, ConfigType=PduR_PBConfigType, ConfigPtrName=PduR_Config_Ptr, ConfigPtrClass=PDUR_INIT_DATA, ModuleRef=PduR
          PduR_InitMemory: Header=PduR.h, InitPhase=INIT_MEMORY, ModuleRef=PduR
          Xcp_Init: Header=Xcp.h, InitPhase=INIT_TWO_TP, ModuleRef=Xcp
          Xcp_InitMemory: Header=Xcp.h, InitPhase=INIT_MEMORY, ModuleRef=Xcp
          FrTp_Init: Header=FrTp.h, InitPhase=INIT_TWO_TP, ConfigType=FrTp_ConfigType, ConfigPtrName=&FrTp_Config, ConfigPtrClass=FRTP_CONST, ModuleRef=FrTp
          FrTp_InitMemory: Header=FrTp.h, InitPhase=INIT_MEMORY, ModuleRef=FrTp
          IoHwAb_Init: Header=IoHwAb.h, InitPhase=INIT_TWO_POST_NVMREADALL, ModuleRef=IoHwAb
          FrXcp_Init: Header=FrXcp.h, InitPhase=INIT_TWO_TP, ConfigType=FrXcp_ConfigType, ConfigPtrName=NULL_PTR, ConfigPtrClass=FRXCP_CONST, ModuleRef=Xcp
          FrXcp_InitMemory: Header=FrXcp.h, InitPhase=INIT_MEMORY, ModuleRef=Xcp
          Dcm_InitMemory: Header=Dcm.h, InitPhase=INIT_MEMORY, ModuleRef=Dcm
          Dcm_Init: Header=Dcm.h, InitPhase=INIT_TWO_POST_NVMREADALL, ConfigType=Dcm_ConfigType, ConfigPtrName=NULL_PTR, ConfigPtrClass=DCM_CONST, ModuleRef=Dcm
          Dem_Init: Header=Dem.h, InitPhase=INIT_TWO_POST_NVMREADALL, ConfigType=Dem_ConfigType, ConfigPtrName=Dem_Config_Ptr, ConfigPtrClass=DEM_INIT_DATA, ModuleRef=Dem
          Dem_PreInit: Header=Dem.h, InitPhase=INIT_ZERO, ConfigType=Dem_ConfigType, ConfigPtrName=Dem_Config_Ptr, ConfigPtrClass=DEM_INIT_DATA, ModuleRef=Dem
          Dem_InitMemory: Header=Dem.h, InitPhase=INIT_MEMORY, ModuleRef=Dem
          ComM_InitMemory: Header=ComM.h, InitPhase=INIT_MEMORY, ModuleRef=ComM
          ComM_Init: Header=ComM.h, InitPhase=INIT_TWO_POST_NVMREADALL, ModuleRef=ComM
          Os_Call_NxtrWdgM_Init: Header=Wdg.h, InitPhase=INIT_ONE, ModuleRef=Wdg
          SyncCrcInit0: Header=SyncCrc.h, InitPhase=INIT_ONE, ModuleRef=SyncCrc
          FlsMemInit2: Header=FlsMem.h, InitPhase=INIT_TWO_POST_NVMREADALL, ModuleRef=FlsMem
          E2EProtectionWrapperInit: Header=E2EPW_Init.h, InitPhase=INIT_TWO_POST_NVMREADALL, ModuleRef=E2EPW
          Os_ModifyPeripheral32: Header=Os.h, InitPhase=INIT_ONE, AdditionalInitCode=Os_ModifyPeripheral32(InterruptController, (uint32 *)0xFFFEEAF0U, 0xFFFEFFFFU, 0x0U);, ModuleRef=Os
    EcucHardware
      EcucCore0 (EcucCoreDefinition): EcucCoreId=0
    EcucPduCollection: PduIdTypeEnum=UINT8, PduLengthTypeEnum=UINT16
      101 x Pdu, all with J1939Requestable=false:
        Dcm_BRC_FR_32_0xF0: PduLength=24
        Dcm_ECU_TRNSM_FR_32_0xF0: PduLength=65535
        Dcm_GW_TRNSM_FR_254_0xF0: PduLength=65535
        pduTrig_FZZSTD_pduPort_EPS_A_FlexRay_IN_55c86d41_4f391dd1: PduLength=8, SysTPduToFrameMappingRef=p2fmap_FZZSTD  # FZZSTD
        pduTrig_A_TEMP_pduPort_EPS_A_FlexRay_IN_55c86d41_4f391dd1: PduLength=2, SysTPduToFrameMappingRef=p2fmap_A_TEMP  # A_TEMP
        pduTrig_VYAW_VEH_pduPort_EPS_A_FlexRay_IN_55c86d41_4f391dd1: PduLength=6, SysTPduToFrameMappingRef=p2fmap_VYAW_VEH  # VYAW_VEH
        SVC_fbd80461_Out: PduLength=8, SysTPduToFrameMappingRef=p2fmap_SVC
        pduTrig_CTR_DIAG_OBD_DRDY_pduPort_EPS_A_FlexRay_IN_55c86d41_4f391dd1: PduLength=2, SysTPduToFrameMappingRef=p2fmap_CTR_DIAG_OBD_DRDY  # CTR_DIAG_OBD_DRDY
        p2fmap_TL_MST_GW_TRNSM_FR_254_c761be43: PduLength=254, SysTPduToFrameMappingRef=p2fmap_TL_MST_GW_TRNSM_FR_254  # TL_MST_GW_TRNSM_FR_254
        pduTrig_ST_CENG_pduPort_EPS_A_FlexRay_IN_55c86d41_4f391dd1: PduLength=8, SysTPduToFrameMappingRef=p2fmap_ST_CENG  # ST_CENG
        pduTrig_SECU_FAHRGESTELLNUMMER_pduPort_EPS_A_FlexRay_IN_55c86d41_4f391dd1: PduLength=8, SysTPduToFrameMappingRef=p2fmap_SECU_FAHRGESTELLNUMMER  # SECU_FAHRGESTELLNUMMER
        pduTrig_ERRM_BN_U_pduPort_EPS_A_FlexRay_IN_55c86d41_4f391dd1: PduLength=2, SysTPduToFrameMappingRef=p2fmap_ERRM_BN_U  # ERRM_BN_U
        pduTrig_KILOMETERSTAND_pduPort_EPS_A_FlexRay_IN_55c86d41_4f391dd1: PduLength=8, SysTPduToFrameMappingRef=p2fmap_KILOMETERSTAND  # KILOMETERSTAND
        pduTrig_xcpdynamic254_5_pduPort_EPS_A_FlexRay_OUT_55c86d41_4f391dd1: PduLength=254, SysTPduToFrameMappingRef=p2fmap_xcpdynamic254_5  # xcpdynamic254_5
        pduTrig_DBG_EPS_MOD_EXT_120_BYTE_pduPort_EPS_A_FlexRay_OUT_55c86d41_4f391dd1: PduLength=58  # DBG_EPS_MOD_EXT_120_BYTE
        pduTrig_RQ_STG_EFAN_pduPort_EPS_A_FlexRay_OUT_55c86d41_4f391dd1: PduLength=8  # RQ_STG_EFAN
        pduTrig_DISP_CC_EPS_pduPort_EPS_A_FlexRay_OUT_55c86d41_4f391dd1: PduLength=5, SysTPduToFrameMappingRef=p2fmap_DISP_CC_EPS  # DISP_CC_EPS
        pduTrig_dummy16bstatic_pduPort_EPS_A_FlexRay_OUT_55c86d41_4f391dd1: PduLength=16, SysTPduToFrameMappingRef=p2fmap_dummy16bstatic  # dummy16bstatic
        ANFRAGE_fbd80461_In: PduLength=8
        pduTrig_ST_DIAG_OBD_3_DRDY_pduPort_EPS_A_FlexRay_OUT_55c86d41_4f391dd1: PduLength=8, SysTPduToFrameMappingRef=p2fmap_ST_DIAG_OBD_3_DRDY  # ST_DIAG_OBD_3_DRDY
        pduTrig_SU_EPS_pduPort_EPS_A_FlexRay_OUT_55c86d41_4f391dd1: PduLength=8, SysTPduToFrameMappingRef=p2fmap_SU_EPS  # SU_EPS
        pduTrig_CTR_VIB_STW_DISP_EXMI_SP2015_pduPort_EPS_A_FlexRay_IN_55c86d41_4f391dd1: PduLength=8, SysTPduToFrameMappingRef=p2fmap_CTR_VIB_STW_DISP_EXMI_SP2015  # CTR_VIB_STW_DISP_EXMI_SP2015
        pduTrig_DBG_EPS_BS_MOD_58_BYTE_pduPort_EPS_A_FlexRay_OUT_55c86d41_4f391dd1: PduLength=58  # DBG_EPS_BS_MOD_58_BYTE
        pduTrig_RELATIVZEIT_pduPort_EPS_A_FlexRay_IN_55c86d41_4f391dd1: PduLength=6, SysTPduToFrameMappingRef=p2fmap_RELATIVZEIT  # RELATIVZEIT
        p2fmap_TL_ECU_TRNSM_FR_32_c9b68eba: PduLength=32, SysTPduToFrameMappingRef=p2fmap_TL_ECU_TRNSM_FR_32  # TL_ECU_TRNSM_FR_32
        pduTrig_DT_EST_pduPort_EPS_A_FlexRay_OUT_55c86d41_4f391dd1: PduLength=16, SysTPduToFrameMappingRef=p2fmap_DT_EST  # DT_EST
        pduTrig_SECU_CHAL_pduPort_EPS_A_FlexRay_OUT_55c86d41_4f391dd1: PduLength=8  # SECU_CHAL
        pduTrig_xcpdynamic254_2_pduPort_EPS_A_FlexRay_OUT_55c86d41_4f391dd1: PduLength=254, SysTPduToFrameMappingRef=p2fmap_xcpdynamic254_2  # xcpdynamic254_2
        pduTrig_AVL_RPM_WHL_pduPort_EPS_A_FlexRay_IN_55c86d41_4f391dd1: PduLength=12, SysTPduToFrameMappingRef=p2fmap_AVL_RPM_WHL  # AVL_RPM_WHL
        pduTrig_xcpdynamic254_6_pduPort_EPS_A_FlexRay_OUT_55c86d41_4f391dd1: PduLength=254, SysTPduToFrameMappingRef=p2fmap_xcpdynamic254_6  # xcpdynamic254_6
        ANFRAGE_fbd80461_Out: PduLength=8
        pduTrig_ENSU_SFY_pduPort_EPS_A_FlexRay_IN_55c86d41_4f391dd1: PduLength=8, SysTPduToFrameMappingRef=p2fmap_ENSU_SFY  # ENSU_SFY
        pduTrig_ST_STAB_DSC_pduPort_EPS_A_FlexRay_IN_55c86d41_4f391dd1: PduLength=8, SysTPduToFrameMappingRef=p2fmap_ST_STAB_DSC  # ST_STAB_DSC
        pduTrig_SU_CLE_DRDY_DXP_pduPort_EPS_A_FlexRay_IN_55c86d41_4f391dd1: PduLength=8, SysTPduToFrameMappingRef=p2fmap_SU_CLE_DRDY_DXP  # SU_CLE_DRDY_DXP
        pduTrig_ENGTORQ_EPS_pduPort_EPS_A_FlexRay_OUT_55c86d41_4f391dd1: PduLength=8, SysTPduToFrameMappingRef=p2fmap_ENGTORQ_EPS  # ENGTORQ_EPS
        pduTrig_FAHRGESTELLNUMMER_pduPort_EPS_A_FlexRay_IN_55c86d41_4f391dd1: PduLength=7, SysTPduToFrameMappingRef=p2fmap_FAHRGESTELLNUMMER  # FAHRGESTELLNUMMER
        pduTrig_V_VEH_pduPort_EPS_A_FlexRay_IN_55c86d41_4f391dd1: PduLength=5, SysTPduToFrameMappingRef=p2fmap_V_VEH  # V_VEH
        pduTrig_SECU_RESP_pduPort_EPS_A_FlexRay_IN_55c86d41_4f391dd1: PduLength=8  # SECU_RESP
        SVC_fbd80461_In: PduLength=8, SysTPduToFrameMappingRef=p2fmap_SVC
        pduTrig_TAR_QTA_STRMOM_DV_pduPort_EPS_A_FlexRay_IN_55c86d41_4f391dd1: PduLength=8, SysTPduToFrameMappingRef=p2fmap_TAR_QTA_STRMOM_DV  # TAR_QTA_STRMOM_DV
        pduTrig_TAR_ESTP_VIRT_FTAX_pduPort_EPS_A_FlexRay_IN_55c86d41_4f391dd1: PduLength=8, SysTPduToFrameMappingRef=p2fmap_TAR_ESTP_VIRT_FTAX  # TAR_ESTP_VIRT_FTAX
        pduTrig_AVL_STMOM_DV_ACT_pduPort_EPS_A_FlexRay_OUT_55c86d41_4f391dd1: PduLength=4, SysTPduToFrameMappingRef=p2fmap_AVL_STMOM_DV_ACT  # AVL_STMOM_DV_ACT
        pduTrig_FR_DBG_EPS_pduPort_EPS_A_FlexRay_OUT_55c86d41_4f391dd1: PduLength=58, SysTPduToFrameMappingRef=p2fmap_FR_DBG_EPS  # FR_DBG_EPS
        pduTrig_ENERG_DGR_DRDY_pduPort_EPS_A_FlexRay_IN_55c86d41_4f391dd1: PduLength=8, SysTPduToFrameMappingRef=p2fmap_ENERG_DGR_DRDY  # ENERG_DGR_DRDY
        pduTrig_ACLNY_MASSCNTR_pduPort_EPS_A_FlexRay_IN_55c86d41_4f391dd1: PduLength=6, SysTPduToFrameMappingRef=p2fmap_ACLNY_MASSCNTR  # ACLNY_MASSCNTR
        pduTrig_OFFS_QUAD_EPS_pduPort_EPS_A_FlexRay_IN_55c86d41_4f391dd1: PduLength=5, SysTPduToFrameMappingRef=p2fmap_OFFS_QUAD_EPS  # OFFS_QUAD_EPS
        pduTrig_TAR_STMOM_DV_ACT_pduPort_EPS_A_FlexRay_IN_55c86d41_4f391dd1: PduLength=8, SysTPduToFrameMappingRef=p2fmap_TAR_STMOM_DV_ACT  # TAR_STMOM_DV_ACT
        pduTrig_xcpdynamic254_7_pduPort_EPS_A_FlexRay_OUT_55c86d41_4f391dd1: PduLength=254, SysTPduToFrameMappingRef=p2fmap_xcpdynamic254_7  # xcpdynamic254_7
        pduTrig_xcpdynamic254_3_pduPort_EPS_A_FlexRay_OUT_55c86d41_4f391dd1: PduLength=254, SysTPduToFrameMappingRef=p2fmap_xcpdynamic254_3  # xcpdynamic254_3
        pduTrig_ST_ENERG_GEN_pduPort_EPS_A_FlexRay_IN_55c86d41_4f391dd1: PduLength=8, SysTPduToFrameMappingRef=p2fmap_ST_ENERG_GEN  # ST_ENERG_GEN
        pduTrig_AVL_PO_EPS_pduPort_EPS_A_FlexRay_OUT_55c86d41_4f391dd1: PduLength=8, SysTPduToFrameMappingRef=p2fmap_AVL_PO_EPS  # AVL_PO_EPS
        pduTrig_STEA_OFFS_pduPort_EPS_A_FlexRay_IN_55c86d41_4f391dd1: PduLength=8, SysTPduToFrameMappingRef=p2fmap_STEA_OFFS  # STEA_OFFS
        pduTrig_xcpdynamic254_1_pduPort_EPS_A_FlexRay_OUT_55c86d41_4f391dd1: PduLength=254, SysTPduToFrameMappingRef=p2fmap_xcpdynamic254_1  # xcpdynamic254_1
        pduTrig_AVL_FORC_GRD_pduPort_EPS_A_FlexRay_OUT_55c86d41_4f391dd1: PduLength=5, SysTPduToFrameMappingRef=p2fmap_AVL_FORC_GRD  # AVL_FORC_GRD
        pduTrig_DIAG_OBD_ENG_pduPort_EPS_A_FlexRay_IN_55c86d41_4f391dd1: PduLength=7, SysTPduToFrameMappingRef=p2fmap_DIAG_OBD_ENG  # DIAG_OBD_ENG
        p2fmap_TL_BRC_FR_32_003b6d76: PduLength=32, SysTPduToFrameMappingRef=p2fmap_TL_BRC_FR_32  # TL_BRC_FR_32
        pduTrig_ST_EST_pduPort_EPS_A_FlexRay_OUT_55c86d41_4f391dd1: PduLength=5, SysTPduToFrameMappingRef=p2fmap_ST_EST  # ST_EST
        pduTrig_xcpdynamic254_8_pduPort_EPS_A_FlexRay_OUT_55c86d41_4f391dd1: PduLength=254, SysTPduToFrameMappingRef=p2fmap_xcpdynamic254_8  # xcpdynamic254_8
        pduTrig_dummy32bmaster_pduPort_EPS_A_FlexRay_IN_55c86d41_4f391dd1: PduLength=32, SysTPduToFrameMappingRef=p2fmap_dummy32bmaster  # dummy32bmaster
        pduTrig_xcpdynamic254_4_pduPort_EPS_A_FlexRay_OUT_55c86d41_4f391dd1: PduLength=254, SysTPduToFrameMappingRef=p2fmap_xcpdynamic254_4  # xcpdynamic254_4
        pduTrig_CON_VEH_pduPort_EPS_A_FlexRay_IN_55c86d41_4f391dd1: PduLength=8, SysTPduToFrameMappingRef=p2fmap_CON_VEH  # CON_VEH
        pduTrig_dummy32bslave_pduPort_EPS_A_FlexRay_OUT_55c86d41_4f391dd1: PduLength=32, SysTPduToFrameMappingRef=p2fmap_dummy32bslave  # dummy32bslave
        Dcm_BRC_FR_32_0xF{1..9}: PduLength=24
        Dcm_BRC_FR_32_0xFA: PduLength=24
        Dcm_BRC_FR_32_0xFB: PduLength=24
        Dcm_BRC_FR_32_0xFC: PduLength=24
        Dcm_BRC_FR_32_0xFD: PduLength=24
        Dcm_ECU_TRNSM_FR_32_0xF{1..9}: PduLength=65535
        Dcm_ECU_TRNSM_FR_32_0xFA: PduLength=65535
        Dcm_ECU_TRNSM_FR_32_0xFB: PduLength=65535
        Dcm_ECU_TRNSM_FR_32_0xFC: PduLength=65535
        Dcm_ECU_TRNSM_FR_32_0xFD: PduLength=65535
        Dcm_GW_TRNSM_FR_254_0xF{1..9}: PduLength=65535
        Dcm_GW_TRNSM_FR_254_0xFA: PduLength=65535
        Dcm_GW_TRNSM_FR_254_0xFB: PduLength=65535
        Dcm_GW_TRNSM_FR_254_0xFC: PduLength=65535
        Dcm_GW_TRNSM_FR_254_0xFD: PduLength=65535
