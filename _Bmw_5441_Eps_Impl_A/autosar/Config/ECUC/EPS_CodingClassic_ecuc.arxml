AUTOSAR XML (schema 4-3-0)
package /ActiveEcuC
  module config CodingClassic: implementation-config-variant=VARIANT-PRE-COMPILE
    CodingClassicGeneral: CodingCycleTime=0.1
    CommonPublishedInformation: SwMajorVersion=5, SwMinorVersion=2, SwPatchVersion=1
