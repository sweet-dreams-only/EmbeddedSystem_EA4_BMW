AUTOSAR XML (schema 4-3-0)
package /ActiveEcuC
  module config FrSM: implementation-config-variant=VARIANT-PRE-COMPILE, module-description=FrSM_Impl
    FrSMConfig
      A_FlexRay_372befd6 (FrSMCluster):
        FrSMCheckWakeupReason = false
        FrSMDelayStartupWithoutWakeup = false
        FrSMDurationT1 = 0.005
        FrSMDurationT2 = 0.05
        FrSMDurationT3 = 0.5
        FrSMIsColdstartEcu = false
        FrSMIsWakeupEcu = false
        FrSMMainFunctionCycleTime = 0.005
        FrSMNumWakeupPatterns = 1
        FrSMStartupRepetitionsUnlimited = false
        FrSMStartupRepetitionsWithWakeupUnlimited = false
        FrSMStartupRepetitionsWithWakeup = 0
        FrSMStartupRepetitions = 0
        FrSMComMNetworkHandleRef = A_FlexRay_372befd6
        FrSMFrIfClusterRef = A_FlexRay
    FrSMGeneral: FrSMDevErrorDetect=true, FrSMVersionInfoApi=false, FrSMEcuPassiveMode=false
      FrSMGeneration: FrSMOutOfBoundsWriteSanitizer=false, FrSMOutOfBoundsReadSanitizer=false
