AUTOSAR XML (schema 4-3-0)
package /BMW_CONF
  module config StdDiagClassic: implementation-config-variant=VARIANT-PRE-COMPILE
    StdDiagGeneral: StdDiagClearSecondaryErrorMemory=true
    StdDiagSgbdIndex: SgbdIndex=993488
    StdDiagUserDefinedMemory: StdDiagUserDefinedMemoryName=BMWSecondaryErrorMemory, StdDiagUserDefinedMemoryId=4
    CommonPublishedInformation: SwMajorVersion=5, SwMinorVersion=4, SwPatchVersion=0
