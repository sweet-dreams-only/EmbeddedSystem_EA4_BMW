AUTOSAR XML (schema 4-3-0)
package /ActiveEcuC
  module config DiagcMgr: implementation-config-variant=VARIANT-PRE-COMPILE, module-description=DiagcMgr_Impl
    DiagcMgrGeneral: DIAGCMGR_DEMCHK=STD_ON, DEMTOTNROFDTC=DEM_CFG_GLOBAL_DTC_COUNT
    DTCEnaCndn:
      DiagcMgrDTCIdx = 1
      Bit_15 = false
      Bit_14 = false
      Bit_13 = false
      Bit_12 = false
      Bit_11 = false
      Bit_10 = false
      Bit__9 = false
      Bit__8 = false
      Bit__7 = false
      Bit__6 = false
      Bit__5 = false
      Bit__4 = false
      Bit__3 = false
      Bit__2 = false
      Bit__1 = false
      Bit__0 = false
      DTC = DTC_02FF30
    65 x NTCNR, all with MfgNtcInhibInOper=false, MfgNtcInhibInNonOper=false, NtcPwrCycLtch=false, LtchgEna=false, LtchCntrThd=0:
      NTCNR_0X006: Debounce=false, NTCOsApplicationRef=Appl10
      NTCNR_0X01E: Debounce=false, NTCOsApplicationRef=Appl10
      NTCNR_0X01F: Debounce=false, NTCOsApplicationRef=Appl10
      NTCNR_0X03A: Debounce=false, NTCOsApplicationRef=Appl10
      NTCNR_0X039: Debounce=false, NTCOsApplicationRef=Appl10
      NTCNR_0X003: Debounce=false, NTCOsApplicationRef=Appl10
      NTCNR_0X010: Debounce=false, NTCOsApplicationRef=Appl10
      NTCNR_0X013: Debounce=false, NTCOsApplicationRef=Appl10
      NTCNR_0X016: Debounce=false, NTCOsApplicationRef=Appl10
      NTCNR_0X{021..029}: Debounce=false, NTCOsApplicationRef=Appl10
      NTCNR_0X02A: Debounce=false, NTCOsApplicationRef=Appl10
      NTCNR_0X02C: Debounce=false, NTCOsApplicationRef=Appl10
      NTCNR_0X02D: Debounce=false, NTCOsApplicationRef=Appl10
      NTCNR_0X030: Debounce=false, NTCOsApplicationRef=Appl10
      NTCNR_0X031: Debounce=false, NTCOsApplicationRef=Appl10
      NTCNR_0X036: Debounce=false, NTCOsApplicationRef=Appl10
      NTCNR_0X037: Debounce=false, NTCOsApplicationRef=Appl10
      NTCNR_0X049: Debounce=false, NTCOsApplicationRef=Appl10
      NTCNR_0X02F: Debounce=false, NTCOsApplicationRef=Appl10
      NTCNR_0X007: Debounce=false, NTCOsApplicationRef=Appl10
      NTCNR_0X008: Debounce=false, NTCOsApplicationRef=Appl10
      NTCNR_0X1FF: Debounce=false, NTCOsApplicationRef=Appl10
      NTCNR_0X0BF: Debounce=false, NTCOsApplicationRef=Appl10
      NTCNR_0X0A0: Debounce=false, NTCOsApplicationRef=Appl10
      NTCNR_0X002: Debounce=false, NTCOsApplicationRef=Appl10
      NTCNR_0X004: Debounce=false, NTCOsApplicationRef=Appl10
      NTCNR_0X10F: Debounce=false, NTCOsApplicationRef=Appl10
      NTCNR_0X017: Debounce=false, NTCOsApplicationRef=Appl10
      NTCNR_0X018: Debounce=true, NTCOsApplicationRef=Appl10
      NTCNR_0X019: Debounce=false, NTCOsApplicationRef=Appl10
      NTCNR_0X01A: Debounce=false, NTCOsApplicationRef=Appl10
      NTCNR_0X01B: Debounce=false, NTCOsApplicationRef=Appl10
      NTCNR_0X01D: Debounce=false, NTCOsApplicationRef=Appl10
      NTCNR_0X032: Debounce=true, NTCOsApplicationRef=Appl10
      NTCNR_0X033: Debounce=true, NTCOsApplicationRef=Appl10
      NTCNR_0X03C: Debounce=true, NTCOsApplicationRef=Appl10
      NTCNR_0X044: Debounce=true, NTCOsApplicationRef=Appl10
      NTCNR_0X045: Debounce=true, NTCOsApplicationRef=Appl9
      NTCNR_0X05D: Debounce=true, NTCOsApplicationRef=Appl10
      NTCNR_0X073: Debounce=true, NTCOsApplicationRef=Appl10
      NTCNR_0X075: Debounce=true, NTCOsApplicationRef=Appl10
      NTCNR_0X083: Debounce=true, NTCOsApplicationRef=Appl10
      NTCNR_0X085: Debounce=true, NTCOsApplicationRef=Appl10
      NTCNR_0X08A: Debounce=false, NTCOsApplicationRef=Appl10
      NTCNR_0X08C: Debounce=true, NTCOsApplicationRef=Appl10
      NTCNR_0X08E: Debounce=true, NTCOsApplicationRef=Appl10
      NTCNR_0X0B0: Debounce=true, NTCOsApplicationRef=Appl10
      NTCNR_0X0B1: Debounce=true, NTCOsApplicationRef=Appl10
      NTCNR_0X0B5: Debounce=true, NTCOsApplicationRef=Appl10
      NTCNR_0X0BD: Debounce=true, NTCOsApplicationRef=Appl10
      NTCNR_0X0BE: Debounce=true, NTCOsApplicationRef=Appl10
      NTCNR_0X1E{0..3}: Debounce=false, NTCOsApplicationRef=Appl10
      NTCNR_0X1EC: Debounce=false, NTCOsApplicationRef=Appl10
      NTCNR_0X1ED: Debounce=false, NTCOsApplicationRef=Appl10
    13 x DTCEnaCndn, all with Bit_15=false, Bit_14=false, Bit_13=false, Bit_12=false, Bit_11=false, Bit_10=false, Bit__9=false, Bit__8=false, Bit__7=false, Bit__6=false, Bit__5=false, Bit__4=false, Bit__3=false, Bit__2=false, Bit__1=false, Bit__0=false:
      DTCEnaCndn_001: DiagcMgrDTCIdx=2, DTC=DTC_02300A
      DTCEnaCndn_002: DiagcMgrDTCIdx=3, DTC=DTC_023000
      DTCEnaCndn_003: DiagcMgrDTCIdx=4, DTC=DTC_023008
      DTCEnaCndn_004: DiagcMgrDTCIdx=5, DTC=DTC_023009
      DTCEnaCndn_005: DiagcMgrDTCIdx=6, DTC=DTC_023040
      DTCEnaCndn_006: DiagcMgrDTCIdx=7, DTC=DTC_023041
      DTCEnaCndn_007: DiagcMgrDTCIdx=8, DTC=DTC_023042
      DTCEnaCndn_008: DiagcMgrDTCIdx=9, DTC=DTC_023043
      DTCEnaCndn_009: DiagcMgrDTCIdx=10, DTC=DTC_023044
      DTCEnaCndn_010: DiagcMgrDTCIdx=11, DTC=DTC_023045
      DTCEnaCndn_011: DiagcMgrDTCIdx=12, DTC=DTC_D50BFF
      DTCEnaCndn_012: DiagcMgrDTCIdx=13, DTC=DTC_D5041F
      DTCEnaCndn_013: DiagcMgrDTCIdx=14, DTC=DTC_D50420
    60 x NTCNR, all with MfgNtcInhibInOper=false, MfgNtcInhibInNonOper=false, NtcPwrCycLtch=false, LtchgEna=false, LtchCntrThd=0:
      NTCNR_0X07B: Debounce=true, NTCOsApplicationRef=Appl10
      NTCNR_0X07C: Debounce=true, NTCOsApplicationRef=Appl10
      NTCNR_0X07D: Debounce=true, NTCOsApplicationRef=Appl10
      NTCNR_0X07E: Debounce=true, NTCOsApplicationRef=Appl10
      NTCNR_0X07F: Debounce=true, NTCOsApplicationRef=Appl10
      NTCNR_0X040: Debounce=false, NTCOsApplicationRef=Appl10
      NTCNR_0X041: Debounce=false, NTCOsApplicationRef=Appl10
      NTCNR_0X042: Debounce=true, NTCOsApplicationRef=Appl10
      NTCNR_0X050: Debounce=true, NTCOsApplicationRef=Appl10
      NTCNR_0X051: Debounce=true, NTCOsApplicationRef=Appl10
      NTCNR_0X053: Debounce=false, NTCOsApplicationRef=Appl10
      NTCNR_0X054: Debounce=false, NTCOsApplicationRef=Appl10
      NTCNR_0X055: Debounce=true, NTCOsApplicationRef=Appl10
      NTCNR_0X070: Debounce=false, NTCOsApplicationRef=Appl10
      NTCNR_0X0A4: Debounce=false, NTCOsApplicationRef=Appl7
      NTCNR_0X0A3: Debounce=false, NTCOsApplicationRef=Appl7
      NTCNR_0X0B2: Debounce=false, NTCOsApplicationRef=Appl10
      NTCNR_0X020: Debounce=false, NTCOsApplicationRef=Appl10
      NTCNR_0X02B: Debounce=true, NTCOsApplicationRef=Appl10
      NTCNR_0X048: Debounce=false, NTCOsApplicationRef=Appl10
      NTCNR_0X04D: Debounce=true, NTCOsApplicationRef=Appl10
      NTCNR_0X09C: Debounce=false, NTCOsApplicationRef=Appl10
      NTCNR_0X09F: Debounce=true, NTCOsApplicationRef=Appl8
      NTCNR_0X0A1: Debounce=false, NTCOsApplicationRef=Appl10
      NTCNR_0X0A2: Debounce=true, NTCOsApplicationRef=Appl10
      NTCNR_0X0A6: Debounce=true, NTCOsApplicationRef=Appl10
      NTCNR_0X0A9: Debounce=false, NTCOsApplicationRef=Appl10
      NTCNR_0X0D7: Debounce=true, NTCOsApplicationRef=Appl10
      NTCNR_0X{102..109}: Debounce=false, NTCOsApplicationRef=Appl10
      NTCNR_0X10A: Debounce=false, NTCOsApplicationRef=Appl10
      NTCNR_0X10B: Debounce=false, NTCOsApplicationRef=Appl10
      NTCNR_0X10C: Debounce=false, NTCOsApplicationRef=Appl10
      NTCNR_0X10D: Debounce=false, NTCOsApplicationRef=Appl10
      NTCNR_0X10E: Debounce=false, NTCOsApplicationRef=Appl10
      NTCNR_0X{110..113}: Debounce=false, NTCOsApplicationRef=Appl10
      NTCNR_0X012: Debounce=false, NTCOsApplicationRef=Appl10
      NTCNR_0X00A: Debounce=false, NTCOsApplicationRef=Appl10
      NTCNR_0X118: Debounce=false, NTCOsApplicationRef=Appl10
      NTCNR_0X119: Debounce=false, NTCOsApplicationRef=Appl10
      NTCNR_0X11A: Debounce=false, NTCOsApplicationRef=Appl10
      NTCNR_0X11B: Debounce=false, NTCOsApplicationRef=Appl10
      NTCNR_0X11C: Debounce=false, NTCOsApplicationRef=Appl10
      NTCNR_0X1E4: Debounce=false, NTCOsApplicationRef=Appl10
      NTCNR_0X1E5: Debounce=false, NTCOsApplicationRef=Appl10
      NTCNR_0X0E0: Debounce=false, NTCOsApplicationRef=Appl10
      NTCNR_0X0E2: Debounce=false, NTCOsApplicationRef=Appl9
      NTCNR_0X0E1: Debounce=false, NTCOsApplicationRef=Appl10
      NTCNR_0X080: Debounce=true, NTCOsApplicationRef=Appl10
      NTCNR_0X090: Debounce=false, NTCOsApplicationRef=Appl10
      NTCNR_0X00D: Debounce=false, NTCOsApplicationRef=Appl10
    DTCEnaCndn_014 (DTCEnaCndn):
      DiagcMgrDTCIdx = 15
      Bit_15 = false
      Bit_14 = false
      Bit_13 = false
      Bit_12 = false
      Bit_11 = false
      Bit_10 = false
      Bit__9 = false
      Bit__8 = false
      Bit__7 = false
      Bit__6 = false
      Bit__5 = false
      Bit__4 = false
      Bit__3 = false
      Bit__2 = false
      Bit__1 = false
      Bit__0 = false
      DTC = Primary_DTC_4822E4
    12 x NTCNR, all with MfgNtcInhibInOper=false, MfgNtcInhibInNonOper=false, NtcPwrCycLtch=false, LtchgEna=false, LtchCntrThd=0:
      NTCNR_0X014: Debounce=false, NTCOsApplicationRef=Appl10
      NTCNR_0X015: Debounce=false, NTCOsApplicationRef=Appl10
      NTCNR_0X01C: Debounce=false, NTCOsApplicationRef=Appl10
      NTCNR_0X056: Debounce=false, NTCOsApplicationRef=Appl10
      NTCNR_0X05F: Debounce=true, NTCOsApplicationRef=Appl7
      NTCNR_0X0AB: Debounce=false, NTCOsApplicationRef=Appl10
      NTCNR_0X0AE: Debounce=false, NTCOsApplicationRef=Appl10
      NTCNR_0X0AC: Debounce=false, NTCOsApplicationRef=Appl10
      NTCNR_0X0AA: Debounce=false, NTCOsApplicationRef=Appl10
      NTCNR_0X0AF: Debounce=false, NTCOsApplicationRef=Appl10
      NTCNR_0X0AD: Debounce=false, NTCOsApplicationRef=Appl10
      NTCNR_0X05E: Debounce=true, NTCOsApplicationRef=Appl8
    7 x DTCEnaCndn, all with Bit_15=false, Bit_14=false, Bit_13=false, Bit_12=false, Bit_11=false, Bit_10=false, Bit__9=false, Bit__8=false, Bit__7=false, Bit__6=false, Bit__5=false, Bit__4=false, Bit__3=false, Bit__2=false, Bit__1=false, Bit__0=false:
      DTCEnaCndn_016: DiagcMgrDTCIdx=16, DTC=Primary_DTC_4822F5
      DTCEnaCndn_017: DiagcMgrDTCIdx=17, DTC=Secondary_DTC_20F300
      DTCEnaCndn_018: DiagcMgrDTCIdx=18, DTC=Secondary_DTC_21F100
      DTCEnaCndn_019: DiagcMgrDTCIdx=19, DTC=Secondary_DTC_21F300
      DTCEnaCndn_020: DiagcMgrDTCIdx=20, DTC=Secondary_DTC_30F300
      DTCEnaCndn_021: DiagcMgrDTCIdx=21, DTC=Secondary_DTC_31F100
      DTCEnaCndn_022: DiagcMgrDTCIdx=22, DTC=Secondary_DTC_31F300
    54 x NTCNR, all with Debounce=false, MfgNtcInhibInOper=false, MfgNtcInhibInNonOper=false, NtcPwrCycLtch=false, LtchgEna=false, LtchCntrThd=0, NTCOsApplicationRef=Appl10:
      NTCNR_0X047
      NTCNR_0X11D
      NTCNR_0X11E
      NTCNR_0X11F
      NTCNR_0X14D
      NTCNR_0X14E
      NTCNR_0X14F
      NTCNR_0X151
      NTCNR_0X150
      NTCNR_0X{133..137}
      NTCNR_0X{120..129}
      NTCNR_0X12A
      NTCNR_0X12B
      NTCNR_0X12C
      NTCNR_0X12D
      NTCNR_0X12E
      NTCNR_0X12F
      NTCNR_0X130
      NTCNR_0X14B
      NTCNR_0X14C
      NTCNR_0X152
      NTCNR_0X153
      NTCNR_0X138
      NTCNR_0X139
      NTCNR_0X13A
      NTCNR_0X13B
      NTCNR_0X13C
      NTCNR_0X{160..163}
      NTCNR_0X159
      NTCNR_0X15A
      NTCNR_0X15B
      NTCNR_0X15C
      NTCNR_0X15D
      NTCNR_0X15E
      NTCNR_0X15F
      NTCNR_0X0D8
      NTCNR_0X0DF
      NTCNR_0X1E6
