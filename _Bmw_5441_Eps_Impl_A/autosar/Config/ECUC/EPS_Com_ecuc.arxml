AUTOSAR XML (schema 4-3-0)
package /ActiveEcuC
  module config Com: implementation-config-variant=VARIANT-PRE-COMPILE, module-description=Com_Impl
    ComGeneral:
      ComConfigurationUseDet = true
      ComEnableSignalGroupArrayApi = false
      ComRetryFailedTransmitRequests = false
      ComSupportedIPduGroups = 13
      ComVersionInfoApi = false
      ComAdvancedIPduCallouts = true
      ComOptimizedIPduGroupHandling = false
      ComMetaDataSupport = false
      ComReceiveSignalMacroAPI = false
      ComDeferredEventCacheSupport = false
      ComMainfunctionTimingDomainSupport = false
      ComDescriptionRoutingCodeGeneration = false
      ComSafeBswChecks = true
      ComUserCbkHeaderFile = Rte_Cbk.h
    ComConfig: ComConfigurationId=0, ComRxDeferredNotificationCacheSize=3, ComRxImmediateNotificationCacheSize=0
      ComTimeBase: ComRxTimeBase=0.005, ComTxTimeBase=0.005, ComGwTimeBase=0.005
      SSV_IDENT_CHAL_5fff8d6b (ComSignal):
        ComBitPosition = 8
        ComBitSize = 8
        ComSignalDataInvalidValue = 255
        ComSignalEndianness = LITTLE_ENDIAN
        ComSignalType = UINT8
        ComSignalInitValue = 0
        ComSignalAccess = ACCESS_NEEDED_BY_SWC_OR_COM
        ComHandleId = 69
        ComTransferProperty = PENDING
        ComSystemTemplateSystemSignalRef = SSV_IDENT_CHAL
      RELATIVZEIT_19255f18 (ComIPdu):
        ComIPduDirection = RECEIVE
        ComIPduType = NORMAL
        ComIPduHandleId = 15
        ComIPduSignalProcessing = DEFERRED
        ComIPduCancellationSupport = false
        ComIPduSignalRef = T_SEC_COU_REL_0b27fbfe
        ComPduIdRef = pduTrig_RELATIVZEIT_pduPort_EPS_A_FlexRay_IN_55c86d41_4f391dd1
        ComIPduGroupRef = EPS_IN_PduGroup4
      TAR_STMOM_DV_ACT_19255f18 (ComIPdu):
        ComIPduDirection = RECEIVE
        ComIPduType = NORMAL
        ComIPduHandleId = 25
        ComIPduSignalProcessing = DEFERRED
        ComIPduCancellationSupport = false
        ComIPduSignalGroupRef = sigGroup_TAR_STMOM_DV_ACT_9a7b28d3
        ComPduIdRef = pduTrig_TAR_STMOM_DV_ACT_pduPort_EPS_A_FlexRay_IN_55c86d41_4f391dd1
        ComIPduGroupRef = EPS_IN_PduGroup3
      DBG_EPS_MOD_EXT_120_BYTE_58e47270 (ComSignal):
        ComBitPosition = 8
        ComBitSize = 8
        ComSignalEndianness = LITTLE_ENDIAN
        ComSignalType = UINT8
        ComSignalInitValue = 0
        ComSignalAccess = ACCESS_NEEDED_BY_SWC_OR_COM
        ComHandleId = 27
        ComTransferProperty = PENDING
        ComSystemTemplateSystemSignalRef = DBG_EPS_MOD_EXT_120_BYTE
      SECU_CHAL_5fff8d6b (ComSignal):
        ComBitPosition = 24
        ComBitSize = 40
        ComSignalDataInvalidValue = 1099511627775
        ComSignalEndianness = LITTLE_ENDIAN
        ComSignalType = UINT64
        ComSignalInitValue = 0
        ComSignalAccess = ACCESS_NEEDED_BY_SWC_OR_COM
        ComHandleId = 66
        ComTransferProperty = PENDING
        ComSystemTemplateSystemSignalRef = SECU_CHAL
      sigGroup_ENSU_SFY_dfa36b36 (ComSignalGroup): ComSignalGroupAccess=ACCESS_NEEDED_BY_SWC_OR_COM, ComHandleId=4, ComDataInvalidAction=REPLACE, ComSystemTemplateSignalGroupRef=sigGroup_ENSU_SFY
        7 x ComGroupSignal, all with ComSignalEndianness=LITTLE_ENDIAN, ComSignalAccess=ACCESS_NEEDED_BY_SWC_OR_COM:
          CHL_ENSU_SFY_db9b6687: ComBitPosition=12, ComBitSize=4, ComSignalDataInvalidValue=15, ComSignalType=UINT8, ComSignalInitValue=0, ComHandleId=24, ComSystemTemplateSystemSignalRef=CHL_ENSU_SFY
          CRC_ENSU_SFY_db9b6687: ComBitPosition=0, ComBitSize=8, ComSignalType=UINT8, ComSignalInitValue=0, ComHandleId=31, ComSystemTemplateSystemSignalRef=CRC_ENSU_SFY
          ENSU_SFY_dummy_32_63_db9b6687: ComBitPosition=32, ComBitSize=32, ComSignalInitValue=4294967295, ComSignalType=UINT32, ComHandleId=49, ComSystemTemplateSystemSignalRef=ENSU_SFY_dummy_32_63
          QU_FN_ENSU_SFY_db9b6687: ComBitPosition=16, ComBitSize=8, ComSignalDataInvalidValue=255, ComSignalType=UINT8, ComSignalInitValue=0, ComHandleId=75, ComSystemTemplateSystemSignalRef=QU_FN_ENSU_SFY
          RQ_CULI_db9b6687: ComBitPosition=24, ComBitSize=4, ComSignalDataInvalidValue=15, ComSignalType=UINT8, ComSignalInitValue=0, ComHandleId=85, ComSystemTemplateSystemSignalRef=RQ_CULI
          ALIV_ENSU_SFY_db9b6687: ComBitPosition=8, ComBitSize=4, ComSignalDataInvalidValue=15, ComSignalType=UINT8, ComSignalInitValue=0, ComHandleId=8, ComSystemTemplateSystemSignalRef=ALIV_ENSU_SFY
          ENSU_SFY_dummy_28_31_db9b6687: ComBitPosition=28, ComBitSize=4, ComSignalInitValue=15, ComSignalType=UINT8, ComHandleId=48, ComSystemTemplateSystemSignalRef=ENSU_SFY_dummy_28_31
      RQ_STG_EFAN_862c1b6d (ComSignal):
        ComBitPosition = 16
        ComBitSize = 4
        ComSignalDataInvalidValue = 15
        ComSignalEndianness = LITTLE_ENDIAN
        ComSignalType = UINT8
        ComSignalInitValue = 0
        ComSignalAccess = ACCESS_NEEDED_BY_SWC_OR_COM
        ComHandleId = 63
        ComTransferProperty = PENDING
        ComSystemTemplateSystemSignalRef = RQ_STG_EFAN
      CTR_VIB_STW_DISP_EXMI_SP2015_19255f18 (ComIPdu):
        ComIPduDirection = RECEIVE
        ComIPduType = NORMAL
        ComIPduHandleId = 6
        ComIPduSignalProcessing = DEFERRED
        ComIPduCancellationSupport = false
        ComIPduSignalRef = CTR_WARN_DIR_VIB_EPS_66c73f8f
        ComIPduSignalRef = CTR_WARN_ILVL_VIB_EPS_66c73f8f
        ComIPduSignalRef = CTR_WARN_PTRN_VIB_EPS_66c73f8f
        ComPduIdRef = pduTrig_CTR_VIB_STW_DISP_EXMI_SP2015_pduPort_EPS_A_FlexRay_IN_55c86d41_4f391dd1
        ComIPduGroupRef = EPS_IN_PduGroup6
      ST_DIAG_OBD_3_DRDY_MAX_MUX_65e49c1b (ComSignal):
        ComBitPosition = 4
        ComBitSize = 6
        ComSignalDataInvalidValue = 63
        ComSignalEndianness = LITTLE_ENDIAN
        ComSignalType = UINT8
        ComTransferProperty = TRIGGERED_ON_CHANGE
        ComSignalInitValue = 0
        ComSignalAccess = ACCESS_NEEDED_BY_SWC_OR_COM
        ComHandleId = 74
        ComSystemTemplateSystemSignalRef = ST_DIAG_OBD_3_DRDY_MAX_MUX
      sigGroup_OFFS_QUAD_EPS_cc150a52 (ComSignalGroup):
        ComSignalGroupAccess = ACCESS_NEEDED_BY_SWC_OR_COM
        ComHandleId = 5
        ComNotification = Rte_COMCbk_sigGroup_OFFS_QUAD_EPS_cc150a52
        ComTimeoutNotification = Rte_COMCbkRxTOut_sigGroup_OFFS_QUAD_EPS_cc150a52
        ComTimeout = 1.1
        ComSystemTemplateSignalGroupRef = sigGroup_OFFS_QUAD_EPS
        5 x ComGroupSignal, all with ComSignalEndianness=LITTLE_ENDIAN, ComSignalInitValue=0, ComSignalAccess=ACCESS_NEEDED_BY_SWC_OR_COM:
          ALIV_OFFS_QUAD_EPS_1a5f7888: ComBitPosition=8, ComBitSize=4, ComSignalDataInvalidValue=15, ComSignalType=UINT8, ComHandleId=9, ComSystemTemplateSystemSignalRef=ALIV_OFFS_QUAD_EPS
          ST_OFFS_QUAD_EPS_1a5f7888: ComBitPosition=12, ComBitSize=4, ComSignalDataInvalidValue=15, ComSignalType=UINT8, ComHandleId=100, ComSystemTemplateSystemSignalRef=ST_OFFS_QUAD_EPS
          AVL_PO_IDX_ICM_1a5f7888: ComBitPosition=24, ComBitSize=16, ComSignalDataInvalidValue=65535, ComSignalType=UINT16, ComHandleId=17, ComSystemTemplateSystemSignalRef=AVL_PO_IDX_ICM
          CRC_OFFS_QUAD_EPS_1a5f7888: ComBitPosition=0, ComBitSize=8, ComSignalType=UINT8, ComHandleId=32, ComSystemTemplateSystemSignalRef=CRC_OFFS_QUAD_EPS
          OFFS_QUAD_RTR_EPS_1a5f7888: ComBitPosition=16, ComBitSize=8, ComSignalDataInvalidValue=255, ComSignalType=UINT8, ComHandleId=68, ComSystemTemplateSystemSignalRef=OFFS_QUAD_RTR_EPS
      V_VEH_19255f18 (ComIPdu):
        ComIPduDirection = RECEIVE
        ComIPduType = NORMAL
        ComIPduHandleId = 27
        ComIPduSignalProcessing = DEFERRED
        ComIPduCancellationSupport = false
        ComIPduSignalGroupRef = sigGroup_V_VEH_2fe00c20
        ComPduIdRef = pduTrig_V_VEH_pduPort_EPS_A_FlexRay_IN_55c86d41_4f391dd1
        ComIPduGroupRef = EPS_IN_PduGroup3
      ID_TEMP_CPO_HET_MNG_862c1b6d (ComSignal):
        ComBitPosition = 20
        ComBitSize = 4
        ComSignalDataInvalidValue = 15
        ComSignalEndianness = LITTLE_ENDIAN
        ComSignalType = UINT8
        ComSignalInitValue = 0
        ComSignalAccess = ACCESS_NEEDED_BY_SWC_OR_COM
        ComHandleId = 46
        ComTransferProperty = PENDING
        ComSystemTemplateSystemSignalRef = ID_TEMP_CPO_HET_MNG
      SECU_CHAL_19255f18 (ComIPdu):
        ComIPduDirection = SEND
        ComIPduType = NORMAL
        ComIPduHandleId = 10
        ComIPduSignalProcessing = DEFERRED
        ComIPduCancellationSupport = false
        ComIPduSignalRef = SECU_CHAL_5fff8d6b
        ComIPduSignalRef = SECU_CHAL_ID2_5fff8d6b
        ComIPduSignalRef = SSS_IDENT_CHAL_5fff8d6b
        ComIPduSignalRef = SSV_IDENT_CHAL_5fff8d6b
        ComPduIdRef = pduTrig_SECU_CHAL_pduPort_EPS_A_FlexRay_OUT_55c86d41_4f391dd1
        ComIPduGroupRef = EPS_OUT_PduGroup3
        ComTxIPdu: ComMinimumDelayTime=0.05, ComTxIPduUnusedAreasDefault=255, ComTxIPduClearUpdateBit=TriggerTransmit
          ComTxModeTrue
            ComTxMode: ComTxModeMode=DIRECT, ComTxModeNumberOfRepetitions=0
          ComTxModeFalse
            ComTxMode: ComTxModeMode=NONE
      DIAG_ST_OBD_3_DRDY_5_65e49c1b (ComSignal):
        ComBitPosition = 40
        ComBitSize = 6
        ComSignalDataInvalidValue = 63
        ComSignalEndianness = LITTLE_ENDIAN
        ComSignalType = UINT8
        ComTransferProperty = TRIGGERED_ON_CHANGE
        ComSignalInitValue = 0
        ComSignalAccess = ACCESS_NEEDED_BY_SWC_OR_COM
        ComHandleId = 33
        ComSystemTemplateSystemSignalRef = DIAG_ST_OBD_3_DRDY_5
      DBG_EPS_MOD_EXT_120_BYTE_19255f18 (ComIPdu):
        ComIPduDirection = SEND
        ComIPduType = NORMAL
        ComIPduHandleId = 5
        ComIPduSignalProcessing = DEFERRED
        ComIPduCancellationSupport = false
        ComIPduSignalRef = DBG_EPS_MOD_EXT_120_BYTE_58e47270
        ComIPduSignalRef = DBG_EPS_MOD_EXT_120_BYTE_ID2_58e47270
        ComPduIdRef = pduTrig_DBG_EPS_MOD_EXT_120_BYTE_pduPort_EPS_A_FlexRay_OUT_55c86d41_4f391dd1
        ComIPduGroupRef = EPS_OUT_PduGroup2
        ComTxIPdu: ComTxIPduUnusedAreasDefault=255, ComMinimumDelayTime=0, ComTxIPduClearUpdateBit=TriggerTransmit
          ComTxModeTrue
            ComTxMode: ComTxModeMode=PERIODIC, ComTxModeTimePeriod=0.005, ComTxModeTimeOffset=0
          ComTxModeFalse
            ComTxMode: ComTxModeMode=NONE
      ST_STAB_DSC_19255f18 (ComIPdu):
        ComIPduDirection = RECEIVE
        ComIPduType = NORMAL
        ComIPduHandleId = 21
        ComIPduSignalProcessing = DEFERRED
        ComIPduCancellationSupport = false
        ComIPduSignalRef = QU_FN_FDR_d5c7d03c
        ComPduIdRef = pduTrig_ST_STAB_DSC_pduPort_EPS_A_FlexRay_IN_55c86d41_4f391dd1
        ComIPduGroupRef = EPS_IN_PduGroup3
      NO_VECH_3_13b7b7e4 (ComSignal):
        ComBitPosition = 16
        ComSignalDataInvalidValue = 255
        ComSignalEndianness = opaque
        ComSignalLength = 1
        ComSignalType = UINT8_N
        ComSignalInitValue = 0
        ComSignalAccess = ACCESS_NEEDED_BY_SWC_OR_COM
        ComHandleId = 63
        ComSystemTemplateSystemSignalRef = NO_VECH_3
      SECU_RESP_ID2_d377025e (ComSignal):
        ComBitPosition = 0
        ComBitSize = 8
        ComSignalEndianness = LITTLE_ENDIAN
        ComSignalInitValue = 247
        ComSignalType = UINT8
        ComSignalAccess = ACCESS_NEEDED_BY_SWC_OR_COM
        ComHandleId = 87
        ComSystemTemplateSystemSignalRef = SECU_RESP_ID2
      AVL_RPM_WHL_19255f18 (ComIPdu):
        ComIPduDirection = RECEIVE
        ComIPduType = NORMAL
        ComIPduHandleId = 2
        ComIPduSignalProcessing = DEFERRED
        ComIPduCancellationSupport = false
        ComIPduSignalGroupRef = sigGroup_AVL_RPM_WHL_eba9ae07
        ComPduIdRef = pduTrig_AVL_RPM_WHL_pduPort_EPS_A_FlexRay_IN_55c86d41_4f391dd1
        ComIPduGroupRef = EPS_IN_PduGroup3
      TEMP_CPO_HET_MNG_862c1b6d (ComSignal):
        ComBitPosition = 24
        ComBitSize = 8
        ComSignalDataInvalidValue = 255
        ComSignalEndianness = LITTLE_ENDIAN
        ComSignalType = UINT8
        ComSignalInitValue = 0
        ComSignalAccess = ACCESS_NEEDED_BY_SWC_OR_COM
        ComHandleId = 80
        ComTransferProperty = PENDING
        ComSystemTemplateSystemSignalRef = TEMP_CPO_HET_MNG
      FZZSTD_19255f18 (ComIPdu):
        ComIPduDirection = RECEIVE
        ComIPduType = NORMAL
        ComIPduHandleId = 12
        ComIPduSignalProcessing = DEFERRED
        ComIPduCancellationSupport = false
        ComIPduSignalRef = ST_ENERG_FZM_e7ce1a0c
        ComIPduSignalRef = ST_ILK_ERRM_FZM_e7ce1a0c
        ComPduIdRef = pduTrig_FZZSTD_pduPort_EPS_A_FlexRay_IN_55c86d41_4f391dd1
        ComIPduGroupRef = EPS_IN_PduGroup4
      sigGroup_V_VEH_2fe00c20 (ComSignalGroup):
        ComSignalGroupAccess = ACCESS_NEEDED_BY_SWC_OR_COM
        ComHandleId = 10
        ComNotification = Rte_COMCbk_sigGroup_V_VEH_2fe00c20
        ComTimeoutNotification = Rte_COMCbkRxTOut_sigGroup_V_VEH_2fe00c20
        ComTimeout = 0.02
        ComSystemTemplateSignalGroupRef = sigGroup_V_VEH
        7 x ComGroupSignal, all with ComSignalEndianness=LITTLE_ENDIAN, ComSignalAccess=ACCESS_NEEDED_BY_SWC_OR_COM:
          ALIV_V_VEH_579a99a0: ComBitPosition=8, ComBitSize=4, ComSignalDataInvalidValue=15, ComSignalType=UINT8, ComSignalInitValue=0, ComHandleId=15, ComSystemTemplateSystemSignalRef=ALIV_V_VEH
          V_VEH_COG_579a99a0: ComBitPosition=16, ComBitSize=16, ComSignalDataInvalidValue=65535, ComSignalType=UINT16, ComSignalInitValue=0, ComHandleId=117, ComSystemTemplateSystemSignalRef=V_VEH_COG
          ST_V_VEH_NSS_579a99a0: ComBitPosition=12, ComBitSize=4, ComSignalDataInvalidValue=15, ComSignalType=UINT8, ComSignalInitValue=0, ComHandleId=103, ComSystemTemplateSystemSignalRef=ST_V_VEH_NSS
          DVCO_VEH_579a99a0: ComBitPosition=36, ComBitSize=3, ComSignalDataInvalidValue=7, ComSignalType=UINT8, ComSignalInitValue=0, ComHandleId=45, ComSystemTemplateSystemSignalRef=DVCO_VEH
          CRC_V_VEH_579a99a0: ComBitPosition=0, ComBitSize=8, ComSignalType=UINT8, ComSignalInitValue=0, ComHandleId=37, ComSystemTemplateSystemSignalRef=CRC_V_VEH
          QU_V_VEH_COG_579a99a0: ComBitPosition=32, ComBitSize=4, ComSignalDataInvalidValue=15, ComSignalType=UINT8, ComSignalInitValue=0, ComHandleId=83, ComSystemTemplateSystemSignalRef=QU_V_VEH_COG
          V_VEH_dummy_39_39_579a99a0: ComBitPosition=39, ComBitSize=1, ComSignalInitValue=1, ComSignalType=UINT8, ComHandleId=118, ComSystemTemplateSystemSignalRef=V_VEH_dummy_39_39
      NO_VECH_4_13b7b7e4 (ComSignal):
        ComBitPosition = 24
        ComSignalDataInvalidValue = 255
        ComSignalEndianness = opaque
        ComSignalLength = 1
        ComSignalType = UINT8_N
        ComSignalInitValue = 0
        ComSignalAccess = ACCESS_NEEDED_BY_OTHER
        ComHandleId = 64
        ComSystemTemplateSystemSignalRef = NO_VECH_4
      TRGG_ENGTORQ_EPS_4e565a26 (ComSignal):
        ComBitPosition = 16
        ComBitSize = 12
        ComSignalDataInvalidValue = 4095
        ComSignalEndianness = LITTLE_ENDIAN
        ComSignalType = UINT16
        ComSignalInitValue = 0
        ComSignalAccess = ACCESS_NEEDED_BY_SWC_OR_COM
        ComHandleId = 83
        ComTransferProperty = PENDING
        ComSystemTemplateSystemSignalRef = TRGG_ENGTORQ_EPS
      ANFRAGE_fbd80461_In (ComIPdu):
        ComIPduDirection = RECEIVE
        ComIPduType = NORMAL
        ComIPduHandleId = 1
        ComIPduSignalProcessing = DEFERRED
        ComIPduCancellationSupport = false
        ComIPduSignalRef = ANFRAGE_ID2_fbd80461_In
        ComIPduSignalRef = ID_FN_INQY_fbd80461_In
        ComPduIdRef = ANFRAGE_fbd80461_In
        ComIPduGroupRef = EPS_IN_PduGroup2
      DIAG_ST_OBD_3_DRDY_6_65e49c1b (ComSignal):
        ComBitPosition = 46
        ComBitSize = 6
        ComSignalDataInvalidValue = 63
        ComSignalEndianness = LITTLE_ENDIAN
        ComSignalType = UINT8
        ComTransferProperty = TRIGGERED_ON_CHANGE
        ComSignalInitValue = 0
        ComSignalAccess = ACCESS_NEEDED_BY_SWC_OR_COM
        ComHandleId = 34
        ComSystemTemplateSystemSignalRef = DIAG_ST_OBD_3_DRDY_6
      SU_EPS_19255f18 (ComIPdu):
        ComIPduDirection = SEND
        ComIPduType = NORMAL
        ComIPduHandleId = 13
        ComIPduSignalProcessing = DEFERRED
        ComIPduCancellationSupport = false
        ComIPduSignalGroupRef = sigGroup_SU_EPS_fe4f71c6
        ComPduIdRef = pduTrig_SU_EPS_pduPort_EPS_A_FlexRay_OUT_55c86d41_4f391dd1
        ComIPduGroupRef = EPS_OUT_PduGroup2
        ComTxIPdu: ComMinimumDelayTime=0.5, ComTxIPduUnusedAreasDefault=255
          ComTxModeTrue
            ComTxMode: ComTxModeMode=MIXED, ComTxModeNumberOfRepetitions=2, ComTxModeRepetitionPeriod=0.5, ComTxModeTimePeriod=5, ComTxModeTimeOffset=0
          ComTxModeFalse
            ComTxMode: ComTxModeMode=NONE
      ALIV_ST_DIAG_OBD_3_DRDY_65e49c1b (ComSignal):
        ComBitPosition = 0
        ComBitSize = 4
        ComSignalDataInvalidValue = 15
        ComSignalEndianness = LITTLE_ENDIAN
        ComSignalType = UINT8
        ComTransferProperty = TRIGGERED_ON_CHANGE
        ComSignalInitValue = 0
        ComSignalAccess = ACCESS_NEEDED_BY_SWC_OR_COM
        ComHandleId = 5
        ComSystemTemplateSystemSignalRef = ALIV_ST_DIAG_OBD_3_DRDY
      DIAG_ST_OBD_3_DRDY_3_65e49c1b (ComSignal):
        ComBitPosition = 28
        ComBitSize = 6
        ComSignalDataInvalidValue = 63
        ComSignalEndianness = LITTLE_ENDIAN
        ComSignalType = UINT8
        ComTransferProperty = TRIGGERED_ON_CHANGE
        ComSignalInitValue = 0
        ComSignalAccess = ACCESS_NEEDED_BY_SWC_OR_COM
        ComHandleId = 31
        ComSystemTemplateSystemSignalRef = DIAG_ST_OBD_3_DRDY_3
      sigGroup_SU_EPS_fe4f71c6 (ComSignalGroup): ComSignalGroupAccess=ACCESS_NEEDED_BY_SWC_OR_COM, ComHandleId=6, ComSystemTemplateSignalGroupRef=sigGroup_SU_EPS
        6 x ComGroupSignal, all with ComSignalEndianness=LITTLE_ENDIAN, ComSignalAccess=ACCESS_NEEDED_BY_SWC_OR_COM, ComTransferProperty=PENDING:
          TOT_STR_EPS_f544de28: ComBitPosition=0, ComBitSize=12, ComSignalDataInvalidValue=4095, ComSignalType=UINT16, ComSignalInitValue=0, ComHandleId=81, ComSystemTemplateSystemSignalRef=TOT_STR_EPS
          UN_TOT_STR_EPS_f544de28: ComBitPosition=12, ComBitSize=2, ComSignalDataInvalidValue=3, ComSignalType=UINT8, ComSignalInitValue=0, ComHandleId=85, ComSystemTemplateSystemSignalRef=UN_TOT_STR_EPS
          SU_EPS_dummy_20_51_f544de28: ComBitPosition=20, ComBitSize=32, ComSignalInitValue=4294967295, ComSignalType=UINT32, ComHandleId=78, ComSystemTemplateSystemSignalRef=SU_EPS_dummy_20_51
          ALIV_SU_EPS_f544de28: ComBitPosition=52, ComBitSize=4, ComSignalDataInvalidValue=15, ComSignalType=UINT8, ComSignalInitValue=0, ComHandleId=7, ComSystemTemplateSystemSignalRef=ALIV_SU_EPS
          SU_EPS_dummy_14_19_f544de28: ComBitPosition=14, ComBitSize=6, ComSignalInitValue=63, ComSignalType=UINT8, ComHandleId=77, ComSystemTemplateSystemSignalRef=SU_EPS_dummy_14_19
          CRC_SU_EPS_f544de28: ComBitPosition=56, ComBitSize=8, ComSignalType=UINT8, ComSignalInitValue=0, ComHandleId=25, ComSystemTemplateSystemSignalRef=CRC_SU_EPS
      SECU_FAHRGESTELLNUMMER_19255f18 (ComIPdu):
        ComIPduDirection = RECEIVE
        ComIPduType = NORMAL
        ComIPduHandleId = 16
        ComIPduSignalProcessing = DEFERRED
        ComIPduCancellationSupport = false
        ComIPduSignalRef = STU_8_BYTE_347be560
        ComPduIdRef = pduTrig_SECU_FAHRGESTELLNUMMER_pduPort_EPS_A_FlexRay_IN_55c86d41_4f391dd1
        ComIPduGroupRef = EPS_IN_PduGroup3
      TEMP_EX_4b857050 (ComSignal):
        ComBitPosition = 0
        ComBitSize = 8
        ComSignalDataInvalidValue = 255
        ComSignalEndianness = LITTLE_ENDIAN
        ComSignalType = UINT8
        ComSignalInitValue = 0
        ComSignalAccess = ACCESS_NEEDED_BY_SWC_OR_COM
        ComHandleId = 112
        ComDataInvalidAction = REPLACE
        ComSystemTemplateSystemSignalRef = TEMP_EX
      4 x ComIPdu, all with ComIPduType=NORMAL, ComIPduSignalProcessing=DEFERRED, ComIPduCancellationSupport=false:
        AVL_FORC_GRD_19255f18: ComIPduDirection=SEND, ComIPduHandleId=1, ComIPduSignalGroupRef=sigGroup_AVL_FORC_GRD_19621f3f, ComPduIdRef=pduTrig_AVL_FORC_GRD_pduPort_EPS_A_FlexRay_OUT_55c86d41_4f391dd1, ComIPduGroupRef=EPS_OUT_PduGroup2
          ComTxIPdu: ComTxIPduUnusedAreasDefault=255, ComMinimumDelayTime=0
            ComTxModeTrue
              ComTxMode: ComTxModeMode=PERIODIC, ComTxModeTimePeriod=0.01, ComTxModeTimeOffset=0
            ComTxModeFalse
              ComTxMode: ComTxModeMode=NONE
        DISP_CC_EPS_19255f18: ComIPduDirection=SEND, ComIPduHandleId=6, ComIPduSignalGroupRef=sigGroup_DISP_CC_EPS_ad160a0a, ComPduIdRef=pduTrig_DISP_CC_EPS_pduPort_EPS_A_FlexRay_OUT_55c86d41_4f391dd1, ComIPduGroupRef=EPS_OUT_PduGroup2
          ComTxIPdu: ComMinimumDelayTime=0.06, ComTxIPduUnusedAreasDefault=255
            ComTxModeTrue
              ComTxMode: ComTxModeMode=MIXED, ComTxModeNumberOfRepetitions=0, ComTxModeTimePeriod=0.32, ComTxModeTimeOffset=0
            ComTxModeFalse
              ComTxMode: ComTxModeMode=NONE
        ACLNY_MASSCNTR_19255f18: ComIPduDirection=RECEIVE, ComIPduHandleId=0, ComIPduSignalGroupRef=sigGroup_ACLNY_MASSCNTR_461c64b1, ComPduIdRef=pduTrig_ACLNY_MASSCNTR_pduPort_EPS_A_FlexRay_IN_55c86d41_4f391dd1, ComIPduGroupRef=EPS_IN_PduGroup
        ST_CENG_19255f18: ComIPduDirection=RECEIVE, ComIPduHandleId=19, ComIPduSignalRef=ALIV_ST_CENG_43f592b4, ComIPduSignalRef=ST_ANO_MSA_ENG_STOP_43f592b4, ComIPduSignalRef=ST_CENG_DRV_43f592b4, ComIPduSignalRef=ST_ENERG_SUPY_43f592b4, ComIPduSignalRef=ST_MOT_DRV_43f592b4, ComIPduSignalRef=ST_UDP_43f592b4, ComPduIdRef=pduTrig_ST_CENG_pduPort_EPS_A_FlexRay_IN_55c86d41_4f391dd1, ComIPduGroupRef=EPS_IN_PduGroup10
      ANFRAGE_ID2_fbd80461_In (ComSignal):
        ComBitPosition = 0
        ComBitSize = 8
        ComSignalEndianness = LITTLE_ENDIAN
        ComSignalInitValue = 1
        ComSignalType = UINT16
        ComSignalAccess = ACCESS_NEEDED_BY_SWC_OR_COM
        ComHandleId = 16
        ComNotification = Rte_COMCbk_ANFRAGE_ID2_fbd80461_In
        ComSystemTemplateSystemSignalRef = ANFRAGE_ID2
      ENSU_SFY_19255f18 (ComIPdu):
        ComIPduDirection = RECEIVE
        ComIPduType = NORMAL
        ComIPduHandleId = 9
        ComIPduSignalProcessing = DEFERRED
        ComIPduCancellationSupport = false
        ComIPduSignalGroupRef = sigGroup_ENSU_SFY_dfa36b36
        ComPduIdRef = pduTrig_ENSU_SFY_pduPort_EPS_A_FlexRay_IN_55c86d41_4f391dd1
        ComIPduGroupRef = EPS_IN_PduGroup6
      4 x ComSignal, all with ComSignalEndianness=LITTLE_ENDIAN, ComSignalAccess=ACCESS_NEEDED_BY_SWC_OR_COM:
        COU_BS_RESP_d377025e: ComBitPosition=16, ComBitSize=24, ComSignalDataInvalidValue=16777215, ComSignalType=UINT32, ComSignalInitValue=0, ComHandleId=26, ComSystemTemplateSystemSignalRef=COU_BS_RESP
        SU_CLU_STMOM_SFE_DXP_59dc6376: ComBitPosition=8, ComBitSize=4, ComSignalDataInvalidValue=15, ComSignalType=UINT8, ComSignalInitValue=0, ComHandleId=104, ComNotification=Rte_COMCbk_SU_CLU_STMOM_SFE_DXP_59dc6376, ComTimeoutNotification=Rte_COMCbkRxTOut_SU_CLU_STMOM_SFE_DXP_59dc6376, ComTimeout=0.045, ComSystemTemplateSystemSignalRef=SU_CLU_STMOM_SFE_DXP
        SSS_IDENT_CHAL_5fff8d6b: ComBitPosition=16, ComBitSize=8, ComSignalDataInvalidValue=255, ComSignalType=UINT8, ComSignalInitValue=0, ComHandleId=68, ComTransferProperty=PENDING, ComSystemTemplateSystemSignalRef=SSS_IDENT_CHAL
        DBG_EPS_BS_MOD_58_BYTE_ID2_df324712: ComBitPosition=0, ComBitSize=8, ComSignalInitValue=1, ComSignalType=UINT8, ComTransferProperty=PENDING, ComHandleId=26, ComSystemTemplateSystemSignalRef=DBG_EPS_BS_MOD_58_BYTE_ID2
      sigGroup_AVL_STMOM_DV_ACT_744f32e2 (ComSignalGroup): ComSignalGroupAccess=ACCESS_NEEDED_BY_SWC_OR_COM, ComHandleId=2, ComSystemTemplateSignalGroupRef=sigGroup_AVL_STMOM_DV_ACT
        5 x ComGroupSignal, all with ComSignalEndianness=LITTLE_ENDIAN, ComSignalAccess=ACCESS_NEEDED_BY_SWC_OR_COM, ComTransferProperty=PENDING:
          AVL_STMOM_DV_ACT_dummy_12_15_3ef6286e: ComBitPosition=12, ComBitSize=4, ComSignalInitValue=15, ComSignalType=UINT8, ComHandleId=16, ComSystemTemplateSystemSignalRef=AVL_STMOM_DV_ACT_dummy_12_15
          QU_AVL_STMOM_DV_ACT_3ef6286e: ComBitPosition=28, ComBitSize=4, ComSignalDataInvalidValue=15, ComSignalType=UINT8, ComSignalInitValue=0, ComHandleId=59, ComSystemTemplateSystemSignalRef=QU_AVL_STMOM_DV_ACT
          AVL_STMOM_DV_ACT_3ef6286e: ComBitPosition=16, ComBitSize=12, ComSignalDataInvalidValue=4095, ComSignalType=UINT16, ComSignalInitValue=0, ComHandleId=15, ComSystemTemplateSystemSignalRef=AVL_STMOM_DV_ACT
          CRC_AVL_STMOM_DV_ACT_3ef6286e: ComBitPosition=0, ComBitSize=8, ComSignalType=UINT8, ComSignalInitValue=0, ComHandleId=21, ComSystemTemplateSystemSignalRef=CRC_AVL_STMOM_DV_ACT
          ALIV_AVL_STMOM_DV_ACT_3ef6286e: ComBitPosition=8, ComBitSize=4, ComSignalDataInvalidValue=15, ComSignalType=UINT8, ComSignalInitValue=0, ComHandleId=2, ComSystemTemplateSystemSignalRef=ALIV_AVL_STMOM_DV_ACT
      ENGTORQ_EPS_19255f18 (ComIPdu):
        ComIPduDirection = SEND
        ComIPduType = NORMAL
        ComIPduHandleId = 8
        ComIPduSignalProcessing = DEFERRED
        ComIPduCancellationSupport = false
        ComIPduSignalRef = TRGG_ENGTORQ_EPS_4e565a26
        ComPduIdRef = pduTrig_ENGTORQ_EPS_pduPort_EPS_A_FlexRay_OUT_55c86d41_4f391dd1
        ComIPduGroupRef = EPS_OUT_PduGroup2
        ComTxIPdu: ComTxIPduUnusedAreasDefault=255, ComMinimumDelayTime=0
          ComTxModeTrue
            ComTxMode: ComTxModeMode=PERIODIC, ComTxModeTimePeriod=0.01, ComTxModeTimeOffset=0
          ComTxModeFalse
            ComTxMode: ComTxModeMode=NONE
      ID_FN_INQY_fbd80461_In (ComSignal):
        ComBitPosition = 8
        ComBitSize = 16
        ComSignalDataInvalidValue = 65535
        ComSignalEndianness = LITTLE_ENDIAN
        ComSignalType = UINT16
        ComSignalInitValue = 0
        ComSignalAccess = ACCESS_NEEDED_BY_SWC_OR_COM
        ComHandleId = 55
        ComDataInvalidAction = REPLACE
        ComSystemTemplateSystemSignalRef = ID_FN_INQY
      sigGroup_TAR_STMOM_DV_ACT_9a7b28d3 (ComSignalGroup):
        ComSignalGroupAccess = ACCESS_NEEDED_BY_SWC_OR_COM
        ComHandleId = 8
        ComNotification = Rte_COMCbk_sigGroup_TAR_STMOM_DV_ACT_9a7b28d3
        ComTimeoutNotification = Rte_COMCbkRxTOut_sigGroup_TAR_STMOM_DV_ACT_9a7b28d3
        ComTimeout = 0.015
        ComSystemTemplateSignalGroupRef = sigGroup_TAR_STMOM_DV_ACT
        8 x ComGroupSignal, all with ComSignalEndianness=LITTLE_ENDIAN, ComSignalAccess=ACCESS_NEEDED_BY_SWC_OR_COM:
          TAR_STMOM_DV_ACT_dummy_32_51_56e1c987: ComBitPosition=32, ComBitSize=20, ComSignalInitValue=1048575, ComSignalType=UINT32, ComHandleId=111, ComSystemTemplateSystemSignalRef=TAR_STMOM_DV_ACT_dummy_32_51
          TAR_STMOM_DV_ACT_56e1c987: ComBitPosition=16, ComBitSize=12, ComSignalDataInvalidValue=4095, ComSignalType=UINT16, ComSignalInitValue=0, ComHandleId=109, ComSystemTemplateSystemSignalRef=TAR_STMOM_DV_ACT
          TAR_STMOM_DV_ACT_dummy_12_15_56e1c987: ComBitPosition=12, ComBitSize=4, ComSignalInitValue=15, ComSignalType=UINT8, ComHandleId=110, ComSystemTemplateSystemSignalRef=TAR_STMOM_DV_ACT_dummy_12_15
          QU_TAR_STMOM_DV_ACT_56e1c987: ComBitPosition=28, ComBitSize=4, ComSignalDataInvalidValue=15, ComSignalType=UINT8, ComSignalInitValue=0, ComHandleId=81, ComSystemTemplateSystemSignalRef=QU_TAR_STMOM_DV_ACT
          FACT_DMPNG_ADDON_STMOM_FTAX_56e1c987: ComBitPosition=56, ComBitSize=8, ComSignalDataInvalidValue=255, ComSignalType=UINT8, ComSignalInitValue=0, ComHandleId=52, ComSystemTemplateSystemSignalRef=FACT_DMPNG_ADDON_STMOM_FTAX
          QU_TAR_DMPNG_ADDON_STMOM_FTAX_56e1c987: ComBitPosition=52, ComBitSize=4, ComSignalDataInvalidValue=15, ComSignalType=UINT8, ComSignalInitValue=0, ComHandleId=78, ComSystemTemplateSystemSignalRef=QU_TAR_DMPNG_ADDON_STMOM_FTAX
          CRC_TAR_STMOM_DV_ACT_56e1c987: ComBitPosition=0, ComBitSize=8, ComSignalType=UINT8, ComSignalInitValue=0, ComHandleId=35, ComSystemTemplateSystemSignalRef=CRC_TAR_STMOM_DV_ACT
          ALIV_TAR_STMOM_DV_ACT_56e1c987: ComBitPosition=8, ComBitSize=4, ComSignalDataInvalidValue=15, ComSignalType=UINT8, ComSignalInitValue=0, ComHandleId=13, ComSystemTemplateSystemSignalRef=ALIV_TAR_STMOM_DV_ACT
      CTR_WARN_PTRN_VIB_EPS_66c73f8f (ComSignal):
        ComBitPosition = 36
        ComBitSize = 4
        ComSignalDataInvalidValue = 15
        ComSignalEndianness = LITTLE_ENDIAN
        ComSignalType = UINT8
        ComSignalInitValue = 0
        ComSignalAccess = ACCESS_NEEDED_BY_SWC_OR_COM
        ComHandleId = 44
        ComNotification = Rte_COMCbk_CTR_WARN_PTRN_VIB_EPS_66c73f8f
        ComTimeoutNotification = Rte_COMCbkRxTOut_CTR_WARN_PTRN_VIB_EPS_66c73f8f
        ComTimeout = 0.55
        ComSystemTemplateSystemSignalRef = CTR_WARN_PTRN_VIB_EPS
      NO_VECH_6_13b7b7e4 (ComSignal):
        ComBitPosition = 40
        ComSignalDataInvalidValue = 255
        ComSignalEndianness = opaque
        ComSignalLength = 1
        ComSignalType = UINT8_N
        ComSignalInitValue = 0
        ComSignalAccess = ACCESS_NEEDED_BY_SWC_OR_COM
        ComHandleId = 66
        ComSystemTemplateSystemSignalRef = NO_VECH_6
      sigGroup_AVL_RPM_WHL_eba9ae07 (ComSignalGroup):
        ComSignalGroupAccess = ACCESS_NEEDED_BY_SWC_OR_COM
        ComHandleId = 1
        ComDataInvalidAction = REPLACE
        ComSystemTemplateSignalGroupRef = sigGroup_AVL_RPM_WHL
        11 x ComGroupSignal, all with ComSignalEndianness=LITTLE_ENDIAN, ComSignalAccess=ACCESS_NEEDED_BY_SWC_OR_COM:
          AVL_RPM_WHL_RRH_c59967bf: ComBitPosition=32, ComBitSize=16, ComSignalDataInvalidValue=65535, ComSignalType=UINT16, ComSignalInitValue=0, ComHandleId=21, ComSystemTemplateSystemSignalRef=AVL_RPM_WHL_RRH
          AVL_RPM_WHL_dummy_12_15_c59967bf: ComBitPosition=12, ComBitSize=4, ComSignalInitValue=15, ComSignalType=UINT8, ComHandleId=22, ComSystemTemplateSystemSignalRef=AVL_RPM_WHL_dummy_12_15
          ALIV_AVL_RPM_WHL_c59967bf: ComBitPosition=8, ComBitSize=4, ComSignalDataInvalidValue=15, ComSignalType=UINT8, ComSignalInitValue=0, ComHandleId=5, ComSystemTemplateSystemSignalRef=ALIV_AVL_RPM_WHL
          AVL_RPM_WHL_FLH_c59967bf: ComBitPosition=48, ComBitSize=16, ComSignalDataInvalidValue=65535, ComSignalType=UINT16, ComSignalInitValue=0, ComHandleId=18, ComSystemTemplateSystemSignalRef=AVL_RPM_WHL_FLH
          CRC_AVL_RPM_WHL_c59967bf: ComBitPosition=0, ComBitSize=8, ComSignalType=UINT8, ComSignalInitValue=0, ComHandleId=28, ComSystemTemplateSystemSignalRef=CRC_AVL_RPM_WHL
          QU_AVL_RPM_WHL_FRH_c59967bf: ComBitPosition=92, ComBitSize=4, ComSignalDataInvalidValue=15, ComSignalType=UINT8, ComSignalInitValue=0, ComHandleId=71, ComSystemTemplateSystemSignalRef=QU_AVL_RPM_WHL_FRH
          AVL_RPM_WHL_FRH_c59967bf: ComBitPosition=64, ComBitSize=16, ComSignalDataInvalidValue=65535, ComSignalType=UINT16, ComSignalInitValue=0, ComHandleId=19, ComSystemTemplateSystemSignalRef=AVL_RPM_WHL_FRH
          QU_AVL_RPM_WHL_FLH_c59967bf: ComBitPosition=88, ComBitSize=4, ComSignalDataInvalidValue=15, ComSignalType=UINT8, ComSignalInitValue=0, ComHandleId=70, ComSystemTemplateSystemSignalRef=QU_AVL_RPM_WHL_FLH
          AVL_RPM_WHL_RLH_c59967bf: ComBitPosition=16, ComBitSize=16, ComSignalDataInvalidValue=65535, ComSignalType=UINT16, ComSignalInitValue=0, ComHandleId=20, ComSystemTemplateSystemSignalRef=AVL_RPM_WHL_RLH
          QU_AVL_RPM_WHL_RLH_c59967bf: ComBitPosition=80, ComBitSize=4, ComSignalDataInvalidValue=15, ComSignalType=UINT8, ComSignalInitValue=0, ComHandleId=72, ComSystemTemplateSystemSignalRef=QU_AVL_RPM_WHL_RLH
          QU_AVL_RPM_WHL_RRH_c59967bf: ComBitPosition=84, ComBitSize=4, ComSignalDataInvalidValue=15, ComSignalType=UINT8, ComSignalInitValue=0, ComHandleId=73, ComSystemTemplateSystemSignalRef=QU_AVL_RPM_WHL_RRH
      TAR_QTA_STRMOM_DV_19255f18 (ComIPdu):
        ComIPduDirection = RECEIVE
        ComIPduType = NORMAL
        ComIPduHandleId = 24
        ComIPduSignalProcessing = DEFERRED
        ComIPduCancellationSupport = false
        ComIPduSignalGroupRef = sigGroup_TAR_QTA_STRMOM_DV_231dfb08
        ComPduIdRef = pduTrig_TAR_QTA_STRMOM_DV_pduPort_EPS_A_FlexRay_IN_55c86d41_4f391dd1
        ComIPduGroupRef = EPS_IN_PduGroup3
      DIAG_ST_OBD_3_DRDY_8_65e49c1b (ComSignal):
        ComBitPosition = 58
        ComBitSize = 6
        ComSignalDataInvalidValue = 63
        ComSignalEndianness = LITTLE_ENDIAN
        ComSignalType = UINT8
        ComTransferProperty = TRIGGERED_ON_CHANGE
        ComSignalInitValue = 0
        ComSignalAccess = ACCESS_NEEDED_BY_SWC_OR_COM
        ComHandleId = 36
        ComSystemTemplateSystemSignalRef = DIAG_ST_OBD_3_DRDY_8
      4 x ComIPdu, all with ComIPduDirection=RECEIVE, ComIPduType=NORMAL, ComIPduSignalProcessing=DEFERRED, ComIPduCancellationSupport=false:
        CTR_DIAG_OBD_DRDY_19255f18: ComIPduHandleId=5, ComIPduSignalRef=RQ_RST_OBD_DIAG_DRDY_85fd80d4, ComPduIdRef=pduTrig_CTR_DIAG_OBD_DRDY_pduPort_EPS_A_FlexRay_IN_55c86d41_4f391dd1, ComIPduGroupRef=EPS_IN_PduGroup6
        DIAG_OBD_ENG_19255f18: ComIPduHandleId=7, ComIPduSignalRef=ST_OBD_CYC_f0d11ff9, ComPduIdRef=pduTrig_DIAG_OBD_ENG_pduPort_EPS_A_FlexRay_IN_55c86d41_4f391dd1, ComIPduGroupRef=EPS_IN_PduGroup7
        VYAW_VEH_19255f18: ComIPduHandleId=26, ComIPduSignalGroupRef=sigGroup_VYAW_VEH_fc66be94, ComPduIdRef=pduTrig_VYAW_VEH_pduPort_EPS_A_FlexRay_IN_55c86d41_4f391dd1, ComIPduGroupRef=EPS_IN_PduGroup3
        TAR_ESTP_VIRT_FTAX_19255f18: ComIPduHandleId=23, ComIPduSignalGroupRef=sigGroup_TAR_ESTP_VIRT_FTAX_7f6c789c, ComPduIdRef=pduTrig_TAR_ESTP_VIRT_FTAX_pduPort_EPS_A_FlexRay_IN_55c86d41_4f391dd1, ComIPduGroupRef=EPS_IN_PduGroup3
      ST_OBD_CYC_f0d11ff9 (ComSignal):
        ComBitPosition = 0
        ComBitSize = 6
        ComSignalDataInvalidValue = 63
        ComSignalEndianness = LITTLE_ENDIAN
        ComSignalType = UINT8
        ComSignalInitValue = 0
        ComSignalAccess = ACCESS_NEEDED_BY_SWC_OR_COM
        ComHandleId = 99
        ComSystemTemplateSystemSignalRef = ST_OBD_CYC
      ST_DIAG_OBD_3_DRDY_IMME_MUX_65e49c1b (ComSignal):
        ComBitPosition = 10
        ComBitSize = 6
        ComSignalDataInvalidValue = 63
        ComSignalEndianness = LITTLE_ENDIAN
        ComSignalType = UINT8
        ComTransferProperty = TRIGGERED_ON_CHANGE
        ComSignalInitValue = 0
        ComSignalAccess = ACCESS_NEEDED_BY_SWC_OR_COM
        ComHandleId = 73
        ComSystemTemplateSystemSignalRef = ST_DIAG_OBD_3_DRDY_IMME_MUX
      4 x ComIPdu, all with ComIPduType=NORMAL, ComIPduSignalProcessing=DEFERRED, ComIPduCancellationSupport=false:
        ERRM_BN_U_19255f18: ComIPduDirection=RECEIVE, ComIPduHandleId=10, ComIPduSignalRef=CTR_ERRM_BN_U_d46c15e6, ComPduIdRef=pduTrig_ERRM_BN_U_pduPort_EPS_A_FlexRay_IN_55c86d41_4f391dd1, ComIPduGroupRef=EPS_IN_PduGroup9
        STEA_OFFS_19255f18: ComIPduDirection=RECEIVE, ComIPduHandleId=18, ComIPduSignalRef=AVL_STEA_PNI_OFFS_9678c0e9, ComPduIdRef=pduTrig_STEA_OFFS_pduPort_EPS_A_FlexRay_IN_55c86d41_4f391dd1, ComIPduGroupRef=EPS_IN_PduGroup
        DBG_EPS_BS_MOD_58_BYTE_19255f18: ComIPduDirection=SEND, ComIPduHandleId=4, ComIPduSignalRef=BATT_VLTG_EPS_df324712, ComIPduSignalRef=DBG_EPS_BS_MOD_58_BYTE_ID2_df324712, ComIPduSignalRef=ECU_TEMP_EPS_df324712, ComIPduSignalRef=ESTIMD_PEAK_MOT_CURR_EPS_df324712, ComIPduSignalRef=MOT_FET_TEMP_EPS_df324712, ComIPduSignalRef=MOT_MAG_TEMP_EPS_df324712, ComIPduSignalRef=MOT_TQ_CMD_EPS_df324712, ComIPduSignalRef=MOT_TQ_CMD_LIMD_EPS_df324712, ComIPduSignalRef=MOT_VEL_EPS_df324712, ComIPduSignalRef=MOT_WIDG_TEMP_EPS_df324712, ComIPduSignalRef=PRIM_HW_TQ_SNSR_VLTG_EPS_df324712, ComIPduSignalRef=SECDRY_HW_TQ_SNSR_VLTG_EPS_df324712, ComIPduSignalRef=ST_CON_VEH_EPS_df324712, ComIPduSignalRef=SYS_ST_EPS_df324712, ComIPduSignalRef=VEH_SPD_EPS_df324712, ComPduIdRef=pduTrig_DBG_EPS_BS_MOD_58_BYTE_pduPort_EPS_A_FlexRay_OUT_55c86d41_4f391dd1, ComIPduGroupRef=EPS_OUT_PduGroup2
          ComTxIPdu: ComTxIPduUnusedAreasDefault=255, ComMinimumDelayTime=0, ComTxIPduClearUpdateBit=TriggerTransmit
            ComTxModeTrue
              ComTxMode: ComTxModeMode=PERIODIC, ComTxModeTimePeriod=0.02, ComTxModeTimeOffset=0
            ComTxModeFalse
              ComTxMode: ComTxModeMode=NONE
        CON_VEH_19255f18: ComIPduDirection=RECEIVE, ComIPduHandleId=4, ComIPduSignalGroupRef=sigGroup_CON_VEH_675e7344, ComPduIdRef=pduTrig_CON_VEH_pduPort_EPS_A_FlexRay_IN_55c86d41_4f391dd1, ComIPduGroupRef=EPS_IN_PduGroup5
      NO_VECH_1_13b7b7e4 (ComSignal):
        ComBitPosition = 0
        ComSignalDataInvalidValue = 255
        ComSignalEndianness = opaque
        ComSignalLength = 1
        ComSignalType = UINT8_N
        ComSignalInitValue = 0
        ComSignalAccess = ACCESS_NEEDED_BY_SWC_OR_COM
        ComHandleId = 61
        ComSystemTemplateSystemSignalRef = NO_VECH_1
      DT_EST_19255f18 (ComIPdu):
        ComIPduDirection = SEND
        ComIPduType = NORMAL
        ComIPduHandleId = 7
        ComIPduSignalProcessing = DEFERRED
        ComIPduCancellationSupport = false
        ComIPduSignalGroupRef = sigGroup_DT_EST_68b5ac35
        ComPduIdRef = pduTrig_DT_EST_pduPort_EPS_A_FlexRay_OUT_55c86d41_4f391dd1
        ComIPduGroupRef = EPS_OUT_PduGroup2
        ComTxIPdu: ComTxIPduUnusedAreasDefault=255, ComMinimumDelayTime=0
          ComTxModeTrue
            ComTxMode: ComTxModeMode=PERIODIC, ComTxModeTimePeriod=0.01, ComTxModeTimeOffset=0
          ComTxModeFalse
            ComTxMode: ComTxModeMode=NONE
      ANFRAGE_fbd80461_Out (ComIPdu):
        ComIPduDirection = SEND
        ComIPduType = NORMAL
        ComIPduHandleId = 0
        ComIPduSignalProcessing = DEFERRED
        ComIPduCancellationSupport = false
        ComIPduSignalRef = ANFRAGE_ID2_fbd80461_Out
        ComIPduSignalRef = ID_FN_INQY_fbd80461_Out
        ComPduIdRef = ANFRAGE_fbd80461_Out
        ComIPduGroupRef = EPS_OUT_PduGroup
        ComTxIPdu: ComMinimumDelayTime=0.5, ComTxIPduUnusedAreasDefault=255, ComTxIPduClearUpdateBit=TriggerTransmit
          ComTxModeTrue
            ComTxMode: ComTxModeMode=DIRECT, ComTxModeNumberOfRepetitions=0
          ComTxModeFalse
            ComTxMode: ComTxModeMode=NONE
      ALIV_ST_CENG_43f592b4 (ComSignal):
        ComBitPosition = 8
        ComBitSize = 4
        ComSignalDataInvalidValue = 15
        ComSignalEndianness = LITTLE_ENDIAN
        ComSignalType = UINT8
        ComSignalInitValue = 0
        ComSignalAccess = ACCESS_NEEDED_BY_SWC_OR_COM
        ComHandleId = 10
        ComSystemTemplateSystemSignalRef = ALIV_ST_CENG
      sigGroup_DISP_CC_EPS_ad160a0a (ComSignalGroup): ComSignalGroupAccess=ACCESS_NEEDED_BY_SWC_OR_COM, ComHandleId=3, ComSystemTemplateSignalGroupRef=sigGroup_DISP_CC_EPS
        7 x ComGroupSignal, all with ComSignalEndianness=LITTLE_ENDIAN, ComSignalInitValue=0, ComSignalAccess=ACCESS_NEEDED_BY_SWC_OR_COM:
          ST_IDC_CC_EPS_8a192f9a: ComBitPosition=38, ComBitSize=2, ComSignalDataInvalidValue=3, ComSignalType=UINT8, ComTransferProperty=TRIGGERED_ON_CHANGE, ComHandleId=76, ComSystemTemplateSystemSignalRef=ST_IDC_CC_EPS
          ST_CC_EPS_8a192f9a: ComBitPosition=32, ComBitSize=2, ComSignalDataInvalidValue=3, ComSignalType=UINT8, ComTransferProperty=TRIGGERED_ON_CHANGE, ComHandleId=70, ComSystemTemplateSystemSignalRef=ST_CC_EPS
          NO_CC_EPS_8a192f9a: ComBitPosition=16, ComBitSize=16, ComSignalDataInvalidValue=65535, ComSignalType=UINT16, ComTransferProperty=TRIGGERED_ON_CHANGE, ComHandleId=53, ComSystemTemplateSystemSignalRef=NO_CC_EPS
          TRANF_CC_EPS_8a192f9a: ComBitPosition=34, ComBitSize=4, ComSignalDataInvalidValue=15, ComSignalType=UINT8, ComTransferProperty=TRIGGERED_ON_CHANGE, ComHandleId=82, ComSystemTemplateSystemSignalRef=TRANF_CC_EPS
          ALIV_DISP_CC_EPS_8a192f9a: ComBitPosition=8, ComBitSize=4, ComSignalDataInvalidValue=15, ComSignalType=UINT8, ComTransferProperty=PENDING, ComHandleId=3, ComSystemTemplateSystemSignalRef=ALIV_DISP_CC_EPS
          CRC_DISP_CC_EPS_8a192f9a: ComBitPosition=0, ComBitSize=8, ComSignalType=UINT8, ComTransferProperty=PENDING, ComHandleId=22, ComSystemTemplateSystemSignalRef=CRC_DISP_CC_EPS
          CHL_DISP_CC_EPS_8a192f9a: ComBitPosition=12, ComBitSize=4, ComSignalDataInvalidValue=15, ComSignalType=UINT8, ComTransferProperty=TRIGGERED_ON_CHANGE, ComHandleId=18, ComSystemTemplateSystemSignalRef=CHL_DISP_CC_EPS
      5 x ComSignal, all with ComSignalEndianness=LITTLE_ENDIAN, ComSignalAccess=ACCESS_NEEDED_BY_SWC_OR_COM:
        DIAG_ST_OBD_3_DRDY_7_65e49c1b: ComBitPosition=52, ComBitSize=6, ComSignalDataInvalidValue=63, ComSignalType=UINT8, ComTransferProperty=TRIGGERED_ON_CHANGE, ComSignalInitValue=0, ComHandleId=35, ComSystemTemplateSystemSignalRef=DIAG_ST_OBD_3_DRDY_7
        ST_SEP_STOR_3319a82a: ComBitPosition=40, ComBitSize=2, ComSignalDataInvalidValue=3, ComSignalType=UINT8, ComSignalInitValue=0, ComHandleId=101, ComSystemTemplateSystemSignalRef=ST_SEP_STOR
        ANFRAGE_ID2_fbd80461_Out: ComBitPosition=0, ComBitSize=8, ComSignalInitValue=1, ComSignalType=UINT8, ComTransferProperty=PENDING, ComHandleId=8, ComSystemTemplateSystemSignalRef=ANFRAGE_ID2
        DIAG_ST_OBD_3_DRDY_2_65e49c1b: ComBitPosition=22, ComBitSize=6, ComSignalDataInvalidValue=63, ComSignalType=UINT8, ComTransferProperty=TRIGGERED_ON_CHANGE, ComSignalInitValue=0, ComHandleId=30, ComSystemTemplateSystemSignalRef=DIAG_ST_OBD_3_DRDY_2
        AVL_STEA_PNI_OFFS_9678c0e9: ComBitPosition=36, ComBitSize=12, ComSignalDataInvalidValue=4095, ComSignalType=UINT16, ComSignalInitValue=0, ComHandleId=23, ComNotification=Rte_COMCbk_AVL_STEA_PNI_OFFS_9678c0e9, ComTimeoutNotification=Rte_COMCbkRxTOut_AVL_STEA_PNI_OFFS_9678c0e9, ComTimeout=0.11, ComSystemTemplateSystemSignalRef=AVL_STEA_PNI_OFFS
      sigGroup_ENERG_DGR_DRDY_3f76efd3 (ComSignalGroup):
        ComSignalGroupAccess = ACCESS_NEEDED_BY_SWC_OR_COM
        ComHandleId = 3
        ComNotification = Rte_COMCbk_sigGroup_ENERG_DGR_DRDY_3f76efd3
        ComTimeoutNotification = Rte_COMCbkRxTOut_sigGroup_ENERG_DGR_DRDY_3f76efd3
        ComTimeout = 0.015
        ComSystemTemplateSignalGroupRef = sigGroup_ENERG_DGR_DRDY
        10 x ComGroupSignal, all with ComSignalEndianness=LITTLE_ENDIAN, ComSignalType=UINT8, ComSignalAccess=ACCESS_NEEDED_BY_SWC_OR_COM:
          MAX_I_SPEC_BAX_STE_6d50c911: ComBitPosition=16, ComBitSize=8, ComSignalDataInvalidValue=255, ComSignalInitValue=0, ComHandleId=58, ComSystemTemplateSystemSignalRef=MAX_I_SPEC_BAX_STE
          MAX_I_RECUP_SPEC_ARS_6d50c911: ComBitPosition=32, ComBitSize=8, ComSignalDataInvalidValue=255, ComSignalInitValue=0, ComHandleId=57, ComSystemTemplateSystemSignalRef=MAX_I_RECUP_SPEC_ARS
          ALIV_ENERG_DGR_DRDY_6d50c911: ComBitPosition=52, ComBitSize=4, ComSignalDataInvalidValue=15, ComSignalInitValue=0, ComHandleId=7, ComSystemTemplateSystemSignalRef=ALIV_ENERG_DGR_DRDY
          CRC_ENERG_DGR_DRDY_6d50c911: ComBitPosition=56, ComBitSize=8, ComSignalInitValue=0, ComHandleId=30, ComSystemTemplateSystemSignalRef=CRC_ENERG_DGR_DRDY
          ENERG_AVAI_ARS_6d50c911: ComBitPosition=40, ComBitSize=8, ComSignalDataInvalidValue=255, ComSignalInitValue=0, ComHandleId=46, ComSystemTemplateSystemSignalRef=ENERG_AVAI_ARS
          RQ_CULI_EST_SFY_6d50c911: ComBitPosition=8, ComBitSize=4, ComSignalDataInvalidValue=15, ComSignalInitValue=0, ComHandleId=84, ComSystemTemplateSystemSignalRef=RQ_CULI_EST_SFY
          MAX_I_LD_SPEC_ARS_6d50c911: ComBitPosition=24, ComBitSize=8, ComSignalDataInvalidValue=255, ComSignalInitValue=0, ComHandleId=56, ComSystemTemplateSystemSignalRef=MAX_I_LD_SPEC_ARS
          MAX_I_SPEC_EPS_6d50c911: ComBitPosition=0, ComBitSize=8, ComSignalDataInvalidValue=255, ComSignalInitValue=0, ComHandleId=59, ComSystemTemplateSystemSignalRef=MAX_I_SPEC_EPS
          ENERG_DGR_DRDY_dummy_12_15_6d50c911: ComBitPosition=12, ComBitSize=4, ComSignalInitValue=15, ComHandleId=47, ComSystemTemplateSystemSignalRef=ENERG_DGR_DRDY_dummy_12_15
          QU_DGR_AISP_ENERG_6d50c911: ComBitPosition=48, ComBitSize=4, ComSignalDataInvalidValue=15, ComSignalInitValue=0, ComHandleId=74, ComSystemTemplateSystemSignalRef=QU_DGR_AISP_ENERG
      RQ_STG_EFAN_19255f18 (ComIPdu):
        ComIPduDirection = SEND
        ComIPduType = NORMAL
        ComIPduHandleId = 9
        ComIPduSignalProcessing = DEFERRED
        ComIPduCancellationSupport = false
        ComIPduSignalRef = ID_FN_RQ_STG_EFAN_862c1b6d
        ComIPduSignalRef = ID_TEMP_CPO_HET_MNG_862c1b6d
        ComIPduSignalRef = RQ_STG_EFAN_862c1b6d
        ComIPduSignalRef = RQ_STG_EFAN_ID2_862c1b6d
        ComIPduSignalRef = TEMP_CPO_HET_MNG_862c1b6d
        ComPduIdRef = pduTrig_RQ_STG_EFAN_pduPort_EPS_A_FlexRay_OUT_55c86d41_4f391dd1
        ComIPduGroupRef = EPS_OUT_PduGroup2
        ComTxIPdu: ComTxIPduUnusedAreasDefault=255, ComMinimumDelayTime=0, ComTxIPduClearUpdateBit=TriggerTransmit
          ComTxModeTrue
            ComTxMode: ComTxModeMode=PERIODIC, ComTxModeTimePeriod=1, ComTxModeTimeOffset=0
          ComTxModeFalse
            ComTxMode: ComTxModeMode=NONE
      ST_EST_19255f18 (ComIPdu):
        ComIPduDirection = SEND
        ComIPduType = NORMAL
        ComIPduHandleId = 12
        ComIPduSignalProcessing = DEFERRED
        ComIPduCancellationSupport = false
        ComIPduSignalGroupRef = sigGroup_ST_EST_76669e16
        ComPduIdRef = pduTrig_ST_EST_pduPort_EPS_A_FlexRay_OUT_55c86d41_4f391dd1
        ComIPduGroupRef = EPS_OUT_PduGroup2
        ComTxIPdu: ComMinimumDelayTime=0.05, ComTxIPduUnusedAreasDefault=255
          ComTxModeTrue
            ComTxMode: ComTxModeMode=MIXED, ComTxModeNumberOfRepetitions=0, ComTxModeTimePeriod=0.5, ComTxModeTimeOffset=0
          ComTxModeFalse
            ComTxMode: ComTxModeMode=NONE
      3 x ComSignal, all with ComSignalEndianness=LITTLE_ENDIAN, ComSignalInitValue=0, ComSignalAccess=ACCESS_NEEDED_BY_SWC_OR_COM:
        STU_RESP_d377025e: ComBitPosition=40, ComBitSize=24, ComSignalDataInvalidValue=16777215, ComSignalType=UINT32, ComHandleId=90, ComSystemTemplateSystemSignalRef=STU_RESP
        DIAG_ST_OBD_3_DRDY_1_65e49c1b: ComBitPosition=16, ComBitSize=6, ComSignalDataInvalidValue=63, ComSignalType=UINT8, ComTransferProperty=TRIGGERED_ON_CHANGE, ComHandleId=29, ComSystemTemplateSystemSignalRef=DIAG_ST_OBD_3_DRDY_1
        ST_LDREL_GEN_3319a82a: ComBitPosition=56, ComBitSize=4, ComSignalDataInvalidValue=15, ComSignalType=UINT8, ComHandleId=97, ComSystemTemplateSystemSignalRef=ST_LDREL_GEN
      sigGroup_TAR_ESTP_VIRT_FTAX_7f6c789c (ComSignalGroup): ComSignalGroupAccess=ACCESS_NEEDED_BY_SWC_OR_COM, ComHandleId=6, ComSystemTemplateSignalGroupRef=sigGroup_TAR_ESTP_VIRT_FTAX
        5 x ComGroupSignal, all with ComSignalEndianness=LITTLE_ENDIAN, ComSignalAccess=ACCESS_NEEDED_BY_SWC_OR_COM:
          TAR_ESTP_VIRT_FTAX_dummy_36_63_0f46fe9b: ComBitPosition=36, ComBitSize=28, ComSignalInitValue=268435455, ComSignalType=UINT32, ComHandleId=106, ComSystemTemplateSystemSignalRef=TAR_ESTP_VIRT_FTAX_dummy_36_63
          CRC_TAR_ESTP_VIRT_FTAX_0f46fe9b: ComBitPosition=0, ComBitSize=8, ComSignalType=UINT8, ComSignalInitValue=0, ComHandleId=33, ComSystemTemplateSystemSignalRef=CRC_TAR_ESTP_VIRT_FTAX
          ALIV_TAR_ESTP_VIRT_FTAX_0f46fe9b: ComBitPosition=8, ComBitSize=4, ComSignalDataInvalidValue=15, ComSignalType=UINT8, ComSignalInitValue=0, ComHandleId=11, ComSystemTemplateSystemSignalRef=ALIV_TAR_ESTP_VIRT_FTAX
          TAR_ESTP_VIRT_FTAX_dummy_12_31_0f46fe9b: ComBitPosition=12, ComBitSize=20, ComSignalInitValue=1048575, ComSignalType=UINT32, ComHandleId=105, ComSystemTemplateSystemSignalRef=TAR_ESTP_VIRT_FTAX_dummy_12_31
          ACTVN_FN_ESTP_VIRT_FTAX_0f46fe9b: ComBitPosition=32, ComBitSize=4, ComSignalDataInvalidValue=15, ComSignalType=UINT8, ComSignalInitValue=0, ComHandleId=3, ComSystemTemplateSystemSignalRef=ACTVN_FN_ESTP_VIRT_FTAX
      ST_ENERG_FZM_e7ce1a0c (ComSignal):
        ComBitPosition = 16
        ComBitSize = 4
        ComSignalDataInvalidValue = 15
        ComSignalEndianness = LITTLE_ENDIAN
        ComSignalType = UINT8
        ComSignalInitValue = 0
        ComSignalAccess = ACCESS_NEEDED_BY_SWC_OR_COM
        ComHandleId = 94
        ComTimeout = 21
        ComNotification = Rte_COMCbk_ST_ENERG_FZM_e7ce1a0c
        ComTimeoutNotification = Rte_COMCbkRxTOut_ST_ENERG_FZM_e7ce1a0c
        ComSystemTemplateSystemSignalRef = ST_ENERG_FZM
      sigGroup_ST_EST_76669e16 (ComSignalGroup): ComSignalGroupAccess=ACCESS_NEEDED_BY_SWC_OR_COM, ComHandleId=5, ComSystemTemplateSignalGroupRef=sigGroup_ST_EST
        6 x ComGroupSignal, all with ComSignalEndianness=LITTLE_ENDIAN, ComSignalType=UINT8, ComSignalAccess=ACCESS_NEEDED_BY_SWC_OR_COM:
          ALIV_ST_EST_FTAX_eef8e21d: ComBitPosition=8, ComBitSize=4, ComSignalDataInvalidValue=15, ComTransferProperty=TRIGGERED_ON_CHANGE, ComSignalInitValue=0, ComHandleId=6, ComSystemTemplateSystemSignalRef=ALIV_ST_EST_FTAX
          QU_FN_EST_eef8e21d: ComBitPosition=32, ComBitSize=8, ComSignalDataInvalidValue=255, ComTransferProperty=TRIGGERED_ON_CHANGE, ComSignalInitValue=0, ComHandleId=60, ComSystemTemplateSystemSignalRef=QU_FN_EST
          ST_EST_dummy_16_23_eef8e21d: ComBitPosition=16, ComBitSize=8, ComSignalInitValue=255, ComTransferProperty=PENDING, ComHandleId=75, ComSystemTemplateSystemSignalRef=ST_EST_dummy_16_23
          QU_FN_VIB_EPS_eef8e21d: ComBitPosition=12, ComBitSize=4, ComSignalDataInvalidValue=15, ComTransferProperty=TRIGGERED_ON_CHANGE, ComSignalInitValue=0, ComHandleId=61, ComSystemTemplateSystemSignalRef=QU_FN_VIB_EPS
          QU_SER_STMOM_DV_ACT_eef8e21d: ComBitPosition=24, ComBitSize=8, ComSignalDataInvalidValue=255, ComTransferProperty=TRIGGERED_ON_CHANGE, ComSignalInitValue=0, ComHandleId=62, ComSystemTemplateSystemSignalRef=QU_SER_STMOM_DV_ACT
          CRC_ST_EST_FTAX_eef8e21d: ComBitPosition=0, ComBitSize=8, ComTransferProperty=TRIGGERED_ON_CHANGE, ComSignalInitValue=0, ComHandleId=24, ComSystemTemplateSystemSignalRef=CRC_ST_EST_FTAX
      3 x ComSignal, all with ComSignalEndianness=LITTLE_ENDIAN, ComSignalInitValue=0, ComSignalAccess=ACCESS_NEEDED_BY_SWC_OR_COM:
        MILE_KM_a6dd5496: ComBitPosition=0, ComBitSize=24, ComSignalDataInvalidValue=16777215, ComSignalType=UINT32, ComHandleId=60, ComNotification=Rte_COMCbk_MILE_KM_a6dd5496, ComTimeoutNotification=Rte_COMCbkRxTOut_MILE_KM_a6dd5496, ComTimeout=11, ComSystemTemplateSystemSignalRef=MILE_KM
        RQ_RST_OBD_DIAG_DRDY_85fd80d4: ComBitPosition=2, ComBitSize=2, ComSignalDataInvalidValue=3, ComSignalType=UINT8, ComHandleId=86, ComSystemTemplateSystemSignalRef=RQ_RST_OBD_DIAG_DRDY
        FACT_MO_STE_SO_DXP_59dc6376: ComBitPosition=16, ComBitSize=8, ComSignalDataInvalidValue=255, ComSignalType=UINT8, ComHandleId=54, ComNotification=Rte_COMCbk_FACT_MO_STE_SO_DXP_59dc6376, ComTimeoutNotification=Rte_COMCbkRxTOut_FACT_MO_STE_SO_DXP_59dc6376, ComTimeout=0.045, ComSystemTemplateSystemSignalRef=FACT_MO_STE_SO_DXP
      sigGroup_ACLNY_MASSCNTR_461c64b1 (ComSignalGroup):
        ComSignalGroupAccess = ACCESS_NEEDED_BY_SWC_OR_COM
        ComHandleId = 0
        ComNotification = Rte_COMCbk_sigGroup_ACLNY_MASSCNTR_461c64b1
        ComTimeoutNotification = Rte_COMCbkRxTOut_sigGroup_ACLNY_MASSCNTR_461c64b1
        ComTimeout = 0.015
        ComSystemTemplateSignalGroupRef = sigGroup_ACLNY_MASSCNTR
        6 x ComGroupSignal, all with ComSignalEndianness=LITTLE_ENDIAN, ComSignalAccess=ACCESS_NEEDED_BY_SWC_OR_COM:
          ACLNY_COG_1311692d: ComBitPosition=16, ComBitSize=16, ComSignalDataInvalidValue=65535, ComSignalType=UINT16, ComSignalInitValue=0, ComHandleId=0, ComSystemTemplateSystemSignalRef=ACLNY_COG
          ACLNY_MASSCNTR_dummy_12_15_1311692d: ComBitPosition=12, ComBitSize=4, ComSignalInitValue=15, ComSignalType=UINT8, ComHandleId=2, ComSystemTemplateSystemSignalRef=ACLNY_MASSCNTR_dummy_12_15
          ALIV_ACLNY_COG_1311692d: ComBitPosition=8, ComBitSize=4, ComSignalDataInvalidValue=15, ComSignalType=UINT8, ComSignalInitValue=0, ComHandleId=4, ComSystemTemplateSystemSignalRef=ALIV_ACLNY_COG
          ACLNY_COG_ERR_AMP_1311692d: ComBitPosition=32, ComBitSize=12, ComSignalDataInvalidValue=4095, ComSignalType=UINT16, ComSignalInitValue=0, ComHandleId=1, ComSystemTemplateSystemSignalRef=ACLNY_COG_ERR_AMP
          CRC_ACLNY_COG_1311692d: ComBitPosition=0, ComBitSize=8, ComSignalType=UINT8, ComSignalInitValue=0, ComHandleId=27, ComSystemTemplateSystemSignalRef=CRC_ACLNY_COG
          QU_ACLNY_COG_1311692d: ComBitPosition=44, ComBitSize=4, ComSignalDataInvalidValue=15, ComSignalType=UINT8, ComSignalInitValue=0, ComHandleId=69, ComSystemTemplateSystemSignalRef=QU_ACLNY_COG
      6 x ComSignal, all with ComSignalEndianness=LITTLE_ENDIAN, ComSignalInitValue=0, ComSignalAccess=ACCESS_NEEDED_BY_SWC_OR_COM:
        ID_FN_RQ_STG_EFAN_862c1b6d: ComBitPosition=8, ComBitSize=8, ComSignalDataInvalidValue=255, ComSignalType=UINT8, ComHandleId=45, ComTransferProperty=PENDING, ComSystemTemplateSystemSignalRef=ID_FN_RQ_STG_EFAN
        SSV_IDENT_RESP_d377025e: ComBitPosition=8, ComBitSize=8, ComSignalDataInvalidValue=255, ComSignalType=UINT8, ComHandleId=88, ComSystemTemplateSystemSignalRef=SSV_IDENT_RESP
        ST_MOT_DRV_43f592b4: ComBitPosition=32, ComBitSize=2, ComSignalDataInvalidValue=3, ComSignalType=UINT8, ComHandleId=98, ComSystemTemplateSystemSignalRef=ST_MOT_DRV
        ST_ILK_ERRM_FZM_e7ce1a0c: ComBitPosition=56, ComBitSize=2, ComSignalDataInvalidValue=3, ComSignalType=UINT8, ComHandleId=96, ComTimeout=21, ComNotification=Rte_COMCbk_ST_ILK_ERRM_FZM_e7ce1a0c, ComTimeoutNotification=Rte_COMCbkRxTOut_ST_ILK_ERRM_FZM_e7ce1a0c, ComSystemTemplateSystemSignalRef=ST_ILK_ERRM_FZM
        T_SEC_COU_REL_0b27fbfe: ComBitPosition=0, ComBitSize=32, ComSignalDataInvalidValue=4294967295, ComSignalType=UINT32, ComHandleId=113, ComNotification=Rte_COMCbk_T_SEC_COU_REL_0b27fbfe, ComSystemTemplateSystemSignalRef=T_SEC_COU_REL
        ID_FN_INQY_fbd80461_Out: ComBitPosition=8, ComBitSize=16, ComSignalDataInvalidValue=65535, ComSignalType=UINT16, ComHandleId=44, ComTransferProperty=PENDING, ComSystemTemplateSystemSignalRef=ID_FN_INQY
      ENERG_DGR_DRDY_19255f18 (ComIPdu):
        ComIPduDirection = RECEIVE
        ComIPduType = NORMAL
        ComIPduHandleId = 8
        ComIPduSignalProcessing = DEFERRED
        ComIPduCancellationSupport = false
        ComIPduSignalGroupRef = sigGroup_ENERG_DGR_DRDY_3f76efd3
        ComPduIdRef = pduTrig_ENERG_DGR_DRDY_pduPort_EPS_A_FlexRay_IN_55c86d41_4f391dd1
        ComIPduGroupRef = EPS_IN_PduGroup8
      SECU_RESP_19255f18 (ComIPdu):
        ComIPduDirection = RECEIVE
        ComIPduType = NORMAL
        ComIPduHandleId = 17
        ComIPduSignalProcessing = DEFERRED
        ComIPduCancellationSupport = false
        ComIPduSignalRef = COU_BS_RESP_d377025e
        ComIPduSignalRef = SECU_RESP_ID2_d377025e
        ComIPduSignalRef = SSV_IDENT_RESP_d377025e
        ComIPduSignalRef = STU_RESP_d377025e
        ComPduIdRef = pduTrig_SECU_RESP_pduPort_EPS_A_FlexRay_IN_55c86d41_4f391dd1
        ComIPduGroupRef = EPS_IN_PduGroup4
      sigGroup_CON_VEH_675e7344 (ComSignalGroup):
        ComSignalGroupAccess = ACCESS_NEEDED_BY_SWC_OR_COM
        ComHandleId = 2
        ComTimeout = 0.11
        ComNotification = Rte_COMCbk_sigGroup_CON_VEH_675e7344
        ComTimeoutNotification = Rte_COMCbkRxTOut_sigGroup_CON_VEH_675e7344
        ComSystemTemplateSignalGroupRef = sigGroup_CON_VEH
        7 x ComGroupSignal, all with ComSignalEndianness=LITTLE_ENDIAN, ComSignalAccess=ACCESS_NEEDED_BY_SWC_OR_COM:
          CRC_CON_VEH_c1ae6ae9: ComBitPosition=0, ComBitSize=8, ComSignalType=UINT8, ComSignalInitValue=0, ComHandleId=29, ComSystemTemplateSystemSignalRef=CRC_CON_VEH
          CTR_BS_PRTNT_c1ae6ae9: ComBitPosition=12, ComBitSize=4, ComSignalDataInvalidValue=15, ComSignalType=UINT8, ComSignalInitValue=0, ComHandleId=38, ComSystemTemplateSystemSignalRef=CTR_BS_PRTNT
          ST_CON_VEH_c1ae6ae9: ComBitPosition=48, ComBitSize=4, ComSignalDataInvalidValue=15, ComSignalType=UINT8, ComSignalInitValue=0, ComHandleId=93, ComSystemTemplateSystemSignalRef=ST_CON_VEH
          CTR_FKTN_PRTNT_c1ae6ae9: ComBitPosition=16, ComBitSize=32, ComSignalDataInvalidValue=4294967295, ComSignalType=UINT32, ComSignalInitValue=0, ComHandleId=41, ComSystemTemplateSystemSignalRef=CTR_FKTN_PRTNT
          ALIV_CON_VEH_c1ae6ae9: ComBitPosition=8, ComBitSize=4, ComSignalDataInvalidValue=15, ComSignalType=UINT8, ComSignalInitValue=0, ComHandleId=6, ComSystemTemplateSystemSignalRef=ALIV_CON_VEH
          CON_VEH_dummy_56_63_c1ae6ae9: ComBitPosition=56, ComBitSize=8, ComSignalInitValue=255, ComSignalType=UINT8, ComHandleId=25, ComSystemTemplateSystemSignalRef=CON_VEH_dummy_56_63
          QU_ST_CON_VEH_c1ae6ae9: ComBitPosition=52, ComBitSize=4, ComSignalDataInvalidValue=15, ComSignalType=UINT8, ComSignalInitValue=0, ComHandleId=77, ComSystemTemplateSystemSignalRef=QU_ST_CON_VEH
      SU_CLE_DRDY_DXP_19255f18 (ComIPdu):
        ComIPduDirection = RECEIVE
        ComIPduType = NORMAL
        ComIPduHandleId = 22
        ComIPduSignalProcessing = DEFERRED
        ComIPduCancellationSupport = false
        ComIPduSignalRef = FACT_MO_STE_SO_DXP_59dc6376
        ComIPduSignalRef = SU_CLU_STMOM_SFE_DXP_59dc6376
        ComPduIdRef = pduTrig_SU_CLE_DRDY_DXP_pduPort_EPS_A_FlexRay_IN_55c86d41_4f391dd1
        ComIPduGroupRef = EPS_IN_PduGroup3
      4 x ComSignal, all with ComSignalAccess=ACCESS_NEEDED_BY_SWC_OR_COM:
        STU_8_BYTE_347be560: ComBitPosition=0, ComBitSize=64, ComSignalDataInvalidValue=18446744073709551615, ComSignalEndianness=LITTLE_ENDIAN, ComSignalType=UINT64, ComSignalInitValue=0, ComHandleId=89, ComTransferProperty=PENDING, ComSystemTemplateSystemSignalRef=STU_8_BYTE
        SECU_CHAL_ID2_5fff8d6b: ComBitPosition=0, ComBitSize=8, ComSignalEndianness=LITTLE_ENDIAN, ComSignalInitValue=248, ComSignalType=UINT8, ComTransferProperty=PENDING, ComHandleId=67, ComSystemTemplateSystemSignalRef=SECU_CHAL_ID2
        NO_VECH_5_13b7b7e4: ComBitPosition=32, ComSignalDataInvalidValue=255, ComSignalEndianness=opaque, ComSignalLength=1, ComSignalType=UINT8_N, ComSignalInitValue=0, ComHandleId=65, ComSystemTemplateSystemSignalRef=NO_VECH_5
        ST_CENG_DRV_43f592b4: ComBitPosition=16, ComBitSize=4, ComSignalDataInvalidValue=15, ComSignalEndianness=LITTLE_ENDIAN, ComSignalType=UINT8, ComSignalInitValue=0, ComHandleId=92, ComSystemTemplateSystemSignalRef=ST_CENG_DRV
      AVL_PO_EPS_19255f18 (ComIPdu):
        ComIPduDirection = SEND
        ComIPduType = NORMAL
        ComIPduHandleId = 2
        ComIPduSignalProcessing = DEFERRED
        ComIPduCancellationSupport = false
        ComIPduSignalGroupRef = sigGroup_AVL_PO_EPS_290f0f6e
        ComPduIdRef = pduTrig_AVL_PO_EPS_pduPort_EPS_A_FlexRay_OUT_55c86d41_4f391dd1
        ComIPduGroupRef = EPS_OUT_PduGroup2
        ComTxIPdu: ComTxIPduUnusedAreasDefault=255, ComMinimumDelayTime=0
          ComTxModeTrue
            ComTxMode: ComTxModeMode=PERIODIC, ComTxModeTimePeriod=0.01, ComTxModeTimeOffset=0
          ComTxModeFalse
            ComTxMode: ComTxModeMode=NONE
      sigGroup_VYAW_VEH_fc66be94 (ComSignalGroup):
        ComSignalGroupAccess = ACCESS_NEEDED_BY_SWC_OR_COM
        ComHandleId = 9
        ComNotification = Rte_COMCbk_sigGroup_VYAW_VEH_fc66be94
        ComTimeoutNotification = Rte_COMCbkRxTOut_sigGroup_VYAW_VEH_fc66be94
        ComTimeout = 0.015
        ComSystemTemplateSignalGroupRef = sigGroup_VYAW_VEH
        6 x ComGroupSignal, all with ComSignalEndianness=LITTLE_ENDIAN, ComSignalAccess=ACCESS_NEEDED_BY_SWC_OR_COM:
          CRC_VYAW_VEH_dc9eeb12: ComBitPosition=0, ComBitSize=8, ComSignalType=UINT8, ComSignalInitValue=0, ComHandleId=36, ComSystemTemplateSystemSignalRef=CRC_VYAW_VEH
          QU_VYAW_VEH_dc9eeb12: ComBitPosition=44, ComBitSize=4, ComSignalDataInvalidValue=15, ComSignalType=UINT8, ComSignalInitValue=0, ComHandleId=82, ComSystemTemplateSystemSignalRef=QU_VYAW_VEH
          VYAW_VEH_ERR_AMP_dc9eeb12: ComBitPosition=32, ComBitSize=12, ComSignalDataInvalidValue=4095, ComSignalType=UINT16, ComSignalInitValue=0, ComHandleId=114, ComSystemTemplateSystemSignalRef=VYAW_VEH_ERR_AMP
          ALIV_VYAW_VEH_dc9eeb12: ComBitPosition=8, ComBitSize=4, ComSignalDataInvalidValue=15, ComSignalType=UINT8, ComSignalInitValue=0, ComHandleId=14, ComSystemTemplateSystemSignalRef=ALIV_VYAW_VEH
          VYAW_VEH_dc9eeb12: ComBitPosition=16, ComBitSize=16, ComSignalDataInvalidValue=65535, ComSignalType=UINT16, ComSignalInitValue=0, ComHandleId=115, ComSystemTemplateSystemSignalRef=VYAW_VEH
          VYAW_VEH_dummy_12_15_dc9eeb12: ComBitPosition=12, ComBitSize=4, ComSignalInitValue=15, ComSignalType=UINT8, ComHandleId=116, ComSystemTemplateSystemSignalRef=VYAW_VEH_dummy_12_15
      sigGroup_AVL_FORC_GRD_19621f3f (ComSignalGroup): ComSignalGroupAccess=ACCESS_NEEDED_BY_SWC_OR_COM, ComHandleId=0, ComSystemTemplateSignalGroupRef=sigGroup_AVL_FORC_GRD
        6 x ComGroupSignal, all with ComSignalEndianness=LITTLE_ENDIAN, ComSignalAccess=ACCESS_NEEDED_BY_SWC_OR_COM, ComTransferProperty=PENDING:
          CRC_AVL_FORC_GRD_c0f3c255: ComBitPosition=0, ComBitSize=8, ComSignalType=UINT8, ComSignalInitValue=0, ComHandleId=19, ComSystemTemplateSystemSignalRef=CRC_AVL_FORC_GRD
          AVL_FORC_GRD_dummy_12_15_c0f3c255: ComBitPosition=12, ComBitSize=4, ComSignalInitValue=15, ComSignalType=UINT8, ComHandleId=10, ComSystemTemplateSystemSignalRef=AVL_FORC_GRD_dummy_12_15
          AVL_PWR_EL_EPS_COOD_c0f3c255: ComBitPosition=32, ComBitSize=8, ComSignalDataInvalidValue=255, ComSignalType=UINT8, ComSignalInitValue=0, ComHandleId=14, ComSystemTemplateSystemSignalRef=AVL_PWR_EL_EPS_COOD
          ALIV_AVL_FORC_GRD_c0f3c255: ComBitPosition=8, ComBitSize=4, ComSignalDataInvalidValue=15, ComSignalType=UINT8, ComSignalInitValue=0, ComHandleId=0, ComSystemTemplateSystemSignalRef=ALIV_AVL_FORC_GRD
          AVL_FORC_GRD_c0f3c255: ComBitPosition=16, ComBitSize=12, ComSignalDataInvalidValue=4095, ComSignalType=UINT16, ComSignalInitValue=0, ComHandleId=9, ComSystemTemplateSystemSignalRef=AVL_FORC_GRD
          QU_AVL_FORC_GRD_c0f3c255: ComBitPosition=28, ComBitSize=4, ComSignalDataInvalidValue=15, ComSignalType=UINT8, ComSignalInitValue=0, ComHandleId=56, ComSystemTemplateSystemSignalRef=QU_AVL_FORC_GRD
      4 x ComSignal, all with ComSignalEndianness=LITTLE_ENDIAN, ComSignalInitValue=0, ComSignalAccess=ACCESS_NEEDED_BY_SWC_OR_COM:
        ST_UDP_43f592b4: ComBitPosition=20, ComBitSize=4, ComSignalDataInvalidValue=15, ComSignalType=UINT8, ComHandleId=102, ComSystemTemplateSystemSignalRef=ST_UDP
        QU_FN_FDR_d5c7d03c: ComBitPosition=16, ComBitSize=12, ComSignalDataInvalidValue=4095, ComSignalType=UINT16, ComHandleId=76, ComSystemTemplateSystemSignalRef=QU_FN_FDR
        CTR_ERRM_BN_U_d46c15e6: ComBitPosition=0, ComBitSize=6, ComSignalDataInvalidValue=63, ComSignalType=UINT8, ComHandleId=40, ComSystemTemplateSystemSignalRef=CTR_ERRM_BN_U
        CTR_WARN_ILVL_VIB_EPS_66c73f8f: ComBitPosition=56, ComBitSize=4, ComSignalDataInvalidValue=15, ComSignalType=UINT8, ComHandleId=43, ComNotification=Rte_COMCbk_CTR_WARN_ILVL_VIB_EPS_66c73f8f, ComTimeoutNotification=Rte_COMCbkRxTOut_CTR_WARN_ILVL_VIB_EPS_66c73f8f, ComTimeout=0.55, ComSystemTemplateSystemSignalRef=CTR_WARN_ILVL_VIB_EPS
      3 x ComIPdu, all with ComIPduDirection=RECEIVE, ComIPduType=NORMAL, ComIPduSignalProcessing=DEFERRED, ComIPduCancellationSupport=false:
        KILOMETERSTAND_19255f18: ComIPduHandleId=13, ComIPduSignalRef=MILE_KM_a6dd5496, ComPduIdRef=pduTrig_KILOMETERSTAND_pduPort_EPS_A_FlexRay_IN_55c86d41_4f391dd1, ComIPduGroupRef=EPS_IN_PduGroup4
        OFFS_QUAD_EPS_19255f18: ComIPduHandleId=14, ComIPduSignalGroupRef=sigGroup_OFFS_QUAD_EPS_cc150a52, ComPduIdRef=pduTrig_OFFS_QUAD_EPS_pduPort_EPS_A_FlexRay_IN_55c86d41_4f391dd1, ComIPduGroupRef=EPS_IN_PduGroup3
        ST_ENERG_GEN_19255f18: ComIPduHandleId=20, ComIPduSignalRef=ST_LDREL_GEN_3319a82a, ComIPduSignalRef=ST_SEP_STOR_3319a82a, ComPduIdRef=pduTrig_ST_ENERG_GEN_pduPort_EPS_A_FlexRay_IN_55c86d41_4f391dd1, ComIPduGroupRef=EPS_IN_PduGroup
      DIAG_ST_OBD_3_DRDY_4_65e49c1b (ComSignal):
        ComBitPosition = 34
        ComBitSize = 6
        ComSignalDataInvalidValue = 63
        ComSignalEndianness = LITTLE_ENDIAN
        ComSignalType = UINT8
        ComTransferProperty = TRIGGERED_ON_CHANGE
        ComSignalInitValue = 0
        ComSignalAccess = ACCESS_NEEDED_BY_SWC_OR_COM
        ComHandleId = 32
        ComSystemTemplateSystemSignalRef = DIAG_ST_OBD_3_DRDY_4
      sigGroup_AVL_PO_EPS_290f0f6e (ComSignalGroup): ComSignalGroupAccess=ACCESS_NEEDED_BY_SWC_OR_COM, ComHandleId=1, ComSystemTemplateSignalGroupRef=sigGroup_AVL_PO_EPS
        8 x ComGroupSignal, all with ComSignalEndianness=LITTLE_ENDIAN, ComSignalInitValue=0, ComSignalAccess=ACCESS_NEEDED_BY_SWC_OR_COM, ComTransferProperty=PENDING:
          IDX_TORQ_SEN_4bf7fe20: ComBitPosition=60, ComBitSize=2, ComSignalDataInvalidValue=3, ComSignalType=UINT8, ComHandleId=43, ComSystemTemplateSystemSignalRef=IDX_TORQ_SEN
          CRC_AVL_PO_EPS_4bf7fe20: ComBitPosition=0, ComBitSize=8, ComSignalType=UINT8, ComHandleId=20, ComSystemTemplateSystemSignalRef=CRC_AVL_PO_EPS
          OFFS_GRD_MID_EPS_4bf7fe20: ComBitPosition=48, ComBitSize=12, ComSignalDataInvalidValue=4095, ComSignalType=UINT16, ComHandleId=54, ComSystemTemplateSystemSignalRef=OFFS_GRD_MID_EPS
          AVL_PO_IDX_EPS_4bf7fe20: ComBitPosition=32, ComBitSize=16, ComSignalDataInvalidValue=65535, ComSignalType=UINT16, ComHandleId=13, ComSystemTemplateSystemSignalRef=AVL_PO_IDX_EPS
          QU_AVL_PO_EPS_4bf7fe20: ComBitPosition=12, ComBitSize=4, ComSignalDataInvalidValue=15, ComSignalType=UINT8, ComHandleId=58, ComSystemTemplateSystemSignalRef=QU_AVL_PO_EPS
          ALIV_AVL_PO_EPS_4bf7fe20: ComBitPosition=8, ComBitSize=4, ComSignalDataInvalidValue=15, ComSignalType=UINT8, ComHandleId=1, ComSystemTemplateSystemSignalRef=ALIV_AVL_PO_EPS
          UN_PO_EPS_4bf7fe20: ComBitPosition=62, ComBitSize=2, ComSignalDataInvalidValue=3, ComSignalType=UINT8, ComHandleId=84, ComSystemTemplateSystemSignalRef=UN_PO_EPS
          AVL_PO_EPS_4bf7fe20: ComBitPosition=16, ComBitSize=16, ComSignalDataInvalidValue=65535, ComSignalType=UINT16, ComHandleId=12, ComSystemTemplateSystemSignalRef=AVL_PO_EPS
      sigGroup_DT_EST_68b5ac35 (ComSignalGroup): ComSignalGroupAccess=ACCESS_NEEDED_BY_SWC_OR_COM, ComHandleId=4, ComSystemTemplateSignalGroupRef=sigGroup_DT_EST
        9 x ComGroupSignal, all with ComSignalEndianness=LITTLE_ENDIAN, ComSignalAccess=ACCESS_NEEDED_BY_SWC_OR_COM, ComTransferProperty=PENDING:
          QU_AVL_I_ACT_EST_dcba517d: ComBitPosition=60, ComBitSize=4, ComSignalDataInvalidValue=15, ComSignalType=UINT8, ComSignalInitValue=0, ComHandleId=57, ComSystemTemplateSystemSignalRef=QU_AVL_I_ACT_EST
          AVL_I_ACT_EST_dcba517d: ComBitPosition=48, ComBitSize=8, ComSignalDataInvalidValue=255, ComSignalType=UINT8, ComSignalInitValue=0, ComHandleId=11, ComSystemTemplateSystemSignalRef=AVL_I_ACT_EST
          DT_EST_dummy_16_47_dcba517d: ComBitPosition=16, ComBitSize=32, ComSignalInitValue=4294967295, ComSignalType=UINT32, ComHandleId=38, ComSystemTemplateSystemSignalRef=DT_EST_dummy_16_47
          ALIV_DT_EST_dcba517d: ComBitPosition=8, ComBitSize=4, ComSignalDataInvalidValue=15, ComSignalType=UINT8, ComSignalInitValue=0, ComHandleId=4, ComSystemTemplateSystemSignalRef=ALIV_DT_EST
          DT_EST_dummy_12_15_dcba517d: ComBitPosition=12, ComBitSize=4, ComSignalInitValue=15, ComSignalType=UINT8, ComHandleId=37, ComSystemTemplateSystemSignalRef=DT_EST_dummy_12_15
          CRC_DT_EST_dcba517d: ComBitPosition=0, ComBitSize=8, ComSignalType=UINT8, ComSignalInitValue=0, ComHandleId=23, ComSystemTemplateSystemSignalRef=CRC_DT_EST
          ST_CULI_EST_dcba517d: ComBitPosition=56, ComBitSize=4, ComSignalDataInvalidValue=15, ComSignalType=UINT8, ComSignalInitValue=0, ComHandleId=72, ComSystemTemplateSystemSignalRef=ST_CULI_EST
          DT_EST_dummy_64_95_dcba517d: ComBitPosition=64, ComBitSize=32, ComSignalInitValue=4294967295, ComSignalType=UINT32, ComHandleId=39, ComSystemTemplateSystemSignalRef=DT_EST_dummy_64_95
          DT_EST_dummy_96_127_dcba517d: ComBitPosition=96, ComBitSize=32, ComSignalInitValue=4294967295, ComSignalType=UINT32, ComHandleId=40, ComSystemTemplateSystemSignalRef=DT_EST_dummy_96_127
      ST_ENERG_SUPY_43f592b4 (ComSignal):
        ComBitPosition = 24
        ComBitSize = 8
        ComSignalDataInvalidValue = 255
        ComSignalEndianness = LITTLE_ENDIAN
        ComSignalType = UINT8
        ComSignalInitValue = 0
        ComSignalAccess = ACCESS_NEEDED_BY_SWC_OR_COM
        ComHandleId = 95
        ComSystemTemplateSystemSignalRef = ST_ENERG_SUPY
      sigGroup_TAR_QTA_STRMOM_DV_231dfb08 (ComSignalGroup):
        ComSignalGroupAccess = ACCESS_NEEDED_BY_SWC_OR_COM
        ComHandleId = 7
        ComNotification = Rte_COMCbk_sigGroup_TAR_QTA_STRMOM_DV_231dfb08
        ComTimeoutNotification = Rte_COMCbkRxTOut_sigGroup_TAR_QTA_STRMOM_DV_231dfb08
        ComTimeout = 0.015
        ComSystemTemplateSignalGroupRef = sigGroup_TAR_QTA_STRMOM_DV
        10 x ComGroupSignal, all with ComSignalEndianness=LITTLE_ENDIAN, ComSignalAccess=ACCESS_NEEDED_BY_SWC_OR_COM:
          TAR_QTA_STRMOM_DV_dummy_12_15_54d7ae59: ComBitPosition=12, ComBitSize=4, ComSignalInitValue=15, ComSignalType=UINT8, ComHandleId=108, ComSystemTemplateSystemSignalRef=TAR_QTA_STRMOM_DV_dummy_12_15
          ALIV_TAR_QTA_STMOM_DV_54d7ae59: ComBitPosition=8, ComBitSize=4, ComSignalDataInvalidValue=15, ComSignalType=UINT8, ComSignalInitValue=0, ComHandleId=12, ComSystemTemplateSystemSignalRef=ALIV_TAR_QTA_STMOM_DV
          QU_TAR_QTA_STMOM_DV_54d7ae59: ComBitPosition=28, ComBitSize=4, ComSignalDataInvalidValue=15, ComSignalType=UINT8, ComSignalInitValue=0, ComHandleId=80, ComSystemTemplateSystemSignalRef=QU_TAR_QTA_STMOM_DV
          CRC_TAR_QTA_STMOM_DV_54d7ae59: ComBitPosition=0, ComBitSize=8, ComSignalType=UINT8, ComSignalInitValue=0, ComHandleId=34, ComSystemTemplateSystemSignalRef=CRC_TAR_QTA_STMOM_DV
          QU_TAR_FACT_STMOM_FTAX_54d7ae59: ComBitPosition=56, ComBitSize=4, ComSignalDataInvalidValue=15, ComSignalType=UINT8, ComSignalInitValue=0, ComHandleId=79, ComSystemTemplateSystemSignalRef=QU_TAR_FACT_STMOM_FTAX
          FACT_DMPNG_STMOM_FTAX_54d7ae59: ComBitPosition=40, ComBitSize=8, ComSignalDataInvalidValue=255, ComSignalType=UINT8, ComSignalInitValue=0, ComHandleId=53, ComSystemTemplateSystemSignalRef=FACT_DMPNG_STMOM_FTAX
          CTR_DEAC_EPS_FNS_54d7ae59: ComBitPosition=60, ComBitSize=4, ComSignalDataInvalidValue=15, ComSignalType=UINT8, ComSignalInitValue=0, ComHandleId=39, ComSystemTemplateSystemSignalRef=CTR_DEAC_EPS_FNS
          FACT_ASS_STMOM_FTAX_54d7ae59: ComBitPosition=48, ComBitSize=8, ComSignalDataInvalidValue=255, ComSignalType=UINT8, ComSignalInitValue=0, ComHandleId=50, ComSystemTemplateSystemSignalRef=FACT_ASS_STMOM_FTAX
          FACT_CTRR_STMOM_FTAX_54d7ae59: ComBitPosition=32, ComBitSize=8, ComSignalDataInvalidValue=255, ComSignalType=UINT8, ComSignalInitValue=0, ComHandleId=51, ComSystemTemplateSystemSignalRef=FACT_CTRR_STMOM_FTAX
          TAR_QTA_STMOM_DV_54d7ae59: ComBitPosition=16, ComBitSize=12, ComSignalDataInvalidValue=4095, ComSignalType=UINT16, ComSignalInitValue=0, ComHandleId=107, ComSystemTemplateSystemSignalRef=TAR_QTA_STMOM_DV
      NO_VECH_2_13b7b7e4 (ComSignal):
        ComBitPosition = 8
        ComSignalDataInvalidValue = 255
        ComSignalEndianness = opaque
        ComSignalLength = 1
        ComSignalType = UINT8_N
        ComSignalInitValue = 0
        ComSignalAccess = ACCESS_NEEDED_BY_SWC_OR_COM
        ComHandleId = 62
        ComSystemTemplateSystemSignalRef = NO_VECH_2
      AVL_STMOM_DV_ACT_19255f18 (ComIPdu):
        ComIPduDirection = SEND
        ComIPduType = NORMAL
        ComIPduHandleId = 3
        ComIPduSignalProcessing = DEFERRED
        ComIPduCancellationSupport = false
        ComIPduSignalGroupRef = sigGroup_AVL_STMOM_DV_ACT_744f32e2
        ComPduIdRef = pduTrig_AVL_STMOM_DV_ACT_pduPort_EPS_A_FlexRay_OUT_55c86d41_4f391dd1
        ComIPduGroupRef = EPS_OUT_PduGroup2
        ComTxIPdu: ComTxIPduUnusedAreasDefault=255, ComMinimumDelayTime=0
          ComTxModeTrue
            ComTxMode: ComTxModeMode=PERIODIC, ComTxModeTimePeriod=0.01, ComTxModeTimeOffset=0
          ComTxModeFalse
            ComTxMode: ComTxModeMode=NONE
      RQ_STG_EFAN_ID2_862c1b6d (ComSignal):
        ComBitPosition = 0
        ComBitSize = 8
        ComSignalEndianness = LITTLE_ENDIAN
        ComSignalInitValue = 21
        ComSignalType = UINT8
        ComTransferProperty = PENDING
        ComSignalAccess = ACCESS_NEEDED_BY_SWC_OR_COM
        ComHandleId = 64
        ComSystemTemplateSystemSignalRef = RQ_STG_EFAN_ID2
      ST_ANO_MSA_ENG_STOP_43f592b4 (ComSignal):
        ComBitPosition = 34
        ComBitSize = 2
        ComSignalDataInvalidValue = 3
        ComSignalEndianness = LITTLE_ENDIAN
        ComSignalType = UINT8
        ComSignalInitValue = 0
        ComSignalAccess = ACCESS_NEEDED_BY_SWC_OR_COM
        ComHandleId = 91
        ComSystemTemplateSystemSignalRef = ST_ANO_MSA_ENG_STOP
      3 x ComIPdu, all with ComIPduType=NORMAL, ComIPduSignalProcessing=DEFERRED, ComIPduCancellationSupport=false:
        FAHRGESTELLNUMMER_19255f18: ComIPduDirection=RECEIVE, ComIPduHandleId=11, ComIPduSignalRef=NO_VECH_1_13b7b7e4, ComIPduSignalRef=NO_VECH_2_13b7b7e4, ComIPduSignalRef=NO_VECH_3_13b7b7e4, ComIPduSignalRef=NO_VECH_4_13b7b7e4, ComIPduSignalRef=NO_VECH_5_13b7b7e4, ComIPduSignalRef=NO_VECH_6_13b7b7e4, ComIPduSignalRef=NO_VECH_7_13b7b7e4, ComPduIdRef=pduTrig_FAHRGESTELLNUMMER_pduPort_EPS_A_FlexRay_IN_55c86d41_4f391dd1, ComIPduGroupRef=EPS_IN_PduGroup3
        ST_DIAG_OBD_3_DRDY_19255f18: ComIPduDirection=SEND, ComIPduHandleId=11, ComIPduSignalRef=ALIV_ST_DIAG_OBD_3_DRDY_65e49c1b, ComIPduSignalRef=DIAG_ST_OBD_3_DRDY_1_65e49c1b, ComIPduSignalRef=DIAG_ST_OBD_3_DRDY_2_65e49c1b, ComIPduSignalRef=DIAG_ST_OBD_3_DRDY_3_65e49c1b, ComIPduSignalRef=DIAG_ST_OBD_3_DRDY_4_65e49c1b, ComIPduSignalRef=DIAG_ST_OBD_3_DRDY_5_65e49c1b, ComIPduSignalRef=DIAG_ST_OBD_3_DRDY_6_65e49c1b, ComIPduSignalRef=DIAG_ST_OBD_3_DRDY_7_65e49c1b, ComIPduSignalRef=DIAG_ST_OBD_3_DRDY_8_65e49c1b, ComIPduSignalRef=ST_DIAG_OBD_3_DRDY_IMME_MUX_65e49c1b, ComIPduSignalRef=ST_DIAG_OBD_3_DRDY_MAX_MUX_65e49c1b, ComPduIdRef=pduTrig_ST_DIAG_OBD_3_DRDY_pduPort_EPS_A_FlexRay_OUT_55c86d41_4f391dd1, ComIPduGroupRef=EPS_OUT_PduGroup2
          ComTxIPdu: ComMinimumDelayTime=0.16, ComTxIPduUnusedAreasDefault=255
            ComTxModeTrue
              ComTxMode: ComTxModeMode=DIRECT, ComTxModeNumberOfRepetitions=0
            ComTxModeFalse
              ComTxMode: ComTxModeMode=NONE
        A_TEMP_19255f18: ComIPduDirection=RECEIVE, ComIPduHandleId=3, ComIPduSignalRef=TEMP_EX_4b857050, ComPduIdRef=pduTrig_A_TEMP_pduPort_EPS_A_FlexRay_IN_55c86d41_4f391dd1, ComIPduGroupRef=EPS_IN_PduGroup4
      3 x ComSignal, all with ComSignalAccess=ACCESS_NEEDED_BY_SWC_OR_COM:
        CTR_WARN_DIR_VIB_EPS_66c73f8f: ComBitPosition=54, ComBitSize=2, ComSignalDataInvalidValue=3, ComSignalEndianness=LITTLE_ENDIAN, ComSignalType=UINT8, ComSignalInitValue=0, ComHandleId=42, ComNotification=Rte_COMCbk_CTR_WARN_DIR_VIB_EPS_66c73f8f, ComTimeoutNotification=Rte_COMCbkRxTOut_CTR_WARN_DIR_VIB_EPS_66c73f8f, ComTimeout=0.55, ComSystemTemplateSystemSignalRef=CTR_WARN_DIR_VIB_EPS
        NO_VECH_7_13b7b7e4: ComBitPosition=48, ComSignalDataInvalidValue=255, ComSignalEndianness=opaque, ComSignalLength=1, ComSignalType=UINT8_N, ComSignalInitValue=0, ComHandleId=67, ComSystemTemplateSystemSignalRef=NO_VECH_7
        DBG_EPS_MOD_EXT_120_BYTE_ID2_58e47270: ComBitPosition=0, ComBitSize=8, ComSignalEndianness=LITTLE_ENDIAN, ComSignalInitValue=2, ComSignalType=UINT8, ComTransferProperty=PENDING, ComHandleId=28, ComSystemTemplateSystemSignalRef=DBG_EPS_MOD_EXT_120_BYTE_ID2
      13 x ComIPduGroup:
        EPS_IN_PduGroup: ComIPduGroupHandleId=1
        EPS_IN_PduGroup{2..10}: ComIPduGroupHandleId={2..10}
        EPS_OUT_PduGroup: ComIPduGroupHandleId=11
        EPS_OUT_PduGroup2: ComIPduGroupHandleId=12
        EPS_OUT_PduGroup3: ComIPduGroupHandleId=0
      14 x ComSignal, all with ComSignalEndianness=LITTLE_ENDIAN, ComSignalInitValue=0, ComTransferProperty=PENDING:
        MOT_WIDG_TEMP_EPS_df324712: ComBitPosition=144, ComBitSize=16, ComSignalType=UINT16, ComSignalAccess=ACCESS_NEEDED_BY_SWC_OR_COM, ComHandleId=52, ComSystemTemplateSystemSignalRef=MOT_WIDG_TEMP_EPS
        MOT_TQ_CMD_EPS_df324712: ComBitPosition=160, ComBitSize=16, ComSignalType=UINT16, ComSignalAccess=ACCESS_NEEDED_BY_SWC_OR_COM, ComHandleId=49, ComSystemTemplateSystemSignalRef=MOT_TQ_CMD_EPS
        SECDRY_HW_TQ_SNSR_VLTG_EPS_df324712: ComBitPosition=112, ComBitSize=8, ComSignalType=UINT8, ComSignalAccess=ACCESS_NEEDED_BY_SWC_OR_COM, ComHandleId=65, ComSystemTemplateSystemSignalRef=SECDRY_HW_TQ_SNSR_VLTG_EPS
        BATT_VLTG_EPS_df324712: ComBitPosition=32, ComBitSize=16, ComSignalType=UINT16, ComSignalAccess=ACCESS_NEEDED_BY_SWC_OR_COM, ComHandleId=17, ComSystemTemplateSystemSignalRef=BATT_VLTG_EPS
        VEH_SPD_EPS_df324712: ComBitPosition=16, ComBitSize=16, ComSignalType=UINT16, ComSignalAccess=ACCESS_NEEDED_BY_SWC_OR_COM, ComHandleId=86, ComSystemTemplateSystemSignalRef=VEH_SPD_EPS
        MOT_TQ_CMD_LIMD_EPS_df324712: ComBitPosition=88, ComBitSize=16, ComSignalType=UINT16, ComSignalAccess=ACCESS_NEEDED_BY_SWC_OR_COM, ComHandleId=50, ComSystemTemplateSystemSignalRef=MOT_TQ_CMD_LIMD_EPS
        PRIM_HW_TQ_SNSR_VLTG_EPS_df324712: ComBitPosition=104, ComBitSize=8, ComSignalType=UINT8, ComSignalAccess=ACCESS_NEEDED_BY_SWC_OR_COM, ComHandleId=55, ComSystemTemplateSystemSignalRef=PRIM_HW_TQ_SNSR_VLTG_EPS
        MOT_VEL_EPS_df324712: ComBitPosition=72, ComBitSize=16, ComSignalType=UINT16, ComSignalAccess=ACCESS_NEEDED_BY_SWC_OR_COM, ComHandleId=51, ComSystemTemplateSystemSignalRef=MOT_VEL_EPS
        ESTIMD_PEAK_MOT_CURR_EPS_df324712: ComBitPosition=48, ComBitSize=24, ComSignalType=UINT32, ComSignalAccess=ACCESS_NEEDED_BY_SWC_OR_COM, ComHandleId=42, ComSystemTemplateSystemSignalRef=ESTIMD_PEAK_MOT_CURR_EPS
        ECU_TEMP_EPS_df324712: ComBitPosition=120, ComBitSize=8, ComSignalType=UINT8, ComSignalAccess=ACCESS_NEEDED_BY_SWC_OR_COM, ComHandleId=41, ComSystemTemplateSystemSignalRef=ECU_TEMP_EPS
        ST_CON_VEH_EPS_df324712: ComBitPosition=12, ComBitSize=4, ComSignalType=UINT8, ComSignalAccess=ACCESS_NEEDED_BY_SWC_OR_COM, ComHandleId=71, ComSystemTemplateSystemSignalRef=ST_CON_VEH_EPS
        MOT_FET_TEMP_EPS_df324712: ComBitPosition=128, ComBitSize=8, ComSignalType=UINT8, ComSignalAccess=ACCESS_UNCLEAR, ComHandleId=47, ComSystemTemplateSystemSignalRef=MOT_FET_TEMP_EPS
        SYS_ST_EPS_df324712: ComBitPosition=8, ComBitSize=4, ComSignalType=UINT8, ComSignalAccess=ACCESS_NEEDED_BY_SWC_OR_COM, ComHandleId=79, ComSystemTemplateSystemSignalRef=SYS_ST_EPS
        MOT_MAG_TEMP_EPS_df324712: ComBitPosition=136, ComBitSize=8, ComSignalType=UINT8, ComSignalAccess=ACCESS_NEEDED_BY_SWC_OR_COM, ComHandleId=48, ComSystemTemplateSystemSignalRef=MOT_MAG_TEMP_EPS
    ComGeneration:
      ComOutOfBoundsWriteProtectionStrategy = NONE
      ComOutOfBoundsWriteSanitizer = false
      ComOutOfBoundsReadSanitizer = false
      ComReduceConstantData2Define = false
      ComBoolDataInArrayOfStructStrategy = BOOLEAN
      ComDeduplicateIndirectedData = true
      ComDataDeduplicationStrategy = WITH_CAST
      ComReduceBoolDataByNegationThreshold = 2
      ComReduceBoolDataByNumericalComparisonThreshold = 2
      ComReduceBoolDataByNumericalRelationThreshold = 2
      ComReduceBoolDataByNumericalOperandStrategy = WITH_ANY_VALUE
      ComReduceNumericalDataByOffsetThreshold = 2
      ComReduceNumericalDataByArraySubtractionThreshold = 2
      ComReduceDataByStreaming = false
      ComShortSymbols = false
      ComInterfacesForDeactivatedData = false
      ComReferringKeysInComments = false
    ComOptimization:
      ComTxCyclicProcessingISRLockThreshold = 1
      ComTxDeadlineMonitoringISRLockThreshold = 1
      ComTxProcessingISRLockThreshold = 1
      ComRxDeadlineMonitoringISRLockThreshold = 1
      ComRxDeferredProcessingISRLockThreshold = 1
      ComGatewayProcessingISRLockThreshold = 1
      ComGatewayDescriptionProcessingISRLockThreshold = 1
      ComIPduGroupISRLockThreshold = 1
