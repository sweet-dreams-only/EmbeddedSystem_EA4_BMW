AUTOSAR XML (schema 4-3-0)
package /ActiveEcuC
  module config Dio: implementation-config-variant=VARIANT-POST-BUILD, module-description=Dio_Impl
    DioGeneral:
      DioVersionCheckExternalModules = false
      DioDevErrorDetect = true
      DioMaskedWritePortApi = false
      DioFlipChannelApi = false
      DioVersionInfoApi = false
      DioCriticalSectionProtection = true
      DioDeviceName = R7F701319
      DioWriteVerify = WV_INIT_RUNTIME
      DioUseWriteVerifyErrorInterface = true
      DioWriteVerifyErrorInterface = HndlMcalWrVrfyErr
    DioConfig
      5 x DioPort:
        Port0: DioPortId=0, DioPortName=PORTGROUP_0_BITS_0_TO_14
          5 x DioChannel:
            PhaFbB: DioChannelId=2, DioChannelBitPosition=0
            DebPin0: DioChannelId=0, DioChannelBitPosition=3
            DebPin1: DioChannelId=1, DioChannelBitPosition=4
            PwrTurnOffCtrl: DioChannelId=3, DioChannelBitPosition=13
            PhaDiscnctC: DioChannelId=4, DioChannelBitPosition=8
        Port2: DioPortId=2, DioPortName=PORTGROUP_2_BITS_0_TO_15
          11 x DioChannel:
            GateDrv0Diagc: DioChannelId=4, DioChannelBitPosition=2
            SysFlt2A: DioChannelId=10, DioChannelBitPosition=4
            MotAg2Mosi: DioChannelId=9, DioChannelBitPosition=5
            MotAg2Miso: DioChannelId=8, DioChannelBitPosition=6
            MotAg2Clk: DioChannelId=7, DioChannelBitPosition=7
            MotAg0Mosi: DioChannelId=6, DioChannelBitPosition=8
            MotAg0Clk: DioChannelId=5, DioChannelBitPosition=9
            FrCs: DioChannelId=2, DioChannelBitPosition=14
            DebPin2: DioChannelId=0, DioChannelBitPosition=11
            DebPin3: DioChannelId=1, DioChannelBitPosition=12
            FrErr: DioChannelId=3, DioChannelBitPosition=3
        Port3: DioPortId=3, DioPortName=PORTGROUP_3_BITS_0_TO_14
          13 x DioChannel:
            MotAg0Miso: DioChannelId=3, DioChannelBitPosition=14
            PhaCUpprCmd: DioChannelId=10, DioChannelBitPosition=12
            PhaCLowrCmd: DioChannelId=9, DioChannelBitPosition=13
            PhaBLowrCmd: DioChannelId=7, DioChannelBitPosition=10
            PhaBUpprCmd: DioChannelId=8, DioChannelBitPosition=9
            PhaALowrCmd: DioChannelId=5, DioChannelBitPosition=8
            PhaAUpprCmd: DioChannelId=6, DioChannelBitPosition=7
            PwrOutpEnaFb: DioChannelId=12, DioChannelBitPosition=6
            GateDrv0Rst: DioChannelId=2, DioChannelBitPosition=5
            MotAg2Cs: DioChannelId=4, DioChannelBitPosition=3
            FrMosi: DioChannelId=1, DioChannelBitPosition=2
            FrClk: DioChannelId=0, DioChannelBitPosition=1
            PhaFbC: DioChannelId=11, DioChannelBitPosition=11
        Port4: DioPortId=4, DioPortName=PORTGROUP_4_BITS_0_TO_14
          7 x DioChannel:
            MotAg0Cs: DioChannelId=3, DioChannelBitPosition=3
            FrTxData: DioChannelId=1, DioChannelBitPosition=9
            FrRxData: DioChannelId=0, DioChannelBitPosition=8
            FrTxEna: DioChannelId=2, DioChannelBitPosition=10
            FrStb: DioChannelId=4, DioChannelBitPosition=5
            MotAg3_ENCA_I: DioChannelId=5, DioChannelBitPosition=2
            MotAg4_ENCA_I: DioChannelId=6, DioChannelBitPosition=6
        Port5: DioPortId=5, DioPortName=PORTGROUP_5_BITS_0_TO_15
          10 x DioChannel:
            PwrSplyMiso: DioChannelId=0, DioChannelBitPosition=0
            PwrSplyMosi: DioChannelId=1, DioChannelBitPosition=1
            PwrSplyClk: DioChannelId=4, DioChannelBitPosition=4
            PwrSplyNotFlt: DioChannelId=6, DioChannelBitPosition=6
            McuEna: DioChannelId=7, DioChannelBitPosition=7
            PwrSplyCs: DioChannelId=9, DioChannelBitPosition=9
            TmplMonrWdg: DioChannelId=10, DioChannelBitPosition=10
            PhaDiscnctA: DioChannelId=13, DioChannelBitPosition=13
            PhaDiscnctB: DioChannelId=15, DioChannelBitPosition=15
            PhaFbA: DioChannelId=14, DioChannelBitPosition=14
    DioDemEventParameterRefs: DIO_E_REG_WRITE_VERIFY=DIO_E_REG_WRITE_VERIFY
