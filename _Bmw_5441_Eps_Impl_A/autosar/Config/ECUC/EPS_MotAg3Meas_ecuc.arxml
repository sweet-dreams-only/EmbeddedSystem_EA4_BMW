AUTOSAR XML (schema 4-3-0)
package /ActiveEcuC
  module config MotAg3Meas: implementation-config-variant=VARIANT-PRE-COMPILE
    MotAg3MeasCfg: MotAg3SnsrRlvBitWidthExp=4
