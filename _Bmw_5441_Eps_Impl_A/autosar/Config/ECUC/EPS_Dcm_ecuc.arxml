AUTOSAR XML (schema 4-3-0)
package /ActiveEcuC
  module config Dcm: implementation-config-variant=VARIANT-PRE-COMPILE, module-description=Dcm_Impl
    DcmConfigSet
      DcmDsd  # DcmDsdServiceTable
        EPS_DCM_UDS_ON_FLEXRAY (DcmDsdServiceTable): DcmDsdSidTabId=0
          16 x DcmDsdService:
            RequestDownload: DcmDsdSidTabServiceId=52, DcmDsdSidTabSubfuncAvail=false, DcmDsdSidTabFnc=DcmDsdSidTabFnc_RequestDownload, DcmDsdSidTabSessionLevelRef=PROGRAMMING_SESSION
            EcuReset: DcmDsdSidTabServiceId=17, DcmDsdSidTabSubfuncAvail=true, DcmDsdSidTabSessionLevelRef=DEFAULT_SESSION, DcmDsdSidTabSessionLevelRef=EXTENDED_DIAGNOSTIC_SESSION, DcmDsdSidTabSessionLevelRef=CODING_SESSION  # EcuReset_0x01
              EcuReset_0x01 (DcmDsdSubService):
                DcmDsdSubServiceId = 1
                DcmDsdSubServiceSessionLevelRef = DEFAULT_SESSION
                DcmDsdSubServiceSessionLevelRef = EXTENDED_DIAGNOSTIC_SESSION
                DcmDsdSubServiceSessionLevelRef = CODING_SESSION
            TransferData: DcmDsdSidTabServiceId=54, DcmDsdSidTabSubfuncAvail=false, DcmDsdSidTabFnc=DcmDsdSidTabFnc_TransferData, DcmDsdSidTabSessionLevelRef=PROGRAMMING_SESSION
            RequestTransferExit: DcmDsdSidTabServiceId=55, DcmDsdSidTabSubfuncAvail=false, DcmDsdSidTabFnc=DcmDsdSidTabFnc_RequestTransferExit, DcmDsdSidTabSessionLevelRef=PROGRAMMING_SESSION
            SessionControl: DcmDsdSidTabServiceId=16, DcmDsdSidTabSubfuncAvail=true, DcmDsdSidTabSessionLevelRef=CODING_SESSION, DcmDsdSidTabSessionLevelRef=DEFAULT_SESSION, DcmDsdSidTabSessionLevelRef=DEVELOPMENT_SESSION, DcmDsdSidTabSessionLevelRef=EXTENDED_DIAGNOSTIC_SESSION, DcmDsdSidTabSessionLevelRef=GarageMode, DcmDsdSidTabSessionLevelRef=PROGRAMMING_SESSION, DcmDsdSidTabSessionLevelRef=RSU_SESSION, DcmDsdSidTabSessionLevelRef=DcmDspSessionRow_NXTRMFG  # DiagnosticSessionControl_0x01
              9 x DcmDsdSubService:
                DiagnosticSessionControl_0x03: DcmDsdSubServiceId=3, DcmDsdSubServiceSessionLevelRef=DEFAULT_SESSION, DcmDsdSubServiceSessionLevelRef=EXTENDED_DIAGNOSTIC_SESSION, DcmDsdSubServiceSessionLevelRef=GarageMode, DcmDsdSubServiceSessionLevelRef=CODING_SESSION, DcmDsdSubServiceSessionLevelRef=PROGRAMMING_SESSION
                DiagnosticSessionControl_0x02: DcmDsdSubServiceId=2, DcmDsdSubServiceSessionLevelRef=EXTENDED_DIAGNOSTIC_SESSION, DcmDsdSubServiceSessionLevelRef=PROGRAMMING_SESSION, DcmDsdSubServiceSessionLevelRef=CODING_SESSION
                DiagnosticSessionControl_0x01: DcmDsdSubServiceId=1, DcmDsdSubServiceSessionLevelRef=DEFAULT_SESSION, DcmDsdSubServiceSessionLevelRef=DEVELOPMENT_SESSION, DcmDsdSubServiceSessionLevelRef=EXTENDED_DIAGNOSTIC_SESSION, DcmDsdSubServiceSessionLevelRef=DcmDspSessionRow_NXTRMFG, DcmDsdSubServiceSessionLevelRef=CODING_SESSION, DcmDsdSubServiceSessionLevelRef=PROGRAMMING_SESSION
                DiagnosticSessionControl_0x5F: DcmDsdSubServiceId=95, DcmDsdSubServiceSessionLevelRef=GarageMode, DcmDsdSubServiceSessionLevelRef=EXTENDED_DIAGNOSTIC_SESSION, DcmDsdSubServiceSessionLevelRef=DEFAULT_SESSION
                DiagnosticSessionControl_0x44: DcmDsdSubServiceId=68, DcmDsdSubServiceSessionLevelRef=EXTENDED_DIAGNOSTIC_SESSION, DcmDsdSubServiceSessionLevelRef=RSU_SESSION
                DiagnosticSessionControl_0x41: DcmDsdSubServiceId=65, DcmDsdSubServiceSessionLevelRef=CODING_SESSION, DcmDsdSubServiceSessionLevelRef=EXTENDED_DIAGNOSTIC_SESSION, DcmDsdSubServiceSessionLevelRef=DEFAULT_SESSION, DcmDsdSubServiceSessionLevelRef=PROGRAMMING_SESSION
                DiagnosticSessionControl_0x7E: DcmDsdSubServiceId=126
                DiagnosticSessionControl_0x4F: DcmDsdSubServiceId=79, DcmDsdSubServiceSessionLevelRef=DEVELOPMENT_SESSION
                DiagnosticSessionControl_0x61: DcmDsdSubServiceId=97, DcmDsdSubServiceSessionLevelRef=SYSTEM_SUPPLIER_SPECIFIC_61
            ControlDTCSetting: DcmDsdSidTabServiceId=133, DcmDsdSidTabSubfuncAvail=true, DcmDsdSidTabSessionLevelRef=EXTENDED_DIAGNOSTIC_SESSION  # ControlDtcSetting_0x01
              ControlDtcSetting_0x01 (DcmDsdSubService): DcmDsdSubServiceId=1, DcmDsdSubServiceSessionLevelRef=EXTENDED_DIAGNOSTIC_SESSION
              ControlDtcSetting_0x02 (DcmDsdSubService): DcmDsdSubServiceId=2, DcmDsdSubServiceSessionLevelRef=EXTENDED_DIAGNOSTIC_SESSION
            ResponseOnEvent: DcmDsdSidTabServiceId=134, DcmDsdSidTabSubfuncAvail=true, DcmDsdSidTabSessionLevelRef=DEFAULT_SESSION, DcmDsdSidTabSessionLevelRef=EXTENDED_DIAGNOSTIC_SESSION  # ResponseOnEvent_0x04
              3 x DcmDsdSubService, all with DcmDsdSubServiceSessionLevelRef=DEFAULT_SESSION, DcmDsdSubServiceSessionLevelRef=EXTENDED_DIAGNOSTIC_SESSION:
                DcmDsdSubService_0x45: DcmDsdSubServiceId=69
                DcmDsdSubService_0x04: DcmDsdSubServiceId=4
                DcmDsdSubServic_0x40: DcmDsdSubServiceId=64
            TesterPresent: DcmDsdSidTabServiceId=62, DcmDsdSidTabSubfuncAvail=true, DcmDsdSidTabSessionLevelRef=DcmDspSessionRow_NXTRMFG, DcmDsdSidTabSessionLevelRef=DEFAULT_SESSION, DcmDsdSidTabSessionLevelRef=EXTENDED_DIAGNOSTIC_SESSION, DcmDsdSidTabSessionLevelRef=GarageMode
              TesterPresent (DcmDsdSubService): DcmDsdSubServiceId=0
            ClearDiagnosticInformation: DcmDsdSidTabServiceId=20, DcmDsdSidTabSubfuncAvail=false, DcmDsdSidTabSessionLevelRef=DEFAULT_SESSION, DcmDsdSidTabSessionLevelRef=EXTENDED_DIAGNOSTIC_SESSION, DcmDsdSidTabSessionLevelRef=GarageMode
            CommunicationControl: DcmDsdSidTabServiceId=40, DcmDsdSidTabSubfuncAvail=true, DcmDsdSidTabSessionLevelRef=EXTENDED_DIAGNOSTIC_SESSION  # CommunicationControl_0x00
              4 x DcmDsdSubService, all with DcmDsdSubServiceSessionLevelRef=EXTENDED_DIAGNOSTIC_SESSION:
                CommunicationControl_0x02: DcmDsdSubServiceId=1
                CommunicationControl_0x03: DcmDsdSubServiceId=2
                CommunicationControl_0x00: DcmDsdSubServiceId=0
                CommunicationControl_0x01: DcmDsdSubServiceId=3
            ReadDTCInformation: DcmDsdSidTabServiceId=25, DcmDsdSidTabSubfuncAvail=true, DcmDsdSidTabSessionLevelRef=CODING_SESSION, DcmDsdSidTabSessionLevelRef=DEFAULT_SESSION, DcmDsdSidTabSessionLevelRef=EXTENDED_DIAGNOSTIC_SESSION  # ReadDtcInformation_0x02
              7 x DcmDsdSubService, all with DcmDsdSubServiceSessionLevelRef=DEFAULT_SESSION, DcmDsdSubServiceSessionLevelRef=EXTENDED_DIAGNOSTIC_SESSION:
                ReadDtcInformation_0x19: DcmDsdSubServiceId=25
                ReadDtcInformation_0x18: DcmDsdSubServiceId=24
                ReadDtcInformation_0x06: DcmDsdSubServiceId=6
                ReadDtcInformation_0x17: DcmDsdSubServiceId=23
                ReadDtcInformation_0x04: DcmDsdSubServiceId=4
                ReadDtcInformation_0x02: DcmDsdSubServiceId=2
                ReadDtcInformation_0x0A: DcmDsdSubServiceId=10, DcmDsdSubServiceSessionLevelRef=CODING_SESSION
            ReadDataByIdentifier: DcmDsdSidTabServiceId=34, DcmDsdSidTabSubfuncAvail=false, DcmDsdSidTabSessionLevelRef=CODING_SESSION, DcmDsdSidTabSessionLevelRef=DEFAULT_SESSION, DcmDsdSidTabSessionLevelRef=EXTENDED_DIAGNOSTIC_SESSION, DcmDsdSidTabSessionLevelRef=GarageMode, DcmDsdSidTabSessionLevelRef=PROGRAMMING_SESSION, DcmDsdSidTabSessionLevelRef=DcmDspSessionRow_NXTRMFG  # RDBI_Readhwmodificationindex
            RoutineControl: DcmDsdSidTabServiceId=49, DcmDsdSidTabSubfuncAvail=true, DcmDsdSidTabSessionLevelRef=CODING_SESSION, DcmDsdSidTabSessionLevelRef=DEFAULT_SESSION, DcmDsdSidTabSessionLevelRef=EXTENDED_DIAGNOSTIC_SESSION, DcmDsdSidTabSessionLevelRef=GarageMode, DcmDsdSidTabSessionLevelRef=PROGRAMMING_SESSION, DcmDsdSidTabSessionLevelRef=SYSTEM_SUPPLIER_SPECIFIC_61, DcmDsdSidTabSessionLevelRef=DcmDspSessionRow_NXTRMFG  # CheckNcd
            WriteDataByIdentifier: DcmDsdSidTabServiceId=46, DcmDsdSidTabSubfuncAvail=false, DcmDsdSidTabSessionLevelRef=DEFAULT_SESSION, DcmDsdSidTabSessionLevelRef=EXTENDED_DIAGNOSTIC_SESSION, DcmDsdSidTabSessionLevelRef=GarageMode, DcmDsdSidTabSessionLevelRef=PROGRAMMING_SESSION, DcmDsdSidTabSessionLevelRef=DcmDspSessionRow_NXTRMFG  # WBDI_EpsLenkwinkelsensorKalibrierung
            SecurityAccess: DcmDsdSidTabServiceId=39, DcmDsdSidTabSubfuncAvail=true, DcmDsdSidTabSessionLevelRef=CODING_SESSION
              DcmDsdSubService_0x01 (DcmDsdSubService): DcmDsdSubServiceId=1, DcmDsdSubServiceSessionLevelRef=CODING_SESSION
              DcmDsdSubService_0x02 (DcmDsdSubService): DcmDsdSubServiceId=2, DcmDsdSubServiceSessionLevelRef=CODING_SESSION
            DcmDsdService_INPUTOUTPUTCONTROLBYIDENTIFIER: DcmDsdSidTabServiceId=47, DcmDsdSidTabSubfuncAvail=false, DcmDsdSidTabSessionLevelRef=DcmDspSessionRow_NXTRMFG, DcmDsdSidTabSessionLevelRef=DEFAULT_SESSION
      DcmDsl  # Darh
        DcmDslBuffer: DcmDslBufferSize=8195
        DcmDslDiagResp: DcmDslDiagRespMaxNumRespPend=2, DcmDslDiagRespOnSecondDeclinedRequest=true, DcmDslDiagRespMaxNumOfDeclinedRequests=3
        DcmDslProtocol
          DcmDslProtocolRow_DCM_UDS_ON_FLEXRAY (DcmDslProtocolRow):
            DcmDslProtocolID = DCM_UDS_ON_FLEXRAY
            DcmDslProtocolTransType = TYPE1
            DcmSendRespPendOnTransToBoot = true
            DcmDslProtocolPriority = 0
            DcmTimStrP2ServerAdjust = 0.03
            DcmTimStrP2StarServerAdjust = 0.03
            DcmDslProtocolMaximumResponseSize = 4095
            DcmDslProtocolEndiannessConvEnabled = false
            DcmDslProtocolIsParallelExecutab = false
            DcmDslProtocolPreemptTimeout = 0
            DcmDslProtocolRxBufferID = DcmDslBuffer
            DcmDslProtocolSIDTable = EPS_DCM_UDS_ON_FLEXRAY
            DcmDslProtocolTxBufferID = DcmDslBuffer
            DcmDemClientRef = DemClient_DCM
            14 x DcmDslConnection:
              DcmDslConnection_0xF4
                DcmDslMainConnection: DcmDslProtocolRxTesterSourceAddr=244
                  DcmDslProtocolRx_0xF4_ph (DcmDslProtocolRx):
                    DcmDslProtocolRxAddrType = DCM_PHYSICAL_TYPE
                    DcmDslProtocolRxPduId = 9
                    DcmDslProtocolRxChannelId = 9
                    DcmDslProtocolRxPduRef = Dcm_GW_TRNSM_FR_254_0xF4
                    DcmDslProtocolRxComMChannelRef = A_FlexRay_372befd6
                  DcmDslProtocolRx_0xF4_fu (DcmDslProtocolRx):
                    DcmDslProtocolRxAddrType = DCM_FUNCTIONAL_TYPE
                    DcmDslProtocolRxPduId = 8
                    DcmDslProtocolRxChannelId = 8
                    DcmDslProtocolRxPduRef = Dcm_BRC_FR_32_0xF4
                    DcmDslProtocolRxComMChannelRef = A_FlexRay_372befd6
                  DcmDslProtocolTx_0xF4 (DcmDslProtocolTx): DcmDslTxConfirmationPduId=4, DcmDslProtocolTxPduRef=Dcm_ECU_TRNSM_FR_32_0xF4
              DcmDslConnection_0xF3
                DcmDslMainConnection: DcmDslProtocolRxTesterSourceAddr=243
                  DcmDslProtocolRx_0xF3_ph (DcmDslProtocolRx):
                    DcmDslProtocolRxAddrType = DCM_PHYSICAL_TYPE
                    DcmDslProtocolRxPduId = 7
                    DcmDslProtocolRxChannelId = 7
                    DcmDslProtocolRxPduRef = Dcm_GW_TRNSM_FR_254_0xF3
                    DcmDslProtocolRxComMChannelRef = A_FlexRay_372befd6
                  DcmDslProtocolRx_0xF3_fu (DcmDslProtocolRx):
                    DcmDslProtocolRxAddrType = DCM_FUNCTIONAL_TYPE
                    DcmDslProtocolRxPduId = 6
                    DcmDslProtocolRxChannelId = 6
                    DcmDslProtocolRxPduRef = Dcm_BRC_FR_32_0xF3
                    DcmDslProtocolRxComMChannelRef = A_FlexRay_372befd6
                  DcmDslProtocolTx_0xF3 (DcmDslProtocolTx): DcmDslTxConfirmationPduId=3, DcmDslProtocolTxPduRef=Dcm_ECU_TRNSM_FR_32_0xF3
              DcmDslConnection_0xF2
                DcmDslMainConnection: DcmDslProtocolRxTesterSourceAddr=242
                  DcmDslProtocolRx_0xF2_ph (DcmDslProtocolRx):
                    DcmDslProtocolRxAddrType = DCM_PHYSICAL_TYPE
                    DcmDslProtocolRxPduId = 5
                    DcmDslProtocolRxChannelId = 5
                    DcmDslProtocolRxPduRef = Dcm_GW_TRNSM_FR_254_0xF2
                    DcmDslProtocolRxComMChannelRef = A_FlexRay_372befd6
                  DcmDslProtocolRx_0xF2_fu (DcmDslProtocolRx):
                    DcmDslProtocolRxAddrType = DCM_FUNCTIONAL_TYPE
                    DcmDslProtocolRxPduId = 4
                    DcmDslProtocolRxChannelId = 4
                    DcmDslProtocolRxPduRef = Dcm_BRC_FR_32_0xF2
                    DcmDslProtocolRxComMChannelRef = A_FlexRay_372befd6
                  DcmDslProtocolTx_0xF2 (DcmDslProtocolTx): DcmDslTxConfirmationPduId=2, DcmDslProtocolTxPduRef=Dcm_ECU_TRNSM_FR_32_0xF2
              DcmDslConnection_0xF1
                DcmDslMainConnection: DcmDslProtocolRxTesterSourceAddr=241
                  DcmDslProtocolTx_0xF1 (DcmDslProtocolTx): DcmDslTxConfirmationPduId=1, DcmDslProtocolTxPduRef=Dcm_ECU_TRNSM_FR_32_0xF1
                  DcmDslProtocolRx_0xF1_ph (DcmDslProtocolRx):
                    DcmDslProtocolRxAddrType = DCM_PHYSICAL_TYPE
                    DcmDslProtocolRxPduId = 3
                    DcmDslProtocolRxChannelId = 3
                    DcmDslProtocolRxPduRef = Dcm_GW_TRNSM_FR_254_0xF1
                    DcmDslProtocolRxComMChannelRef = A_FlexRay_372befd6
                  DcmDslProtocolRx_0xF1_fu (DcmDslProtocolRx):
                    DcmDslProtocolRxAddrType = DCM_FUNCTIONAL_TYPE
                    DcmDslProtocolRxPduId = 2
                    DcmDslProtocolRxChannelId = 2
                    DcmDslProtocolRxPduRef = Dcm_BRC_FR_32_0xF1
                    DcmDslProtocolRxComMChannelRef = A_FlexRay_372befd6
              DcmDslConnection_0xF8
                DcmDslMainConnection: DcmDslProtocolRxTesterSourceAddr=248
                  DcmDslProtocolRx_0xF8_ph (DcmDslProtocolRx):
                    DcmDslProtocolRxAddrType = DCM_PHYSICAL_TYPE
                    DcmDslProtocolRxPduId = 17
                    DcmDslProtocolRxChannelId = 17
                    DcmDslProtocolRxPduRef = Dcm_GW_TRNSM_FR_254_0xF8
                    DcmDslProtocolRxComMChannelRef = A_FlexRay_372befd6
                  DcmDslProtocolTx_0xF8 (DcmDslProtocolTx): DcmDslTxConfirmationPduId=8, DcmDslProtocolTxPduRef=Dcm_ECU_TRNSM_FR_32_0xF8
                  DcmDslProtocolRx_0xF8_fu (DcmDslProtocolRx):
                    DcmDslProtocolRxAddrType = DCM_FUNCTIONAL_TYPE
                    DcmDslProtocolRxPduId = 16
                    DcmDslProtocolRxChannelId = 16
                    DcmDslProtocolRxPduRef = Dcm_BRC_FR_32_0xF8
                    DcmDslProtocolRxComMChannelRef = A_FlexRay_372befd6
              DcmDslConnection_0xF7
                DcmDslMainConnection: DcmDslProtocolRxTesterSourceAddr=247
                  DcmDslProtocolRx_0xF7_ph (DcmDslProtocolRx):
                    DcmDslProtocolRxAddrType = DCM_PHYSICAL_TYPE
                    DcmDslProtocolRxPduId = 15
                    DcmDslProtocolRxChannelId = 15
                    DcmDslProtocolRxPduRef = Dcm_GW_TRNSM_FR_254_0xF7
                    DcmDslProtocolRxComMChannelRef = A_FlexRay_372befd6
                  DcmDslProtocolTx_0xF7 (DcmDslProtocolTx): DcmDslTxConfirmationPduId=7, DcmDslProtocolTxPduRef=Dcm_ECU_TRNSM_FR_32_0xF7
                  DcmDslProtocolRx_0xF7_fu (DcmDslProtocolRx):
                    DcmDslProtocolRxAddrType = DCM_FUNCTIONAL_TYPE
                    DcmDslProtocolRxPduId = 14
                    DcmDslProtocolRxChannelId = 14
                    DcmDslProtocolRxPduRef = Dcm_BRC_FR_32_0xF7
                    DcmDslProtocolRxComMChannelRef = A_FlexRay_372befd6
              DcmDslConnection_0xF6
                DcmDslMainConnection: DcmDslProtocolRxTesterSourceAddr=246
                  DcmDslProtocolRx_0xF6_ph (DcmDslProtocolRx):
                    DcmDslProtocolRxAddrType = DCM_PHYSICAL_TYPE
                    DcmDslProtocolRxPduId = 13
                    DcmDslProtocolRxChannelId = 13
                    DcmDslProtocolRxPduRef = Dcm_GW_TRNSM_FR_254_0xF6
                    DcmDslProtocolRxComMChannelRef = A_FlexRay_372befd6
                  DcmDslProtocolTx_0xF6 (DcmDslProtocolTx): DcmDslTxConfirmationPduId=6, DcmDslProtocolTxPduRef=Dcm_ECU_TRNSM_FR_32_0xF6
                  DcmDslProtocolRx_0xF6_fu (DcmDslProtocolRx):
                    DcmDslProtocolRxAddrType = DCM_FUNCTIONAL_TYPE
                    DcmDslProtocolRxPduId = 12
                    DcmDslProtocolRxChannelId = 12
                    DcmDslProtocolRxPduRef = Dcm_BRC_FR_32_0xF6
                    DcmDslProtocolRxComMChannelRef = A_FlexRay_372befd6
              DcmDslConnection_0xF5
                DcmDslMainConnection: DcmDslProtocolRxTesterSourceAddr=245
                  DcmDslProtocolRx_0xF5_ph (DcmDslProtocolRx):
                    DcmDslProtocolRxAddrType = DCM_PHYSICAL_TYPE
                    DcmDslProtocolRxPduId = 11
                    DcmDslProtocolRxChannelId = 11
                    DcmDslProtocolRxPduRef = Dcm_GW_TRNSM_FR_254_0xF5
                    DcmDslProtocolRxComMChannelRef = A_FlexRay_372befd6
                  DcmDslProtocolRx_0xF5_fu (DcmDslProtocolRx):
                    DcmDslProtocolRxAddrType = DCM_FUNCTIONAL_TYPE
                    DcmDslProtocolRxPduId = 10
                    DcmDslProtocolRxChannelId = 10
                    DcmDslProtocolRxPduRef = Dcm_BRC_FR_32_0xF5
                    DcmDslProtocolRxComMChannelRef = A_FlexRay_372befd6
                  DcmDslProtocolTx_0xF5 (DcmDslProtocolTx): DcmDslTxConfirmationPduId=5, DcmDslProtocolTxPduRef=Dcm_ECU_TRNSM_FR_32_0xF5
              DcmDslConnection_0xF0
                DcmDslMainConnection: DcmDslProtocolRxTesterSourceAddr=240
                  DcmDslProtocolTx_0xF0 (DcmDslProtocolTx): DcmDslTxConfirmationPduId=0, DcmDslProtocolTxPduRef=Dcm_ECU_TRNSM_FR_32_0xF0
                  DcmDslProtocolRx_0xF0_fu (DcmDslProtocolRx):
                    DcmDslProtocolRxAddrType = DCM_FUNCTIONAL_TYPE
                    DcmDslProtocolRxPduId = 0
                    DcmDslProtocolRxChannelId = 0
                    DcmDslProtocolRxPduRef = Dcm_BRC_FR_32_0xF0
                    DcmDslProtocolRxComMChannelRef = A_FlexRay_372befd6
                  DcmDslProtocolRx_0xF0_ph (DcmDslProtocolRx):
                    DcmDslProtocolRxAddrType = DCM_PHYSICAL_TYPE
                    DcmDslProtocolRxPduId = 1
                    DcmDslProtocolRxChannelId = 1
                    DcmDslProtocolRxPduRef = Dcm_GW_TRNSM_FR_254_0xF0
                    DcmDslProtocolRxComMChannelRef = A_FlexRay_372befd6
              DcmDslConnection_0xFD
                DcmDslMainConnection: DcmDslProtocolRxTesterSourceAddr=253
                  DcmDslProtocolRx_0xFD_fu (DcmDslProtocolRx):
                    DcmDslProtocolRxAddrType = DCM_FUNCTIONAL_TYPE
                    DcmDslProtocolRxPduId = 26
                    DcmDslProtocolRxChannelId = 26
                    DcmDslProtocolRxPduRef = Dcm_BRC_FR_32_0xFD
                    DcmDslProtocolRxComMChannelRef = A_FlexRay_372befd6
                  DcmDslProtocolRx_0xFD_ph (DcmDslProtocolRx):
                    DcmDslProtocolRxAddrType = DCM_PHYSICAL_TYPE
                    DcmDslProtocolRxPduId = 27
                    DcmDslProtocolRxChannelId = 27
                    DcmDslProtocolRxPduRef = Dcm_GW_TRNSM_FR_254_0xFD
                    DcmDslProtocolRxComMChannelRef = A_FlexRay_372befd6
                  DcmDslProtocolTx_0xFD (DcmDslProtocolTx): DcmDslTxConfirmationPduId=13, DcmDslProtocolTxPduRef=Dcm_ECU_TRNSM_FR_32_0xFD
              DcmDslConnection_0xFC
                DcmDslMainConnection: DcmDslProtocolRxTesterSourceAddr=252
                  DcmDslProtocolRx_0xFC_fu (DcmDslProtocolRx):
                    DcmDslProtocolRxAddrType = DCM_FUNCTIONAL_TYPE
                    DcmDslProtocolRxPduId = 24
                    DcmDslProtocolRxChannelId = 24
                    DcmDslProtocolRxPduRef = Dcm_BRC_FR_32_0xFC
                    DcmDslProtocolRxComMChannelRef = A_FlexRay_372befd6
                  DcmDslProtocolRx_0xFC_ph (DcmDslProtocolRx):
                    DcmDslProtocolRxAddrType = DCM_PHYSICAL_TYPE
                    DcmDslProtocolRxPduId = 25
                    DcmDslProtocolRxChannelId = 25
                    DcmDslProtocolRxPduRef = Dcm_GW_TRNSM_FR_254_0xFC
                    DcmDslProtocolRxComMChannelRef = A_FlexRay_372befd6
                  DcmDslProtocolTx_0xFC (DcmDslProtocolTx): DcmDslTxConfirmationPduId=12, DcmDslProtocolTxPduRef=Dcm_ECU_TRNSM_FR_32_0xFC
              DcmDslConnection_0xFB
                DcmDslMainConnection: DcmDslProtocolRxTesterSourceAddr=251
                  DcmDslProtocolRx_0xFB_fu (DcmDslProtocolRx):
                    DcmDslProtocolRxAddrType = DCM_FUNCTIONAL_TYPE
                    DcmDslProtocolRxPduId = 22
                    DcmDslProtocolRxChannelId = 22
                    DcmDslProtocolRxPduRef = Dcm_BRC_FR_32_0xFB
                    DcmDslProtocolRxComMChannelRef = A_FlexRay_372befd6
                  DcmDslProtocolRx_0xFB_ph (DcmDslProtocolRx):
                    DcmDslProtocolRxAddrType = DCM_PHYSICAL_TYPE
                    DcmDslProtocolRxPduId = 23
                    DcmDslProtocolRxChannelId = 23
                    DcmDslProtocolRxPduRef = Dcm_GW_TRNSM_FR_254_0xFB
                    DcmDslProtocolRxComMChannelRef = A_FlexRay_372befd6
                  DcmDslProtocolTx_0xFB (DcmDslProtocolTx): DcmDslTxConfirmationPduId=11, DcmDslProtocolTxPduRef=Dcm_ECU_TRNSM_FR_32_0xFB
              DcmDslConnection_0xFA
                DcmDslMainConnection: DcmDslProtocolRxTesterSourceAddr=250
                  DcmDslProtocolRx_0xFA_ph (DcmDslProtocolRx):
                    DcmDslProtocolRxAddrType = DCM_PHYSICAL_TYPE
                    DcmDslProtocolRxPduId = 21
                    DcmDslProtocolRxChannelId = 21
                    DcmDslProtocolRxPduRef = Dcm_GW_TRNSM_FR_254_0xFA
                    DcmDslProtocolRxComMChannelRef = A_FlexRay_372befd6
                  DcmDslProtocolTx_0xFA (DcmDslProtocolTx): DcmDslTxConfirmationPduId=10, DcmDslProtocolTxPduRef=Dcm_ECU_TRNSM_FR_32_0xFA
                  DcmDslProtocolRx_0xFA_fu (DcmDslProtocolRx):
                    DcmDslProtocolRxAddrType = DCM_FUNCTIONAL_TYPE
                    DcmDslProtocolRxPduId = 20
                    DcmDslProtocolRxChannelId = 20
                    DcmDslProtocolRxPduRef = Dcm_BRC_FR_32_0xFA
                    DcmDslProtocolRxComMChannelRef = A_FlexRay_372befd6
              DcmDslConnection_0xF9
                DcmDslMainConnection: DcmDslProtocolRxTesterSourceAddr=249
                  DcmDslProtocolRx_0xF9_fu (DcmDslProtocolRx):
                    DcmDslProtocolRxAddrType = DCM_FUNCTIONAL_TYPE
                    DcmDslProtocolRxPduId = 18
                    DcmDslProtocolRxChannelId = 18
                    DcmDslProtocolRxPduRef = Dcm_BRC_FR_32_0xF9
                    DcmDslProtocolRxComMChannelRef = A_FlexRay_372befd6
                  DcmDslProtocolRx_0xF9_ph (DcmDslProtocolRx):
                    DcmDslProtocolRxAddrType = DCM_PHYSICAL_TYPE
                    DcmDslProtocolRxPduId = 19
                    DcmDslProtocolRxChannelId = 19
                    DcmDslProtocolRxPduRef = Dcm_GW_TRNSM_FR_254_0xF9
                    DcmDslProtocolRxComMChannelRef = A_FlexRay_372befd6
                  DcmDslProtocolTx_0xF9 (DcmDslProtocolTx): DcmDslTxConfirmationPduId=9, DcmDslProtocolTxPduRef=Dcm_ECU_TRNSM_FR_32_0xF9
        StdDiag (DcmDslServiceRequestManufacturerNotification): DcmDslServiceRequestManufacturerNotificationUsePort=true
        Coding (DcmDslServiceRequestManufacturerNotification): DcmDslServiceRequestManufacturerNotificationUsePort=true
      DcmDsp: DcmDspMaxDidToRead=1, DcmDspReadDIDReportsNODIByte=false
        DcmDspSession
          9 x DcmDspSessionRow, all with DcmDspSessionP2ServerMax=0.05, DcmDspSessionP2StarServerMax=5:
            DcmDspSessionRow_NXTRMFG: DcmDspSessionForBoot=DCM_NO_BOOT, DcmDspSessionLevel=126
            CODING_SESSION: DcmDspSessionForBoot=DCM_NO_BOOT, DcmDspSessionLevel=65
            DEFAULT_SESSION: DcmDspSessionForBoot=DCM_NO_BOOT, DcmDspSessionLevel=1
            EXTENDED_DIAGNOSTIC_SESSION: DcmDspSessionForBoot=DCM_NO_BOOT, DcmDspSessionLevel=3
            RSU_SESSION: DcmDspSessionForBoot=DCM_NO_BOOT, DcmDspSessionLevel=68
            DEVELOPMENT_SESSION: DcmDspSessionForBoot=DCM_NO_BOOT, DcmDspSessionLevel=79
            SYSTEM_SUPPLIER_SPECIFIC_61: DcmDspSessionLevel=97, DcmDspSessionForBoot=DCM_NO_BOOT
            GarageMode: DcmDspSessionForBoot=DCM_NO_BOOT, DcmDspSessionLevel=95
            PROGRAMMING_SESSION: DcmDspSessionForBoot=DCM_OEM_BOOT, DcmDspSessionLevel=2
        DcmDspData_ReadOpMode (DcmDspData):
          DcmDspDataConditionCheckReadFncUsed = true
          DcmDspDataSize = 8
          DcmDspDataType = UINT8
          DcmDspDataUsePort = USE_DATA_SYNCH_CLIENT_SERVER
          DcmDspDataInfoRef = DcmDspDataInfo_ReadOpMode
        DcmDspSecurity
          DcmDspSecurityRow_Coding (DcmDspSecurityRow):
            DcmDspSecurityAttemptCounterEnabled = false
            DcmDspSecurityDelayTime = 0
            DcmDspSecurityDelayTimeOnBoot = 0
            DcmDspSecurityKeySize = 132
            DcmDspSecurityLevel = 1
            DcmDspSecurityNumAttDelay = 3
            DcmDspSecuritySeedSize = 8
            DcmDspSecurityUsePort = USE_ASYNCH_CLIENT_SERVER
            DcmDspSecurityADRSize = 4
        DcmDspData_StatusFzgBordnetz (DcmDspData): DcmDspDataSize=120, DcmDspDataType=UINT8, DcmDspDataUsePort=USE_DATA_ASYNCH_CLIENT_SERVER, DcmDspDataInfoRef=DcmDspDataInfo_StatusFzgBordnetz
        DcmDspData_ReadRoeState (DcmDspData):
          DcmDspDataConditionCheckReadFncUsed = true
          DcmDspDataSize = 8
          DcmDspDataType = UINT8
          DcmDspDataUsePort = USE_DATA_SYNCH_CLIENT_SERVER
          DcmDspDataInfoRef = DcmDspDataInfo_ReadRoeState
        DcmDspRoe:
          DcmDspRoeInitOnDSC = false
          DcmDspRoeInterMessageTime = 0.01
          DcmDspRoeMaxNumberOfRetry = 0
          DcmDspRoeQueueEnabled = false
          DcmDspRoeBlockIdRef = NVM_BLOCK_DCM_ROE
          DcmDspRoeEventWindowTime: DcmDspRoeEventWindowTime=DCM_ROE_EVENT_WINDOW_INFINITE, DcmDspRoeStorageState=true
          DcmDspRoeEvent: DcmDspRoeEventId=0
        35 x DcmDspDataInfo:
          DcmDspDataInfo_GCft1: DcmDspDataFixedLength=false
          DcmDspDataInfo_EcuSerialNumber: DcmDspDataFixedLength=true
          DcmDspDataInfo_EnergySavingState: DcmDspDataFixedLength=true
          DcmDspDataInfo_EpsLenkwinkelsensorKalibrierung: DcmDspDataFixedLength=true
          DcmDspDataInfo_EpsMomentensensor: DcmDspDataFixedLength=true
          DcmDspDataInfo_EpsRitzelwinkelsensor: DcmDspDataFixedLength=true
          DcmDspDataInfo_EpsZahnstangenmitte: DcmDspDataFixedLength=true
          DcmDspDataInfo_ExtendedEnergySavingState: DcmDspDataFixedLength=true
          DcmDspDataInfo_FlashTimingParameter: DcmDspDataFixedLength=true
          DcmDspDataInfo_GelernterZahnstangenweg: DcmDspDataFixedLength=true
          DcmDspDataInfo_Herstelldatum: DcmDspDataFixedLength=true
          DcmDspDataInfo_MileKmEeprom: DcmDspDataFixedLength=true
          DcmDspDataInfo_ProgrammingCounter: DcmDspDataFixedLength=true
          DcmDspDataInfo_ProgrammingCounterMaxValue: DcmDspDataFixedLength=true
          DcmDspDataInfo_Pruefstempel: DcmDspDataFixedLength=true
          DcmDspDataInfo_ReadActiveSessionState: DcmDspDataFixedLength=true
          DcmDspDataInfo_Readhwmodificationindex: DcmDspDataFixedLength=true
          DcmDspDataInfo_ReadOpMode: DcmDspDataFixedLength=true
          DcmDspDataInfo_ReadProtocolData: DcmDspDataFixedLength=true
          DcmDspDataInfo_ReadRoeState: DcmDspDataFixedLength=true
          DcmDspDataInfo_ReadSwRevision: DcmDspDataFixedLength=true
          DcmDspDataInfo_SgbdIdx: DcmDspDataFixedLength=true
          DcmDspDataInfo_StatusCalcvn: DcmDspDataFixedLength=true
          DcmDspDataInfo_StatusFzgBordnetz: DcmDspDataFixedLength=true
          DcmDspDataInfo_SvkAktuell: DcmDspDataFixedLength=true
          DcmDspDataInfo_SvkSysSupplier: DcmDspDataFixedLength=true
          DcmDspDataInfo_SvkWerk: DcmDspDataFixedLength=true
          DcmDspDataInfo_SwfkDeleteSupported: DcmDspDataFixedLength=true
          DcmDspDataInfo_SystemSupplierIdentifier: DcmDspDataFixedLength=true
          DcmDspDataInfo_Systemzeit: DcmDspDataFixedLength=true
          DcmDspDataInfo_SvkBackup1: DcmDspDataFixedLength=true
          DcmDspDataInfo_SvkBackup0: DcmDspDataFixedLength=true
          DcmDspDataInfo_SvkBackup2: DcmDspDataFixedLength=true
          DcmDspDataInfo_AssistLinearGain: DcmDspDataFixedLength=true
          DcmDspDataInfo_VehSpdOverride: DcmDspDataFixedLength=true
        3 x DcmDspData, all with DcmDspDataConditionCheckReadFncUsed=true, DcmDspDataType=UINT8, DcmDspDataUsePort=USE_DATA_ASYNCH_CLIENT_SERVER, DcmDspDataSize=456:
          DcmDspData_SvkBackup{0..2}: DcmDspDataInfoRef=DcmDspDataInfo_SvkBackup{0..2}
        DcmDspDid_SvkBackup0 (DcmDspDid): DcmDspDidIdentifier=61700, DcmDspDidUsed=true, DcmDspDidUsePort=USE_DATA_ELEMENT_SPECIFIC_INTERFACES, DcmDspDidInfoRef=DcmDspDidInfo_SvkBackup0
          DcmDspDidSignal: DcmDspDidDataPos=0, DcmDspDidDataRef=DcmDspData_SvkBackup0
        3 x DcmDspDidInfo, all with DcmDspDidDynamicallyDefined=false:
          DcmDspDidInfo_SvkBackup0
            DcmDspDidAccess
              DcmDspDidRead: DcmDspDidReadSessionRef=DEFAULT_SESSION, DcmDspDidReadSessionRef=EXTENDED_DIAGNOSTIC_SESSION
          DcmDspDidInfo_SvkBackup1
            DcmDspDidAccess
              DcmDspDidRead: DcmDspDidReadSessionRef=DEFAULT_SESSION, DcmDspDidReadSessionRef=EXTENDED_DIAGNOSTIC_SESSION
          DcmDspDidInfo_SvkBackup2
            DcmDspDidAccess
              DcmDspDidRead: DcmDspDidReadSessionRef=DEFAULT_SESSION, DcmDspDidReadSessionRef=EXTENDED_DIAGNOSTIC_SESSION
        DcmDspDid_SvkBackup1 (DcmDspDid): DcmDspDidIdentifier=61701, DcmDspDidUsed=true, DcmDspDidUsePort=USE_DATA_ELEMENT_SPECIFIC_INTERFACES, DcmDspDidInfoRef=DcmDspDidInfo_SvkBackup1
          DcmDspDidSignal: DcmDspDidDataPos=0, DcmDspDidDataRef=DcmDspData_SvkBackup1
        DcmDspDid_SvkBackup2 (DcmDspDid): DcmDspDidIdentifier=61702, DcmDspDidUsed=true, DcmDspDidUsePort=USE_DATA_ELEMENT_SPECIFIC_INTERFACES, DcmDspDidInfoRef=DcmDspDidInfo_SvkBackup2
          DcmDspDidSignal: DcmDspDidDataPos=0, DcmDspDidDataRef=DcmDspData_SvkBackup2
        DcmDspDataInfo_Vin (DcmDspDataInfo): DcmDspDataFixedLength=true
        DcmDspData_Vin (DcmDspData):
          DcmDspDataSize = 136
          DcmDspDataUsePort = USE_DATA_ASYNCH_CLIENT_SERVER
          DcmDspDataType = UINT8
          DcmDspDataConditionCheckReadFncUsed = false
          DcmDspDataInfoRef = DcmDspDataInfo_Vin
        DcmDspDidInfo_Vin (DcmDspDidInfo): DcmDspDidDynamicallyDefined=false
          DcmDspDidAccess
            DcmDspDidRead
        DcmDspDid_Vin (DcmDspDid): DcmDspDidIdentifier=61840, DcmDspDidUsed=true, DcmDspDidUsePort=USE_DATA_ELEMENT_SPECIFIC_INTERFACES, DcmDspDidInfoRef=DcmDspDidInfo_Vin
          DcmDspDidSignal: DcmDspDidDataPos=0, DcmDspDidDataRef=DcmDspData_Vin
        DidInfo_Did_WdbiFp (DcmDspDidInfo): DcmDspDidDynamicallyDefined=false  # Did_WdbiFp
          DcmDspDidAccess
            DcmDspDidWrite: DcmDspDidWriteSessionRef=PROGRAMMING_SESSION
        Did_DmDtcAktiveMeldung (DcmDspDid):
          DcmDspDidIdentifier = 5892
          DcmDspDidUsed = true
          DcmDspDidUsePort = USE_DATA_ELEMENT_SPECIFIC_INTERFACES
          DcmDspDidInfoRef = DidInfo_Did_DmDtcAktiveMeldung
          DcmDspDidSystemTemplateDiagnosticDataIdentifierRef = Did_DmDtcAktiveMeldung
          DmDtcAktiveMeldung (DcmDspDidSignal): DcmDspDidDataPos=0, DcmDspDidDataRef=DID_1704_DmDtcAktiveMeldung
        DID_1704_DmDtcAktiveMeldung (DcmDspData):  # DmDtcAktiveMeldung
          DcmDspDataSize = 32
          DcmDspDataUsePort = USE_DATA_ASYNCH_CLIENT_SERVER
          DcmDspDataType = UINT8
          DcmDspDataSystemTemplateDiagnosticDataElementRef = DmDtcAktiveMeldung
          DcmDspDataInfoRef = DID_1704_DataInfo_DmDtcAktiveMeldung
        Did_ReadProtocolData (DcmDspDid):
          DcmDspDidIdentifier = 14335
          DcmDspDidUsed = true
          DcmDspDidUsePort = USE_DATA_ELEMENT_SPECIFIC_INTERFACES
          DcmDspDidInfoRef = DidInfo_Did_ReadProtocolData
          DcmDspDidSystemTemplateDiagnosticDataIdentifierRef = Did_ReadProtocolData
          ReadProtocolData (DcmDspDidSignal): DcmDspDidDataPos=0, DcmDspDidDataRef=DID_37FF_ReadProtocolData
        RoutineInfo_EpsVerfahren_Routine (DcmDspRoutineInfo)  # EpsVerfahren_Routine
          DcmDspRoutineRequestResOut
            StatEpsVerfahrenAktivNr_Out (DcmDspRoutineRequestResOutSignal): DcmDspRoutineSignalLength=8, DcmDspRoutineSignalPos=0, DcmDspRoutineSignalType=UINT8
          DcmDspStartRoutineIn
            4 x DcmDspStartRoutineInSignal, all with DcmDspRoutineSignalType=UINT8:
              AbsolutEin_In: DcmDspRoutineSignalLength=8, DcmDspRoutineSignalPos=32, DcmDspRoutineSignalEndianness=opaque
              Winkel_In: DcmDspRoutineSignalPos=0, DcmDspRoutineSignalLength=16, DcmDspRoutineSignalEndianness=opaque
              Winkelbeschleunigung_In: DcmDspRoutineSignalLength=8, DcmDspRoutineSignalPos=24, DcmDspRoutineSignalEndianness=opaque
              Winkelgeschwindigkeit_In: DcmDspRoutineSignalLength=8, DcmDspRoutineSignalPos=16
          DcmDspRoutineAuthorization: DcmDspRoutineSessionRef=GarageMode
        DID_37FE_Cps (DcmDspData):  # Cps
          DcmDspDataSize = 144
          DcmDspDataUsePort = USE_DATA_SYNCH_CLIENT_SERVER
          DcmDspDataType = UINT8_N
          DcmDspDataConditionCheckReadFncUsed = true
          DcmDspDataSystemTemplateDiagnosticDataElementRef = Cps
          DcmDspDataInfoRef = DID_37FE_DataInfo_Cps
        DID_F152_Readhwmodificationindex (DcmDspData):  # Readhwmodificationindex
          DcmDspDataSize = 16
          DcmDspDataUsePort = USE_DATA_SYNCH_CLIENT_SERVER
          DcmDspDataType = UINT8
          DcmDspDataConditionCheckReadFncUsed = false
          DcmDspDataSystemTemplateDiagnosticDataElementRef = Readhwmodificationindex
          DcmDspDataInfoRef = DcmDspDataInfo_Readhwmodificationindex
        EpsZahnstangenmitteReset_Routine (DcmDspRoutine):
          DcmDspRequestResultsRoutineSupported = false
          DcmDspRoutineIdentifier = 43900
          DcmDspRoutineUsed = true
          DcmDspStopRoutineSupported = false
          DcmDspRoutineFixedLength = true
          DcmDspRoutineUsePort = true
          DcmDspRoutineInfoRef = RoutineInfo_EpsZahnstangenmitteReset_Routine
          DcmDspRoutineSystemTemplateDiagnosticRoutineRef = EpsZahnstangenmitteReset_Routine
        DID_2503_ProgrammingCounterMaxValue (DcmDspData):  # ProgrammingCounterMaxValue
          DcmDspDataSize = 16
          DcmDspDataUsePort = USE_DATA_SYNCH_CLIENT_SERVER
          DcmDspDataType = UINT8
          DcmDspDataSystemTemplateDiagnosticDataElementRef = ProgrammingCounterMaxValue
          DcmDspDataInfoRef = DcmDspDataInfo_ProgrammingCounterMaxValue
        RoutineInfo_DmClientTriggerDtcEntry_Routine (DcmDspRoutineInfo)  # DmClientTriggerDtcEntry_Routine
          DcmDspStartRoutineIn
            DTCType_In (DcmDspStartRoutineInSignal): DcmDspRoutineSignalLength=8, DcmDspRoutineSignalPos=0, DcmDspRoutineSignalType=UINT8
          DcmDspRoutineAuthorization: DcmDspRoutineSessionRef=DEFAULT_SESSION, DcmDspRoutineSessionRef=EXTENDED_DIAGNOSTIC_SESSION
          DcmDspStartRoutineOut
            4 x DcmDspStartRoutineOutSignal, all with DcmDspRoutineSignalLength=8, DcmDspRoutineSignalType=UINT8:
              DTCByte1_Out: DcmDspRoutineSignalPos=8
              DTCTypeOut_Out: DcmDspRoutineSignalPos=0
              DTCByte2_Out: DcmDspRoutineSignalPos=16
              DTCByte3_Out: DcmDspRoutineSignalPos=24
        Did_EcuSerialNumber (DcmDspDid):
          DcmDspDidIdentifier = 61836
          DcmDspDidUsed = true
          DcmDspDidUsePort = USE_DATA_ELEMENT_SPECIFIC_INTERFACES
          DcmDspDidInfoRef = DidInfo_Did_EcuSerialNumber
          DcmDspDidSystemTemplateDiagnosticDataIdentifierRef = Did_EcuSerialNumber
          EcuSerialNumber (DcmDspDidSignal): DcmDspDidDataPos=0, DcmDspDidDataRef=DID_F18C_EcuSerialNumber
        RoutineInfo_RcCppc_Routine (DcmDspRoutineInfo)  # RcCppc_Routine
          DcmDspRoutineAuthorization:
            DcmDspRoutineSessionRef = DEFAULT_SESSION
            DcmDspRoutineSessionRef = EXTENDED_DIAGNOSTIC_SESSION
            DcmDspRoutineSessionRef = CODING_SESSION
            DcmDspRoutineSessionRef = DcmDspSessionRow_NXTRMFG
            DcmDspRoutineSessionRef = DEVELOPMENT_SESSION
            DcmDspRoutineSessionRef = GarageMode
            DcmDspRoutineSessionRef = PROGRAMMING_SESSION
            DcmDspRoutineSessionRef = RSU_SESSION
            DcmDspRoutineSessionRef = SYSTEM_SUPPLIER_SPECIFIC_61
          DcmDspStartRoutineOut
            dataOut_Out (DcmDspStartRoutineOutSignal): DcmDspRoutineSignalPos=0, DcmDspRoutineSignalLength=2048, DcmDspRoutineSignalType=VARIABLE_LENGTH
        Did_MileKmEeprom (DcmDspDid):
          DcmDspDidIdentifier = 9536
          DcmDspDidUsed = true
          DcmDspDidUsePort = USE_DATA_ELEMENT_SPECIFIC_INTERFACES
          DcmDspDidInfoRef = DidInfo_Did_MileKmEeprom
          DcmDspDidSystemTemplateDiagnosticDataIdentifierRef = Did_MileKmEeprom
          MileKmEeprom (DcmDspDidSignal): DcmDspDidDataPos=0, DcmDspDidDataRef=DID_2540_MileKmEeprom
        DidInfo_Did_Cps (DcmDspDidInfo): DcmDspDidDynamicallyDefined=false  # Did_Cps
          DcmDspDidAccess
            DcmDspDidRead: DcmDspDidReadSessionRef=CODING_SESSION, DcmDspDidReadSessionRef=DEFAULT_SESSION, DcmDspDidReadSessionRef=EXTENDED_DIAGNOSTIC_SESSION
        Fahrzeuggeschwindigkeit (DcmDspDid):
          DcmDspDidIdentifier = 10343
          DcmDspDidUsed = true
          DcmDspDidUsePort = USE_DATA_ELEMENT_SPECIFIC_INTERFACES
          DcmDspDidInfoRef = DidInfo_Fahrzeuggeschwindigkeit
          DcmDspDidSystemTemplateDiagnosticDataIdentifierRef = Fahrzeuggeschwindigkeit
          Fahrzeuggeschwindigkeit (DcmDspDidSignal): DcmDspDidDataPos=0, DcmDspDidDataRef=DID_2867_Fahrzeuggeschwindigkeit
        RoutineInfo_ControlExtendedEnergySavingState_Routine (DcmDspRoutineInfo)  # ControlExtendedEnergySavingState_Routine
          DcmDspStartRoutineIn
            dataIn_In (DcmDspStartRoutineInSignal): DcmDspRoutineSignalLength=8, DcmDspRoutineSignalPos=0, DcmDspRoutineSignalType=UINT8
          DcmDspRoutineAuthorization: DcmDspRoutineSessionRef=DEFAULT_SESSION, DcmDspRoutineSessionRef=EXTENDED_DIAGNOSTIC_SESSION, DcmDspRoutineSessionRef=PROGRAMMING_SESSION
        RcCpd_Routine (DcmDspRoutine):
          DcmDspRequestResultsRoutineSupported = false
          DcmDspRoutineIdentifier = 65281
          DcmDspRoutineUsed = true
          DcmDspStopRoutineSupported = false
          DcmDspRoutineFixedLength = true
          DcmDspRoutineUsePort = true
          DcmDspRoutineInfoRef = RoutineInfo_RcCpd_Routine
          DcmDspRoutineSystemTemplateDiagnosticRoutineRef = RcCpd_Routine
        DidInfo_Did_ProgrammingCounter (DcmDspDidInfo): DcmDspDidDynamicallyDefined=false  # Did_ProgrammingCounter
          DcmDspDidAccess
            DcmDspDidRead: DcmDspDidReadSessionRef=DEFAULT_SESSION, DcmDspDidReadSessionRef=EXTENDED_DIAGNOSTIC_SESSION, DcmDspDidReadSessionRef=PROGRAMMING_SESSION
        ReadNcd_Routine (DcmDspRoutine):
          DcmDspRequestResultsRoutineSupported = false
          DcmDspRoutineIdentifier = 14332
          DcmDspRoutineUsed = true
          DcmDspStopRoutineSupported = false
          DcmDspRoutineFixedLength = false
          DcmDspRoutineUsePort = true
          DcmDspRoutineInfoRef = RoutineInfo_ReadNcd_Routine
          DcmDspRoutineSystemTemplateDiagnosticRoutineRef = ReadNcd_Routine
        DID_100E_ExtendedEnergySavingState (DcmDspData):  # ExtendedEnergySavingState
          DcmDspDataSize = 8
          DcmDspDataUsePort = USE_DATA_SYNCH_CLIENT_SERVER
          DcmDspDataType = UINT8
          DcmDspDataConditionCheckReadFncUsed = false
          DcmDspDataSystemTemplateDiagnosticDataElementRef = ExtendedEnergySavingState
          DcmDspDataInfoRef = DcmDspDataInfo_ExtendedEnergySavingState
        DcmDspControlDTCSetting
        RoutineInfo_IsLoeschen_Routine (DcmDspRoutineInfo)  # IsLoeschen_Routine
          DcmDspRoutineAuthorization: DcmDspRoutineSessionRef=DEFAULT_SESSION, DcmDspRoutineSessionRef=EXTENDED_DIAGNOSTIC_SESSION, DcmDspRoutineSessionRef=GarageMode
        3 x DcmDspDidInfo, all with DcmDspDidDynamicallyDefined=false:
          DidInfo_Did_EpsZahnstangenmitte  # Did_EpsZahnstangenmitte
            DcmDspDidAccess
              DcmDspDidRead:
                DcmDspDidReadSessionRef = CODING_SESSION
                DcmDspDidReadSessionRef = DEFAULT_SESSION
                DcmDspDidReadSessionRef = EXTENDED_DIAGNOSTIC_SESSION
                DcmDspDidReadSessionRef = PROGRAMMING_SESSION
          DidInfo_Did_ReadSwRevision  # Did_ReadSwRevision
            DcmDspDidAccess
              DcmDspDidRead: DcmDspDidReadSessionRef=DEFAULT_SESSION, DcmDspDidReadSessionRef=EXTENDED_DIAGNOSTIC_SESSION, DcmDspDidReadSessionRef=PROGRAMMING_SESSION
          DidInfo_Did_Readhwmodificationindex  # Did_Readhwmodificationindex
            DcmDspDidAccess
              DcmDspDidRead: DcmDspDidReadSessionRef=DEFAULT_SESSION, DcmDspDidReadSessionRef=EXTENDED_DIAGNOSTIC_SESSION, DcmDspDidReadSessionRef=PROGRAMMING_SESSION
        RoutineInfo_RcRswedi_Routine (DcmDspRoutineInfo)  # RcRswedi_Routine
          DcmDspStartRoutineIn
            DataIn_In (DcmDspStartRoutineInSignal): DcmDspRoutineSignalPos=0, DcmDspRoutineSignalLength=64, DcmDspRoutineSignalType=UINT8
          DcmDspRoutineAuthorization: DcmDspRoutineSessionRef=DEFAULT_SESSION, DcmDspRoutineSessionRef=EXTENDED_DIAGNOSTIC_SESSION
          DcmDspStartRoutineOut
            DataOut_Out (DcmDspStartRoutineOutSignal): DcmDspRoutineSignalPos=0, DcmDspRoutineSignalLength=2048, DcmDspRoutineSignalType=VARIABLE_LENGTH
        DidInfo_Betriebsspannung (DcmDspDidInfo): DcmDspDidDynamicallyDefined=false  # Betriebsspannung
          DcmDspDidAccess
        IsLoeschen_Routine (DcmDspRoutine):
          DcmDspRequestResultsRoutineSupported = false
          DcmDspRoutineIdentifier = 3846
          DcmDspRoutineUsed = true
          DcmDspStopRoutineSupported = false
          DcmDspRoutineFixedLength = true
          DcmDspRoutineUsePort = true
          DcmDspRoutineInfoRef = RoutineInfo_IsLoeschen_Routine
          DcmDspRoutineSystemTemplateDiagnosticRoutineRef = IsLoeschen_Routine
        Aussentemperatur (DcmDspDid):
          DcmDspDidIdentifier = 10245
          DcmDspDidUsed = true
          DcmDspDidUsePort = USE_DATA_ELEMENT_SPECIFIC_INTERFACES
          DcmDspDidInfoRef = DidInfo_Aussentemperatur
          DcmDspDidSystemTemplateDiagnosticDataIdentifierRef = Aussentemperatur
          Aussentemperatur (DcmDspDidSignal): DcmDspDidDataPos=0, DcmDspDidDataRef=DID_2805_Aussentemperatur
        DidInfo_Did_EpsLenkwinkelsensorKalibrierung (DcmDspDidInfo): DcmDspDidDynamicallyDefined=false  # Did_EpsLenkwinkelsensorKalibrierung
          DcmDspDidAccess
            DcmDspDidWrite: DcmDspDidWriteSessionRef=DEFAULT_SESSION, DcmDspDidWriteSessionRef=EXTENDED_DIAGNOSTIC_SESSION, DcmDspDidWriteSessionRef=GarageMode
            DcmDspDidRead: DcmDspDidReadSessionRef=DEFAULT_SESSION, DcmDspDidReadSessionRef=EXTENDED_DIAGNOSTIC_SESSION, DcmDspDidReadSessionRef=GarageMode
        DID_DB57_EpsRitzelwinkelsensor (DcmDspData):  # EpsRitzelwinkelsensor
          DcmDspDataSize = 56
          DcmDspDataUsePort = USE_DATA_ASYNCH_CLIENT_SERVER
          DcmDspDataType = UINT8
          DcmDspDataSystemTemplateDiagnosticDataElementRef = EpsRitzelwinkelsensor
          DcmDspDataInfoRef = DcmDspDataInfo_EpsRitzelwinkelsensor
        Did_SvkAktuell (DcmDspDid):
          DcmDspDidIdentifier = 61697
          DcmDspDidUsed = true
          DcmDspDidUsePort = USE_DATA_ELEMENT_SPECIFIC_INTERFACES
          DcmDspDidInfoRef = DidInfo_Did_SvkAktuell
          DcmDspDidSystemTemplateDiagnosticDataIdentifierRef = Did_SvkAktuell
          SvkAktuell (DcmDspDidSignal): DcmDspDidDataPos=0, DcmDspDidDataRef=DID_F101_SvkAktuell
        DID_2866_DataInfo_Betriebsspannung (DcmDspDataInfo): DcmDspDataFixedLength=true  # Betriebsspannung
        Did_Systemzeit (DcmDspDid):
          DcmDspDidIdentifier = 5889
          DcmDspDidUsed = true
          DcmDspDidUsePort = USE_DATA_ELEMENT_SPECIFIC_INTERFACES
          DcmDspDidInfoRef = DidInfo_Did_Systemzeit
          DcmDspDidSystemTemplateDiagnosticDataIdentifierRef = Did_Systemzeit
          Systemzeit (DcmDspDidSignal): DcmDspDidDataPos=0, DcmDspDidDataRef=DID_1701_Systemzeit
        DidInfo_KmStand (DcmDspDidInfo): DcmDspDidDynamicallyDefined=false  # KmStand
          DcmDspDidAccess
        DID_2867_Fahrzeuggeschwindigkeit (DcmDspData):  # Fahrzeuggeschwindigkeit
          DcmDspDataSize = 8
          DcmDspDataType = UINT8
          DcmDspDataUsePort = USE_DATA_ASYNCH_CLIENT_SERVER
          DcmDspDataInfoRef = DID_2867_DataInfo_Fahrzeuggeschwindigkeit
          DcmDspDataSystemTemplateDiagnosticDataElementRef = Fahrzeuggeschwindigkeit
        DidInfo_Fahrzeuggeschwindigkeit (DcmDspDidInfo): DcmDspDidDynamicallyDefined=false  # Fahrzeuggeschwindigkeit
          DcmDspDidAccess
        RoutineInfo_WriteNcd_Routine (DcmDspRoutineInfo)  # WriteNcd_Routine
          DcmDspStartRoutineIn
            ArgCodingArea_In (DcmDspStartRoutineInSignal): DcmDspRoutineSignalPos=0, DcmDspRoutineSignalLength=8192, DcmDspRoutineSignalType=VARIABLE_LENGTH, DcmDspRoutineSignalEndianness=opaque
          DcmDspRoutineAuthorization: DcmDspRoutineSessionRef=CODING_SESSION
        RoutineInfo_EpsZahnstangenmitteReset_Routine (DcmDspRoutineInfo)  # EpsZahnstangenmitteReset_Routine
          DcmDspRoutineAuthorization: DcmDspRoutineSessionRef=SYSTEM_SUPPLIER_SPECIFIC_61, DcmDspRoutineSessionRef=GarageMode
        Did_DmIsDtcActiveResponse (DcmDspDid):
          DcmDspDidIdentifier = 5923
          DcmDspDidUsed = true
          DcmDspDidUsePort = USE_DATA_ELEMENT_SPECIFIC_INTERFACES
          DcmDspDidInfoRef = DidInfo_Did_DmIsDtcActiveResponse
          DcmDspDidSystemTemplateDiagnosticDataIdentifierRef = Did_DmIsDtcActiveResponse
          DmIsDtcActiveResponse (DcmDspDidSignal): DcmDspDidDataPos=0, DcmDspDidDataRef=DID_1723_DmIsDtcActiveResponse
        Did_ExtendedEnergySavingState (DcmDspDid):
          DcmDspDidIdentifier = 4110
          DcmDspDidUsed = true
          DcmDspDidUsePort = USE_DATA_ELEMENT_SPECIFIC_INTERFACES
          DcmDspDidInfoRef = DidInfo_Did_ExtendedEnergySavingState
          DcmDspDidSystemTemplateDiagnosticDataIdentifierRef = Did_ExtendedEnergySavingState
          ExtendedEnergySavingState (DcmDspDidSignal): DcmDspDidDataPos=0, DcmDspDidDataRef=DID_100E_ExtendedEnergySavingState
        RoutineInfo_RcCpd_Routine (DcmDspRoutineInfo)  # RcCpd_Routine
          DcmDspRoutineAuthorization: DcmDspRoutineSessionRef=PROGRAMMING_SESSION
          DcmDspStartRoutineOut
            StatRoutineStatus_Out (DcmDspStartRoutineOutSignal): DcmDspRoutineSignalLength=8, DcmDspRoutineSignalPos=0, DcmDspRoutineSignalType=UINT8
        DidInfo_Did_ReadProtocolData (DcmDspDidInfo): DcmDspDidDynamicallyDefined=false  # Did_ReadProtocolData
          DcmDspDidAccess
            DcmDspDidRead: DcmDspDidReadSessionRef=CODING_SESSION, DcmDspDidReadSessionRef=DEFAULT_SESSION, DcmDspDidReadSessionRef=EXTENDED_DIAGNOSTIC_SESSION
        Did_FlashTimingParameter (DcmDspDid):
          DcmDspDidIdentifier = 9476
          DcmDspDidUsed = true
          DcmDspDidUsePort = USE_DATA_ELEMENT_SPECIFIC_INTERFACES
          DcmDspDidInfoRef = DidInfo_Did_FlashTimingParameter
          DcmDspDidSystemTemplateDiagnosticDataIdentifierRef = Did_FlashTimingParameter
          FlashTimingParameter (DcmDspDidSignal): DcmDspDidDataPos=0, DcmDspDidDataRef=DID_2504_FlashTimingParameter
        DidInfo_FUwBn (DcmDspDidInfo): DcmDspDidDynamicallyDefined=false  # FUwBn
          DcmDspDidAccess
        DeleteSwPackage_Routine (DcmDspRoutine):
          DcmDspRequestResultsRoutineSupported = false
          DcmDspRoutineIdentifier = 544
          DcmDspRoutineUsed = true
          DcmDspStopRoutineSupported = false
          DcmDspRoutineFixedLength = false
          DcmDspRoutineUsePort = true
          DcmDspRoutineInfoRef = RoutineInfo_DeleteSwPackage_Routine
          DcmDspRoutineSystemTemplateDiagnosticRoutineRef = DeleteSwPackage_Routine
        DID_1750_DataInfo_FUwBn (DcmDspDataInfo): DcmDspDataFixedLength=true  # FUwBn
        SteuernEpsMultiturnwertReset_Routine (DcmDspRoutine):
          DcmDspRequestResultsRoutineSupported = false
          DcmDspRoutineIdentifier = 43901
          DcmDspRoutineUsed = true
          DcmDspStopRoutineSupported = false
          DcmDspRoutineFixedLength = true
          DcmDspRoutineUsePort = true
          DcmDspRoutineInfoRef = RoutineInfo_SteuernEpsMultiturnwertReset_Routine
          DcmDspRoutineSystemTemplateDiagnosticRoutineRef = SteuernEpsMultiturnwertReset_Routine
        RcCppc_Routine (DcmDspRoutine):
          DcmDspRequestResultsRoutineSupported = false
          DcmDspRoutineIdentifier = 515
          DcmDspRoutineUsed = true
          DcmDspStopRoutineSupported = false
          DcmDspRoutineFixedLength = false
          DcmDspRoutineUsePort = true
          DcmDspRoutineInfoRef = RoutineInfo_RcCppc_Routine
          DcmDspRoutineSystemTemplateDiagnosticRoutineRef = RcCppc_Routine
        DidInfo_Systemzeit (DcmDspDidInfo): DcmDspDidDynamicallyDefined=false  # Systemzeit
          DcmDspDidAccess
            DcmDspDidRead:
              DcmDspDidReadSessionRef = CODING_SESSION
              DcmDspDidReadSessionRef = DcmDspSessionRow_NXTRMFG
              DcmDspDidReadSessionRef = DEFAULT_SESSION
              DcmDspDidReadSessionRef = DEVELOPMENT_SESSION
              DcmDspDidReadSessionRef = EXTENDED_DIAGNOSTIC_SESSION
              DcmDspDidReadSessionRef = GarageMode
              DcmDspDidReadSessionRef = PROGRAMMING_SESSION
              DcmDspDidReadSessionRef = RSU_SESSION
              DcmDspDidReadSessionRef = SYSTEM_SUPPLIER_SPECIFIC_61
        DidInfo_Did_GelernterZahnstangenweg (DcmDspDidInfo): DcmDspDidDynamicallyDefined=false  # Did_GelernterZahnstangenweg
          DcmDspDidAccess
            DcmDspDidRead: DcmDspDidReadSessionRef=DEFAULT_SESSION, DcmDspDidReadSessionRef=EXTENDED_DIAGNOSTIC_SESSION
        RoutineInfo_EpsPendeln_Routine (DcmDspRoutineInfo)  # EpsPendeln_Routine
          DcmDspRoutineRequestResOut
            StatEpsPendelnAktivNr_Out (DcmDspRoutineRequestResOutSignal): DcmDspRoutineSignalLength=8, DcmDspRoutineSignalPos=0, DcmDspRoutineSignalType=UINT8
          DcmDspStartRoutineIn
            3 x DcmDspStartRoutineInSignal, all with DcmDspRoutineSignalLength=8, DcmDspRoutineSignalType=UINT8:
              Frequenz_In: DcmDspRoutineSignalPos=0
              NumberOfCycles_In: DcmDspRoutineSignalPos=16
              MaxAmplitude_In: DcmDspRoutineSignalPos=8
          DcmDspRoutineAuthorization: DcmDspRoutineSessionRef=GarageMode
        ControlExtendedEnergySavingState_Routine (DcmDspRoutine):
          DcmDspRequestResultsRoutineSupported = false
          DcmDspRoutineIdentifier = 4099
          DcmDspRoutineUsed = true
          DcmDspStopRoutineSupported = false
          DcmDspRoutineFixedLength = true
          DcmDspRoutineUsePort = true
          DcmDspRoutineInfoRef = RoutineInfo_ControlExtendedEnergySavingState_Routine
          DcmDspRoutineSystemTemplateDiagnosticRoutineRef = ControlExtendedEnergySavingState_Routine
        DID_2540_MileKmEeprom (DcmDspData):  # MileKmEeprom
          DcmDspDataSize = 24
          DcmDspDataUsePort = USE_DATA_ASYNCH_CLIENT_SERVER
          DcmDspDataType = UINT8
          DcmDspDataSystemTemplateDiagnosticDataElementRef = MileKmEeprom
          DcmDspDataInfoRef = DcmDspDataInfo_MileKmEeprom
        Did_EpsMomentensensor (DcmDspDid):
          DcmDspDidIdentifier = 56217
          DcmDspDidUsed = true
          DcmDspDidUsePort = USE_DATA_ELEMENT_SPECIFIC_INTERFACES
          DcmDspDidInfoRef = DidInfo_Did_EpsMomentensensor
          DcmDspDidSystemTemplateDiagnosticDataIdentifierRef = Did_EpsMomentensensor
          EpsMomentensensor (DcmDspDidSignal): DcmDspDidDataPos=0, DcmDspDidDataRef=DID_DB99_EpsMomentensensor
        RoutineInfo_CheckNcd_Routine (DcmDspRoutineInfo)  # CheckNcd_Routine
          DcmDspStartRoutineIn
            Cps_In (DcmDspStartRoutineInSignal): DcmDspRoutineSignalPos=0, DcmDspRoutineSignalLength=144, DcmDspRoutineSignalType=VARIABLE_LENGTH, DcmDspRoutineSignalEndianness=opaque
          DcmDspRoutineAuthorization: DcmDspRoutineSessionRef=CODING_SESSION
          DcmDspStartRoutineOut
            StatCheckNcdResult_Out (DcmDspStartRoutineOutSignal): DcmDspRoutineSignalLength=8, DcmDspRoutineSignalPos=0, DcmDspRoutineSignalType=UINT8
        DID_F100_ReadActiveSessionState (DcmDspData):  # ReadActiveSessionState
          DcmDspDataSize = 32
          DcmDspDataUsePort = USE_DATA_SYNCH_CLIENT_SERVER
          DcmDspDataType = UINT8
          DcmDspDataConditionCheckReadFncUsed = true
          DcmDspDataSystemTemplateDiagnosticDataElementRef = ReadActiveSessionState
          DcmDspDataInfoRef = DcmDspDataInfo_ReadActiveSessionState
        DID_F150_SgbdIdx (DcmDspData):  # SgbdIdx
          DcmDspDataSize = 24
          DcmDspDataUsePort = USE_DATA_SYNCH_CLIENT_SERVER
          DcmDspDataType = UINT8
          DcmDspDataConditionCheckReadFncUsed = false
          DcmDspDataSystemTemplateDiagnosticDataElementRef = SgbdIdx
          DcmDspDataInfoRef = DcmDspDataInfo_SgbdIdx
        3 x DcmDspRoutine, all with DcmDspRoutineUsed=true, DcmDspRoutineFixedLength=true, DcmDspRoutineUsePort=true:
          RcCm_Routine: DcmDspRequestResultsRoutineSupported=false, DcmDspRoutineIdentifier=514, DcmDspStopRoutineSupported=false, DcmDspRoutineInfoRef=RoutineInfo_RcCm_Routine, DcmDspRoutineSystemTemplateDiagnosticRoutineRef=RcCm_Routine
          EpsInitialisierungService_Routine: DcmDspRequestResultsRoutineSupported=true, DcmDspRoutineIdentifier=43884, DcmDspStopRoutineSupported=true, DcmDspRoutineInfoRef=RoutineInfo_EpsInitialisierungService_Routine, DcmDspRoutineSystemTemplateDiagnosticRoutineRef=EpsInitialisierungService_Routine
          EpsVerfahren_Routine: DcmDspRequestResultsRoutineSupported=true, DcmDspRoutineIdentifier=43889, DcmDspStopRoutineSupported=false, DcmDspRoutineInfoRef=RoutineInfo_EpsVerfahren_Routine, DcmDspRoutineSystemTemplateDiagnosticRoutineRef=EpsVerfahren_Routine
        DidInfo_Did_ActiveDiagnosticSession (DcmDspDidInfo): DcmDspDidDynamicallyDefined=false  # Did_ActiveDiagnosticSession
          DcmDspDidAccess
            DcmDspDidRead:
              DcmDspDidReadSessionRef = DEFAULT_SESSION
              DcmDspDidReadSessionRef = EXTENDED_DIAGNOSTIC_SESSION
              DcmDspDidReadSessionRef = GarageMode
              DcmDspDidReadSessionRef = PROGRAMMING_SESSION
              DcmDspDidReadSessionRef = CODING_SESSION
              DcmDspDidReadSessionRef = DcmDspSessionRow_NXTRMFG
        DidInfo_Did_Herstelldatum (DcmDspDidInfo): DcmDspDidDynamicallyDefined=false  # Did_Herstelldatum
          DcmDspDidAccess
            DcmDspDidRead: DcmDspDidReadSessionRef=DEFAULT_SESSION, DcmDspDidReadSessionRef=EXTENDED_DIAGNOSTIC_SESSION, DcmDspDidReadSessionRef=PROGRAMMING_SESSION
        DiagCommLoopback_Routine (DcmDspRoutine):
          DcmDspRequestResultsRoutineSupported = false
          DcmDspRoutineIdentifier = 771
          DcmDspRoutineUsed = true
          DcmDspStopRoutineSupported = false
          DcmDspRoutineFixedLength = false
          DcmDspRoutineUsePort = true
          DcmDspRoutineInfoRef = RoutineInfo_DiagCommLoopback_Routine
          DcmDspRoutineSystemTemplateDiagnosticRoutineRef = DiagCommLoopback_Routine
        DID_2502_ProgrammingCounter (DcmDspData):  # ProgrammingCounter
          DcmDspDataSize = 32
          DcmDspDataUsePort = USE_DATA_SYNCH_CLIENT_SERVER
          DcmDspDataType = UINT8
          DcmDspDataReadFnc = 
          DcmDspDataConditionCheckReadFncUsed = false
          DcmDspDataSystemTemplateDiagnosticDataElementRef = ProgrammingCounter
          DcmDspDataInfoRef = DcmDspDataInfo_ProgrammingCounter
        DID_37FF_ReadProtocolData (DcmDspData):  # ReadProtocolData
          DcmDspDataSize = 72
          DcmDspDataUsePort = USE_DATA_SYNCH_CLIENT_SERVER
          DcmDspDataType = UINT8
          DcmDspDataConditionCheckReadFncUsed = true
          DcmDspDataSystemTemplateDiagnosticDataElementRef = ReadProtocolData
          DcmDspDataInfoRef = DcmDspDataInfo_ReadProtocolData
        DidInfo_Did_DmDtcAktiveMeldung (DcmDspDidInfo): DcmDspDidDynamicallyDefined=false  # Did_DmDtcAktiveMeldung
          DcmDspDidAccess
            DcmDspDidRead: DcmDspDidReadSessionRef=DEFAULT_SESSION, DcmDspDidReadSessionRef=EXTENDED_DIAGNOSTIC_SESSION
        DID_1723_DmIsDtcActiveResponse (DcmDspData):  # DmIsDtcActiveResponse
          DcmDspDataSize = 320
          DcmDspDataUsePort = USE_DATA_SYNCH_CLIENT_SERVER
          DcmDspDataType = UINT8
          DcmDspDataConditionCheckReadFncUsed = false
          DcmDspDataSystemTemplateDiagnosticDataElementRef = DmIsDtcActiveResponse
          DcmDspDataInfoRef = DID_1723_DataInfo_DmIsDtcActiveResponse
        Did_EpsLenkwinkelsensorKalibrierung (DcmDspDid):
          DcmDspDidIdentifier = 56154
          DcmDspDidUsed = true
          DcmDspDidUsePort = USE_DATA_ELEMENT_SPECIFIC_INTERFACES
          DcmDspDidInfoRef = DidInfo_Did_EpsLenkwinkelsensorKalibrierung
          DcmDspDidSystemTemplateDiagnosticDataIdentifierRef = Did_EpsLenkwinkelsensorKalibrierung
          EpsLenkwinkelsensorKalibrierung (DcmDspDidSignal): DcmDspDidDataPos=0, DcmDspDidDataRef=DID_DB5A_EpsLenkwinkelsensorKalibrierung
        DidInfo_Did_SgbdIdx (DcmDspDidInfo): DcmDspDidDynamicallyDefined=false  # Did_SgbdIdx
          DcmDspDidAccess
            DcmDspDidRead:
              DcmDspDidReadSessionRef = DEFAULT_SESSION
              DcmDspDidReadSessionRef = EXTENDED_DIAGNOSTIC_SESSION
              DcmDspDidReadSessionRef = CODING_SESSION
              DcmDspDidReadSessionRef = DcmDspSessionRow_NXTRMFG
              DcmDspDidReadSessionRef = DEVELOPMENT_SESSION
              DcmDspDidReadSessionRef = GarageMode
              DcmDspDidReadSessionRef = PROGRAMMING_SESSION
              DcmDspDidReadSessionRef = RSU_SESSION
              DcmDspDidReadSessionRef = SYSTEM_SUPPLIER_SPECIFIC_61
        Did_Pruefstempel (DcmDspDid):
          DcmDspDidIdentifier = 4096
          DcmDspDidUsed = true
          DcmDspDidUsePort = USE_DATA_ELEMENT_SPECIFIC_INTERFACES
          DcmDspDidInfoRef = DidInfo_Did_Pruefstempel
          DcmDspDidSystemTemplateDiagnosticDataIdentifierRef = Did_Pruefstempel
          Pruefstempel (DcmDspDidSignal): DcmDspDidDataPos=0, DcmDspDidDataRef=DID_1000_Pruefstempel
        DID_F15A_WdbiFp (DcmDspData):  # WdbiFp
          DcmDspDataSize = 8
          DcmDspDataUsePort = USE_DATA_ASYNCH_CLIENT_SERVER
          DcmDspDataType = UINT8
          DcmDspDataSystemTemplateDiagnosticDataElementRef = WdbiFp
          DcmDspDataInfoRef = DID_F15A_DataInfo_WdbiFp
        Did_SystemSupplierIdentifier (DcmDspDid):
          DcmDspDidIdentifier = 61834
          DcmDspDidUsed = true
          DcmDspDidUsePort = USE_DATA_ELEMENT_SPECIFIC_INTERFACES
          DcmDspDidInfoRef = DidInfo_Did_SystemSupplierIdentifier
          DcmDspDidSystemTemplateDiagnosticDataIdentifierRef = Did_SystemSupplierIdentifier
          SystemSupplierIdentifier (DcmDspDidSignal): DcmDspDidDataPos=0, DcmDspDidDataRef=DID_F18A_SystemSupplierIdentifier
        EpsLenkwinkelsensorKalibrierungReset_Routine (DcmDspRoutine):
          DcmDspRequestResultsRoutineSupported = false
          DcmDspRoutineIdentifier = 43881
          DcmDspRoutineUsed = true
          DcmDspStopRoutineSupported = false
          DcmDspRoutineFixedLength = true
          DcmDspRoutineUsePort = true
          DcmDspRoutineInfoRef = RoutineInfo_EpsLenkwinkelsensorKalibrierungReset_Routine
          DcmDspRoutineSystemTemplateDiagnosticRoutineRef = EpsLenkwinkelsensorKalibrierungReset_Routine
        CheckNcd_Routine (DcmDspRoutine):
          DcmDspRequestResultsRoutineSupported = false
          DcmDspRoutineIdentifier = 14334
          DcmDspRoutineUsed = true
          DcmDspStopRoutineSupported = false
          DcmDspRoutineFixedLength = true
          DcmDspRoutineUsePort = true
          DcmDspRoutineInfoRef = RoutineInfo_CheckNcd_Routine
          DcmDspRoutineSystemTemplateDiagnosticRoutineRef = CheckNcd_Routine
        RoutineInfo_EpsInitialisierungWerk_Routine (DcmDspRoutineInfo)  # EpsInitialisierungWerk_Routine
          DcmDspRoutineRequestResOut
            StatRoutineStatus_Out (DcmDspRoutineRequestResOutSignal): DcmDspRoutineSignalLength=8, DcmDspRoutineSignalPos=0, DcmDspRoutineSignalType=UINT8
          DcmDspStartRoutineIn
            3 x DcmDspStartRoutineInSignal, all with DcmDspRoutineSignalLength=8, DcmDspRoutineSignalType=UINT8:
              Winkel_In: DcmDspRoutineSignalPos=0
              Winkelbeschleunigung_In: DcmDspRoutineSignalPos=16
              Winkelgeschwindigkeit_In: DcmDspRoutineSignalPos=8
          DcmDspRoutineAuthorization: DcmDspRoutineSessionRef=GarageMode
        DidInfo_Did_SwfkDeleteSupported (DcmDspDidInfo): DcmDspDidDynamicallyDefined=false  # Did_SwfkDeleteSupported
          DcmDspDidAccess
            DcmDspDidRead: DcmDspDidReadSessionRef=DEFAULT_SESSION, DcmDspDidReadSessionRef=EXTENDED_DIAGNOSTIC_SESSION, DcmDspDidReadSessionRef=PROGRAMMING_SESSION
        DidInfo_Did_ExtendedEnergySavingState (DcmDspDidInfo): DcmDspDidDynamicallyDefined=false  # Did_ExtendedEnergySavingState
          DcmDspDidAccess
            DcmDspDidRead: DcmDspDidReadSessionRef=DEFAULT_SESSION, DcmDspDidReadSessionRef=EXTENDED_DIAGNOSTIC_SESSION, DcmDspDidReadSessionRef=PROGRAMMING_SESSION
        Did_EnergySavingState (DcmDspDid):
          DcmDspDidIdentifier = 4106
          DcmDspDidUsed = true
          DcmDspDidUsePort = USE_DATA_ELEMENT_SPECIFIC_INTERFACES
          DcmDspDidInfoRef = DidInfo_Did_EnergySavingState
          DcmDspDidSystemTemplateDiagnosticDataIdentifierRef = Did_EnergySavingState
          EnergySavingState (DcmDspDidSignal): DcmDspDidDataPos=0, DcmDspDidDataRef=DID_100A_EnergySavingState
        DidInfo_Did_ProgrammingCounterMaxValue (DcmDspDidInfo): DcmDspDidDynamicallyDefined=false  # Did_ProgrammingCounterMaxValue
          DcmDspDidAccess
            DcmDspDidRead:
              DcmDspDidReadSessionRef = DEFAULT_SESSION
              DcmDspDidReadSessionRef = EXTENDED_DIAGNOSTIC_SESSION
              DcmDspDidReadSessionRef = PROGRAMMING_SESSION
              DcmDspDidReadSessionRef = DcmDspSessionRow_NXTRMFG
            DcmDspDidWrite: DcmDspDidWriteSessionRef=DcmDspSessionRow_NXTRMFG
        DidInfo_Did_DmIsDtcActiveResponse (DcmDspDidInfo): DcmDspDidDynamicallyDefined=false  # Did_DmIsDtcActiveResponse
          DcmDspDidAccess
            DcmDspDidRead:
              DcmDspDidReadSessionRef = DEFAULT_SESSION
              DcmDspDidReadSessionRef = EXTENDED_DIAGNOSTIC_SESSION
              DcmDspDidReadSessionRef = CODING_SESSION
              DcmDspDidReadSessionRef = DcmDspSessionRow_NXTRMFG
              DcmDspDidReadSessionRef = GarageMode
              DcmDspDidReadSessionRef = PROGRAMMING_SESSION
              DcmDspDidReadSessionRef = RSU_SESSION
              DcmDspDidReadSessionRef = SYSTEM_SUPPLIER_SPECIFIC_61
        Did_EpsRitzelwinkelsensor (DcmDspDid):
          DcmDspDidIdentifier = 56151
          DcmDspDidUsed = true
          DcmDspDidUsePort = USE_DATA_ELEMENT_SPECIFIC_INTERFACES
          DcmDspDidInfoRef = DidInfo_Did_EpsRitzelwinkelsensor
          DcmDspDidSystemTemplateDiagnosticDataIdentifierRef = Did_EpsRitzelwinkelsensor
          EpsRitzelwinkelsensor (DcmDspDidSignal): DcmDspDidDataPos=0, DcmDspDidDataRef=DID_DB57_EpsRitzelwinkelsensor
        RoutineInfo_RcEm_Routine (DcmDspRoutineInfo)  # RcEm_Routine
          DcmDspStartRoutineIn
            RcEmIeRco_In (DcmDspStartRoutineInSignal): DcmDspRoutineSignalPos=0, DcmDspRoutineSignalLength=8, DcmDspRoutineSignalType=UINT8
          DcmDspRoutineAuthorization: DcmDspRoutineSessionRef=PROGRAMMING_SESSION
          DcmDspStartRoutineOut
            StatRoutineStatus_Out (DcmDspStartRoutineOutSignal): DcmDspRoutineSignalLength=8, DcmDspRoutineSignalPos=0, DcmDspRoutineSignalType=UINT8
        RoutineInfo_DeleteSwPackage_Routine (DcmDspRoutineInfo)  # DeleteSwPackage_Routine
          DcmDspRoutineAuthorization: DcmDspRoutineSessionRef=PROGRAMMING_SESSION
        DID_DFDD_GelernterZahnstangenweg (DcmDspData):  # GelernterZahnstangenweg
          DcmDspDataSize = 64
          DcmDspDataUsePort = USE_DATA_ASYNCH_CLIENT_SERVER
          DcmDspDataType = UINT8
          DcmDspDataSystemTemplateDiagnosticDataElementRef = GelernterZahnstangenweg
          DcmDspDataInfoRef = DcmDspDataInfo_GelernterZahnstangenweg
        Did_SgbdIdx (DcmDspDid):
          DcmDspDidIdentifier = 61776
          DcmDspDidUsed = true
          DcmDspDidUsePort = USE_DATA_ELEMENT_SPECIFIC_INTERFACES
          DcmDspDidInfoRef = DidInfo_Did_SgbdIdx
          DcmDspDidSystemTemplateDiagnosticDataIdentifierRef = Did_SgbdIdx
          SgbdIdx (DcmDspDidSignal): DcmDspDidDataPos=0, DcmDspDidDataRef=DID_F150_SgbdIdx
        DID_2541_StatusCalcvn (DcmDspData):  # StatusCalcvn
          DcmDspDataSize = 160
          DcmDspDataUsePort = USE_DATA_SYNCH_CLIENT_SERVER
          DcmDspDataType = UINT8
          DcmDspDataConditionCheckReadFncUsed = false
          DcmDspDataSystemTemplateDiagnosticDataElementRef = StatusCalcvn
          DcmDspDataInfoRef = DcmDspDataInfo_StatusCalcvn
        EpsPendeln_Routine (DcmDspRoutine):
          DcmDspRequestResultsRoutineSupported = true
          DcmDspRoutineIdentifier = 43862
          DcmDspRoutineUsed = true
          DcmDspStopRoutineSupported = false
          DcmDspRoutineFixedLength = true
          DcmDspRoutineUsePort = true
          DcmDspRoutineInfoRef = RoutineInfo_EpsPendeln_Routine
          DcmDspRoutineSystemTemplateDiagnosticRoutineRef = EpsPendeln_Routine
        DID_2805_Aussentemperatur (DcmDspData):  # Aussentemperatur
          DcmDspDataSize = 8
          DcmDspDataUsePort = USE_DATA_ASYNCH_CLIENT_SERVER
          DcmDspDataType = UINT8
          DcmDspDataSystemTemplateDiagnosticDataElementRef = Aussentemperatur
          DcmDspDataInfoRef = DID_2805_DataInfo_Aussentemperatur
        DID_DB3C_StatusFzgBordnetz (DcmDspData):  # StatusFzgBordnetz
          DcmDspDataSize = 120
          DcmDspDataUsePort = USE_DATA_ASYNCH_CLIENT_SERVER
          DcmDspDataType = UINT8
          DcmDspDataSystemTemplateDiagnosticDataElementRef = StatusFzgBordnetz
          DcmDspDataInfoRef = DcmDspDataInfo_StatusFzgBordnetz
        Did_StatusFzgBordnetz (DcmDspDid):
          DcmDspDidIdentifier = 56124
          DcmDspDidUsed = true
          DcmDspDidUsePort = USE_DATA_ELEMENT_SPECIFIC_INTERFACES
          DcmDspDidInfoRef = DidInfo_Did_StatusFzgBordnetz
          DcmDspDidSystemTemplateDiagnosticDataIdentifierRef = Did_StatusFzgBordnetz
          StatusFzgBordnetz (DcmDspDidSignal): DcmDspDidDataPos=0, DcmDspDidDataRef=DID_DB3C_StatusFzgBordnetz
        RoutineInfo_Energiesparmode_Routine (DcmDspRoutineInfo)  # Energiesparmode_Routine
          DcmDspStartRoutineIn
            dataIn_In (DcmDspStartRoutineInSignal): DcmDspRoutineSignalLength=8, DcmDspRoutineSignalPos=0, DcmDspRoutineSignalType=UINT8
          DcmDspRoutineAuthorization: DcmDspRoutineSessionRef=DEFAULT_SESSION, DcmDspRoutineSessionRef=EXTENDED_DIAGNOSTIC_SESSION
        Betriebsspannung (DcmDspDid):
          DcmDspDidIdentifier = 10342
          DcmDspDidUsed = true
          DcmDspDidUsePort = USE_DATA_ELEMENT_SPECIFIC_INTERFACES
          DcmDspDidInfoRef = DidInfo_Betriebsspannung
          DcmDspDidSystemTemplateDiagnosticDataIdentifierRef = Betriebsspannung
          Betriebsspannung (DcmDspDidSignal): DcmDspDidDataPos=0, DcmDspDidDataRef=DID_2866_Betriebsspannung
        Did_Readhwmodificationindex (DcmDspDid):
          DcmDspDidIdentifier = 61778
          DcmDspDidUsed = true
          DcmDspDidUsePort = USE_DATA_ELEMENT_SPECIFIC_INTERFACES
          DcmDspDidInfoRef = DidInfo_Did_Readhwmodificationindex
          DcmDspDidSystemTemplateDiagnosticDataIdentifierRef = Did_Readhwmodificationindex
          Readhwmodificationindex (DcmDspDidSignal): DcmDspDidDataPos=0, DcmDspDidDataRef=DID_F152_Readhwmodificationindex
        DidInfo_Aussentemperatur (DcmDspDidInfo): DcmDspDidDynamicallyDefined=false  # Aussentemperatur
          DcmDspDidAccess
        Did_WdbiFp (DcmDspDid):
          DcmDspDidIdentifier = 61786
          DcmDspDidUsed = true
          DcmDspDidUsePort = USE_DATA_ELEMENT_SPECIFIC_INTERFACES
          DcmDspDidInfoRef = DidInfo_Did_WdbiFp
          DcmDspDidSystemTemplateDiagnosticDataIdentifierRef = Did_WdbiFp
          WdbiFp (DcmDspDidSignal): DcmDspDidDataPos=0, DcmDspDidDataRef=DID_F15A_WdbiFp
        RoutineInfo_SteuernEpsPulldriftOffsetReset_Routine (DcmDspRoutineInfo)  # SteuernEpsPulldriftOffsetReset_Routine
          DcmDspRoutineAuthorization: DcmDspRoutineSessionRef=GarageMode
        Did_GelernterZahnstangenweg (DcmDspDid):
          DcmDspDidIdentifier = 57309
          DcmDspDidUsed = true
          DcmDspDidUsePort = USE_DATA_ELEMENT_SPECIFIC_INTERFACES
          DcmDspDidInfoRef = DidInfo_Did_GelernterZahnstangenweg
          DcmDspDidSystemTemplateDiagnosticDataIdentifierRef = Did_GelernterZahnstangenweg
          GelernterZahnstangenweg (DcmDspDidSignal): DcmDspDidDataPos=0, DcmDspDidDataRef=DID_DFDD_GelernterZahnstangenweg
        KmStand (DcmDspDid):
          DcmDspDidIdentifier = 5888
          DcmDspDidUsed = true
          DcmDspDidUsePort = USE_DATA_ELEMENT_SPECIFIC_INTERFACES
          DcmDspDidInfoRef = DidInfo_KmStand
          DcmDspDidSystemTemplateDiagnosticDataIdentifierRef = KmStand
          KmStand (DcmDspDidSignal): DcmDspDidDataPos=0, DcmDspDidDataRef=DID_1700_KmStand
        DidInfo_Did_SvkAktuell (DcmDspDidInfo): DcmDspDidDynamicallyDefined=false  # Did_SvkAktuell
          DcmDspDidAccess
            DcmDspDidRead:
              DcmDspDidReadSessionRef = DEFAULT_SESSION
              DcmDspDidReadSessionRef = EXTENDED_DIAGNOSTIC_SESSION
              DcmDspDidReadSessionRef = GarageMode
              DcmDspDidReadSessionRef = PROGRAMMING_SESSION
        DidInfo_Did_SystemSupplierIdentifier (DcmDspDidInfo): DcmDspDidDynamicallyDefined=false  # Did_SystemSupplierIdentifier
          DcmDspDidAccess
            DcmDspDidRead: DcmDspDidReadSessionRef=DEFAULT_SESSION, DcmDspDidReadSessionRef=EXTENDED_DIAGNOSTIC_SESSION
        Energiesparmode_Routine (DcmDspRoutine):
          DcmDspRequestResultsRoutineSupported = false
          DcmDspRoutineIdentifier = 3852
          DcmDspRoutineUsed = true
          DcmDspStopRoutineSupported = false
          DcmDspRoutineFixedLength = true
          DcmDspRoutineUsePort = true
          DcmDspRoutineInfoRef = RoutineInfo_Energiesparmode_Routine
          DcmDspRoutineSystemTemplateDiagnosticRoutineRef = Energiesparmode_Routine
        DID_250B_ReadSwRevision (DcmDspData):  # ReadSwRevision
          DcmDspDataSize = 1120
          DcmDspDataUsePort = USE_DATA_ASYNCH_CLIENT_SERVER
          DcmDspDataType = UINT8
          DcmDspDataSystemTemplateDiagnosticDataElementRef = ReadSwRevision
          DcmDspDataInfoRef = DcmDspDataInfo_ReadSwRevision
        DID_DC77_EpsZahnstangenmitte (DcmDspData):  # EpsZahnstangenmitte
          DcmDspDataSize = 8
          DcmDspDataUsePort = USE_DATA_ASYNCH_CLIENT_SERVER
          DcmDspDataType = UINT8
          DcmDspDataSystemTemplateDiagnosticDataElementRef = EpsZahnstangenmitte
          DcmDspDataInfoRef = DcmDspDataInfo_EpsZahnstangenmitte
        DidInfo_Did_StatusCalcvn (DcmDspDidInfo): DcmDspDidDynamicallyDefined=false  # Did_StatusCalcvn
          DcmDspDidAccess
            DcmDspDidRead: DcmDspDidReadSessionRef=DEFAULT_SESSION, DcmDspDidReadSessionRef=EXTENDED_DIAGNOSTIC_SESSION
        DidInfo_Did_StatusFzgBordnetz (DcmDspDidInfo): DcmDspDidDynamicallyDefined=false  # Did_StatusFzgBordnetz
          DcmDspDidAccess
            DcmDspDidRead: DcmDspDidReadSessionRef=DEFAULT_SESSION, DcmDspDidReadSessionRef=EXTENDED_DIAGNOSTIC_SESSION
        DID_1750_FUwBn (DcmDspData):  # FUwBn
          DcmDspDataSize = 8
          DcmDspDataType = UINT8
          DcmDspDataUsePort = USE_DATA_ASYNCH_CLIENT_SERVER
          DcmDspDataInfoRef = DID_1750_DataInfo_FUwBn
          DcmDspDataSystemTemplateDiagnosticDataElementRef = FUwBn
        Did_SwfkDeleteSupported (DcmDspDid):
          DcmDspDidIdentifier = 9479
          DcmDspDidUsed = true
          DcmDspDidUsePort = USE_DATA_ELEMENT_SPECIFIC_INTERFACES
          DcmDspDidInfoRef = DidInfo_Did_SwfkDeleteSupported
          DcmDspDidSystemTemplateDiagnosticDataIdentifierRef = Did_SwfkDeleteSupported
          SwfkDeleteSupported (DcmDspDidSignal): DcmDspDidDataPos=0, DcmDspDidDataRef=DID_2507_SwfkDeleteSupported
        DidInfo_Did_EpsRitzelwinkelsensor (DcmDspDidInfo): DcmDspDidDynamicallyDefined=false  # Did_EpsRitzelwinkelsensor
          DcmDspDidAccess
            DcmDspDidRead: DcmDspDidReadSessionRef=DEFAULT_SESSION, DcmDspDidReadSessionRef=EXTENDED_DIAGNOSTIC_SESSION, DcmDspDidReadSessionRef=GarageMode
        DidInfo_Did_MileKmEeprom (DcmDspDidInfo): DcmDspDidDynamicallyDefined=false  # Did_MileKmEeprom
          DcmDspDidAccess
            DcmDspDidRead: DcmDspDidReadSessionRef=DEFAULT_SESSION, DcmDspDidReadSessionRef=EXTENDED_DIAGNOSTIC_SESSION
        3 x DcmDspData, all with DcmDspDataType=UINT8:
          DID_1701_Systemzeit: DcmDspDataSize=32, DcmDspDataUsePort=USE_DATA_SYNCH_CLIENT_SERVER, DcmDspDataConditionCheckReadFncUsed=false, DcmDspDataSystemTemplateDiagnosticDataElementRef=Systemzeit, DcmDspDataInfoRef=DcmDspDataInfo_Systemzeit  # Systemzeit
          DID_F186_ActiveDiagnosticSession: DcmDspDataSize=8, DcmDspDataUsePort=USE_DATA_SYNCH_FNC, DcmDspDataReadFnc=Dcm_DidMgr_F186_ReadData, DcmDspDataConditionCheckReadFncUsed=false, DcmDspDataSystemTemplateDiagnosticDataElementRef=ActiveDiagnosticSession, DcmDspDataInfoRef=DID_F186_DataInfo_ActiveDiagnosticSession  # ActiveDiagnosticSession
          DID_DB99_EpsMomentensensor: DcmDspDataSize=24, DcmDspDataUsePort=USE_DATA_ASYNCH_CLIENT_SERVER, DcmDspDataSystemTemplateDiagnosticDataElementRef=EpsMomentensensor, DcmDspDataInfoRef=DcmDspDataInfo_EpsMomentensensor  # EpsMomentensensor
        DidInfo_Did_EpsMomentensensor (DcmDspDidInfo): DcmDspDidDynamicallyDefined=false  # Did_EpsMomentensensor
          DcmDspDidAccess
            DcmDspDidRead: DcmDspDidReadSessionRef=DEFAULT_SESSION, DcmDspDidReadSessionRef=EXTENDED_DIAGNOSTIC_SESSION, DcmDspDidReadSessionRef=GarageMode
        DID_2507_SwfkDeleteSupported (DcmDspData):  # SwfkDeleteSupported
          DcmDspDataSize = 8
          DcmDspDataUsePort = USE_DATA_SYNCH_CLIENT_SERVER
          DcmDspDataType = UINT8
          DcmDspDataSystemTemplateDiagnosticDataElementRef = SwfkDeleteSupported
          DcmDspDataInfoRef = DcmDspDataInfo_SwfkDeleteSupported
        DID_2504_FlashTimingParameter (DcmDspData):  # FlashTimingParameter
          DcmDspDataSize = 96
          DcmDspDataUsePort = USE_DATA_SYNCH_CLIENT_SERVER
          DcmDspDataType = UINT8
          DcmDspDataConditionCheckReadFncUsed = false
          DcmDspDataSystemTemplateDiagnosticDataElementRef = FlashTimingParameter
          DcmDspDataInfoRef = DcmDspDataInfo_FlashTimingParameter
        Did_ProgrammingCounter (DcmDspDid):
          DcmDspDidIdentifier = 9474
          DcmDspDidUsed = true
          DcmDspDidUsePort = USE_DATA_ELEMENT_SPECIFIC_INTERFACES
          DcmDspDidInfoRef = DidInfo_Did_ProgrammingCounter
          DcmDspDidSystemTemplateDiagnosticDataIdentifierRef = Did_ProgrammingCounter
          ProgrammingCounter (DcmDspDidSignal): DcmDspDidDataPos=0, DcmDspDidDataRef=DID_2502_ProgrammingCounter
        RcRswedi_Routine (DcmDspRoutine):
          DcmDspRequestResultsRoutineSupported = false
          DcmDspRoutineIdentifier = 517
          DcmDspRoutineUsed = true
          DcmDspStopRoutineSupported = false
          DcmDspRoutineFixedLength = false
          DcmDspRoutineUsePort = true
          DcmDspRoutineInfoRef = RoutineInfo_RcRswedi_Routine
          DcmDspRoutineSystemTemplateDiagnosticRoutineRef = RcRswedi_Routine
        DidInfo_Did_EcuSerialNumber (DcmDspDidInfo): DcmDspDidDynamicallyDefined=false  # Did_EcuSerialNumber
          DcmDspDidAccess
            DcmDspDidRead: DcmDspDidReadSessionRef=DEFAULT_SESSION, DcmDspDidReadSessionRef=EXTENDED_DIAGNOSTIC_SESSION, DcmDspDidReadSessionRef=PROGRAMMING_SESSION
        DID_F102_SvkSysSupplier (DcmDspData):  # SvkSysSupplier
          DcmDspDataSize = 384
          DcmDspDataUsePort = USE_DATA_ASYNCH_CLIENT_SERVER
          DcmDspDataType = UINT8
          DcmDspDataConditionCheckReadFncUsed = true
          DcmDspDataSystemTemplateDiagnosticDataElementRef = SvkSysSupplier
          DcmDspDataInfoRef = DcmDspDataInfo_SvkSysSupplier
        Did_ActiveDiagnosticSession (DcmDspDid):
          DcmDspDidIdentifier = 61830
          DcmDspDidUsed = true
          DcmDspDidUsePort = USE_DATA_ELEMENT_SPECIFIC_INTERFACES
          DcmDspDidInfoRef = DidInfo_Did_ActiveDiagnosticSession
          DcmDspDidSystemTemplateDiagnosticDataIdentifierRef = Did_ActiveDiagnosticSession
          ActiveDiagnosticSession (DcmDspDidSignal): DcmDspDidDataPos=0, DcmDspDidDataRef=DID_F186_ActiveDiagnosticSession
        Did_ReadActiveSessionState (DcmDspDid):
          DcmDspDidIdentifier = 61696
          DcmDspDidUsed = true
          DcmDspDidUsePort = USE_DATA_ELEMENT_SPECIFIC_INTERFACES
          DcmDspDidInfoRef = DidInfo_Did_ReadActiveSessionState
          DcmDspDidSystemTemplateDiagnosticDataIdentifierRef = Did_ReadActiveSessionState
          ReadActiveSessionState (DcmDspDidSignal): DcmDspDidDataPos=0, DcmDspDidDataRef=DID_F100_ReadActiveSessionState
        DID_100A_EnergySavingState (DcmDspData):  # EnergySavingState
          DcmDspDataSize = 8
          DcmDspDataUsePort = USE_DATA_SYNCH_CLIENT_SERVER
          DcmDspDataType = UINT8
          DcmDspDataConditionCheckReadFncUsed = false
          DcmDspDataSystemTemplateDiagnosticDataElementRef = EnergySavingState
          DcmDspDataInfoRef = DcmDspDataInfo_EnergySavingState
        RoutineInfo_SteuernEpsMultiturnwertReset_Routine (DcmDspRoutineInfo)  # SteuernEpsMultiturnwertReset_Routine
          DcmDspRoutineAuthorization: DcmDspRoutineSessionRef=DEFAULT_SESSION, DcmDspRoutineSessionRef=EXTENDED_DIAGNOSTIC_SESSION, DcmDspRoutineSessionRef=GarageMode
        DID_1700_KmStand (DcmDspData):  # KmStand
          DcmDspDataSize = 8
          DcmDspDataUsePort = USE_DATA_ASYNCH_CLIENT_SERVER
          DcmDspDataType = UINT8
          DcmDspDataSystemTemplateDiagnosticDataElementRef = KmStand
          DcmDspDataInfoRef = DID_1700_DataInfo_KmStand
        Did_ReadSwRevision (DcmDspDid):
          DcmDspDidIdentifier = 9483
          DcmDspDidUsed = true
          DcmDspDidUsePort = USE_DATA_ELEMENT_SPECIFIC_INTERFACES
          DcmDspDidInfoRef = DidInfo_Did_ReadSwRevision
          DcmDspDidSystemTemplateDiagnosticDataIdentifierRef = Did_ReadSwRevision
          ReadSwRevision (DcmDspDidSignal): DcmDspDidDataPos=0, DcmDspDidDataRef=DID_250B_ReadSwRevision
        DID_1000_Pruefstempel (DcmDspData):  # Pruefstempel
          DcmDspDataSize = 24
          DcmDspDataUsePort = USE_DATA_ASYNCH_CLIENT_SERVER
          DcmDspDataType = UINT8
          DcmDspDataSystemTemplateDiagnosticDataElementRef = Pruefstempel
          DcmDspDataInfoRef = DcmDspDataInfo_Pruefstempel
        DidInfo_Did_EnergySavingState (DcmDspDidInfo): DcmDspDidDynamicallyDefined=false  # Did_EnergySavingState
          DcmDspDidAccess
            DcmDspDidRead: DcmDspDidReadSessionRef=DEFAULT_SESSION, DcmDspDidReadSessionRef=EXTENDED_DIAGNOSTIC_SESSION, DcmDspDidReadSessionRef=PROGRAMMING_SESSION
        RoutineInfo_ReadNcd_Routine (DcmDspRoutineInfo)  # ReadNcd_Routine
          DcmDspStartRoutineIn
            ArgCodingArea_In (DcmDspStartRoutineInSignal): DcmDspRoutineSignalPos=0, DcmDspRoutineSignalLength=48, DcmDspRoutineSignalType=UINT8, DcmDspRoutineSignalEndianness=opaque
          DcmDspRoutineAuthorization: DcmDspRoutineSessionRef=CODING_SESSION, DcmDspRoutineSessionRef=DEFAULT_SESSION, DcmDspRoutineSessionRef=EXTENDED_DIAGNOSTIC_SESSION
          DcmDspStartRoutineOut
            StatCodingArea_Out (DcmDspStartRoutineOutSignal): DcmDspRoutineSignalPos=0, DcmDspRoutineSignalLength=8192, DcmDspRoutineSignalType=VARIABLE_LENGTH
        Did_SvkSysSupplier (DcmDspDid):
          DcmDspDidIdentifier = 61698
          DcmDspDidUsed = true
          DcmDspDidUsePort = USE_DATA_ELEMENT_SPECIFIC_INTERFACES
          DcmDspDidInfoRef = DidInfo_Did_SvkSysSupplier
          DcmDspDidSystemTemplateDiagnosticDataIdentifierRef = Did_SvkSysSupplier
          SvkSysSupplier (DcmDspDidSignal): DcmDspDidDataPos=0, DcmDspDidDataRef=DID_F102_SvkSysSupplier
        Did_StatusCalcvn (DcmDspDid):
          DcmDspDidIdentifier = 9537
          DcmDspDidUsed = true
          DcmDspDidUsePort = USE_DATA_ELEMENT_SPECIFIC_INTERFACES
          DcmDspDidInfoRef = DidInfo_Did_StatusCalcvn
          DcmDspDidSystemTemplateDiagnosticDataIdentifierRef = Did_StatusCalcvn
          StatusCalcvn (DcmDspDidSignal): DcmDspDidDataPos=0, DcmDspDidDataRef=DID_2541_StatusCalcvn
        DmClientTriggerDtcEntry_Routine (DcmDspRoutine):
          DcmDspRequestResultsRoutineSupported = false
          DcmDspRoutineIdentifier = 772
          DcmDspRoutineUsed = true
          DcmDspStopRoutineSupported = false
          DcmDspRoutineFixedLength = true
          DcmDspRoutineUsePort = true
          DcmDspRoutineInfoRef = RoutineInfo_DmClientTriggerDtcEntry_Routine
          DcmDspRoutineSystemTemplateDiagnosticRoutineRef = DmClientTriggerDtcEntry_Routine
        DcmDspComControl
          DcmDspComControlAllChannel: DcmDspAllComMChannelRef=A_FlexRay_372befd6
        DID_F103_SvkWerk (DcmDspData):  # SvkWerk
          DcmDspDataSize = 384
          DcmDspDataUsePort = USE_DATA_ASYNCH_CLIENT_SERVER
          DcmDspDataType = UINT8
          DcmDspDataConditionCheckReadFncUsed = true
          DcmDspDataSystemTemplateDiagnosticDataElementRef = SvkWerk
          DcmDspDataInfoRef = DcmDspDataInfo_SvkWerk
        DID_F101_SvkAktuell (DcmDspData):  # SvkAktuell
          DcmDspDataSize = 800
          DcmDspDataUsePort = USE_DATA_ASYNCH_CLIENT_SERVER
          DcmDspDataType = UINT8
          DcmDspDataConditionCheckReadFncUsed = true
          DcmDspDataSystemTemplateDiagnosticDataElementRef = SvkAktuell
          DcmDspDataInfoRef = DcmDspDataInfo_SvkAktuell
        RoutineInfo_RcCm_Routine (DcmDspRoutineInfo)  # RcCm_Routine
          DcmDspStartRoutineIn
            RcCmIcvRcoStruct_In (DcmDspStartRoutineInSignal): DcmDspRoutineSignalPos=0, DcmDspRoutineSignalLength=8, DcmDspRoutineSignalType=UINT8
          DcmDspRoutineAuthorization: DcmDspRoutineSessionRef=PROGRAMMING_SESSION
          DcmDspStartRoutineOut
            StatRoutineStatus_Out (DcmDspStartRoutineOutSignal): DcmDspRoutineSignalLength=8, DcmDspRoutineSignalPos=0, DcmDspRoutineSignalType=UINT8
        RoutineInfo_EpsLenkwinkelsensorKalibrierungReset_Routine (DcmDspRoutineInfo)  # EpsLenkwinkelsensorKalibrierungReset_Routine
          DcmDspRoutineAuthorization: DcmDspRoutineSessionRef=GarageMode
        DID_F18C_EcuSerialNumber (DcmDspData):  # EcuSerialNumber
          DcmDspDataSize = 80
          DcmDspDataUsePort = USE_DATA_SYNCH_CLIENT_SERVER
          DcmDspDataType = UINT8
          DcmDspDataConditionCheckReadFncUsed = false
          DcmDspDataSystemTemplateDiagnosticDataElementRef = EcuSerialNumber
          DcmDspDataInfoRef = DcmDspDataInfo_EcuSerialNumber
        WriteNcd_Routine (DcmDspRoutine):
          DcmDspRequestResultsRoutineSupported = false
          DcmDspRoutineIdentifier = 14333
          DcmDspRoutineUsed = true
          DcmDspStopRoutineSupported = false
          DcmDspRoutineFixedLength = false
          DcmDspRoutineUsePort = true
          DcmDspRoutineInfoRef = RoutineInfo_WriteNcd_Routine
          DcmDspRoutineSystemTemplateDiagnosticRoutineRef = WriteNcd_Routine
        DidInfo_Did_FlashTimingParameter (DcmDspDidInfo): DcmDspDidDynamicallyDefined=false  # Did_FlashTimingParameter
          DcmDspDidAccess
            DcmDspDidRead:
              DcmDspDidReadSessionRef = DEFAULT_SESSION
              DcmDspDidReadSessionRef = EXTENDED_DIAGNOSTIC_SESSION
              DcmDspDidReadSessionRef = PROGRAMMING_SESSION
              DcmDspDidReadSessionRef = CODING_SESSION
        DidInfo_Did_SvkWerk (DcmDspDidInfo): DcmDspDidDynamicallyDefined=false  # Did_SvkWerk
          DcmDspDidAccess
            DcmDspDidRead: DcmDspDidReadSessionRef=DEFAULT_SESSION, DcmDspDidReadSessionRef=EXTENDED_DIAGNOSTIC_SESSION, DcmDspDidReadSessionRef=PROGRAMMING_SESSION
        RoutineInfo_DiagCommLoopback_Routine (DcmDspRoutineInfo)  # DiagCommLoopback_Routine
          DcmDspStartRoutineIn
            dataIn_In (DcmDspStartRoutineInSignal): DcmDspRoutineSignalPos=0, DcmDspRoutineSignalLength=8192, DcmDspRoutineSignalType=VARIABLE_LENGTH, DcmDspRoutineSignalEndianness=opaque
          DcmDspRoutineAuthorization: DcmDspRoutineSessionRef=DEFAULT_SESSION, DcmDspRoutineSessionRef=EXTENDED_DIAGNOSTIC_SESSION
          DcmDspStartRoutineOut
            dataOut_Out (DcmDspStartRoutineOutSignal): DcmDspRoutineSignalPos=0, DcmDspRoutineSignalLength=8192, DcmDspRoutineSignalType=VARIABLE_LENGTH, DcmDspRoutineSignalEndianness=opaque
        DID_2867_DataInfo_Fahrzeuggeschwindigkeit (DcmDspDataInfo): DcmDspDataFixedLength=true  # Fahrzeuggeschwindigkeit
        Did_EpsZahnstangenmitte (DcmDspDid):
          DcmDspDidIdentifier = 56439
          DcmDspDidUsed = true
          DcmDspDidUsePort = USE_DATA_ELEMENT_SPECIFIC_INTERFACES
          DcmDspDidInfoRef = DidInfo_Did_EpsZahnstangenmitte
          DcmDspDidSystemTemplateDiagnosticDataIdentifierRef = Did_EpsZahnstangenmitte
          EpsZahnstangenmitte (DcmDspDidSignal): DcmDspDidDataPos=0, DcmDspDidDataRef=DID_DC77_EpsZahnstangenmitte
        DidInfo_Did_ReadActiveSessionState (DcmDspDidInfo): DcmDspDidDynamicallyDefined=false  # Did_ReadActiveSessionState
          DcmDspDidAccess
            DcmDspDidRead:
              DcmDspDidReadSessionRef = DEFAULT_SESSION
              DcmDspDidReadSessionRef = EXTENDED_DIAGNOSTIC_SESSION
              DcmDspDidReadSessionRef = PROGRAMMING_SESSION
              DcmDspDidReadSessionRef = CODING_SESSION
        3 x DcmDspDid, all with DcmDspDidUsed=true, DcmDspDidUsePort=USE_DATA_ELEMENT_SPECIFIC_INTERFACES:
          FUwBn: DcmDspDidIdentifier=5968, DcmDspDidInfoRef=DidInfo_FUwBn, DcmDspDidSystemTemplateDiagnosticDataIdentifierRef=FUwBn
            FUwBn (DcmDspDidSignal): DcmDspDidDataPos=0, DcmDspDidDataRef=DID_1750_FUwBn
          Did_SvkWerk: DcmDspDidIdentifier=61699, DcmDspDidInfoRef=DidInfo_Did_SvkWerk, DcmDspDidSystemTemplateDiagnosticDataIdentifierRef=Did_SvkWerk
            SvkWerk (DcmDspDidSignal): DcmDspDidDataPos=0, DcmDspDidDataRef=DID_F103_SvkWerk
          Did_ProgrammingCounterMaxValue: DcmDspDidIdentifier=9475, DcmDspDidInfoRef=DidInfo_Did_ProgrammingCounterMaxValue, DcmDspDidSystemTemplateDiagnosticDataIdentifierRef=Did_ProgrammingCounterMaxValue
            ProgrammingCounterMaxValue (DcmDspDidSignal): DcmDspDidDataPos=0, DcmDspDidDataRef=DID_2503_ProgrammingCounterMaxValue
        DID_DB5A_EpsLenkwinkelsensorKalibrierung (DcmDspData):  # EpsLenkwinkelsensorKalibrierung
          DcmDspDataSize = 16
          DcmDspDataUsePort = USE_DATA_ASYNCH_CLIENT_SERVER
          DcmDspDataType = UINT8
          DcmDspDataSystemTemplateDiagnosticDataElementRef = EpsLenkwinkelsensorKalibrierung
          DcmDspDataInfoRef = DcmDspDataInfo_EpsLenkwinkelsensorKalibrierung
        SteuernEpsPulldriftOffsetReset_Routine (DcmDspRoutine):
          DcmDspRequestResultsRoutineSupported = false
          DcmDspRoutineIdentifier = 41659
          DcmDspRoutineUsed = true
          DcmDspStopRoutineSupported = false
          DcmDspRoutineFixedLength = true
          DcmDspRoutineUsePort = true
          DcmDspRoutineInfoRef = RoutineInfo_SteuernEpsPulldriftOffsetReset_Routine
          DcmDspRoutineSystemTemplateDiagnosticRoutineRef = SteuernEpsPulldriftOffsetReset_Routine
        DidInfo_Did_Pruefstempel (DcmDspDidInfo): DcmDspDidDynamicallyDefined=false  # Did_Pruefstempel
          DcmDspDidAccess
            DcmDspDidWrite: DcmDspDidWriteSessionRef=DEFAULT_SESSION, DcmDspDidWriteSessionRef=EXTENDED_DIAGNOSTIC_SESSION
            DcmDspDidRead: DcmDspDidReadSessionRef=DEFAULT_SESSION, DcmDspDidReadSessionRef=EXTENDED_DIAGNOSTIC_SESSION
        EpsInitialisierungWerk_Routine (DcmDspRoutine):
          DcmDspRequestResultsRoutineSupported = true
          DcmDspRoutineIdentifier = 43890
          DcmDspRoutineUsed = true
          DcmDspStopRoutineSupported = true
          DcmDspRoutineFixedLength = true
          DcmDspRoutineUsePort = true
          DcmDspRoutineInfoRef = RoutineInfo_EpsInitialisierungWerk_Routine
          DcmDspRoutineSystemTemplateDiagnosticRoutineRef = EpsInitialisierungWerk_Routine
        Did_Herstelldatum (DcmDspDid):
          DcmDspDidIdentifier = 61835
          DcmDspDidUsed = true
          DcmDspDidUsePort = USE_DATA_ELEMENT_SPECIFIC_INTERFACES
          DcmDspDidInfoRef = DidInfo_Did_Herstelldatum
          DcmDspDidSystemTemplateDiagnosticDataIdentifierRef = Did_Herstelldatum
          Herstelldatum (DcmDspDidSignal): DcmDspDidDataPos=0, DcmDspDidDataRef=DID_F18B_Herstelldatum
        DidInfo_Did_SvkSysSupplier (DcmDspDidInfo): DcmDspDidDynamicallyDefined=false  # Did_SvkSysSupplier
          DcmDspDidAccess
            DcmDspDidRead: DcmDspDidReadSessionRef=DEFAULT_SESSION, DcmDspDidReadSessionRef=EXTENDED_DIAGNOSTIC_SESSION, DcmDspDidReadSessionRef=PROGRAMMING_SESSION
        DID_F18A_SystemSupplierIdentifier (DcmDspData):  # SystemSupplierIdentifier
          DcmDspDataSize = 24
          DcmDspDataUsePort = USE_DATA_ASYNCH_CLIENT_SERVER
          DcmDspDataType = UINT8
          DcmDspDataSystemTemplateDiagnosticDataElementRef = SystemSupplierIdentifier
          DcmDspDataInfoRef = DcmDspDataInfo_SystemSupplierIdentifier
        DidInfo_Did_Systemzeit (DcmDspDidInfo): DcmDspDidDynamicallyDefined=false  # Did_Systemzeit
          DcmDspDidAccess
            DcmDspDidRead: DcmDspDidReadSessionRef=DEFAULT_SESSION, DcmDspDidReadSessionRef=EXTENDED_DIAGNOSTIC_SESSION
        RoutineInfo_EpsInitialisierungService_Routine (DcmDspRoutineInfo)  # EpsInitialisierungService_Routine
          DcmDspRoutineRequestResOut
            3 x DcmDspRoutineRequestResOutSignal, all with DcmDspRoutineSignalType=UINT8:
              StatLenkradwinkelWert_Out: DcmDspRoutineSignalPos=8, DcmDspRoutineSignalLength=16
              StatRoutineStatus_Out: DcmDspRoutineSignalLength=8, DcmDspRoutineSignalPos=0
              StatSensorZustandNr_Out: DcmDspRoutineSignalLength=8, DcmDspRoutineSignalPos=24
          DcmDspRoutineAuthorization: DcmDspRoutineSessionRef=DEFAULT_SESSION, DcmDspRoutineSessionRef=EXTENDED_DIAGNOSTIC_SESSION, DcmDspRoutineSessionRef=GarageMode
        DID_2866_Betriebsspannung (DcmDspData):  # Betriebsspannung
          DcmDspDataSize = 8
          DcmDspDataType = UINT8
          DcmDspDataUsePort = USE_DATA_ASYNCH_CLIENT_SERVER
          DcmDspDataInfoRef = DID_2866_DataInfo_Betriebsspannung
          DcmDspDataSystemTemplateDiagnosticDataElementRef = Betriebsspannung
        RcEm_Routine (DcmDspRoutine):
          DcmDspRequestResultsRoutineSupported = false
          DcmDspRoutineIdentifier = 65280
          DcmDspRoutineUsed = true
          DcmDspStopRoutineSupported = false
          DcmDspRoutineFixedLength = true
          DcmDspRoutineUsePort = true
          DcmDspRoutineInfoRef = RoutineInfo_RcEm_Routine
          DcmDspRoutineSystemTemplateDiagnosticRoutineRef = RcEm_Routine
        DID_F18B_Herstelldatum (DcmDspData):  # Herstelldatum
          DcmDspDataSize = 24
          DcmDspDataUsePort = USE_DATA_SYNCH_CLIENT_SERVER
          DcmDspDataType = UINT8
          DcmDspDataConditionCheckReadFncUsed = false
          DcmDspDataSystemTemplateDiagnosticDataElementRef = Herstelldatum
          DcmDspDataInfoRef = DcmDspDataInfo_Herstelldatum
        8 x DcmDspDataInfo:
          DID_37FE_DataInfo_Cps: DcmDspDataFixedLength=true
          DID_1700_DataInfo_KmStand: DcmDspDataFixedLength=true
          DID_1704_DataInfo_DmDtcAktiveMeldung: DcmDspDataFixedLength=true
          DID_1723_DataInfo_DmIsDtcActiveResponse: DcmDspDataFixedLength=false
          DID_2805_DataInfo_Aussentemperatur: DcmDspDataFixedLength=true
          DID_DB3C_DataInfo_StatusFzgBordnetz: DcmDspDataFixedLength=true
          DID_F15A_DataInfo_WdbiFp: DcmDspDataFixedLength=true
          DID_F186_DataInfo_ActiveDiagnosticSession: DcmDspDataFixedLength=true
        DarhStrtStop_Routine (DcmDspRoutine):  # Darh - Integration PLAIN_TEXT This service added to support DMA_PA_9154 - Refer "Routine Control' Section in DarhClassic Integration manual
          DcmDspRequestResultsRoutineSupported = false
          DcmDspRoutineIdentifier = 16394
          DcmDspRoutineUsePort = true
          DcmDspRoutineUsed = true
          DcmDspStopRoutineSupported = true
          DcmDspRoutineFixedLength = true
          DcmDspRoutineInfoRef = RoutineInfo_DarhStrtStop_Routine
        RoutineInfo_DarhStrtStop_Routine (DcmDspRoutineInfo)
          DcmDspRoutineAuthorization: DcmDspRoutineSessionRef=EXTENDED_DIAGNOSTIC_SESSION, DcmDspRoutineSessionRef=DEFAULT_SESSION
        Did_Cps (DcmDspDid):
          DcmDspDidIdentifier = 14334
          DcmDspDidUsed = true
          DcmDspDidUsePort = USE_DATA_ELEMENT_SPECIFIC_INTERFACES
          DcmDspDidInfoRef = DidInfo_Did_Cps
          DcmDspDidSystemTemplateDiagnosticDataIdentifierRef = Did_Cps
          Cps (DcmDspDidSignal): DcmDspDidDataPos=0, DcmDspDidDataRef=DID_37FE_Cps
        DcmDspDidInfo_CmnMfgSrv_SrvFE90 (DcmDspDidInfo): DcmDspDidDynamicallyDefined=false
          DcmDspDidAccess
            DcmDspDidRead: DcmDspDidReadSessionRef=DcmDspSessionRow_NXTRMFG
            DcmDspDidWrite: DcmDspDidWriteSessionRef=DcmDspSessionRow_NXTRMFG
        DcmDspRoutineInfo_CmnMfgSrv_SrvFDF0 (DcmDspRoutineInfo)
          DcmDspRoutineAuthorization: DcmDspRoutineSessionRef=DcmDspSessionRow_NXTRMFG, DcmDspRoutineSessionRef=DEFAULT_SESSION
          DcmDspRoutineRequestResOut
            DcmDspRoutineRequestResOutSignal: DcmDspRoutineSignalLength=8, DcmDspRoutineSignalPos=0, DcmDspRoutineSignalType=UINT8
        4 x DcmDspDataInfo, all with DcmDspDataFixedLength=true:
          DcmDspDataInfo_CmnMfgSrv_SrvFD02
          DcmDspDataInfo_CmnMfgSrv_SrvFD01
          DcmDspDataInfo_CmnMfgSrv_SrvFD00
          DcmDspDataInfo_CmnMfgSrv_SrvFE21
        DcmDspDidInfo_CmnMfgSrv_SrvFDF7 (DcmDspDidInfo): DcmDspDidDynamicallyDefined=false
          DcmDspDidAccess
            DcmDspDidRead: DcmDspDidReadSessionRef=DcmDspSessionRow_NXTRMFG
            DcmDspDidWrite: DcmDspDidWriteSessionRef=DcmDspSessionRow_NXTRMFG
        DcmDspDid_CmnMfgSrv_SrvFE8A (DcmDspDid):
          DcmDspDidIdentifier = 65162
          DcmDspDidUsed = true
          DcmDspDidUsePort = USE_DATA_ELEMENT_SPECIFIC_INTERFACES
          DcmDspDidInfoRef = DcmDspDidInfo_CmnMfgSrv_SrvFE8A
          DcmDspDidSignal: DcmDspDidDataPos=0, DcmDspDidDataRef=DcmDspData_CmnMfgSrv_SrvFE8A
        DcmDspDidInfo_CmnMfgSrv_SrvFDF6 (DcmDspDidInfo): DcmDspDidDynamicallyDefined=false
          DcmDspDidAccess
            DcmDspDidRead: DcmDspDidReadSessionRef=DcmDspSessionRow_NXTRMFG
            DcmDspDidWrite: DcmDspDidWriteSessionRef=DcmDspSessionRow_NXTRMFG
        DcmDspDid_CmnMfgSrv_SrvFE8B (DcmDspDid):
          DcmDspDidIdentifier = 65163
          DcmDspDidUsed = true
          DcmDspDidUsePort = USE_DATA_ELEMENT_SPECIFIC_INTERFACES
          DcmDspDidInfoRef = DcmDspDidInfo_CmnMfgSrv_SrvFE8B
          DcmDspDidSignal: DcmDspDidDataPos=0, DcmDspDidDataRef=DcmDspData_CmnMfgSrv_SrvFE8B
        DcmDspDid_CmnMfgSrv_SrvFE8C (DcmDspDid):
          DcmDspDidIdentifier = 65164
          DcmDspDidUsed = true
          DcmDspDidUsePort = USE_DATA_ELEMENT_SPECIFIC_INTERFACES
          DcmDspDidInfoRef = DcmDspDidInfo_CmnMfgSrv_SrvFE8C
          DcmDspDidSignal: DcmDspDidDataPos=0, DcmDspDidDataRef=DcmDspData_CmnMfgSrv_SrvFE8C
        DcmDspDidInfo_CmnMfgSrv_SrvFDF8 (DcmDspDidInfo): DcmDspDidDynamicallyDefined=false
          DcmDspDidAccess
            DcmDspDidRead: DcmDspDidReadSessionRef=DcmDspSessionRow_NXTRMFG
            DcmDspDidWrite: DcmDspDidWriteSessionRef=DcmDspSessionRow_NXTRMFG
        3 x DcmDspDataInfo, all with DcmDspDataFixedLength=true:
          DcmDspDataInfo_CmnMfgSrv_SrvFD06
          DcmDspDataInfo_CmnMfgSrv_SrvFD05
          DcmDspDataInfo_CmnMfgSrv_SrvFD03
        DcmDspRoutineInfo_CmnMfgSrv_SrvF200 (DcmDspRoutineInfo)
          DcmDspRoutineAuthorization: DcmDspRoutineSessionRef=DcmDspSessionRow_NXTRMFG, DcmDspRoutineSessionRef=DEFAULT_SESSION
          DcmDspStartRoutineIn
            DcmDspStartRoutineInSignal: DcmDspRoutineSignalLength=32, DcmDspRoutineSignalPos=0, DcmDspRoutineSignalType=UINT8
        DcmDspData_CmnMfgSrv_SrvF1FE (DcmDspData):
          DcmDspDataSize = 40
          DcmDspDataUsePort = USE_DATA_ASYNCH_FNC
          DcmDspDataType = UINT8
          DcmDspDataConditionCheckReadFncUsed = false
          DcmDspDataReadFnc = CmnMfgSrvIf_Srv0xF1FERd
          DcmDspDataInfoRef = DcmDspDataInfo_CmnMfgSrv_SrvF1FE
        DcmDspData_CmnMfgSrv_SrvF1FD (DcmDspData):
          DcmDspDataSize = 72
          DcmDspDataUsePort = USE_DATA_ASYNCH_FNC
          DcmDspDataType = UINT8
          DcmDspDataConditionCheckReadFncUsed = false
          DcmDspDataReadFnc = CmnMfgSrvIf_Srv0xF1FDRd
          DcmDspDataInfoRef = DcmDspDataInfo_CmnMfgSrv_SrvF1FD
        DcmDspRoutine_CmnMfgSrv_SrvF151 (DcmDspRoutine):
          DcmDspRequestResultsRoutineSupported = true
          DcmDspRoutineIdentifier = 61777
          DcmDspRoutineUsePort = false
          DcmDspRoutineUsed = true
          DcmDspStopRoutineSupported = true
          DcmDspRoutineFixedLength = false
          DcmDspStartRoutineFnc = CmnMfgSrvIf_Srv0xF151Strt
          DcmDspStopRoutineFnc = CmnMfgSrvIf_Srv0xF151Stop
          DcmDspRequestResultsRoutineFnc = CmnMfgSrvIf_Srv0xF151Sts
          DcmDspRoutineInfoRef = DcmDspRoutineInfo_CmnMfgSrv_SrvF151
        3 x DcmDspDidInfo, all with DcmDspDidDynamicallyDefined=false:
          DcmDspDidInfo_CmnMfgSrv_SrvFD60
            DcmDspDidAccess
              DcmDspDidRead: DcmDspDidReadSessionRef=DcmDspSessionRow_NXTRMFG
          DcmDspDidInfo_CmnMfgSrv_SrvFD63
            DcmDspDidAccess
              DcmDspDidRead: DcmDspDidReadSessionRef=DcmDspSessionRow_NXTRMFG
          DcmDspDidInfo_CmnMfgSrv_SrvFD62
            DcmDspDidAccess
              DcmDspDidRead: DcmDspDidReadSessionRef=DcmDspSessionRow_NXTRMFG
        DcmDspData_CmnMfgSrv_SrvF1FF (DcmDspData):
          DcmDspDataSize = 160
          DcmDspDataUsePort = USE_DATA_ASYNCH_FNC
          DcmDspDataType = UINT8
          DcmDspDataConditionCheckReadFncUsed = false
          DcmDspDataReadFnc = CmnMfgSrvIf_Srv0xF1FFRd
          DcmDspDataInfoRef = DcmDspDataInfo_CmnMfgSrv_SrvF1FF
        DcmDspRoutine_CmnMfgSrv_SrvF150 (DcmDspRoutine):
          DcmDspRequestResultsRoutineSupported = true
          DcmDspRoutineIdentifier = 61776
          DcmDspRoutineUsePort = false
          DcmDspRoutineUsed = true
          DcmDspStopRoutineSupported = true
          DcmDspRoutineFixedLength = false
          DcmDspStartRoutineFnc = CmnMfgSrvIf_Srv0xF150Strt
          DcmDspStopRoutineFnc = CmnMfgSrvIf_Srv0xF150Stop
          DcmDspRequestResultsRoutineFnc = CmnMfgSrvIf_Srv0xF150Sts
          DcmDspRoutineInfoRef = DcmDspRoutineInfo_CmnMfgSrv_SrvF150
        DcmDspDid_CmnMfgSrv_SrvFE90 (DcmDspDid):
          DcmDspDidIdentifier = 65168
          DcmDspDidUsed = true
          DcmDspDidUsePort = USE_DATA_ELEMENT_SPECIFIC_INTERFACES
          DcmDspDidInfoRef = DcmDspDidInfo_CmnMfgSrv_SrvFE90
          DcmDspDidSignal: DcmDspDidDataPos=0, DcmDspDidDataRef=DcmDspData_CmnMfgSrv_SrvFE90
        3 x DcmDspDidInfo, all with DcmDspDidDynamicallyDefined=false:
          DcmDspDidInfo_CmnMfgSrv_SrvFE8B
            DcmDspDidAccess
              DcmDspDidRead: DcmDspDidReadSessionRef=DcmDspSessionRow_NXTRMFG
              DcmDspDidWrite: DcmDspDidWriteSessionRef=DcmDspSessionRow_NXTRMFG
          DcmDspDidInfo_CmnMfgSrv_SrvFE8A
            DcmDspDidAccess
              DcmDspDidRead: DcmDspDidReadSessionRef=DcmDspSessionRow_NXTRMFG
              DcmDspDidWrite: DcmDspDidWriteSessionRef=DcmDspSessionRow_NXTRMFG
          DcmDspDidInfo_CmnMfgSrv_SrvFE8C
            DcmDspDidAccess
              DcmDspDidRead: DcmDspDidReadSessionRef=DcmDspSessionRow_NXTRMFG
              DcmDspDidWrite: DcmDspDidWriteSessionRef=DcmDspSessionRow_NXTRMFG
        DcmDspDataInfo_CmnMfgSrv_SrvFDB4 (DcmDspDataInfo): DcmDspDataFixedLength=true
        DcmDspRoutine_CmnMfgSrv_SrvF140 (DcmDspRoutine):
          DcmDspRequestResultsRoutineSupported = true
          DcmDspRoutineIdentifier = 61760
          DcmDspRoutineUsePort = false
          DcmDspRoutineUsed = true
          DcmDspStopRoutineSupported = true
          DcmDspRoutineFixedLength = false
          DcmDspStartRoutineFnc = CmnMfgSrvIf_Srv0xF140Strt
          DcmDspStopRoutineFnc = CmnMfgSrvIf_Srv0xF140Stop
          DcmDspRequestResultsRoutineFnc = CmnMfgSrvIf_Srv0xF140Sts
          DcmDspRoutineInfoRef = DcmDspRoutineInfo_CmnMfgSrv_SrvF140
        DcmDspRoutine_CmnMfgSrv_SrvF141 (DcmDspRoutine):
          DcmDspRequestResultsRoutineSupported = true
          DcmDspRoutineIdentifier = 61761
          DcmDspRoutineUsePort = false
          DcmDspRoutineUsed = true
          DcmDspStopRoutineSupported = true
          DcmDspRoutineFixedLength = false
          DcmDspStartRoutineFnc = CmnMfgSrvIf_Srv0xF141Strt
          DcmDspStopRoutineFnc = CmnMfgSrvIf_Srv0xF141Stop
          DcmDspRequestResultsRoutineFnc = CmnMfgSrvIf_Srv0xF141Sts
          DcmDspRoutineInfoRef = DcmDspRoutineInfo_CmnMfgSrv_SrvF141
        3 x DcmDspDid, all with DcmDspDidUsed=true, DcmDspDidUsePort=USE_DATA_ELEMENT_SPECIFIC_INTERFACES:
          DcmDspDid_CmnMfgSrv_SrvFD60: DcmDspDidIdentifier=64864, DcmDspDidInfoRef=DcmDspDidInfo_CmnMfgSrv_SrvFD60
            DcmDspDidSignal: DcmDspDidDataPos=0, DcmDspDidDataRef=DcmDspData_CmnMfgSrv_SrvFD60
          DcmDspDid_CmnMfgSrv_SrvFD62: DcmDspDidIdentifier=64866, DcmDspDidInfoRef=DcmDspDidInfo_CmnMfgSrv_SrvFD62
            DcmDspDidSignal: DcmDspDidDataPos=0, DcmDspDidDataRef=DcmDspData_CmnMfgSrv_SrvFD62
          DcmDspDid_CmnMfgSrv_SrvFD63: DcmDspDidIdentifier=64867, DcmDspDidInfoRef=DcmDspDidInfo_CmnMfgSrv_SrvFD63
            DcmDspDidSignal: DcmDspDidDataPos=0, DcmDspDidDataRef=DcmDspData_CmnMfgSrv_SrvFD63
        4 x DcmDspDataInfo, all with DcmDspDataFixedLength=true:
          DcmDspDataInfo_CmnMfgSrv_SrvFDB7
          DcmDspDataInfo_CmnMfgSrv_SrvFDB6
          DcmDspDataInfo_CmnMfgSrv_SrvFDB5
          DcmDspDataInfo_CmnMfgSrv_SrvFDBD
        DcmDspDid_CmnMfgSrv_SrvFDF8 (DcmDspDid):
          DcmDspDidIdentifier = 65016
          DcmDspDidUsed = true
          DcmDspDidUsePort = USE_DATA_ELEMENT_SPECIFIC_INTERFACES
          DcmDspDidInfoRef = DcmDspDidInfo_CmnMfgSrv_SrvFDF8
          DcmDspDidSignal: DcmDspDidDataPos=0, DcmDspDidDataRef=DcmDspData_CmnMfgSrv_SrvFDF8
        DcmDspDataInfo_CmnMfgSrv_SrvFDBC (DcmDspDataInfo): DcmDspDataFixedLength=true
        DcmDspDid_CmnMfgSrv_SrvFDF6 (DcmDspDid):
          DcmDspDidIdentifier = 65014
          DcmDspDidUsed = true
          DcmDspDidUsePort = USE_DATA_ELEMENT_SPECIFIC_INTERFACES
          DcmDspDidInfoRef = DcmDspDidInfo_CmnMfgSrv_SrvFDF6
          DcmDspDidSignal: DcmDspDidDataPos=0, DcmDspDidDataRef=DcmDspData_CmnMfgSrv_SrvFDF6
        DcmDspDid_CmnMfgSrv_SrvFDF7 (DcmDspDid):
          DcmDspDidIdentifier = 65015
          DcmDspDidUsed = true
          DcmDspDidUsePort = USE_DATA_ELEMENT_SPECIFIC_INTERFACES
          DcmDspDidInfoRef = DcmDspDidInfo_CmnMfgSrv_SrvFDF7
          DcmDspDidSignal: DcmDspDidDataPos=0, DcmDspDidDataRef=DcmDspData_CmnMfgSrv_SrvFDF7
        DcmDspDataInfo_CmnMfgSrv_SrvFDBF (DcmDspDataInfo): DcmDspDataFixedLength=true
        DcmDspDataInfo_CmnMfgSrv_SrvFDBE (DcmDspDataInfo): DcmDspDataFixedLength=true
        DcmDspDid_CmnMfgSrv_SrvFDDF (DcmDspDid):
          DcmDspDidIdentifier = 64991
          DcmDspDidUsed = true
          DcmDspDidUsePort = USE_DATA_ELEMENT_SPECIFIC_INTERFACES
          DcmDspDidInfoRef = DcmDspDidInfo_CmnMfgSrv_SrvFDDF
          DcmDspDidSignal: DcmDspDidDataPos=0, DcmDspDidDataRef=DcmDspData_CmnMfgSrv_SrvFDDF
        DcmDspDid_CmnMfgSrv_SrvFD42 (DcmDspDid):
          DcmDspDidIdentifier = 64834
          DcmDspDidUsed = true
          DcmDspDidUsePort = USE_DATA_ELEMENT_SPECIFIC_INTERFACES
          DcmDspDidInfoRef = DcmDspDidInfo_CmnMfgSrv_SrvFD42
          DcmDspDidSignal: DcmDspDidDataPos=0, DcmDspDidDataRef=DcmDspData_CmnMfgSrv_SrvFD42
        4 x DcmDspDataInfo, all with DcmDspDataFixedLength=true:
          DcmDspDataInfo_CmnMfgSrv_SrvFDC0
          DcmDspDataInfo_CmnMfgSrv_SrvFD32
          DcmDspDataInfo_CmnMfgSrv_SrvFD31
          DcmDspDataInfo_CmnMfgSrv_SrvFD30
        DcmDspRoutineInfo_CmnMfgSrv_SrvFDA5 (DcmDspRoutineInfo)
          DcmDspRoutineAuthorization: DcmDspRoutineSessionRef=DcmDspSessionRow_NXTRMFG, DcmDspRoutineSessionRef=DEFAULT_SESSION
        DcmDspRoutineInfo_CmnMfgSrv_SrvFDA4 (DcmDspRoutineInfo)
          DcmDspRoutineAuthorization: DcmDspRoutineSessionRef=DcmDspSessionRow_NXTRMFG, DcmDspRoutineSessionRef=DEFAULT_SESSION
        DcmDspDataInfo_CmnMfgSrv_SrvFD39 (DcmDspDataInfo): DcmDspDataFixedLength=true
        DcmDspDid_CmnMfgSrv_SrvFD39 (DcmDspDid):
          DcmDspDidIdentifier = 64825
          DcmDspDidUsed = true
          DcmDspDidUsePort = USE_DATA_ELEMENT_SPECIFIC_INTERFACES
          DcmDspDidInfoRef = DcmDspDidInfo_CmnMfgSrv_SrvFD39
          DcmDspDidSignal: DcmDspDidDataPos=0, DcmDspDidDataRef=DcmDspData_CmnMfgSrv_SrvFD39
        DcmDspDataInfo_CmnMfgSrv_SrvFD38 (DcmDspDataInfo): DcmDspDataFixedLength=true
        DcmDspData_CmnMfgSrv_SrvFE8C (DcmDspData):
          DcmDspDataSize = 1696
          DcmDspDataUsePort = USE_DATA_ASYNCH_FNC
          DcmDspDataType = UINT8
          DcmDspDataConditionCheckReadFncUsed = false
          DcmDspDataReadFnc = CmnMfgSrvIf_Srv0xFE8CRd
          DcmDspDataWriteFnc = CmnMfgSrvIf_Srv0xFE8CWr
          DcmDspDataInfoRef = DcmDspDataInfo_CmnMfgSrv_SrvFE8C
        DcmDspRoutine_CmnMfgSrv_SrvF000 (DcmDspRoutine):
          DcmDspRequestResultsRoutineSupported = false
          DcmDspRoutineIdentifier = 61440
          DcmDspRoutineUsePort = false
          DcmDspRoutineUsed = true
          DcmDspStopRoutineSupported = false
          DcmDspRoutineFixedLength = false
          DcmDspStartRoutineFnc = CmnMfgSrvIf_Srv0xF000Strt
          DcmDspRoutineInfoRef = DcmDspRoutineInfo_CmnMfgSrv_SrvF000
        DcmDspData_CmnMfgSrv_SrvFE8B (DcmDspData):
          DcmDspDataSize = 8
          DcmDspDataUsePort = USE_DATA_ASYNCH_FNC
          DcmDspDataType = UINT8
          DcmDspDataConditionCheckReadFncUsed = false
          DcmDspDataReadFnc = CmnMfgSrvIf_Srv0xFE8BRd
          DcmDspDataWriteFnc = CmnMfgSrvIf_Srv0xFE8BWr
          DcmDspDataInfoRef = DcmDspDataInfo_CmnMfgSrv_SrvFE8B
        DcmDspDataInfo_CmnMfgSrv_SrvFD3C (DcmDspDataInfo): DcmDspDataFixedLength=true
        DcmDspData_CmnMfgSrv_SrvFE8A (DcmDspData):
          DcmDspDataSize = 56
          DcmDspDataUsePort = USE_DATA_ASYNCH_FNC
          DcmDspDataType = UINT8
          DcmDspDataConditionCheckReadFncUsed = false
          DcmDspDataReadFnc = CmnMfgSrvIf_Srv0xFE8ARd
          DcmDspDataWriteFnc = CmnMfgSrvIf_Srv0xFE8AWr
          DcmDspDataInfoRef = DcmDspDataInfo_CmnMfgSrv_SrvFE8A
        DcmDspDid_CmnMfgSrv_SrvFD38 (DcmDspDid):
          DcmDspDidIdentifier = 64824
          DcmDspDidUsed = true
          DcmDspDidUsePort = USE_DATA_ELEMENT_SPECIFIC_INTERFACES
          DcmDspDidInfoRef = DcmDspDidInfo_CmnMfgSrv_SrvFD38
          DcmDspDidSignal: DcmDspDidDataPos=0, DcmDspDidDataRef=DcmDspData_CmnMfgSrv_SrvFD38
        DcmDspDataInfo_CmnMfgSrv_SrvFD3B (DcmDspDataInfo): DcmDspDataFixedLength=true
        DcmDspDid_CmnMfgSrv_SrvFD31 (DcmDspDid):
          DcmDspDidIdentifier = 64817
          DcmDspDidUsed = true
          DcmDspDidUsePort = USE_DATA_ELEMENT_SPECIFIC_INTERFACES
          DcmDspDidInfoRef = DcmDspDidInfo_CmnMfgSrv_SrvFD31
          DcmDspDidSignal: DcmDspDidDataPos=0, DcmDspDidDataRef=DcmDspData_CmnMfgSrv_SrvFD31
        DcmDspDataInfo_CmnMfgSrv_SrvFD3A (DcmDspDataInfo): DcmDspDataFixedLength=true
        DcmDspDid_CmnMfgSrv_SrvFD32 (DcmDspDid):
          DcmDspDidIdentifier = 64818
          DcmDspDidUsed = true
          DcmDspDidUsePort = USE_DATA_ELEMENT_SPECIFIC_INTERFACES
          DcmDspDidInfoRef = DcmDspDidInfo_CmnMfgSrv_SrvFD32
          DcmDspDidSignal: DcmDspDidDataPos=0, DcmDspDidDataRef=DcmDspData_CmnMfgSrv_SrvFD32
        DcmDspRoutine_CmnMfgSrv_SrvF001 (DcmDspRoutine):
          DcmDspRequestResultsRoutineSupported = false
          DcmDspRoutineIdentifier = 61441
          DcmDspRoutineUsePort = false
          DcmDspRoutineUsed = true
          DcmDspStopRoutineSupported = false
          DcmDspRoutineFixedLength = false
          DcmDspStartRoutineFnc = CmnMfgSrvIf_Srv0xF001Strt
          DcmDspRoutineInfoRef = DcmDspRoutineInfo_CmnMfgSrv_SrvF001
        DcmDspRoutine_CmnMfgSrv_SrvF002 (DcmDspRoutine):
          DcmDspRequestResultsRoutineSupported = false
          DcmDspRoutineIdentifier = 61442
          DcmDspRoutineUsePort = false
          DcmDspRoutineUsed = true
          DcmDspStopRoutineSupported = false
          DcmDspRoutineFixedLength = false
          DcmDspStartRoutineFnc = CmnMfgSrvIf_Srv0xF002Strt
          DcmDspRoutineInfoRef = DcmDspRoutineInfo_CmnMfgSrv_SrvF002
        DcmDspRoutineInfo_CmnMfgSrv_SrvFDAF (DcmDspRoutineInfo)
          DcmDspRoutineAuthorization: DcmDspRoutineSessionRef=DcmDspSessionRow_NXTRMFG, DcmDspRoutineSessionRef=DEFAULT_SESSION
        DcmDspRoutineInfo_CmnMfgSrv_SrvFDAE (DcmDspRoutineInfo)
          DcmDspRoutineAuthorization: DcmDspRoutineSessionRef=DcmDspSessionRow_NXTRMFG, DcmDspRoutineSessionRef=DEFAULT_SESSION
        DcmDspDid_CmnMfgSrv_SrvFD40 (DcmDspDid):
          DcmDspDidIdentifier = 64832
          DcmDspDidUsed = true
          DcmDspDidUsePort = USE_DATA_ELEMENT_SPECIFIC_INTERFACES
          DcmDspDidInfoRef = DcmDspDidInfo_CmnMfgSrv_SrvFD40
          DcmDspDidSignal: DcmDspDidDataPos=0, DcmDspDidDataRef=DcmDspData_CmnMfgSrv_SrvFD40
        DcmDspData_CmnMfgSrv_SrvFDF8 (DcmDspData):
          DcmDspDataSize = 64
          DcmDspDataUsePort = USE_DATA_ASYNCH_FNC
          DcmDspDataType = UINT8
          DcmDspDataConditionCheckReadFncUsed = false
          DcmDspDataReadFnc = CmnMfgSrvIf_Srv0xFDF8Rd
          DcmDspDataWriteFnc = CmnMfgSrvIf_Srv0xFDF8Wr
          DcmDspDataInfoRef = DcmDspDataInfo_CmnMfgSrv_SrvFDF8
        DcmDspRoutineInfo_CmnMfgSrv_SrvFDAD (DcmDspRoutineInfo)
          DcmDspRoutineAuthorization: DcmDspRoutineSessionRef=DcmDspSessionRow_NXTRMFG, DcmDspRoutineSessionRef=DEFAULT_SESSION
        DcmDspDid_CmnMfgSrv_SrvFD41 (DcmDspDid):
          DcmDspDidIdentifier = 64833
          DcmDspDidUsed = true
          DcmDspDidUsePort = USE_DATA_ELEMENT_SPECIFIC_INTERFACES
          DcmDspDidInfoRef = DcmDspDidInfo_CmnMfgSrv_SrvFD41
          DcmDspDidSignal: DcmDspDidDataPos=0, DcmDspDidDataRef=DcmDspData_CmnMfgSrv_SrvFD41
        DcmDspData_CmnMfgSrv_SrvFDF7 (DcmDspData):
          DcmDspDataSize = 224
          DcmDspDataUsePort = USE_DATA_ASYNCH_FNC
          DcmDspDataType = UINT8
          DcmDspDataConditionCheckReadFncUsed = false
          DcmDspDataReadFnc = CmnMfgSrvIf_Srv0xFDF7Rd
          DcmDspDataWriteFnc = CmnMfgSrvIf_Srv0xFDF7Wr
          DcmDspDataInfoRef = DcmDspDataInfo_CmnMfgSrv_SrvFDF7
        DcmDspDataInfo_CmnMfgSrv_SrvFDD7 (DcmDspDataInfo): DcmDspDataFixedLength=true
        DcmDspData_CmnMfgSrv_SrvFD62 (DcmDspData):
          DcmDspDataSize = 2048
          DcmDspDataUsePort = USE_DATA_ASYNCH_FNC
          DcmDspDataType = UINT8
          DcmDspDataConditionCheckReadFncUsed = false
          DcmDspDataReadFnc = CmnMfgSrvIf_Srv0xFD62Rd
          DcmDspDataInfoRef = DcmDspDataInfo_CmnMfgSrv_SrvFD62
        DcmDspDataInfo_CmnMfgSrv_SrvFDDF (DcmDspDataInfo): DcmDspDataFixedLength=true
        DcmDspDid_CmnMfgSrv_SrvFDD7 (DcmDspDid):
          DcmDspDidIdentifier = 64983
          DcmDspDidUsed = true
          DcmDspDidUsePort = USE_DATA_ELEMENT_SPECIFIC_INTERFACES
          DcmDspDidInfoRef = DcmDspDidInfo_CmnMfgSrv_SrvFDD7
          DcmDspDidSignal: DcmDspDidDataPos=0, DcmDspDidDataRef=DcmDspData_CmnMfgSrv_SrvFDD7
        DcmDspRoutine_CmnMfgSrv_SrvFD70 (DcmDspRoutine):
          DcmDspRequestResultsRoutineSupported = false
          DcmDspRoutineIdentifier = 64880
          DcmDspRoutineUsePort = false
          DcmDspRoutineUsed = true
          DcmDspStopRoutineSupported = false
          DcmDspRoutineFixedLength = false
          DcmDspStartRoutineFnc = CmnMfgSrvIf_Srv0xFD70Strt
          DcmDspRoutineInfoRef = DcmDspRoutineInfo_CmnMfgSrv_SrvFD70
        DcmDspDidInfo_CmnMfgSrv_SrvF1FD (DcmDspDidInfo): DcmDspDidDynamicallyDefined=false
          DcmDspDidAccess
            DcmDspDidRead: DcmDspDidReadSessionRef=DcmDspSessionRow_NXTRMFG
        DcmDspData_CmnMfgSrv_SrvFD60 (DcmDspData):
          DcmDspDataSize = 800
          DcmDspDataUsePort = USE_DATA_ASYNCH_FNC
          DcmDspDataType = UINT8
          DcmDspDataConditionCheckReadFncUsed = false
          DcmDspDataReadFnc = CmnMfgSrvIf_Srv0xFD60Rd
          DcmDspDataInfoRef = DcmDspDataInfo_CmnMfgSrv_SrvFD60
        DcmDspRoutine_CmnMfgSrv_SrvFD71 (DcmDspRoutine):
          DcmDspRequestResultsRoutineSupported = false
          DcmDspRoutineIdentifier = 64881
          DcmDspRoutineUsePort = false
          DcmDspRoutineUsed = true
          DcmDspStopRoutineSupported = false
          DcmDspRoutineFixedLength = false
          DcmDspStartRoutineFnc = CmnMfgSrvIf_Srv0xFD71Strt
          DcmDspRoutineInfoRef = DcmDspRoutineInfo_CmnMfgSrv_SrvFD71
        DcmDspRoutineInfo_CmnMfgSrv_SrvFDAC (DcmDspRoutineInfo)
          DcmDspRoutineAuthorization: DcmDspRoutineSessionRef=DcmDspSessionRow_NXTRMFG, DcmDspRoutineSessionRef=DEFAULT_SESSION
        DcmDspDidInfo_CmnMfgSrv_SrvF1FF (DcmDspDidInfo): DcmDspDidDynamicallyDefined=false
          DcmDspDidAccess
            DcmDspDidRead: DcmDspDidReadSessionRef=DcmDspSessionRow_NXTRMFG
        DcmDspDid_CmnMfgSrv_SrvFD3A (DcmDspDid):
          DcmDspDidIdentifier = 64826
          DcmDspDidUsed = true
          DcmDspDidUsePort = USE_DATA_ELEMENT_SPECIFIC_INTERFACES
          DcmDspDidInfoRef = DcmDspDidInfo_CmnMfgSrv_SrvFD3A
          DcmDspDidSignal: DcmDspDidDataPos=0, DcmDspDidDataRef=DcmDspData_CmnMfgSrv_SrvFD3A
        DcmDspDataInfo_CmnMfgSrv_SrvFD42 (DcmDspDataInfo): DcmDspDataFixedLength=true
        DcmDspDidInfo_CmnMfgSrv_SrvF1FE (DcmDspDidInfo): DcmDspDidDynamicallyDefined=false
          DcmDspDidAccess
            DcmDspDidRead: DcmDspDidReadSessionRef=DcmDspSessionRow_NXTRMFG
        DcmDspDid_CmnMfgSrv_SrvFD3B (DcmDspDid):
          DcmDspDidIdentifier = 64827
          DcmDspDidUsed = true
          DcmDspDidUsePort = USE_DATA_ELEMENT_SPECIFIC_INTERFACES
          DcmDspDidInfoRef = DcmDspDidInfo_CmnMfgSrv_SrvFD3B
          DcmDspDidSignal: DcmDspDidDataPos=0, DcmDspDidDataRef=DcmDspData_CmnMfgSrv_SrvFD3B
        DcmDspDataInfo_CmnMfgSrv_SrvFD41 (DcmDspDataInfo): DcmDspDataFixedLength=true
        DcmDspRoutine_CmnMfgSrv_SrvF11A (DcmDspRoutine):
          DcmDspRequestResultsRoutineSupported = true
          DcmDspRoutineIdentifier = 61722
          DcmDspRoutineUsePort = false
          DcmDspRoutineUsed = true
          DcmDspStopRoutineSupported = true
          DcmDspRoutineFixedLength = false
          DcmDspStartRoutineFnc = CmnMfgSrvIf_Srv0xF11AStrt
          DcmDspStopRoutineFnc = CmnMfgSrvIf_Srv0xF11AStop
          DcmDspRequestResultsRoutineFnc = CmnMfgSrvIf_Srv0xF11ASts
          DcmDspRoutineInfoRef = DcmDspRoutineInfo_CmnMfgSrv_SrvF11A
        DcmDspDid_CmnMfgSrv_SrvFD3C (DcmDspDid):
          DcmDspDidIdentifier = 64828
          DcmDspDidUsed = true
          DcmDspDidUsePort = USE_DATA_ELEMENT_SPECIFIC_INTERFACES
          DcmDspDidInfoRef = DcmDspDidInfo_CmnMfgSrv_SrvFD3C
          DcmDspDidSignal: DcmDspDidDataPos=0, DcmDspDidDataRef=DcmDspData_CmnMfgSrv_SrvFD3C
        DcmDspDataInfo_CmnMfgSrv_SrvFD40 (DcmDspDataInfo): DcmDspDataFixedLength=true
        DcmDspData_CmnMfgSrv_SrvFD63 (DcmDspData):
          DcmDspDataSize = 160
          DcmDspDataUsePort = USE_DATA_ASYNCH_FNC
          DcmDspDataType = UINT8
          DcmDspDataConditionCheckReadFncUsed = false
          DcmDspDataReadFnc = CmnMfgSrvIf_Srv0xFD63Rd
          DcmDspDataInfoRef = DcmDspDataInfo_CmnMfgSrv_SrvFD63
        4 x DcmDspRoutine, all with DcmDspRequestResultsRoutineSupported=true, DcmDspRoutineUsePort=false, DcmDspRoutineUsed=true, DcmDspStopRoutineSupported=true, DcmDspRoutineFixedLength=false:
          DcmDspRoutine_CmnMfgSrv_SrvF117: DcmDspRoutineIdentifier=61719, DcmDspStartRoutineFnc=CmnMfgSrvIf_Srv0xF117Strt, DcmDspStopRoutineFnc=CmnMfgSrvIf_Srv0xF117Stop, DcmDspRequestResultsRoutineFnc=CmnMfgSrvIf_Srv0xF117Sts, DcmDspRoutineInfoRef=DcmDspRoutineInfo_CmnMfgSrv_SrvF117
          DcmDspRoutine_CmnMfgSrv_SrvF118: DcmDspRoutineIdentifier=61720, DcmDspStartRoutineFnc=CmnMfgSrvIf_Srv0xF118Strt, DcmDspStopRoutineFnc=CmnMfgSrvIf_Srv0xF118Stop, DcmDspRequestResultsRoutineFnc=CmnMfgSrvIf_Srv0xF118Sts, DcmDspRoutineInfoRef=DcmDspRoutineInfo_CmnMfgSrv_SrvF118
          DcmDspRoutine_CmnMfgSrv_SrvF115: DcmDspRoutineIdentifier=61717, DcmDspStartRoutineFnc=CmnMfgSrvIf_Srv0xF115Strt, DcmDspStopRoutineFnc=CmnMfgSrvIf_Srv0xF115Stop, DcmDspRequestResultsRoutineFnc=CmnMfgSrvIf_Srv0xF115Sts, DcmDspRoutineInfoRef=DcmDspRoutineInfo_CmnMfgSrv_SrvF115
          DcmDspRoutine_CmnMfgSrv_SrvF116: DcmDspRoutineIdentifier=61718, DcmDspStartRoutineFnc=CmnMfgSrvIf_Srv0xF116Strt, DcmDspStopRoutineFnc=CmnMfgSrvIf_Srv0xF116Stop, DcmDspRequestResultsRoutineFnc=CmnMfgSrvIf_Srv0xF116Sts, DcmDspRoutineInfoRef=DcmDspRoutineInfo_CmnMfgSrv_SrvF116
        DcmDspDid_CmnMfgSrv_SrvFDC0 (DcmDspDid):
          DcmDspDidIdentifier = 64960
          DcmDspDidUsed = true
          DcmDspDidUsePort = USE_DATA_ELEMENT_SPECIFIC_INTERFACES
          DcmDspDidInfoRef = DcmDspDidInfo_CmnMfgSrv_SrvFDC0
          DcmDspDidSignal: DcmDspDidDataPos=0, DcmDspDidDataRef=DcmDspData_CmnMfgSrv_SrvFDC0
        DcmDspRoutine_CmnMfgSrv_SrvF119 (DcmDspRoutine):
          DcmDspRequestResultsRoutineSupported = true
          DcmDspRoutineIdentifier = 61721
          DcmDspRoutineUsePort = false
          DcmDspRoutineUsed = true
          DcmDspStopRoutineSupported = true
          DcmDspRoutineFixedLength = false
          DcmDspStartRoutineFnc = CmnMfgSrvIf_Srv0xF119Strt
          DcmDspStopRoutineFnc = CmnMfgSrvIf_Srv0xF119Stop
          DcmDspRequestResultsRoutineFnc = CmnMfgSrvIf_Srv0xF119Sts
          DcmDspRoutineInfoRef = DcmDspRoutineInfo_CmnMfgSrv_SrvF119
        DcmDspDid_CmnMfgSrv_SrvFDBD (DcmDspDid):
          DcmDspDidIdentifier = 64957
          DcmDspDidUsed = true
          DcmDspDidUsePort = USE_DATA_ELEMENT_SPECIFIC_INTERFACES
          DcmDspDidInfoRef = DcmDspDidInfo_CmnMfgSrv_SrvFDBD
          DcmDspDidSignal: DcmDspDidDataPos=0, DcmDspDidDataRef=DcmDspData_CmnMfgSrv_SrvFDBD
        DcmDspRoutine_CmnMfgSrv_SrvF110 (DcmDspRoutine):
          DcmDspRequestResultsRoutineSupported = true
          DcmDspRoutineIdentifier = 61712
          DcmDspRoutineUsePort = false
          DcmDspRoutineUsed = true
          DcmDspStopRoutineSupported = true
          DcmDspRoutineFixedLength = false
          DcmDspStartRoutineFnc = CmnMfgSrvIf_Srv0xF110Strt
          DcmDspStopRoutineFnc = CmnMfgSrvIf_Srv0xF110Stop
          DcmDspRequestResultsRoutineFnc = CmnMfgSrvIf_Srv0xF110Sts
          DcmDspRoutineInfoRef = DcmDspRoutineInfo_CmnMfgSrv_SrvF110
        DcmDspDid_CmnMfgSrv_SrvFDBE (DcmDspDid):
          DcmDspDidIdentifier = 64958
          DcmDspDidUsed = true
          DcmDspDidUsePort = USE_DATA_ELEMENT_SPECIFIC_INTERFACES
          DcmDspDidInfoRef = DcmDspDidInfo_CmnMfgSrv_SrvFDBE
          DcmDspDidSignal: DcmDspDidDataPos=0, DcmDspDidDataRef=DcmDspData_CmnMfgSrv_SrvFDBE
        DcmDspDid_CmnMfgSrv_SrvFDBF (DcmDspDid):
          DcmDspDidIdentifier = 64959
          DcmDspDidUsed = true
          DcmDspDidUsePort = USE_DATA_ELEMENT_SPECIFIC_INTERFACES
          DcmDspDidInfoRef = DcmDspDidInfo_CmnMfgSrv_SrvFDBF
          DcmDspDidSignal: DcmDspDidDataPos=0, DcmDspDidDataRef=DcmDspData_CmnMfgSrv_SrvFDBF
        4 x DcmDspRoutine, all with DcmDspRequestResultsRoutineSupported=true, DcmDspRoutineUsePort=false, DcmDspRoutineUsed=true, DcmDspStopRoutineSupported=true, DcmDspRoutineFixedLength=false:
          DcmDspRoutine_CmnMfgSrv_SrvF113: DcmDspRoutineIdentifier=61715, DcmDspStartRoutineFnc=CmnMfgSrvIf_Srv0xF113Strt, DcmDspStopRoutineFnc=CmnMfgSrvIf_Srv0xF113Stop, DcmDspRequestResultsRoutineFnc=CmnMfgSrvIf_Srv0xF113Sts, DcmDspRoutineInfoRef=DcmDspRoutineInfo_CmnMfgSrv_SrvF113
          DcmDspRoutine_CmnMfgSrv_SrvF114: DcmDspRoutineIdentifier=61716, DcmDspStartRoutineFnc=CmnMfgSrvIf_Srv0xF114Strt, DcmDspStopRoutineFnc=CmnMfgSrvIf_Srv0xF114Stop, DcmDspRequestResultsRoutineFnc=CmnMfgSrvIf_Srv0xF114Sts, DcmDspRoutineInfoRef=DcmDspRoutineInfo_CmnMfgSrv_SrvF114
          DcmDspRoutine_CmnMfgSrv_SrvF111: DcmDspRoutineIdentifier=61713, DcmDspStartRoutineFnc=CmnMfgSrvIf_Srv0xF111Strt, DcmDspStopRoutineFnc=CmnMfgSrvIf_Srv0xF111Stop, DcmDspRequestResultsRoutineFnc=CmnMfgSrvIf_Srv0xF111Sts, DcmDspRoutineInfoRef=DcmDspRoutineInfo_CmnMfgSrv_SrvF111
          DcmDspRoutine_CmnMfgSrv_SrvF112: DcmDspRoutineIdentifier=61714, DcmDspStartRoutineFnc=CmnMfgSrvIf_Srv0xF112Strt, DcmDspStopRoutineFnc=CmnMfgSrvIf_Srv0xF112Stop, DcmDspRequestResultsRoutineFnc=CmnMfgSrvIf_Srv0xF112Sts, DcmDspRoutineInfoRef=DcmDspRoutineInfo_CmnMfgSrv_SrvF112
        DcmDspDid_CmnMfgSrv_SrvFDBC (DcmDspDid):
          DcmDspDidIdentifier = 64956
          DcmDspDidUsed = true
          DcmDspDidUsePort = USE_DATA_ELEMENT_SPECIFIC_INTERFACES
          DcmDspDidInfoRef = DcmDspDidInfo_CmnMfgSrv_SrvFDBC
          DcmDspDidSignal: DcmDspDidDataPos=0, DcmDspDidDataRef=DcmDspData_CmnMfgSrv_SrvFDBC
        3 x DcmDspRoutine, all with DcmDspRequestResultsRoutineSupported=false, DcmDspRoutineUsePort=false, DcmDspRoutineUsed=true, DcmDspStopRoutineSupported=false, DcmDspRoutineFixedLength=false:
          DcmDspRoutine_CmnMfgSrv_SrvFE88: DcmDspRoutineIdentifier=65160, DcmDspStartRoutineFnc=CmnMfgSrvIf_Srv0xFE88Strt, DcmDspRoutineInfoRef=DcmDspRoutineInfo_CmnMfgSrv_SrvFE88
          DcmDspRoutine_CmnMfgSrv_SrvFD68: DcmDspRoutineIdentifier=64872, DcmDspStartRoutineFnc=CmnMfgSrvIf_Srv0xFD68Strt, DcmDspRoutineInfoRef=DcmDspRoutineInfo_CmnMfgSrv_SrvFD68
          DcmDspRoutine_CmnMfgSrv_SrvFE89: DcmDspRoutineIdentifier=65161, DcmDspStartRoutineFnc=CmnMfgSrvIf_Srv0xFE89Strt, DcmDspRoutineInfoRef=DcmDspRoutineInfo_CmnMfgSrv_SrvFE89
        DcmDspDid_CmnMfgSrv_SrvFD30 (DcmDspDid):
          DcmDspDidIdentifier = 64816
          DcmDspDidUsed = true
          DcmDspDidUsePort = USE_DATA_ELEMENT_SPECIFIC_INTERFACES
          DcmDspDidInfoRef = DcmDspDidInfo_CmnMfgSrv_SrvFD30
          DcmDspDidSignal: DcmDspDidDataPos=0, DcmDspDidDataRef=DcmDspData_CmnMfgSrv_SrvFD30
        DcmDspData_CmnMfgSrv_SrvFE90 (DcmDspData):
          DcmDspDataSize = 32
          DcmDspDataUsePort = USE_DATA_ASYNCH_FNC
          DcmDspDataType = UINT8
          DcmDspDataConditionCheckReadFncUsed = false
          DcmDspDataReadFnc = CmnMfgSrvIf_Srv0xFE90Rd
          DcmDspDataWriteFnc = CmnMfgSrvIf_Srv0xFE90Wr
          DcmDspDataInfoRef = DcmDspDataInfo_CmnMfgSrv_SrvFE90
        DcmDspRoutineInfo_CmnMfgSrv_SrvFE20 (DcmDspRoutineInfo)
          DcmDspRoutineAuthorization: DcmDspRoutineSessionRef=DcmDspSessionRow_NXTRMFG, DcmDspRoutineSessionRef=DEFAULT_SESSION
          DcmDspStartRoutineIn
            DcmDspStartRoutineInSignal: DcmDspRoutineSignalLength=64, DcmDspRoutineSignalPos=0, DcmDspRoutineSignalType=UINT8
          DcmDspRoutineStopIn
            DcmDspRoutineStopInSignal: DcmDspRoutineSignalLength=32, DcmDspRoutineSignalPos=0, DcmDspRoutineSignalType=UINT8
        DcmDspRoutine_CmnMfgSrv_SrvFDF1 (DcmDspRoutine):
          DcmDspRequestResultsRoutineSupported = true
          DcmDspRoutineIdentifier = 65009
          DcmDspRoutineUsePort = false
          DcmDspRoutineUsed = true
          DcmDspStopRoutineSupported = false
          DcmDspRoutineFixedLength = false
          DcmDspStartRoutineFnc = CmnMfgSrvIf_Srv0xFDF1Strt
          DcmDspRequestResultsRoutineFnc = CmnMfgSrvIf_Srv0xFDF1Sts
          DcmDspRoutineInfoRef = DcmDspRoutineInfo_CmnMfgSrv_SrvFDF1
        3 x DcmDspDataInfo, all with DcmDspDataFixedLength=true:
          DcmDspDataInfo_CmnMfgSrv_SrvFDF8
          DcmDspDataInfo_CmnMfgSrv_SrvFDF7
          DcmDspDataInfo_CmnMfgSrv_SrvFDF6
        DcmDspRoutine_CmnMfgSrv_SrvFDF0 (DcmDspRoutine):
          DcmDspRequestResultsRoutineSupported = true
          DcmDspRoutineIdentifier = 65008
          DcmDspRoutineUsePort = false
          DcmDspRoutineUsed = true
          DcmDspStopRoutineSupported = false
          DcmDspRoutineFixedLength = false
          DcmDspStartRoutineFnc = CmnMfgSrvIf_Srv0xFDF0Strt
          DcmDspRequestResultsRoutineFnc = CmnMfgSrvIf_Srv0xFDF0Sts
          DcmDspRoutineInfoRef = DcmDspRoutineInfo_CmnMfgSrv_SrvFDF0
        DcmDspRoutineInfo_CmnMfgSrv_SrvFEA1 (DcmDspRoutineInfo)
          DcmDspRoutineAuthorization: DcmDspRoutineSessionRef=DcmDspSessionRow_NXTRMFG, DcmDspRoutineSessionRef=DEFAULT_SESSION
        DcmDspRoutine_CmnMfgSrv_SrvF100 (DcmDspRoutine):
          DcmDspRequestResultsRoutineSupported = true
          DcmDspRoutineIdentifier = 61696
          DcmDspRoutineUsePort = false
          DcmDspRoutineUsed = true
          DcmDspStopRoutineSupported = true
          DcmDspRoutineFixedLength = false
          DcmDspStartRoutineFnc = CmnMfgSrvIf_Srv0xF100Strt
          DcmDspStopRoutineFnc = CmnMfgSrvIf_Srv0xF100Stop
          DcmDspRequestResultsRoutineFnc = CmnMfgSrvIf_Srv0xF100Sts
          DcmDspRoutineInfoRef = DcmDspRoutineInfo_CmnMfgSrv_SrvF100
        DcmDspRoutine_CmnMfgSrv_SrvF101 (DcmDspRoutine):
          DcmDspRequestResultsRoutineSupported = true
          DcmDspRoutineIdentifier = 61697
          DcmDspRoutineUsePort = false
          DcmDspRoutineUsed = true
          DcmDspStopRoutineSupported = true
          DcmDspRoutineFixedLength = false
          DcmDspStartRoutineFnc = CmnMfgSrvIf_Srv0xF101Strt
          DcmDspStopRoutineFnc = CmnMfgSrvIf_Srv0xF101Stop
          DcmDspRequestResultsRoutineFnc = CmnMfgSrvIf_Srv0xF101Sts
          DcmDspRoutineInfoRef = DcmDspRoutineInfo_CmnMfgSrv_SrvF101
        DcmDspDataInfo_CmnMfgSrv_SrvFD60 (DcmDspDataInfo): DcmDspDataFixedLength=true
        4 x DcmDspDid, all with DcmDspDidUsed=true, DcmDspDidUsePort=USE_DATA_ELEMENT_SPECIFIC_INTERFACES:
          DcmDspDid_CmnMfgSrv_SrvFDB4: DcmDspDidIdentifier=64948, DcmDspDidInfoRef=DcmDspDidInfo_CmnMfgSrv_SrvFDB4
            DcmDspDidSignal: DcmDspDidDataPos=0, DcmDspDidDataRef=DcmDspData_CmnMfgSrv_SrvFDB4
          DcmDspDid_CmnMfgSrv_SrvFDB5: DcmDspDidIdentifier=64949, DcmDspDidInfoRef=DcmDspDidInfo_CmnMfgSrv_SrvFDB5
            DcmDspDidSignal: DcmDspDidDataPos=0, DcmDspDidDataRef=DcmDspData_CmnMfgSrv_SrvFDB5
          DcmDspDid_CmnMfgSrv_SrvFDB6: DcmDspDidIdentifier=64950, DcmDspDidInfoRef=DcmDspDidInfo_CmnMfgSrv_SrvFDB6
            DcmDspDidSignal: DcmDspDidDataPos=0, DcmDspDidDataRef=DcmDspData_CmnMfgSrv_SrvFDB6
          DcmDspDid_CmnMfgSrv_SrvFDB7: DcmDspDidIdentifier=64951, DcmDspDidInfoRef=DcmDspDidInfo_CmnMfgSrv_SrvFDB7
            DcmDspDidSignal: DcmDspDidDataPos=0, DcmDspDidDataRef=DcmDspData_CmnMfgSrv_SrvFDB7
        3 x DcmDspDataInfo, all with DcmDspDataFixedLength=true:
          DcmDspDataInfo_CmnMfgSrv_SrvFD63
          DcmDspDataInfo_CmnMfgSrv_SrvFD62
          DcmDspDataInfo_CmnMfgSrv_SrvFE8A
        6 x DcmDspDid, all with DcmDspDidUsed=true, DcmDspDidUsePort=USE_DATA_ELEMENT_SPECIFIC_INTERFACES:
          DcmDspDid_CmnMfgSrv_SrvFD06: DcmDspDidIdentifier=64774, DcmDspDidInfoRef=DcmDspDidInfo_CmnMfgSrv_SrvFD06
            DcmDspDidSignal: DcmDspDidDataPos=0, DcmDspDidDataRef=DcmDspData_CmnMfgSrv_SrvFD06
          DcmDspDid_CmnMfgSrv_SrvFD02: DcmDspDidIdentifier=64770, DcmDspDidInfoRef=DcmDspDidInfo_CmnMfgSrv_SrvFD02
            DcmDspDidSignal: DcmDspDidDataPos=0, DcmDspDidDataRef=DcmDspData_CmnMfgSrv_SrvFD02
          DcmDspDid_CmnMfgSrv_SrvFD03: DcmDspDidIdentifier=64771, DcmDspDidInfoRef=DcmDspDidInfo_CmnMfgSrv_SrvFD03
            DcmDspDidSignal: DcmDspDidDataPos=0, DcmDspDidDataRef=DcmDspData_CmnMfgSrv_SrvFD03
          DcmDspDid_CmnMfgSrv_SrvFD05: DcmDspDidIdentifier=64773, DcmDspDidInfoRef=DcmDspDidInfo_CmnMfgSrv_SrvFD05
            DcmDspDidSignal: DcmDspDidDataPos=0, DcmDspDidDataRef=DcmDspData_CmnMfgSrv_SrvFD05
          DcmDspDid_CmnMfgSrv_SrvFD00: DcmDspDidIdentifier=64768, DcmDspDidInfoRef=DcmDspDidInfo_CmnMfgSrv_SrvFD00
            DcmDspDidSignal: DcmDspDidDataPos=0, DcmDspDidDataRef=DcmDspData_CmnMfgSrv_SrvFD00
          DcmDspDid_CmnMfgSrv_SrvFE21: DcmDspDidIdentifier=65057, DcmDspDidInfoRef=DcmDspDidInfo_CmnMfgSrv_SrvFE21
            DcmDspDidSignal: DcmDspDidDataPos=0, DcmDspDidDataRef=DcmDspData_CmnMfgSrv_SrvFE21
        DcmDspDataInfo_CmnMfgSrv_SrvFE8C (DcmDspDataInfo): DcmDspDataFixedLength=true
        DcmDspDid_CmnMfgSrv_SrvFD01 (DcmDspDid):
          DcmDspDidIdentifier = 64769
          DcmDspDidUsed = true
          DcmDspDidUsePort = USE_DATA_ELEMENT_SPECIFIC_INTERFACES
          DcmDspDidInfoRef = DcmDspDidInfo_CmnMfgSrv_SrvFD01
          DcmDspDidSignal: DcmDspDidDataPos=0, DcmDspDidDataRef=DcmDspData_CmnMfgSrv_SrvFD01
        DcmDspDataInfo_CmnMfgSrv_SrvFE8B (DcmDspDataInfo): DcmDspDataFixedLength=true
        DcmDspDataInfo_CmnMfgSrv_SrvFE90 (DcmDspDataInfo): DcmDspDataFixedLength=true
        4 x DcmDspData, all with DcmDspDataSize=8, DcmDspDataUsePort=USE_DATA_ASYNCH_FNC, DcmDspDataType=UINT8, DcmDspDataConditionCheckReadFncUsed=false:
          DcmDspData_CmnMfgSrv_SrvFDBF: DcmDspDataReadFnc=CmnMfgSrvIf_Srv0xFDBFRd, DcmDspDataInfoRef=DcmDspDataInfo_CmnMfgSrv_SrvFDBF
          DcmDspData_CmnMfgSrv_SrvFDBE: DcmDspDataReadFnc=CmnMfgSrvIf_Srv0xFDBERd, DcmDspDataInfoRef=DcmDspDataInfo_CmnMfgSrv_SrvFDBE
          DcmDspData_CmnMfgSrv_SrvFDBD: DcmDspDataReadFnc=CmnMfgSrvIf_Srv0xFDBDRd, DcmDspDataInfoRef=DcmDspDataInfo_CmnMfgSrv_SrvFDBD
          DcmDspData_CmnMfgSrv_SrvFDBC: DcmDspDataReadFnc=CmnMfgSrvIf_Srv0xFDBCRd, DcmDspDataInfoRef=DcmDspDataInfo_CmnMfgSrv_SrvFDBC
        DcmDspRoutine_CmnMfgSrv_SrvF200 (DcmDspRoutine):
          DcmDspRequestResultsRoutineSupported = false
          DcmDspRoutineIdentifier = 61952
          DcmDspRoutineUsePort = false
          DcmDspRoutineUsed = true
          DcmDspStopRoutineSupported = false
          DcmDspRoutineFixedLength = false
          DcmDspStartRoutineFnc = CmnMfgSrvIf_Srv0xF200Strt
          DcmDspRoutineInfoRef = DcmDspRoutineInfo_CmnMfgSrv_SrvF200
        5 x DcmDspData, all with DcmDspDataUsePort=USE_DATA_ASYNCH_FNC, DcmDspDataType=UINT8, DcmDspDataConditionCheckReadFncUsed=false:
          DcmDspData_CmnMfgSrv_SrvFDC0: DcmDspDataSize=16, DcmDspDataReadFnc=CmnMfgSrvIf_Srv0xFDC0Rd, DcmDspDataWriteFnc=CmnMfgSrvIf_Srv0xFDC0Wr, DcmDspDataInfoRef=DcmDspDataInfo_CmnMfgSrv_SrvFDC0
          DcmDspData_CmnMfgSrv_SrvFDB6: DcmDspDataSize=32, DcmDspDataReadFnc=CmnMfgSrvIf_Srv0xFDB6Rd, DcmDspDataWriteFnc=CmnMfgSrvIf_Srv0xFDB6Wr, DcmDspDataInfoRef=DcmDspDataInfo_CmnMfgSrv_SrvFDB6
          DcmDspData_CmnMfgSrv_SrvFDB5: DcmDspDataSize=32, DcmDspDataReadFnc=CmnMfgSrvIf_Srv0xFDB5Rd, DcmDspDataWriteFnc=CmnMfgSrvIf_Srv0xFDB5Wr, DcmDspDataInfoRef=DcmDspDataInfo_CmnMfgSrv_SrvFDB5
          DcmDspData_CmnMfgSrv_SrvFDB4: DcmDspDataSize=32, DcmDspDataReadFnc=CmnMfgSrvIf_Srv0xFDB4Rd, DcmDspDataWriteFnc=CmnMfgSrvIf_Srv0xFDB4Wr, DcmDspDataInfoRef=DcmDspDataInfo_CmnMfgSrv_SrvFDB4
          DcmDspData_CmnMfgSrv_SrvFDB7: DcmDspDataSize=32, DcmDspDataReadFnc=CmnMfgSrvIf_Srv0xFDB7Rd, DcmDspDataWriteFnc=CmnMfgSrvIf_Srv0xFDB7Wr, DcmDspDataInfoRef=DcmDspDataInfo_CmnMfgSrv_SrvFDB7
        DcmDspDid_CmnMfgSrv_SrvF195 (DcmDspDid):
          DcmDspDidIdentifier = 61845
          DcmDspDidUsed = true
          DcmDspDidUsePort = USE_DATA_ELEMENT_SPECIFIC_INTERFACES
          DcmDspDidInfoRef = DcmDspDidInfo_CmnMfgSrv_SrvF195
          DcmDspDidSignal: DcmDspDidDataPos=0, DcmDspDidDataRef=DcmDspData_CmnMfgSrv_SrvF195
        DcmDspDid_CmnMfgSrv_SrvF194 (DcmDspDid):
          DcmDspDidIdentifier = 61844
          DcmDspDidUsed = true
          DcmDspDidUsePort = USE_DATA_ELEMENT_SPECIFIC_INTERFACES
          DcmDspDidInfoRef = DcmDspDidInfo_CmnMfgSrv_SrvF194
          DcmDspDidSignal: DcmDspDidDataPos=0, DcmDspDidDataRef=DcmDspData_CmnMfgSrv_SrvF194
        5 x DcmDspData, all with DcmDspDataSize=128, DcmDspDataUsePort=USE_DATA_ASYNCH_FNC, DcmDspDataType=UINT8, DcmDspDataConditionCheckReadFncUsed=false:
          DcmDspData_CmnMfgSrv_SrvFD39: DcmDspDataReadFnc=CmnMfgSrvIf_Srv0xFD39Rd, DcmDspDataWriteFnc=CmnMfgSrvIf_Srv0xFD39Wr, DcmDspDataInfoRef=DcmDspDataInfo_CmnMfgSrv_SrvFD39
          DcmDspData_CmnMfgSrv_SrvFD38: DcmDspDataReadFnc=CmnMfgSrvIf_Srv0xFD38Rd, DcmDspDataWriteFnc=CmnMfgSrvIf_Srv0xFD38Wr, DcmDspDataInfoRef=DcmDspDataInfo_CmnMfgSrv_SrvFD38
          DcmDspData_CmnMfgSrv_SrvFD3C: DcmDspDataReadFnc=CmnMfgSrvIf_Srv0xFD3CRd, DcmDspDataWriteFnc=CmnMfgSrvIf_Srv0xFD3CWr, DcmDspDataInfoRef=DcmDspDataInfo_CmnMfgSrv_SrvFD3C
          DcmDspData_CmnMfgSrv_SrvFD3B: DcmDspDataReadFnc=CmnMfgSrvIf_Srv0xFD3BRd, DcmDspDataWriteFnc=CmnMfgSrvIf_Srv0xFD3BWr, DcmDspDataInfoRef=DcmDspDataInfo_CmnMfgSrv_SrvFD3B
          DcmDspData_CmnMfgSrv_SrvFD3A: DcmDspDataReadFnc=CmnMfgSrvIf_Srv0xFD3ARd, DcmDspDataWriteFnc=CmnMfgSrvIf_Srv0xFD3AWr, DcmDspDataInfoRef=DcmDspDataInfo_CmnMfgSrv_SrvFD3A
        DcmDspDidInfo_CmnMfgSrv_SrvF195 (DcmDspDidInfo): DcmDspDidDynamicallyDefined=false
          DcmDspDidAccess
            DcmDspDidRead: DcmDspDidReadSessionRef=DcmDspSessionRow_NXTRMFG
        DcmDspDidInfo_CmnMfgSrv_SrvF194 (DcmDspDidInfo): DcmDspDidDynamicallyDefined=false
          DcmDspDidAccess
            DcmDspDidRead: DcmDspDidReadSessionRef=DcmDspSessionRow_NXTRMFG
        4 x DcmDspData, all with DcmDspDataUsePort=USE_DATA_ASYNCH_FNC, DcmDspDataType=UINT8, DcmDspDataConditionCheckReadFncUsed=false:
          DcmDspData_CmnMfgSrv_SrvFD32: DcmDspDataSize=160, DcmDspDataReadFnc=CmnMfgSrvIf_Srv0xFD32Rd, DcmDspDataWriteFnc=CmnMfgSrvIf_Srv0xFD32Wr, DcmDspDataInfoRef=DcmDspDataInfo_CmnMfgSrv_SrvFD32
          DcmDspData_CmnMfgSrv_SrvFD31: DcmDspDataSize=160, DcmDspDataReadFnc=CmnMfgSrvIf_Srv0xFD31Rd, DcmDspDataWriteFnc=CmnMfgSrvIf_Srv0xFD31Wr, DcmDspDataInfoRef=DcmDspDataInfo_CmnMfgSrv_SrvFD31
          DcmDspData_CmnMfgSrv_SrvFD30: DcmDspDataSize=160, DcmDspDataReadFnc=CmnMfgSrvIf_Srv0xFD30Rd, DcmDspDataWriteFnc=CmnMfgSrvIf_Srv0xFD30Wr, DcmDspDataInfoRef=DcmDspDataInfo_CmnMfgSrv_SrvFD30
          DcmDspData_CmnMfgSrv_SrvFDDF: DcmDspDataSize=848, DcmDspDataReadFnc=CmnMfgSrvIf_Srv0xFDDFRd, DcmDspDataWriteFnc=CmnMfgSrvIf_Srv0xFDDFWr, DcmDspDataInfoRef=DcmDspDataInfo_CmnMfgSrv_SrvFDDF
        DcmDspRoutine_CmnMfgSrv_SrvFDAD (DcmDspRoutine):
          DcmDspRequestResultsRoutineSupported = false
          DcmDspRoutineIdentifier = 64941
          DcmDspRoutineUsePort = false
          DcmDspRoutineUsed = true
          DcmDspStopRoutineSupported = false
          DcmDspRoutineFixedLength = false
          DcmDspStartRoutineFnc = CmnMfgSrvIf_Srv0xFDADStrt
          DcmDspRoutineInfoRef = DcmDspRoutineInfo_CmnMfgSrv_SrvFDAD
        DcmDspRoutine_CmnMfgSrv_SrvFDAE (DcmDspRoutine):
          DcmDspRequestResultsRoutineSupported = false
          DcmDspRoutineIdentifier = 64942
          DcmDspRoutineUsePort = false
          DcmDspRoutineUsed = true
          DcmDspStopRoutineSupported = false
          DcmDspRoutineFixedLength = false
          DcmDspStartRoutineFnc = CmnMfgSrvIf_Srv0xFDAEStrt
          DcmDspRoutineInfoRef = DcmDspRoutineInfo_CmnMfgSrv_SrvFDAE
        DcmDspData_CmnMfgSrv_SrvFDD7 (DcmDspData):
          DcmDspDataSize = 848
          DcmDspDataUsePort = USE_DATA_ASYNCH_FNC
          DcmDspDataType = UINT8
          DcmDspDataConditionCheckReadFncUsed = false
          DcmDspDataReadFnc = CmnMfgSrvIf_Srv0xFDD7Rd
          DcmDspDataWriteFnc = CmnMfgSrvIf_Srv0xFDD7Wr
          DcmDspDataInfoRef = DcmDspDataInfo_CmnMfgSrv_SrvFDD7
        DcmDspRoutine_CmnMfgSrv_SrvFDAC (DcmDspRoutine):
          DcmDspRequestResultsRoutineSupported = false
          DcmDspRoutineIdentifier = 64940
          DcmDspRoutineUsePort = false
          DcmDspRoutineUsed = true
          DcmDspStopRoutineSupported = false
          DcmDspRoutineFixedLength = false
          DcmDspStartRoutineFnc = CmnMfgSrvIf_Srv0xFDACStrt
          DcmDspRoutineInfoRef = DcmDspRoutineInfo_CmnMfgSrv_SrvFDAC
        DcmDspRoutine_CmnMfgSrv_SrvFDAF (DcmDspRoutine):
          DcmDspRequestResultsRoutineSupported = false
          DcmDspRoutineIdentifier = 64943
          DcmDspRoutineUsePort = false
          DcmDspRoutineUsed = true
          DcmDspStopRoutineSupported = false
          DcmDspRoutineFixedLength = false
          DcmDspStartRoutineFnc = CmnMfgSrvIf_Srv0xFDAFStrt
          DcmDspRoutineInfoRef = DcmDspRoutineInfo_CmnMfgSrv_SrvFDAF
        3 x DcmDspData, all with DcmDspDataSize=32, DcmDspDataUsePort=USE_DATA_ASYNCH_FNC, DcmDspDataType=UINT8, DcmDspDataConditionCheckReadFncUsed=false:
          DcmDspData_CmnMfgSrv_SrvFD40: DcmDspDataReadFnc=CmnMfgSrvIfDcmWrpSrvFD40Rd, DcmDspDataReturnControlToEcuFnc=CmnMfgSrvIfDcmWrpSrvFD40CtrlRtn, DcmDspDataShortTermAdjustmentFnc=CmnMfgSrvIfDcmWrpSrvFD40CtrlAdj, DcmDspDataInfoRef=DcmDspDataInfo_CmnMfgSrv_SrvFD40
          DcmDspData_CmnMfgSrv_SrvFD42: DcmDspDataReadFnc=CmnMfgSrvIfDcmWrpSrvFD42Rd, DcmDspDataReturnControlToEcuFnc=CmnMfgSrvIfDcmWrpSrvFD42CtrlRtn, DcmDspDataShortTermAdjustmentFnc=CmnMfgSrvIfDcmWrpSrvFD42CtrlAdj, DcmDspDataInfoRef=DcmDspDataInfo_CmnMfgSrv_SrvFD42
          DcmDspData_CmnMfgSrv_SrvFD41: DcmDspDataReadFnc=CmnMfgSrvIfDcmWrpSrvFD41Rd, DcmDspDataReturnControlToEcuFnc=CmnMfgSrvIfDcmWrpSrvFD41CtrlRtn, DcmDspDataShortTermAdjustmentFnc=CmnMfgSrvIfDcmWrpSrvFD41CtrlAdj, DcmDspDataInfoRef=DcmDspDataInfo_CmnMfgSrv_SrvFD41
        DcmDspRoutine_CmnMfgSrv_SrvFDA4 (DcmDspRoutine):
          DcmDspRequestResultsRoutineSupported = false
          DcmDspRoutineIdentifier = 64932
          DcmDspRoutineUsePort = false
          DcmDspRoutineUsed = true
          DcmDspStopRoutineSupported = false
          DcmDspRoutineFixedLength = false
          DcmDspStartRoutineFnc = CmnMfgSrvIf_Srv0xFDA4Strt
          DcmDspRoutineInfoRef = DcmDspRoutineInfo_CmnMfgSrv_SrvFDA4
        DcmDspRoutine_CmnMfgSrv_SrvFDA5 (DcmDspRoutine):
          DcmDspRequestResultsRoutineSupported = false
          DcmDspRoutineIdentifier = 64933
          DcmDspRoutineUsePort = false
          DcmDspRoutineUsed = true
          DcmDspStopRoutineSupported = false
          DcmDspRoutineFixedLength = false
          DcmDspStartRoutineFnc = CmnMfgSrvIf_Srv0xFDA5Strt
          DcmDspRoutineInfoRef = DcmDspRoutineInfo_CmnMfgSrv_SrvFDA5
        DcmDspData_CmnMfgSrv_SrvFDF6 (DcmDspData):
          DcmDspDataSize = 96
          DcmDspDataUsePort = USE_DATA_ASYNCH_FNC
          DcmDspDataType = UINT8
          DcmDspDataConditionCheckReadFncUsed = false
          DcmDspDataReadFnc = CmnMfgSrvIf_Srv0xFDF6Rd
          DcmDspDataWriteFnc = CmnMfgSrvIf_Srv0xFDF6Wr
          DcmDspDataInfoRef = DcmDspDataInfo_CmnMfgSrv_SrvFDF6
        6 x DcmDspDidInfo, all with DcmDspDidDynamicallyDefined=false:
          DcmDspDidInfo_CmnMfgSrv_SrvFD01
            DcmDspDidAccess
              DcmDspDidRead: DcmDspDidReadSessionRef=DcmDspSessionRow_NXTRMFG
          DcmDspDidInfo_CmnMfgSrv_SrvFD00
            DcmDspDidAccess
              DcmDspDidRead: DcmDspDidReadSessionRef=DcmDspSessionRow_NXTRMFG
          DcmDspDidInfo_CmnMfgSrv_SrvFE21
            DcmDspDidAccess
              DcmDspDidRead: DcmDspDidReadSessionRef=DcmDspSessionRow_NXTRMFG
              DcmDspDidWrite: DcmDspDidWriteSessionRef=DcmDspSessionRow_NXTRMFG
          DcmDspDidInfo_CmnMfgSrv_SrvFD03
            DcmDspDidAccess
              DcmDspDidRead: DcmDspDidReadSessionRef=DcmDspSessionRow_NXTRMFG
              DcmDspDidWrite: DcmDspDidWriteSessionRef=DcmDspSessionRow_NXTRMFG
          DcmDspDidInfo_CmnMfgSrv_SrvFD02
            DcmDspDidAccess
              DcmDspDidRead: DcmDspDidReadSessionRef=DcmDspSessionRow_NXTRMFG
              DcmDspDidWrite: DcmDspDidWriteSessionRef=DcmDspSessionRow_NXTRMFG
          DcmDspDidInfo_CmnMfgSrv_SrvFD05
            DcmDspDidAccess
              DcmDspDidRead: DcmDspDidReadSessionRef=DcmDspSessionRow_NXTRMFG
              DcmDspDidWrite: DcmDspDidWriteSessionRef=DcmDspSessionRow_NXTRMFG
        DcmDspRoutineInfo_CmnMfgSrv_SrvF151 (DcmDspRoutineInfo)
          DcmDspRoutineAuthorization: DcmDspRoutineSessionRef=DcmDspSessionRow_NXTRMFG, DcmDspRoutineSessionRef=DEFAULT_SESSION
          DcmDspRoutineRequestResOut
            DcmDspRoutineRequestResOutSignal: DcmDspRoutineSignalLength=8, DcmDspRoutineSignalPos=0, DcmDspRoutineSignalType=UINT8
        DcmDspRoutineInfo_CmnMfgSrv_SrvF150 (DcmDspRoutineInfo)
          DcmDspRoutineAuthorization: DcmDspRoutineSessionRef=DcmDspSessionRow_NXTRMFG, DcmDspRoutineSessionRef=DEFAULT_SESSION
          DcmDspRoutineRequestResOut
            DcmDspRoutineRequestResOutSignal: DcmDspRoutineSignalLength=8, DcmDspRoutineSignalPos=0, DcmDspRoutineSignalType=UINT8
        DcmDspDidInfo_CmnMfgSrv_SrvFD06 (DcmDspDidInfo): DcmDspDidDynamicallyDefined=false
          DcmDspDidAccess
            DcmDspDidRead: DcmDspDidReadSessionRef=DcmDspSessionRow_NXTRMFG
        DcmDspRoutine_CmnMfgSrv_SrvFE20 (DcmDspRoutine):
          DcmDspRequestResultsRoutineSupported = false
          DcmDspRoutineIdentifier = 65056
          DcmDspRoutineUsePort = false
          DcmDspRoutineUsed = true
          DcmDspStopRoutineSupported = true
          DcmDspRoutineFixedLength = false
          DcmDspStartRoutineFnc = CmnMfgSrvIf_Srv0xFE20Strt
          DcmDspStopRoutineFnc = CmnMfgSrvIf_Srv0xFE20Stop
          DcmDspRoutineInfoRef = DcmDspRoutineInfo_CmnMfgSrv_SrvFE20
        DcmDspData_CmnMfgSrv_SrvF194 (DcmDspData):
          DcmDspDataSize = 128
          DcmDspDataUsePort = USE_DATA_ASYNCH_FNC
          DcmDspDataType = UINT8
          DcmDspDataConditionCheckReadFncUsed = false
          DcmDspDataReadFnc = CmnMfgSrvIf_Srv0xF194Rd
          DcmDspDataInfoRef = DcmDspDataInfo_CmnMfgSrv_SrvF194
        3 x DcmDspDid, all with DcmDspDidUsed=true, DcmDspDidUsePort=USE_DATA_ELEMENT_SPECIFIC_INTERFACES:
          DcmDspDid_CmnMfgSrv_SrvF1FF: DcmDspDidIdentifier=61951, DcmDspDidInfoRef=DcmDspDidInfo_CmnMfgSrv_SrvF1FF
            DcmDspDidSignal: DcmDspDidDataPos=0, DcmDspDidDataRef=DcmDspData_CmnMfgSrv_SrvF1FF
          DcmDspDid_CmnMfgSrv_SrvF1FE: DcmDspDidIdentifier=61950, DcmDspDidInfoRef=DcmDspDidInfo_CmnMfgSrv_SrvF1FE
            DcmDspDidSignal: DcmDspDidDataPos=0, DcmDspDidDataRef=DcmDspData_CmnMfgSrv_SrvF1FE
          DcmDspDid_CmnMfgSrv_SrvF1FD: DcmDspDidIdentifier=61949, DcmDspDidInfoRef=DcmDspDidInfo_CmnMfgSrv_SrvF1FD
            DcmDspDidSignal: DcmDspDidDataPos=0, DcmDspDidDataRef=DcmDspData_CmnMfgSrv_SrvF1FD
        DcmDspData_CmnMfgSrv_SrvF195 (DcmDspData):
          DcmDspDataSize = 128
          DcmDspDataUsePort = USE_DATA_ASYNCH_FNC
          DcmDspDataType = UINT8
          DcmDspDataConditionCheckReadFncUsed = false
          DcmDspDataReadFnc = CmnMfgSrvIf_Srv0xF195Rd
          DcmDspDataInfoRef = DcmDspDataInfo_CmnMfgSrv_SrvF195
        DcmDspDidInfo_CmnMfgSrv_SrvFD30 (DcmDspDidInfo): DcmDspDidDynamicallyDefined=false
          DcmDspDidAccess
            DcmDspDidRead: DcmDspDidReadSessionRef=DcmDspSessionRow_NXTRMFG
            DcmDspDidWrite: DcmDspDidWriteSessionRef=DcmDspSessionRow_NXTRMFG
        DcmDspDataInfo_CmnMfgSrv_SrvF1FF (DcmDspDataInfo): DcmDspDataFixedLength=true
        DcmDspDataInfo_CmnMfgSrv_SrvF1FE (DcmDspDataInfo): DcmDspDataFixedLength=true
        DcmDspDidInfo_CmnMfgSrv_SrvFD32 (DcmDspDidInfo): DcmDspDidDynamicallyDefined=false
          DcmDspDidAccess
            DcmDspDidRead: DcmDspDidReadSessionRef=DcmDspSessionRow_NXTRMFG
            DcmDspDidWrite: DcmDspDidWriteSessionRef=DcmDspSessionRow_NXTRMFG
        DcmDspDataInfo_CmnMfgSrv_SrvF1FD (DcmDspDataInfo): DcmDspDataFixedLength=true
        DcmDspDidInfo_CmnMfgSrv_SrvFD31 (DcmDspDidInfo): DcmDspDidDynamicallyDefined=false
          DcmDspDidAccess
            DcmDspDidRead: DcmDspDidReadSessionRef=DcmDspSessionRow_NXTRMFG
            DcmDspDidWrite: DcmDspDidWriteSessionRef=DcmDspSessionRow_NXTRMFG
        DcmDspRoutineInfo_CmnMfgSrv_SrvF141 (DcmDspRoutineInfo)
          DcmDspRoutineAuthorization: DcmDspRoutineSessionRef=DcmDspSessionRow_NXTRMFG, DcmDspRoutineSessionRef=DEFAULT_SESSION
          DcmDspRoutineRequestResOut
            DcmDspRoutineRequestResOutSignal: DcmDspRoutineSignalLength=64, DcmDspRoutineSignalPos=0, DcmDspRoutineSignalType=UINT8
        DcmDspDidInfo_CmnMfgSrv_SrvFD38 (DcmDspDidInfo): DcmDspDidDynamicallyDefined=false
          DcmDspDidAccess
            DcmDspDidRead: DcmDspDidReadSessionRef=DcmDspSessionRow_NXTRMFG
            DcmDspDidWrite: DcmDspDidWriteSessionRef=DcmDspSessionRow_NXTRMFG
        DcmDspRoutineInfo_CmnMfgSrv_SrvF140 (DcmDspRoutineInfo)
          DcmDspRoutineAuthorization: DcmDspRoutineSessionRef=DcmDspSessionRow_NXTRMFG, DcmDspRoutineSessionRef=DEFAULT_SESSION
          DcmDspRoutineRequestResOut
            DcmDspRoutineRequestResOutSignal: DcmDspRoutineSignalLength=64, DcmDspRoutineSignalPos=0, DcmDspRoutineSignalType=UINT8
        3 x DcmDspDidInfo, all with DcmDspDidDynamicallyDefined=false:
          DcmDspDidInfo_CmnMfgSrv_SrvFD39
            DcmDspDidAccess
              DcmDspDidRead: DcmDspDidReadSessionRef=DcmDspSessionRow_NXTRMFG
              DcmDspDidWrite: DcmDspDidWriteSessionRef=DcmDspSessionRow_NXTRMFG
          DcmDspDidInfo_CmnMfgSrv_SrvFD3B
            DcmDspDidAccess
              DcmDspDidRead: DcmDspDidReadSessionRef=DcmDspSessionRow_NXTRMFG
              DcmDspDidWrite: DcmDspDidWriteSessionRef=DcmDspSessionRow_NXTRMFG
          DcmDspDidInfo_CmnMfgSrv_SrvFD3A
            DcmDspDidAccess
              DcmDspDidRead: DcmDspDidReadSessionRef=DcmDspSessionRow_NXTRMFG
              DcmDspDidWrite: DcmDspDidWriteSessionRef=DcmDspSessionRow_NXTRMFG
        DcmDspRoutine_CmnMfgSrv_SrvFEA1 (DcmDspRoutine):
          DcmDspRequestResultsRoutineSupported = false
          DcmDspRoutineIdentifier = 65185
          DcmDspRoutineUsePort = false
          DcmDspRoutineUsed = true
          DcmDspStopRoutineSupported = false
          DcmDspRoutineFixedLength = false
          DcmDspStartRoutineFnc = CmnMfgSrvIf_Srv0xFEA1Strt
          DcmDspRoutineInfoRef = DcmDspRoutineInfo_CmnMfgSrv_SrvFEA1
        4 x DcmDspDidInfo, all with DcmDspDidDynamicallyDefined=false:
          DcmDspDidInfo_CmnMfgSrv_SrvFDB5
            DcmDspDidAccess
              DcmDspDidRead: DcmDspDidReadSessionRef=DcmDspSessionRow_NXTRMFG
              DcmDspDidWrite: DcmDspDidWriteSessionRef=DcmDspSessionRow_NXTRMFG
          DcmDspDidInfo_CmnMfgSrv_SrvFDB4
            DcmDspDidAccess
              DcmDspDidRead: DcmDspDidReadSessionRef=DcmDspSessionRow_NXTRMFG
              DcmDspDidWrite: DcmDspDidWriteSessionRef=DcmDspSessionRow_NXTRMFG
          DcmDspDidInfo_CmnMfgSrv_SrvFDB7
            DcmDspDidAccess
              DcmDspDidRead: DcmDspDidReadSessionRef=DcmDspSessionRow_NXTRMFG
              DcmDspDidWrite: DcmDspDidWriteSessionRef=DcmDspSessionRow_NXTRMFG
          DcmDspDidInfo_CmnMfgSrv_SrvFDB6
            DcmDspDidAccess
              DcmDspDidRead: DcmDspDidReadSessionRef=DcmDspSessionRow_NXTRMFG
              DcmDspDidWrite: DcmDspDidWriteSessionRef=DcmDspSessionRow_NXTRMFG
        3 x DcmDspRoutineInfo:
          DcmDspRoutineInfo_CmnMfgSrv_SrvF002
            DcmDspRoutineAuthorization: DcmDspRoutineSessionRef=DcmDspSessionRow_NXTRMFG, DcmDspRoutineSessionRef=DEFAULT_SESSION
          DcmDspRoutineInfo_CmnMfgSrv_SrvF001
            DcmDspRoutineAuthorization: DcmDspRoutineSessionRef=DcmDspSessionRow_NXTRMFG, DcmDspRoutineSessionRef=DEFAULT_SESSION
          DcmDspRoutineInfo_CmnMfgSrv_SrvF000
            DcmDspRoutineAuthorization: DcmDspRoutineSessionRef=DcmDspSessionRow_NXTRMFG, DcmDspRoutineSessionRef=DEFAULT_SESSION
        5 x DcmDspDidInfo, all with DcmDspDidDynamicallyDefined=false:
          DcmDspDidInfo_CmnMfgSrv_SrvFDBC
            DcmDspDidAccess
              DcmDspDidRead: DcmDspDidReadSessionRef=DcmDspSessionRow_NXTRMFG
          DcmDspDidInfo_CmnMfgSrv_SrvFDBE
            DcmDspDidAccess
              DcmDspDidRead: DcmDspDidReadSessionRef=DcmDspSessionRow_NXTRMFG
          DcmDspDidInfo_CmnMfgSrv_SrvFDBD
            DcmDspDidAccess
              DcmDspDidRead: DcmDspDidReadSessionRef=DcmDspSessionRow_NXTRMFG
          DcmDspDidInfo_CmnMfgSrv_SrvFDBF
            DcmDspDidAccess
              DcmDspDidRead: DcmDspDidReadSessionRef=DcmDspSessionRow_NXTRMFG
          DcmDspDidInfo_CmnMfgSrv_SrvFDC0
            DcmDspDidAccess
              DcmDspDidRead: DcmDspDidReadSessionRef=DcmDspSessionRow_NXTRMFG
              DcmDspDidWrite: DcmDspDidWriteSessionRef=DcmDspSessionRow_NXTRMFG
        DcmDspRoutineInfo_CmnMfgSrv_SrvF119 (DcmDspRoutineInfo)
          DcmDspRoutineAuthorization: DcmDspRoutineSessionRef=DcmDspSessionRow_NXTRMFG, DcmDspRoutineSessionRef=DEFAULT_SESSION
          DcmDspRoutineRequestResOut
            DcmDspRoutineRequestResOutSignal: DcmDspRoutineSignalLength=8, DcmDspRoutineSignalPos=0, DcmDspRoutineSignalType=UINT8
        DcmDspData_CmnMfgSrv_SrvFD03 (DcmDspData):
          DcmDspDataSize = 32
          DcmDspDataUsePort = USE_DATA_ASYNCH_FNC
          DcmDspDataType = UINT8
          DcmDspDataConditionCheckReadFncUsed = false
          DcmDspDataReadFnc = CmnMfgSrvIf_Srv0xFD03Rd
          DcmDspDataWriteFnc = CmnMfgSrvIf_Srv0xFD03Wr
          DcmDspDataInfoRef = DcmDspDataInfo_CmnMfgSrv_SrvFD03
        DcmDspRoutineInfo_CmnMfgSrv_SrvF118 (DcmDspRoutineInfo)
          DcmDspRoutineAuthorization: DcmDspRoutineSessionRef=DcmDspSessionRow_NXTRMFG, DcmDspRoutineSessionRef=DEFAULT_SESSION
          DcmDspRoutineRequestResOut
            DcmDspRoutineRequestResOutSignal: DcmDspRoutineSignalLength=8, DcmDspRoutineSignalPos=0, DcmDspRoutineSignalType=UINT8
        DcmDspData_CmnMfgSrv_SrvFD02 (DcmDspData):
          DcmDspDataSize = 8
          DcmDspDataUsePort = USE_DATA_ASYNCH_FNC
          DcmDspDataType = UINT8
          DcmDspDataConditionCheckReadFncUsed = false
          DcmDspDataReadFnc = CmnMfgSrvIf_Srv0xFD02Rd
          DcmDspDataWriteFnc = CmnMfgSrvIf_Srv0xFD02Wr
          DcmDspDataInfoRef = DcmDspDataInfo_CmnMfgSrv_SrvFD02
        DcmDspRoutineInfo_CmnMfgSrv_SrvF117 (DcmDspRoutineInfo)
          DcmDspRoutineAuthorization: DcmDspRoutineSessionRef=DcmDspSessionRow_NXTRMFG, DcmDspRoutineSessionRef=DEFAULT_SESSION
          DcmDspRoutineRequestResOut
            DcmDspRoutineRequestResOutSignal: DcmDspRoutineSignalLength=8, DcmDspRoutineSignalPos=0, DcmDspRoutineSignalType=UINT8
        DcmDspData_CmnMfgSrv_SrvFD01 (DcmDspData):
          DcmDspDataSize = 32
          DcmDspDataUsePort = USE_DATA_ASYNCH_FNC
          DcmDspDataType = UINT8
          DcmDspDataConditionCheckReadFncUsed = false
          DcmDspDataReadFnc = CmnMfgSrvIf_Srv0xFD01Rd
          DcmDspDataInfoRef = DcmDspDataInfo_CmnMfgSrv_SrvFD01
        DcmDspRoutineInfo_CmnMfgSrv_SrvFD71 (DcmDspRoutineInfo)
          DcmDspRoutineAuthorization: DcmDspRoutineSessionRef=DcmDspSessionRow_NXTRMFG, DcmDspRoutineSessionRef=DEFAULT_SESSION
        DcmDspRoutineInfo_CmnMfgSrv_SrvFD70 (DcmDspRoutineInfo)
          DcmDspRoutineAuthorization: DcmDspRoutineSessionRef=DcmDspSessionRow_NXTRMFG, DcmDspRoutineSessionRef=DEFAULT_SESSION
        DcmDspData_CmnMfgSrv_SrvFD06 (DcmDspData):
          DcmDspDataSize = 8
          DcmDspDataUsePort = USE_DATA_ASYNCH_FNC
          DcmDspDataType = UINT8
          DcmDspDataConditionCheckReadFncUsed = false
          DcmDspDataReadFnc = CmnMfgSrvIf_Srv0xFD06Rd
          DcmDspDataInfoRef = DcmDspDataInfo_CmnMfgSrv_SrvFD06
        DcmDspData_CmnMfgSrv_SrvFD05 (DcmDspData):
          DcmDspDataSize = 64
          DcmDspDataUsePort = USE_DATA_ASYNCH_FNC
          DcmDspDataType = UINT8
          DcmDspDataConditionCheckReadFncUsed = false
          DcmDspDataReadFnc = CmnMfgSrvIf_Srv0xFD05Rd
          DcmDspDataWriteFnc = CmnMfgSrvIf_Srv0xFD05Wr
          DcmDspDataInfoRef = DcmDspDataInfo_CmnMfgSrv_SrvFD05
        8 x DcmDspRoutineInfo:
          DcmDspRoutineInfo_CmnMfgSrv_SrvF112
            DcmDspRoutineAuthorization: DcmDspRoutineSessionRef=DcmDspSessionRow_NXTRMFG, DcmDspRoutineSessionRef=DEFAULT_SESSION
            DcmDspRoutineRequestResOut
              DcmDspRoutineRequestResOutSignal: DcmDspRoutineSignalLength=8, DcmDspRoutineSignalPos=0, DcmDspRoutineSignalType=UINT8
          DcmDspRoutineInfo_CmnMfgSrv_SrvF111
            DcmDspRoutineAuthorization: DcmDspRoutineSessionRef=DcmDspSessionRow_NXTRMFG, DcmDspRoutineSessionRef=DEFAULT_SESSION
            DcmDspRoutineRequestResOut
              DcmDspRoutineRequestResOutSignal: DcmDspRoutineSignalLength=8, DcmDspRoutineSignalPos=0, DcmDspRoutineSignalType=UINT8
          DcmDspRoutineInfo_CmnMfgSrv_SrvF110
            DcmDspRoutineAuthorization: DcmDspRoutineSessionRef=DcmDspSessionRow_NXTRMFG, DcmDspRoutineSessionRef=DEFAULT_SESSION
            DcmDspRoutineRequestResOut
              DcmDspRoutineRequestResOutSignal: DcmDspRoutineSignalLength=8, DcmDspRoutineSignalPos=0, DcmDspRoutineSignalType=UINT8
          DcmDspRoutineInfo_CmnMfgSrv_SrvF116
            DcmDspRoutineAuthorization: DcmDspRoutineSessionRef=DcmDspSessionRow_NXTRMFG, DcmDspRoutineSessionRef=DEFAULT_SESSION
            DcmDspRoutineRequestResOut
              DcmDspRoutineRequestResOutSignal: DcmDspRoutineSignalLength=8, DcmDspRoutineSignalPos=0, DcmDspRoutineSignalType=UINT8
          DcmDspRoutineInfo_CmnMfgSrv_SrvF115
            DcmDspRoutineAuthorization: DcmDspRoutineSessionRef=DcmDspSessionRow_NXTRMFG, DcmDspRoutineSessionRef=DEFAULT_SESSION
            DcmDspRoutineRequestResOut
              DcmDspRoutineRequestResOutSignal: DcmDspRoutineSignalLength=8, DcmDspRoutineSignalPos=0, DcmDspRoutineSignalType=UINT8
          DcmDspRoutineInfo_CmnMfgSrv_SrvF114
            DcmDspRoutineAuthorization: DcmDspRoutineSessionRef=DcmDspSessionRow_NXTRMFG, DcmDspRoutineSessionRef=DEFAULT_SESSION
            DcmDspRoutineRequestResOut
              DcmDspRoutineRequestResOutSignal: DcmDspRoutineSignalLength=8, DcmDspRoutineSignalPos=0, DcmDspRoutineSignalType=UINT8
          DcmDspRoutineInfo_CmnMfgSrv_SrvF113
            DcmDspRoutineAuthorization: DcmDspRoutineSessionRef=DcmDspSessionRow_NXTRMFG, DcmDspRoutineSessionRef=DEFAULT_SESSION
            DcmDspRoutineRequestResOut
              DcmDspRoutineRequestResOutSignal: DcmDspRoutineSignalLength=8, DcmDspRoutineSignalPos=0, DcmDspRoutineSignalType=UINT8
          DcmDspRoutineInfo_CmnMfgSrv_SrvF11A
            DcmDspRoutineAuthorization: DcmDspRoutineSessionRef=DcmDspSessionRow_NXTRMFG, DcmDspRoutineSessionRef=DEFAULT_SESSION
            DcmDspRoutineRequestResOut
              DcmDspRoutineRequestResOutSignal: DcmDspRoutineSignalLength=8, DcmDspRoutineSignalPos=0, DcmDspRoutineSignalType=UINT8
        DcmDspData_CmnMfgSrv_SrvFD00 (DcmDspData):
          DcmDspDataSize = 8
          DcmDspDataUsePort = USE_DATA_ASYNCH_FNC
          DcmDspDataType = UINT8
          DcmDspDataConditionCheckReadFncUsed = false
          DcmDspDataReadFnc = CmnMfgSrvIf_Srv0xFD00Rd
          DcmDspDataInfoRef = DcmDspDataInfo_CmnMfgSrv_SrvFD00
        DcmDspData_CmnMfgSrv_SrvFE21 (DcmDspData):
          DcmDspDataSize = 224
          DcmDspDataUsePort = USE_DATA_ASYNCH_FNC
          DcmDspDataType = UINT8
          DcmDspDataConditionCheckReadFncUsed = false
          DcmDspDataReadFnc = CmnMfgSrvIf_Srv0xFE21Rd
          DcmDspDataWriteFnc = CmnMfgSrvIf_Srv0xFE21Wr
          DcmDspDataInfoRef = DcmDspDataInfo_CmnMfgSrv_SrvFE21
        DcmDspDataInfo_CmnMfgSrv_SrvF195 (DcmDspDataInfo): DcmDspDataFixedLength=true
        DcmDspDidInfo_CmnMfgSrv_SrvFD3C (DcmDspDidInfo): DcmDspDidDynamicallyDefined=false
          DcmDspDidAccess
            DcmDspDidRead: DcmDspDidReadSessionRef=DcmDspSessionRow_NXTRMFG
            DcmDspDidWrite: DcmDspDidWriteSessionRef=DcmDspSessionRow_NXTRMFG
        DcmDspDataInfo_CmnMfgSrv_SrvF194 (DcmDspDataInfo): DcmDspDataFixedLength=true
        DcmDspDidInfo_CmnMfgSrv_SrvFDD7 (DcmDspDidInfo): DcmDspDidDynamicallyDefined=false
          DcmDspDidAccess
            DcmDspDidRead: DcmDspDidReadSessionRef=DcmDspSessionRow_NXTRMFG
            DcmDspDidWrite: DcmDspDidWriteSessionRef=DcmDspSessionRow_NXTRMFG
        3 x DcmDspRoutineInfo:
          DcmDspRoutineInfo_CmnMfgSrv_SrvF101
            DcmDspRoutineAuthorization: DcmDspRoutineSessionRef=DcmDspSessionRow_NXTRMFG, DcmDspRoutineSessionRef=DEFAULT_SESSION
            DcmDspRoutineRequestResOut
              DcmDspRoutineRequestResOutSignal: DcmDspRoutineSignalLength=8, DcmDspRoutineSignalPos=0, DcmDspRoutineSignalType=UINT8
          DcmDspRoutineInfo_CmnMfgSrv_SrvF100
            DcmDspRoutineAuthorization: DcmDspRoutineSessionRef=DcmDspSessionRow_NXTRMFG, DcmDspRoutineSessionRef=DEFAULT_SESSION
            DcmDspRoutineRequestResOut
              DcmDspRoutineRequestResOutSignal: DcmDspRoutineSignalLength=8, DcmDspRoutineSignalPos=0, DcmDspRoutineSignalType=UINT8
          DcmDspRoutineInfo_CmnMfgSrv_SrvFDF1
            DcmDspRoutineAuthorization: DcmDspRoutineSessionRef=DcmDspSessionRow_NXTRMFG, DcmDspRoutineSessionRef=DEFAULT_SESSION
            DcmDspRoutineRequestResOut
              DcmDspRoutineRequestResOutSignal: DcmDspRoutineSignalLength=8, DcmDspRoutineSignalPos=0, DcmDspRoutineSignalType=UINT8
        4 x DcmDspDidInfo, all with DcmDspDidDynamicallyDefined=false:
          DcmDspDidInfo_CmnMfgSrv_SrvFD41
            DcmDspDidAccess
              DcmDspDidRead: DcmDspDidReadSessionRef=DcmDspSessionRow_NXTRMFG
              DcmDspDidControl:
                DcmDspDidControlMask = DCM_CONTROLMASK_INTERNAL
                DcmDspDidFreezeCurrentState = false
                DcmDspDidResetToDefault = false
                DcmDspDidReturnControlToEcu = true
                DcmDspDidShortTermAdjustment = true
                DcmDspDidControlSessionRef = DcmDspSessionRow_NXTRMFG
          DcmDspDidInfo_CmnMfgSrv_SrvFD40
            DcmDspDidAccess
              DcmDspDidRead: DcmDspDidReadSessionRef=DcmDspSessionRow_NXTRMFG
              DcmDspDidControl:
                DcmDspDidControlMask = DCM_CONTROLMASK_INTERNAL
                DcmDspDidFreezeCurrentState = false
                DcmDspDidResetToDefault = false
                DcmDspDidReturnControlToEcu = true
                DcmDspDidShortTermAdjustment = true
                DcmDspDidControlSessionRef = DcmDspSessionRow_NXTRMFG
          DcmDspDidInfo_CmnMfgSrv_SrvFD42
            DcmDspDidAccess
              DcmDspDidRead: DcmDspDidReadSessionRef=DcmDspSessionRow_NXTRMFG
              DcmDspDidControl:
                DcmDspDidControlMask = DCM_CONTROLMASK_INTERNAL
                DcmDspDidFreezeCurrentState = false
                DcmDspDidResetToDefault = false
                DcmDspDidReturnControlToEcu = true
                DcmDspDidShortTermAdjustment = true
                DcmDspDidControlSessionRef = DcmDspSessionRow_NXTRMFG
          DcmDspDidInfo_CmnMfgSrv_SrvFDDF
            DcmDspDidAccess
              DcmDspDidRead: DcmDspDidReadSessionRef=DcmDspSessionRow_NXTRMFG
              DcmDspDidWrite: DcmDspDidWriteSessionRef=DcmDspSessionRow_NXTRMFG
        3 x DcmDspRoutineInfo:
          DcmDspRoutineInfo_CmnMfgSrv_SrvFD68
            DcmDspRoutineAuthorization: DcmDspRoutineSessionRef=DcmDspSessionRow_NXTRMFG, DcmDspRoutineSessionRef=DEFAULT_SESSION
            DcmDspStartRoutineIn
              DcmDspStartRoutineInSignal: DcmDspRoutineSignalLength=16, DcmDspRoutineSignalPos=0, DcmDspRoutineSignalType=UINT8
            DcmDspStartRoutineOut
              DcmDspStartRoutineOutSignal: DcmDspRoutineSignalLength=40, DcmDspRoutineSignalPos=0, DcmDspRoutineSignalType=UINT8
          DcmDspRoutineInfo_CmnMfgSrv_SrvFE89
            DcmDspRoutineAuthorization: DcmDspRoutineSessionRef=DcmDspSessionRow_NXTRMFG, DcmDspRoutineSessionRef=DEFAULT_SESSION
          DcmDspRoutineInfo_CmnMfgSrv_SrvFE88
            DcmDspRoutineAuthorization: DcmDspRoutineSessionRef=DcmDspSessionRow_NXTRMFG, DcmDspRoutineSessionRef=DEFAULT_SESSION
        DcmDspDidRange_Nxtr_F201_F23F (DcmDspDidRange):
          DcmDspDidRangeHasGaps = false
          DcmDspDidRangeIdentifierLowerLimit = 61953
          DcmDspDidRangeIdentifierUpperLimit = 62015
          DcmDspDidRangeMaxDataLength = 300
          DcmDspDidRangeUsePort = false
          DcmDspDidRangeReadDidFnc = CmnMfgSrvIfDcmReadDataIdWrpr_Oper
          DcmDspDidRangeInfoRef = DcmDspDidInfo_Nxtr_F201_F23F
        DcmDspDidInfo_Nxtr_F201_F23F (DcmDspDidInfo): DcmDspDidDynamicallyDefined=false
          DcmDspDidAccess
            DcmDspDidRead: DcmDspDidReadSessionRef=DcmDspSessionRow_NXTRMFG
        DcmDspData_CmnMfgSrv_SrvFED0 (DcmDspData):
          DcmDspDataSize = 8
          DcmDspDataUsePort = USE_DATA_ASYNCH_FNC
          DcmDspDataType = UINT8
          DcmDspDataConditionCheckReadFncUsed = false
          DcmDspDataReadFnc = CmnMfgSrvIf_Srv0xFED0Rd
          DcmDspDataWriteFnc = CmnMfgSrvIf_Srv0xFED0Wr
          DcmDspDataInfoRef = DcmDspDataInfo_CmnMfgSrv_SrvFED0
        DcmDspDataInfo_CmnMfgSrv_SrvFED0 (DcmDspDataInfo): DcmDspDataFixedLength=true
        DcmDspDid_CmnMfgSrv_SrvFED0 (DcmDspDid):
          DcmDspDidIdentifier = 65232
          DcmDspDidUsed = true
          DcmDspDidUsePort = USE_DATA_ELEMENT_SPECIFIC_INTERFACES
          DcmDspDidInfoRef = DcmDspDidInfo_CmnMfgSrv_SrvFED0
          DcmDspDidSignal: DcmDspDidDataPos=0, DcmDspDidDataRef=DcmDspData_CmnMfgSrv_SrvFED0
        DcmDspDidInfo_CmnMfgSrv_SrvFED0 (DcmDspDidInfo): DcmDspDidDynamicallyDefined=false
          DcmDspDidAccess
            DcmDspDidRead: DcmDspDidReadSessionRef=DcmDspSessionRow_NXTRMFG
            DcmDspDidWrite: DcmDspDidWriteSessionRef=DcmDspSessionRow_NXTRMFG
        DcmDspData_CmnMfgSrv_SrvFED1 (DcmDspData):
          DcmDspDataSize = 8
          DcmDspDataUsePort = USE_DATA_ASYNCH_FNC
          DcmDspDataType = UINT8
          DcmDspDataConditionCheckReadFncUsed = false
          DcmDspDataWriteFnc = CmnMfgSrvIf_Srv0xFED1Wr
          DcmDspDataReadFnc = CmnMfgSrvIf_Srv0xFED1Rd
          DcmDspDataInfoRef = DcmDspDataInfo_CmnMfgSrv_SrvFED1
        DcmDspDataInfo_CmnMfgSrv_SrvFED1 (DcmDspDataInfo): DcmDspDataFixedLength=true
        DcmDspDid_CmnMfgSrv_SrvFED1 (DcmDspDid):
          DcmDspDidIdentifier = 65233
          DcmDspDidUsed = true
          DcmDspDidUsePort = USE_DATA_ELEMENT_SPECIFIC_INTERFACES
          DcmDspDidInfoRef = DcmDspDidInfo_CmnMfgSrv_SrvFED1
          DcmDspDidSignal: DcmDspDidDataPos=0, DcmDspDidDataRef=DcmDspData_CmnMfgSrv_SrvFED1
        DcmDspDidInfo_CmnMfgSrv_SrvFED1 (DcmDspDidInfo): DcmDspDidDynamicallyDefined=false
          DcmDspDidAccess
            DcmDspDidWrite: DcmDspDidWriteSessionRef=DcmDspSessionRow_NXTRMFG
            DcmDspDidRead: DcmDspDidReadSessionRef=DcmDspSessionRow_NXTRMFG
        6 x DcmDspData, all with DcmDspDataUsePort=USE_DATA_ASYNCH_FNC, DcmDspDataType=UINT8, DcmDspDataConditionCheckReadFncUsed=false:
          DcmDspData_CmnMfgSrv_SrvF1F4: DcmDspDataSize=40, DcmDspDataReadFnc=CmnMfgSrvIf_Srv0xF1F4Rd, DcmDspDataInfoRef=DcmDspDataInfo_CmnMfgSrv_SrvF1F4
          DcmDspData_CmnMfgSrv_SrvF1F3: DcmDspDataSize=40, DcmDspDataReadFnc=CmnMfgSrvIf_Srv0xF1F3Rd, DcmDspDataInfoRef=DcmDspDataInfo_CmnMfgSrv_SrvF1F3
          DcmDspData_CmnMfgSrv_SrvF1F2: DcmDspDataSize=40, DcmDspDataReadFnc=CmnMfgSrvIf_Srv0xF1F2Rd, DcmDspDataInfoRef=DcmDspDataInfo_CmnMfgSrv_SrvF1F2
          DcmDspData_CmnMfgSrv_SrvF1F9: DcmDspDataSize=472, DcmDspDataReadFnc=CmnMfgSrvIf_Srv0xF1F9Rd, DcmDspDataInfoRef=DcmDspDataInfo_CmnMfgSrv_SrvF1F9
          DcmDspData_CmnMfgSrv_SrvF1F8: DcmDspDataSize=472, DcmDspDataReadFnc=CmnMfgSrvIf_Srv0xF1F8Rd, DcmDspDataInfoRef=DcmDspDataInfo_CmnMfgSrv_SrvF1F8
          DcmDspData_CmnMfgSrv_SrvF1F7: DcmDspDataSize=472, DcmDspDataReadFnc=CmnMfgSrvIf_Srv0xF1F7Rd, DcmDspDataInfoRef=DcmDspDataInfo_CmnMfgSrv_SrvF1F7
        6 x DcmDspDidInfo, all with DcmDspDidDynamicallyDefined=false:
          DcmDspDidInfo_CmnMfgSrv_SrvF1F2
            DcmDspDidAccess
              DcmDspDidRead: DcmDspDidReadSessionRef=DcmDspSessionRow_NXTRMFG
          DcmDspDidInfo_CmnMfgSrv_SrvF1F4
            DcmDspDidAccess
              DcmDspDidRead: DcmDspDidReadSessionRef=DcmDspSessionRow_NXTRMFG
          DcmDspDidInfo_CmnMfgSrv_SrvF1F3
            DcmDspDidAccess
              DcmDspDidRead: DcmDspDidReadSessionRef=DcmDspSessionRow_NXTRMFG
          DcmDspDidInfo_CmnMfgSrv_SrvF1F8
            DcmDspDidAccess
              DcmDspDidRead: DcmDspDidReadSessionRef=DcmDspSessionRow_NXTRMFG
          DcmDspDidInfo_CmnMfgSrv_SrvF1F7
            DcmDspDidAccess
              DcmDspDidRead: DcmDspDidReadSessionRef=DcmDspSessionRow_NXTRMFG
          DcmDspDidInfo_CmnMfgSrv_SrvF1F9
            DcmDspDidAccess
              DcmDspDidRead: DcmDspDidReadSessionRef=DcmDspSessionRow_NXTRMFG
        6 x DcmDspDataInfo, all with DcmDspDataFixedLength=true:
          DcmDspDataInfo_CmnMfgSrv_SrvF1F3
          DcmDspDataInfo_CmnMfgSrv_SrvF1F2
          DcmDspDataInfo_CmnMfgSrv_SrvF1F9
          DcmDspDataInfo_CmnMfgSrv_SrvF1F8
          DcmDspDataInfo_CmnMfgSrv_SrvF1F7
          DcmDspDataInfo_CmnMfgSrv_SrvF1F4
        6 x DcmDspDid, all with DcmDspDidUsed=true, DcmDspDidUsePort=USE_DATA_ELEMENT_SPECIFIC_INTERFACES:
          DcmDspDid_CmnMfgSrv_SrvF1F9: DcmDspDidIdentifier=61945, DcmDspDidInfoRef=DcmDspDidInfo_CmnMfgSrv_SrvF1F9
            DcmDspDidSignal: DcmDspDidDataPos=0, DcmDspDidDataRef=DcmDspData_CmnMfgSrv_SrvF1F9
          DcmDspDid_CmnMfgSrv_SrvF1F8: DcmDspDidIdentifier=61944, DcmDspDidInfoRef=DcmDspDidInfo_CmnMfgSrv_SrvF1F8
            DcmDspDidSignal: DcmDspDidDataPos=0, DcmDspDidDataRef=DcmDspData_CmnMfgSrv_SrvF1F8
          DcmDspDid_CmnMfgSrv_SrvF1F7: DcmDspDidIdentifier=61943, DcmDspDidInfoRef=DcmDspDidInfo_CmnMfgSrv_SrvF1F7
            DcmDspDidSignal: DcmDspDidDataPos=0, DcmDspDidDataRef=DcmDspData_CmnMfgSrv_SrvF1F7
          DcmDspDid_CmnMfgSrv_SrvF1F2: DcmDspDidIdentifier=61938, DcmDspDidInfoRef=DcmDspDidInfo_CmnMfgSrv_SrvF1F2
            DcmDspDidSignal: DcmDspDidDataPos=0, DcmDspDidDataRef=DcmDspData_CmnMfgSrv_SrvF1F2
          DcmDspDid_CmnMfgSrv_SrvF1F4: DcmDspDidIdentifier=61940, DcmDspDidInfoRef=DcmDspDidInfo_CmnMfgSrv_SrvF1F4
            DcmDspDidSignal: DcmDspDidDataPos=0, DcmDspDidDataRef=DcmDspData_CmnMfgSrv_SrvF1F4
          DcmDspDid_CmnMfgSrv_SrvF1F3: DcmDspDidIdentifier=61939, DcmDspDidInfoRef=DcmDspDidInfo_CmnMfgSrv_SrvF1F3
            DcmDspDidSignal: DcmDspDidDataPos=0, DcmDspDidDataRef=DcmDspData_CmnMfgSrv_SrvF1F3
        3 x DcmDspDidInfo, all with DcmDspDidDynamicallyDefined=false:
          DcmDspDidInfo_CmnMfgSrv_SrvFE82
            DcmDspDidAccess
              DcmDspDidWrite: DcmDspDidWriteSessionRef=DcmDspSessionRow_NXTRMFG
          DcmDspDidInfo_CmnMfgSrv_SrvFE81
            DcmDspDidAccess
              DcmDspDidRead: DcmDspDidReadSessionRef=DcmDspSessionRow_NXTRMFG
          DcmDspDidInfo_CmnMfgSrv_SrvFE83
            DcmDspDidAccess
              DcmDspDidWrite: DcmDspDidWriteSessionRef=DcmDspSessionRow_NXTRMFG
        3 x DcmDspDid, all with DcmDspDidUsed=true, DcmDspDidUsePort=USE_DATA_ELEMENT_SPECIFIC_INTERFACES:
          DcmDspDid_CmnMfgSrv_SrvFE81: DcmDspDidIdentifier=65153, DcmDspDidInfoRef=DcmDspDidInfo_CmnMfgSrv_SrvFE81
            DcmDspDidSignal: DcmDspDidDataPos=0, DcmDspDidDataRef=DcmDspData_CmnMfgSrv_SrvFE81
          DcmDspDid_CmnMfgSrv_SrvFE82: DcmDspDidIdentifier=65154, DcmDspDidInfoRef=DcmDspDidInfo_CmnMfgSrv_SrvFE82
            DcmDspDidSignal: DcmDspDidDataPos=0, DcmDspDidDataRef=DcmDspData_CmnMfgSrv_SrvFE82
          DcmDspDid_CmnMfgSrv_SrvFE83: DcmDspDidIdentifier=65155, DcmDspDidInfoRef=DcmDspDidInfo_CmnMfgSrv_SrvFE83
            DcmDspDidSignal: DcmDspDidDataPos=0, DcmDspDidDataRef=DcmDspData_CmnMfgSrv_SrvFE83
        3 x DcmDspData, all with DcmDspDataUsePort=USE_DATA_ASYNCH_FNC, DcmDspDataType=UINT8, DcmDspDataConditionCheckReadFncUsed=false:
          DcmDspData_CmnMfgSrv_SrvFE83: DcmDspDataSize=32, DcmDspDataWriteFnc=CmnMfgSrvIf_Srv0xFE83Wr, DcmDspDataInfoRef=DcmDspDataInfo_CmnMfgSrv_SrvFE83
          DcmDspData_CmnMfgSrv_SrvFE82: DcmDspDataSize=32, DcmDspDataWriteFnc=CmnMfgSrvIf_Srv0xFE82Wr, DcmDspDataInfoRef=DcmDspDataInfo_CmnMfgSrv_SrvFE82
          DcmDspData_CmnMfgSrv_SrvFE81: DcmDspDataSize=104, DcmDspDataReadFnc=CmnMfgSrvIf_Srv0xFE81Rd, DcmDspDataInfoRef=DcmDspDataInfo_CmnMfgSrv_SrvFE81
        DcmDspRoutine_CmnMfgSrv_SrvFE80 (DcmDspRoutine):
          DcmDspRequestResultsRoutineSupported = false
          DcmDspRoutineIdentifier = 65152
          DcmDspRoutineUsePort = false
          DcmDspRoutineUsed = true
          DcmDspStopRoutineSupported = false
          DcmDspRoutineFixedLength = false
          DcmDspStartRoutineFnc = CmnMfgSrvIf_Srv0xFE80Strt
          DcmDspRoutineInfoRef = DcmDspRoutineInfo_CmnMfgSrv_SrvFE80
        3 x DcmDspDataInfo, all with DcmDspDataFixedLength=true:
          DcmDspDataInfo_CmnMfgSrv_SrvFE81
          DcmDspDataInfo_CmnMfgSrv_SrvFE83
          DcmDspDataInfo_CmnMfgSrv_SrvFE82
        DcmDspRoutineInfo_CmnMfgSrv_SrvFE80 (DcmDspRoutineInfo)
          DcmDspRoutineAuthorization: DcmDspRoutineSessionRef=DcmDspSessionRow_NXTRMFG
      DcmGeneral:
        DcmRespondAllRequest = false
        DcmDemApiVersion = DCM_DEM_API_4_03_00
        DcmDevErrorDetect = true
        DcmRequestManufacturerNotificationEnabled = true
        DcmRequestSupplierNotificationEnabled = false
        DcmTaskTime = 0.005
        DcmVersionInfoApi = true
        DcmDspDataDefaultEndianness = BIG_ENDIAN
        DcmSafeBswChecks = true
        DcmSupportedIDCalculationSuppressionEnabled = false
        DcmDtrDataProvisionViaDemEnabled = true
        DcmForeignDiagnosticRequestDetectionEnabled = false
        DcmSuppressResponseOnCanTpFuncMixedAddrRequests = false
        DcmResetToFblAfterSessionFinalResposeEnabled = true
        DcmSplitTasksEnabled = false
        DcmMainFunctionWorkerTaskTime = 0.1
      DcmPageBufferCfg: DcmPagedBufferEnabled=true
