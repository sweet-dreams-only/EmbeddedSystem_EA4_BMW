AUTOSAR XML (schema 4-3-0)
package /ActiveEcuC
  module config Omc: implementation-config-variant=VARIANT-PRE-COMPILE
    OmcGeneral: OmcDevErrorDetect=false, OmcOperatingModeCallout=false
    CommonPublishedInformation: SwMajorVersion=5, SwMinorVersion=1, SwPatchVersion=0
