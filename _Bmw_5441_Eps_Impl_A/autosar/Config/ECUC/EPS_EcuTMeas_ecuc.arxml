AUTOSAR XML (schema 4-3-0)
package /ActiveEcuC
  module config EcuTMeas: implementation-config-variant=VARIANT-PRE-COMPILE
    EcuTMeasGeneral: DftTemp=60, FilTau=100
    EcuTMeasConversionTables:
      EcuTx = 0.1115
      EcuTx = 1.324
      EcuTx = 1.33025
      EcuTx = 1.3365
      EcuTx = 1.34275
      EcuTx = 1.349
      EcuTx = 1.35525
      EcuTx = 1.3615
      EcuTy = -50
      EcuTy = {144..150}
    EcuTMeasDiagc: Ntc0x045FailStep=3000, Ntc0x045PassStep=3000, MaxTLim=125, MinTLim=-40
