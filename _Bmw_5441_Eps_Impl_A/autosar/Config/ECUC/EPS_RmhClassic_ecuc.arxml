AUTOSAR XML (schema 4-3-0)
package /ActiveEcuC
  module config RmhClassic: implementation-config-variant=VARIANT-PRE-COMPILE
    CommonPublishedInformation: SwMajorVersion=5, SwMinorVersion=0, SwPatchVersion=0
    RmhGeneral: RmhDevErrorDetect=false
      RmhPduTriggerMode
        RMH_MODE_TRIGGER_IPDU_SEND
          RmhRequestPduMapping: RmhRequestedMsgId=13316, RmhRequestedComTxPdu=SU_EPS_19255f18
