AUTOSAR XML (schema 4-3-0)
package /ActiveEcuC
  module config Wdg: implementation-config-variant=VARIANT-POST-BUILD, module-description=Wdg_Impl
    WdgGeneral:
      WdgVersionCheckExternalModules = false
      WdgDevErrorDetect = true
      WdgDisableAllowed = false
      WdgIndex = 0
      WdgInitialTimeout = 10
      WdgMaxTimeout = 10
      WdgRunArea = ROM
      WdgTriggerLocation = NULL
      WdgVersionInfoApi = true
      WdgCriticalSectionProtection = true
      WdgVaryingActivationCodeMode = ENABLE
      WdgDeviceName = R7F701319
      WdgInterruptConsistencyCheck = false
      WdgWriteVerify = WV_DISABLE
      WdgUseWriteVerifyErrorInterface = true
      WdgWriteVerifyErrorInterface = HndlMcalWrVrfyErr
      WdgClockRef = McuWdtacounterClk
    WdgPublishedInformation: WdgTriggerMode=WDG_WINDOW
    WdgSettingsConfig: WdgDefaultMode=WDGIF_SLOW_MODE
      WdgSettingsFast: WdgClkSettingsFast=WDGCLK_DIVBY_2POWOF_10
      WdgSettingsOff
      WdgSettingsSlow: WdgClkSettingsSlow=WDGCLK_DIVBY_2POWOF_16
    WdgDemEventParameterRefs:
      WDG_E_DISABLE_REJECTED = WDG_E_DISABLE_REJECTED
      WDG_E_INT_INCONSISTENT = WDG_E_INT_INCONSISTENT
      WDG_E_MODE_FAILED = WDG_E_MODE_FAILED
      WDG_E_REG_WRITE_VERIFY = WDG_E_REG_WRITE_VERIFY
