AUTOSAR XML (schema 4-3-0)
package /ActiveEcuC
  module config E2EPW: implementation-config-variant=VARIANT-PRE-COMPILE, module-description=E2EPW_Impl
