AUTOSAR XML (schema 4-3-0)
package /ActiveEcuC
  module config CryptoClassic: implementation-config-variant=VARIANT-PRE-COMPILE
    CommonPublishedInformation: SwMajorVersion=5, SwMinorVersion=2, SwPatchVersion=0
    Crypto_Certificate: Enable_Certificate_Code=true, Enable_Certificate_JumpTable=true
    Crypto_ECDSA: Enable_ECDSA_Code=true, Enable_ECDSA_JumpTable=true
    Crypto_RSA: Enable_RSA_JumpTable=true
    Crypto_SHA256: Enable_SHA256_Code=true, Enable_SHA256_JumpTable=true
    Crypto_SHA384: Enable_SHA384_Code=true, Enable_SHA384_JumpTable=true
    Crypto_SHA512: Enable_SHA512_Code=false, Enable_SHA512_JumpTable=true
