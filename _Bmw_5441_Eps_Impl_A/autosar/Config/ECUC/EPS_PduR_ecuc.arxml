AUTOSAR XML (schema 4-3-0)
package /ActiveEcuC
  module config PduR: implementation-config-variant=VARIANT-PRE-COMPILE, module-description=PduR_Impl
    PduRGeneral: PduRDevErrorDetect=true, PduRVersionInfoApi=false, PduRMetaDataSupport=false, PduRPduCallback=false, PduRSwitching=false, PduRSafeBswChecks=true
      PduRGeneration:
        PduROutOfBoundsWriteProtectionStrategy = NONE
        PduROutOfBoundsWriteSanitizer = false
        PduROutOfBoundsReadSanitizer = false
        PduRNumericalDataTypeMinimizationStrategy = WITH_CAST
        PduRReduceConstantData2Define = false
        PduRBoolDataInArrayOfStructStrategy = BITMASKING
        PduRDeduplicateIndirectedData = true
        PduRDataDeduplicationStrategy = WITH_CAST
        PduRReduceBoolDataByNegationThreshold = 2
        PduRReduceBoolDataByNumericalComparisonThreshold = 2
        PduRReduceBoolDataByNumericalRelationThreshold = 2
        PduRReduceBoolDataByNumericalOperandStrategy = WITH_ANY_VALUE
        PduRReduceNumericalDataByOffsetThreshold = 2
        PduRReduceNumericalDataByArraySubtractionThreshold = 2
        PduRReduceDataByStreaming = false
        PduRShortSymbols = false
        PduRInterfacesForDeactivatedData = false
        PduRReferringKeysInComments = false
    PduRRoutingTables: PduRConfigurationId=0
      PduRRoutingTable
        87 x PduRRoutingPath:
          Dcm_ECU_TRNSM_FR_32_0xF0: PduRRoutingPathCommunicationType=TRANSPORT_PROTOCOL
            DST_Dcm_ECU_TRNSM_FR_32_0xF0 (PduRDestPdu):
              PduRDestPduHandleId = 0
              PduRDestPduDirection = TRANSMIT
              PduRDestPduRoutingType = API_FORWARDING
              PduRDestPduRef = Dcm_ECU_TRNSM_FR_32_0xF0
              PduRDestPduPduRBswModulesRef = FrTp
            SRC_Dcm_ECU_TRNSM_FR_32_0xF0 (PduRSrcPdu): PduRSourcePduHandleId=1, PduRSrcPduDirection=TRANSMIT, PduRSrcPduRef=Dcm_ECU_TRNSM_FR_32_0xF0, PduRSrcPduPduRBswModulesRef=Dcm
          Dcm_BRC_FR_32_0xF0: PduRRoutingPathCommunicationType=TRANSPORT_PROTOCOL
            DST_Dcm_BRC_FR_32_0xF0 (PduRDestPdu):
              PduRDestPduHandleId = 0
              PduRDestPduDirection = RECEIVE
              PduRDestPduRoutingType = API_FORWARDING
              PduRDestPduRef = Dcm_BRC_FR_32_0xF0
              PduRDestPduPduRBswModulesRef = Dcm
            SRC_Dcm_BRC_FR_32_0xF0 (PduRSrcPdu): PduRSourcePduHandleId=0, PduRSrcPduDirection=RECEIVE, PduRSrcPduRef=Dcm_BRC_FR_32_0xF0, PduRSrcPduPduRBswModulesRef=FrTp
          Dcm_GW_TRNSM_FR_254_0xF0: PduRRoutingPathCommunicationType=TRANSPORT_PROTOCOL
            DST_Dcm_GW_TRNSM_FR_254_0xF0 (PduRDestPdu):
              PduRDestPduHandleId = 14
              PduRDestPduDirection = RECEIVE
              PduRDestPduRoutingType = API_FORWARDING
              PduRDestPduRef = Dcm_GW_TRNSM_FR_254_0xF0
              PduRDestPduPduRBswModulesRef = Dcm
            SRC_Dcm_GW_TRNSM_FR_254_0xF0 (PduRSrcPdu): PduRSourcePduHandleId=14, PduRSrcPduDirection=RECEIVE, PduRSrcPduRef=Dcm_GW_TRNSM_FR_254_0xF0, PduRSrcPduPduRBswModulesRef=FrTp
          Fr_pduTrig_ENERG_DGR_DRDY_55c86d41: PduRRoutingPathCommunicationType=COMMUNICATION_INTERFACE  # ENERG_DGR_DRDY
            DST_Fr_pduTrig_ENERG_DGR_DRDY_55c86d41 (PduRDestPdu):
              PduRDestPduHandleId = 9
              PduRDestPduDirection = RECEIVE
              PduRDestPduRoutingType = API_FORWARDING
              PduRTransmissionConfirmation = false
              PduRDestPduRef = pduTrig_ENERG_DGR_DRDY_pduPort_EPS_A_FlexRay_IN_55c86d41_4f391dd1
              PduRDestPduPduRBswModulesRef = Com
            SRC_Fr_pduTrig_ENERG_DGR_DRDY_55c86d41 (PduRSrcPdu):
              PduRSourcePduHandleId = 8
              PduRSrcPduDirection = RECEIVE
              PduRSrcPduRef = pduTrig_ENERG_DGR_DRDY_pduPort_EPS_A_FlexRay_IN_55c86d41_4f391dd1
              PduRSrcPduPduRBswModulesRef = FrIf
          ANFRAGE_fbd80461_In: PduRRoutingPathCommunicationType=COMMUNICATION_INTERFACE
            DST_ANFRAGE_fbd80461_In (PduRDestPdu):
              PduRDestPduHandleId = 0
              PduRDestPduDirection = RECEIVE
              PduRDestPduRoutingType = API_FORWARDING
              PduRTransmissionConfirmation = false
              PduRDestPduRef = ANFRAGE_fbd80461_In
              PduRDestPduPduRBswModulesRef = Com
            SRC_ANFRAGE_fbd80461_In (PduRSrcPdu): PduRSourcePduHandleId=0, PduRSrcPduDirection=RECEIVE, PduRSrcPduRef=ANFRAGE_fbd80461_In, PduRSrcPduPduRBswModulesRef=IpduM
          Fr_pduTrig_DISP_CC_EPS_55c86d41: PduRRoutingPathCommunicationType=COMMUNICATION_INTERFACE  # DISP_CC_EPS
            DST_Fr_pduTrig_DISP_CC_EPS_55c86d41 (PduRDestPdu):
              PduRDestPduHandleId = 7
              PduRDestPduDirection = TRANSMIT
              PduRDestPduRoutingType = API_FORWARDING
              PduRTransmissionConfirmation = true
              PduRDestPduDataProvision = PDUR_TRIGGERTRANSMIT
              PduRDestPduRef = pduTrig_DISP_CC_EPS_pduPort_EPS_A_FlexRay_OUT_55c86d41_4f391dd1
              PduRDestPduPduRBswModulesRef = FrIf
            SRC_Fr_pduTrig_DISP_CC_EPS_55c86d41 (PduRSrcPdu):
              PduRSourcePduHandleId = 20
              PduRSrcPduDirection = TRANSMIT
              PduRSrcPduRef = pduTrig_DISP_CC_EPS_pduPort_EPS_A_FlexRay_OUT_55c86d41_4f391dd1
              PduRSrcPduPduRBswModulesRef = Com
          ANFRAGE_fbd80461_Out: PduRRoutingPathCommunicationType=COMMUNICATION_INTERFACE
            SRC_ANFRAGE_fbd80461_Out (PduRSrcPdu): PduRSourcePduHandleId=0, PduRSrcPduDirection=TRANSMIT, PduRSrcPduRef=ANFRAGE_fbd80461_Out, PduRSrcPduPduRBswModulesRef=Com
            DST_ANFRAGE_fbd80461_Out (PduRDestPdu):
              PduRDestPduHandleId = 0
              PduRDestPduDirection = TRANSMIT
              PduRDestPduRoutingType = API_FORWARDING
              PduRTransmissionConfirmation = true
              PduRDestPduDataProvision = PDUR_TRIGGERTRANSMIT
              PduRDestPduRef = ANFRAGE_fbd80461_Out
              PduRDestPduPduRBswModulesRef = IpduM
          Fr_pduTrig_SU_EPS_55c86d41: PduRRoutingPathCommunicationType=COMMUNICATION_INTERFACE  # SU_EPS
            DST_Fr_pduTrig_SU_EPS_55c86d41 (PduRDestPdu):
              PduRDestPduHandleId = 15
              PduRDestPduDirection = TRANSMIT
              PduRDestPduRoutingType = API_FORWARDING
              PduRDestPduDataProvision = PDUR_TRIGGERTRANSMIT
              PduRTransmissionConfirmation = true
              PduRDestPduRef = pduTrig_SU_EPS_pduPort_EPS_A_FlexRay_OUT_55c86d41_4f391dd1
              PduRDestPduPduRBswModulesRef = FrIf
            SRC_Fr_pduTrig_SU_EPS_55c86d41 (PduRSrcPdu):
              PduRSourcePduHandleId = 28
              PduRSrcPduDirection = TRANSMIT
              PduRSrcPduRef = pduTrig_SU_EPS_pduPort_EPS_A_FlexRay_OUT_55c86d41_4f391dd1
              PduRSrcPduPduRBswModulesRef = Com
          Fr_pduTrig_ACLNY_MASSCNTR_55c86d41: PduRRoutingPathCommunicationType=COMMUNICATION_INTERFACE  # ACLNY_MASSCNTR
            SRC_Fr_pduTrig_ACLNY_MASSCNTR_55c86d41 (PduRSrcPdu):
              PduRSourcePduHandleId = 1
              PduRSrcPduDirection = RECEIVE
              PduRSrcPduRef = pduTrig_ACLNY_MASSCNTR_pduPort_EPS_A_FlexRay_IN_55c86d41_4f391dd1
              PduRSrcPduPduRBswModulesRef = FrIf
            DST_Fr_pduTrig_ACLNY_MASSCNTR_55c86d41 (PduRDestPdu):
              PduRDestPduHandleId = 2
              PduRDestPduDirection = RECEIVE
              PduRDestPduRoutingType = API_FORWARDING
              PduRTransmissionConfirmation = false
              PduRDestPduRef = pduTrig_ACLNY_MASSCNTR_pduPort_EPS_A_FlexRay_IN_55c86d41_4f391dd1
              PduRDestPduPduRBswModulesRef = Com
          Fr_pduTrig_AVL_STMOM_DV_ACT_55c86d41: PduRRoutingPathCommunicationType=COMMUNICATION_INTERFACE  # AVL_STMOM_DV_ACT
            SRC_Fr_pduTrig_AVL_STMOM_DV_ACT_55c86d41 (PduRSrcPdu):
              PduRSourcePduHandleId = 17
              PduRSrcPduDirection = TRANSMIT
              PduRSrcPduRef = pduTrig_AVL_STMOM_DV_ACT_pduPort_EPS_A_FlexRay_OUT_55c86d41_4f391dd1
              PduRSrcPduPduRBswModulesRef = Com
            DST_Fr_pduTrig_AVL_STMOM_DV_ACT_55c86d41 (PduRDestPdu):
              PduRDestPduHandleId = 4
              PduRDestPduDirection = TRANSMIT
              PduRDestPduRoutingType = API_FORWARDING
              PduRTransmissionConfirmation = false
              PduRDestPduDataProvision = PDUR_TRIGGERTRANSMIT
              PduRDestPduRef = pduTrig_AVL_STMOM_DV_ACT_pduPort_EPS_A_FlexRay_OUT_55c86d41_4f391dd1
              PduRDestPduPduRBswModulesRef = FrIf
          SVC_fbd80461_Out: PduRRoutingPathCommunicationType=COMMUNICATION_INTERFACE
            DST_SVC_fbd80461_Out (PduRDestPdu):
              PduRDestPduHandleId = 1
              PduRDestPduDirection = TRANSMIT
              PduRDestPduRoutingType = API_FORWARDING
              PduRTransmissionConfirmation = true
              PduRDestPduDataProvision = PDUR_TRIGGERTRANSMIT
              PduRDestPduRef = SVC_fbd80461_Out
              PduRDestPduPduRBswModulesRef = FrIf
            SRC_SVC_fbd80461_Out (PduRSrcPdu): PduRSourcePduHandleId=29, PduRSrcPduDirection=TRANSMIT, PduRSrcPduRef=SVC_fbd80461_Out, PduRSrcPduPduRBswModulesRef=IpduM
          Fr_pduTrig_DBG_EPS_BS_MOD_58_BYTE_55c86d41: PduRRoutingPathCommunicationType=COMMUNICATION_INTERFACE  # DBG_EPS_BS_MOD_58_BYTE
            DST_Fr_pduTrig_DBG_EPS_BS_MOD_58_BYTE_55c86d41 (PduRDestPdu):
              PduRDestPduHandleId = 5
              PduRDestPduDirection = TRANSMIT
              PduRDestPduRoutingType = API_FORWARDING
              PduRTransmissionConfirmation = false
              PduRDestPduDataProvision = PDUR_TRIGGERTRANSMIT
              PduRDestPduRef = pduTrig_DBG_EPS_BS_MOD_58_BYTE_pduPort_EPS_A_FlexRay_OUT_55c86d41_4f391dd1
              PduRDestPduPduRBswModulesRef = IpduM
            SRC_Fr_pduTrig_DBG_EPS_BS_MOD_58_BYTE_55c86d41 (PduRSrcPdu):
              PduRSourcePduHandleId = 18
              PduRSrcPduDirection = TRANSMIT
              PduRSrcPduRef = pduTrig_DBG_EPS_BS_MOD_58_BYTE_pduPort_EPS_A_FlexRay_OUT_55c86d41_4f391dd1
              PduRSrcPduPduRBswModulesRef = Com
          Fr_pduTrig_AVL_FORC_GRD_55c86d41: PduRRoutingPathCommunicationType=COMMUNICATION_INTERFACE  # AVL_FORC_GRD
            DST_Fr_pduTrig_AVL_FORC_GRD_55c86d41 (PduRDestPdu):
              PduRDestPduHandleId = 2
              PduRDestPduDirection = TRANSMIT
              PduRDestPduRoutingType = API_FORWARDING
              PduRDestPduDataProvision = PDUR_TRIGGERTRANSMIT
              PduRTransmissionConfirmation = false
              PduRDestPduRef = pduTrig_AVL_FORC_GRD_pduPort_EPS_A_FlexRay_OUT_55c86d41_4f391dd1
              PduRDestPduPduRBswModulesRef = FrIf
            SRC_Fr_pduTrig_AVL_FORC_GRD_55c86d41 (PduRSrcPdu):
              PduRSourcePduHandleId = 15
              PduRSrcPduDirection = TRANSMIT
              PduRSrcPduRef = pduTrig_AVL_FORC_GRD_pduPort_EPS_A_FlexRay_OUT_55c86d41_4f391dd1
              PduRSrcPduPduRBswModulesRef = Com
          Fr_pduTrig_TAR_QTA_STRMOM_DV_55c86d41: PduRRoutingPathCommunicationType=COMMUNICATION_INTERFACE  # TAR_QTA_STRMOM_DV
            DST_Fr_pduTrig_TAR_QTA_STRMOM_DV_55c86d41 (PduRDestPdu):
              PduRDestPduHandleId = 25
              PduRDestPduDirection = RECEIVE
              PduRDestPduRoutingType = API_FORWARDING
              PduRTransmissionConfirmation = false
              PduRDestPduRef = pduTrig_TAR_QTA_STRMOM_DV_pduPort_EPS_A_FlexRay_IN_55c86d41_4f391dd1
              PduRDestPduPduRBswModulesRef = Com
            SRC_Fr_pduTrig_TAR_QTA_STRMOM_DV_55c86d41 (PduRSrcPdu):
              PduRSourcePduHandleId = 24
              PduRSrcPduDirection = RECEIVE
              PduRSrcPduRef = pduTrig_TAR_QTA_STRMOM_DV_pduPort_EPS_A_FlexRay_IN_55c86d41_4f391dd1
              PduRSrcPduPduRBswModulesRef = FrIf
          Fr_pduTrig_SECU_CHAL_55c86d41: PduRRoutingPathCommunicationType=COMMUNICATION_INTERFACE  # SECU_CHAL
            DST_Fr_pduTrig_SECU_CHAL_55c86d41 (PduRDestPdu):
              PduRDestPduHandleId = 12
              PduRDestPduDirection = TRANSMIT
              PduRDestPduRoutingType = API_FORWARDING
              PduRDestPduDataProvision = PDUR_TRIGGERTRANSMIT
              PduRTransmissionConfirmation = true
              PduRDestPduRef = pduTrig_SECU_CHAL_pduPort_EPS_A_FlexRay_OUT_55c86d41_4f391dd1
              PduRDestPduPduRBswModulesRef = IpduM
            SRC_Fr_pduTrig_SECU_CHAL_55c86d41 (PduRSrcPdu):
              PduRSourcePduHandleId = 25
              PduRSrcPduDirection = TRANSMIT
              PduRSrcPduRef = pduTrig_SECU_CHAL_pduPort_EPS_A_FlexRay_OUT_55c86d41_4f391dd1
              PduRSrcPduPduRBswModulesRef = Com
          Fr_pduTrig_CTR_DIAG_OBD_DRDY_55c86d41: PduRRoutingPathCommunicationType=COMMUNICATION_INTERFACE  # CTR_DIAG_OBD_DRDY
            SRC_Fr_pduTrig_CTR_DIAG_OBD_DRDY_55c86d41 (PduRSrcPdu):
              PduRSourcePduHandleId = 5
              PduRSrcPduDirection = RECEIVE
              PduRSrcPduRef = pduTrig_CTR_DIAG_OBD_DRDY_pduPort_EPS_A_FlexRay_IN_55c86d41_4f391dd1
              PduRSrcPduPduRBswModulesRef = FrIf
            DST_Fr_pduTrig_CTR_DIAG_OBD_DRDY_55c86d41 (PduRDestPdu):
              PduRDestPduHandleId = 6
              PduRDestPduDirection = RECEIVE
              PduRDestPduRoutingType = API_FORWARDING
              PduRTransmissionConfirmation = false
              PduRDestPduRef = pduTrig_CTR_DIAG_OBD_DRDY_pduPort_EPS_A_FlexRay_IN_55c86d41_4f391dd1
              PduRDestPduPduRBswModulesRef = Com
          Fr_pduTrig_FAHRGESTELLNUMMER_55c86d41: PduRRoutingPathCommunicationType=COMMUNICATION_INTERFACE  # FAHRGESTELLNUMMER
            DST_Fr_pduTrig_FAHRGESTELLNUMMER_55c86d41 (PduRDestPdu):
              PduRDestPduHandleId = 12
              PduRDestPduDirection = RECEIVE
              PduRDestPduRoutingType = API_FORWARDING
              PduRTransmissionConfirmation = false
              PduRDestPduRef = pduTrig_FAHRGESTELLNUMMER_pduPort_EPS_A_FlexRay_IN_55c86d41_4f391dd1
              PduRDestPduPduRBswModulesRef = Com
            SRC_Fr_pduTrig_FAHRGESTELLNUMMER_55c86d41 (PduRSrcPdu):
              PduRSourcePduHandleId = 11
              PduRSrcPduDirection = RECEIVE
              PduRSrcPduRef = pduTrig_FAHRGESTELLNUMMER_pduPort_EPS_A_FlexRay_IN_55c86d41_4f391dd1
              PduRSrcPduPduRBswModulesRef = FrIf
          Fr_pduTrig_OFFS_QUAD_EPS_55c86d41: PduRRoutingPathCommunicationType=COMMUNICATION_INTERFACE  # OFFS_QUAD_EPS
            SRC_Fr_pduTrig_OFFS_QUAD_EPS_55c86d41 (PduRSrcPdu):
              PduRSourcePduHandleId = 14
              PduRSrcPduDirection = RECEIVE
              PduRSrcPduRef = pduTrig_OFFS_QUAD_EPS_pduPort_EPS_A_FlexRay_IN_55c86d41_4f391dd1
              PduRSrcPduPduRBswModulesRef = FrIf
            DST_Fr_pduTrig_OFFS_QUAD_EPS_55c86d41 (PduRDestPdu):
              PduRDestPduHandleId = 15
              PduRDestPduDirection = RECEIVE
              PduRDestPduRoutingType = API_FORWARDING
              PduRTransmissionConfirmation = false
              PduRDestPduRef = pduTrig_OFFS_QUAD_EPS_pduPort_EPS_A_FlexRay_IN_55c86d41_4f391dd1
              PduRDestPduPduRBswModulesRef = Com
          Fr_pduTrig_FZZSTD_55c86d41: PduRRoutingPathCommunicationType=COMMUNICATION_INTERFACE  # FZZSTD
            SRC_Fr_pduTrig_FZZSTD_55c86d41 (PduRSrcPdu):
              PduRSourcePduHandleId = 12
              PduRSrcPduDirection = RECEIVE
              PduRSrcPduRef = pduTrig_FZZSTD_pduPort_EPS_A_FlexRay_IN_55c86d41_4f391dd1
              PduRSrcPduPduRBswModulesRef = FrIf
            DST_Fr_pduTrig_FZZSTD_55c86d41 (PduRDestPdu):
              PduRDestPduHandleId = 13
              PduRDestPduDirection = RECEIVE
              PduRDestPduRoutingType = API_FORWARDING
              PduRTransmissionConfirmation = false
              PduRDestPduRef = pduTrig_FZZSTD_pduPort_EPS_A_FlexRay_IN_55c86d41_4f391dd1
              PduRDestPduPduRBswModulesRef = Com
          Fr_pduTrig_V_VEH_55c86d41: PduRRoutingPathCommunicationType=COMMUNICATION_INTERFACE  # V_VEH
            DST_Fr_pduTrig_V_VEH_55c86d41 (PduRDestPdu):
              PduRDestPduHandleId = 28
              PduRDestPduDirection = RECEIVE
              PduRDestPduRoutingType = API_FORWARDING
              PduRTransmissionConfirmation = false
              PduRDestPduRef = pduTrig_V_VEH_pduPort_EPS_A_FlexRay_IN_55c86d41_4f391dd1
              PduRDestPduPduRBswModulesRef = Com
            SRC_Fr_pduTrig_V_VEH_55c86d41 (PduRSrcPdu):
              PduRSourcePduHandleId = 27
              PduRSrcPduDirection = RECEIVE
              PduRSrcPduRef = pduTrig_V_VEH_pduPort_EPS_A_FlexRay_IN_55c86d41_4f391dd1
              PduRSrcPduPduRBswModulesRef = FrIf
          Fr_pduTrig_VYAW_VEH_55c86d41: PduRRoutingPathCommunicationType=COMMUNICATION_INTERFACE  # VYAW_VEH
            SRC_Fr_pduTrig_VYAW_VEH_55c86d41 (PduRSrcPdu):
              PduRSourcePduHandleId = 26
              PduRSrcPduDirection = RECEIVE
              PduRSrcPduRef = pduTrig_VYAW_VEH_pduPort_EPS_A_FlexRay_IN_55c86d41_4f391dd1
              PduRSrcPduPduRBswModulesRef = FrIf
            DST_Fr_pduTrig_VYAW_VEH_55c86d41 (PduRDestPdu):
              PduRDestPduHandleId = 27
              PduRDestPduDirection = RECEIVE
              PduRDestPduRoutingType = API_FORWARDING
              PduRTransmissionConfirmation = false
              PduRDestPduRef = pduTrig_VYAW_VEH_pduPort_EPS_A_FlexRay_IN_55c86d41_4f391dd1
              PduRDestPduPduRBswModulesRef = Com
          Fr_pduTrig_SECU_FAHRGESTELLNUMMER_55c86d41: PduRRoutingPathCommunicationType=COMMUNICATION_INTERFACE  # SECU_FAHRGESTELLNUMMER
            DST_Fr_pduTrig_SECU_FAHRGESTELLNUMMER_55c86d41 (PduRDestPdu):
              PduRDestPduHandleId = 17
              PduRDestPduDirection = RECEIVE
              PduRDestPduRoutingType = API_FORWARDING
              PduRTransmissionConfirmation = false
              PduRDestPduRef = pduTrig_SECU_FAHRGESTELLNUMMER_pduPort_EPS_A_FlexRay_IN_55c86d41_4f391dd1
              PduRDestPduPduRBswModulesRef = Com
            SRC_Fr_pduTrig_SECU_FAHRGESTELLNUMMER_55c86d41 (PduRSrcPdu):
              PduRSourcePduHandleId = 16
              PduRSrcPduDirection = RECEIVE
              PduRSrcPduRef = pduTrig_SECU_FAHRGESTELLNUMMER_pduPort_EPS_A_FlexRay_IN_55c86d41_4f391dd1
              PduRSrcPduPduRBswModulesRef = FrIf
          Fr_pduTrig_A_TEMP_55c86d41: PduRRoutingPathCommunicationType=COMMUNICATION_INTERFACE  # A_TEMP
            SRC_Fr_pduTrig_A_TEMP_55c86d41 (PduRSrcPdu):
              PduRSourcePduHandleId = 3
              PduRSrcPduDirection = RECEIVE
              PduRSrcPduRef = pduTrig_A_TEMP_pduPort_EPS_A_FlexRay_IN_55c86d41_4f391dd1
              PduRSrcPduPduRBswModulesRef = FrIf
            DST_Fr_pduTrig_A_TEMP_55c86d41 (PduRDestPdu):
              PduRDestPduHandleId = 4
              PduRDestPduDirection = RECEIVE
              PduRDestPduRoutingType = API_FORWARDING
              PduRTransmissionConfirmation = false
              PduRDestPduRef = pduTrig_A_TEMP_pduPort_EPS_A_FlexRay_IN_55c86d41_4f391dd1
              PduRDestPduPduRBswModulesRef = Com
          Fr_pduTrig_ST_EST_55c86d41: PduRRoutingPathCommunicationType=COMMUNICATION_INTERFACE  # ST_EST
            DST_Fr_pduTrig_ST_EST_55c86d41 (PduRDestPdu):
              PduRDestPduHandleId = 14
              PduRDestPduDirection = TRANSMIT
              PduRDestPduRoutingType = API_FORWARDING
              PduRDestPduDataProvision = PDUR_TRIGGERTRANSMIT
              PduRTransmissionConfirmation = true
              PduRDestPduRef = pduTrig_ST_EST_pduPort_EPS_A_FlexRay_OUT_55c86d41_4f391dd1
              PduRDestPduPduRBswModulesRef = FrIf
            SRC_Fr_pduTrig_ST_EST_55c86d41 (PduRSrcPdu):
              PduRSourcePduHandleId = 27
              PduRSrcPduDirection = TRANSMIT
              PduRSrcPduRef = pduTrig_ST_EST_pduPort_EPS_A_FlexRay_OUT_55c86d41_4f391dd1
              PduRSrcPduPduRBswModulesRef = Com
          Fr_pduTrig_ST_STAB_DSC_55c86d41: PduRRoutingPathCommunicationType=COMMUNICATION_INTERFACE  # ST_STAB_DSC
            DST_Fr_pduTrig_ST_STAB_DSC_55c86d41 (PduRDestPdu):
              PduRDestPduHandleId = 22
              PduRDestPduDirection = RECEIVE
              PduRDestPduRoutingType = API_FORWARDING
              PduRTransmissionConfirmation = false
              PduRDestPduRef = pduTrig_ST_STAB_DSC_pduPort_EPS_A_FlexRay_IN_55c86d41_4f391dd1
              PduRDestPduPduRBswModulesRef = Com
            SRC_Fr_pduTrig_ST_STAB_DSC_55c86d41 (PduRSrcPdu):
              PduRSourcePduHandleId = 21
              PduRSrcPduDirection = RECEIVE
              PduRSrcPduRef = pduTrig_ST_STAB_DSC_pduPort_EPS_A_FlexRay_IN_55c86d41_4f391dd1
              PduRSrcPduPduRBswModulesRef = FrIf
          Fr_pduTrig_DBG_EPS_MOD_EXT_120_BYTE_55c86d41: PduRRoutingPathCommunicationType=COMMUNICATION_INTERFACE  # DBG_EPS_MOD_EXT_120_BYTE
            SRC_Fr_pduTrig_DBG_EPS_MOD_EXT_120_BYTE_55c86d41 (PduRSrcPdu):
              PduRSourcePduHandleId = 19
              PduRSrcPduDirection = TRANSMIT
              PduRSrcPduRef = pduTrig_DBG_EPS_MOD_EXT_120_BYTE_pduPort_EPS_A_FlexRay_OUT_55c86d41_4f391dd1
              PduRSrcPduPduRBswModulesRef = Com
            DST_Fr_pduTrig_DBG_EPS_MOD_EXT_120_BYTE_55c86d41 (PduRDestPdu):
              PduRDestPduHandleId = 6
              PduRDestPduDirection = TRANSMIT
              PduRDestPduRoutingType = API_FORWARDING
              PduRDestPduDataProvision = PDUR_TRIGGERTRANSMIT
              PduRTransmissionConfirmation = false
              PduRDestPduRef = pduTrig_DBG_EPS_MOD_EXT_120_BYTE_pduPort_EPS_A_FlexRay_OUT_55c86d41_4f391dd1
              PduRDestPduPduRBswModulesRef = IpduM
          Fr_pduTrig_FR_DBG_EPS_55c86d41: PduRRoutingPathCommunicationType=COMMUNICATION_INTERFACE  # FR_DBG_EPS
            DST_Fr_pduTrig_FR_DBG_EPS_55c86d41 (PduRDestPdu):
              PduRDestPduHandleId = 10
              PduRDestPduDirection = TRANSMIT
              PduRDestPduRoutingType = API_FORWARDING
              PduRTransmissionConfirmation = false
              PduRDestPduDataProvision = PDUR_TRIGGERTRANSMIT
              PduRDestPduRef = pduTrig_FR_DBG_EPS_pduPort_EPS_A_FlexRay_OUT_55c86d41_4f391dd1
              PduRDestPduPduRBswModulesRef = FrIf
            SRC_Fr_pduTrig_FR_DBG_EPS_55c86d41 (PduRSrcPdu):
              PduRSourcePduHandleId = 23
              PduRSrcPduDirection = TRANSMIT
              PduRSrcPduRef = pduTrig_FR_DBG_EPS_pduPort_EPS_A_FlexRay_OUT_55c86d41_4f391dd1
              PduRSrcPduPduRBswModulesRef = IpduM
          Fr_pduTrig_RQ_STG_EFAN_55c86d41: PduRRoutingPathCommunicationType=COMMUNICATION_INTERFACE  # RQ_STG_EFAN
            SRC_Fr_pduTrig_RQ_STG_EFAN_55c86d41 (PduRSrcPdu):
              PduRSourcePduHandleId = 24
              PduRSrcPduDirection = TRANSMIT
              PduRSrcPduRef = pduTrig_RQ_STG_EFAN_pduPort_EPS_A_FlexRay_OUT_55c86d41_4f391dd1
              PduRSrcPduPduRBswModulesRef = Com
            DST_Fr_pduTrig_RQ_STG_EFAN_55c86d41 (PduRDestPdu):
              PduRDestPduHandleId = 11
              PduRDestPduDirection = TRANSMIT
              PduRDestPduRoutingType = API_FORWARDING
              PduRDestPduDataProvision = PDUR_TRIGGERTRANSMIT
              PduRTransmissionConfirmation = false
              PduRDestPduRef = pduTrig_RQ_STG_EFAN_pduPort_EPS_A_FlexRay_OUT_55c86d41_4f391dd1
              PduRDestPduPduRBswModulesRef = IpduM
          Fr_pduTrig_ENGTORQ_EPS_55c86d41: PduRRoutingPathCommunicationType=COMMUNICATION_INTERFACE  # ENGTORQ_EPS
            DST_Fr_pduTrig_ENGTORQ_EPS_55c86d41 (PduRDestPdu):
              PduRDestPduHandleId = 9
              PduRDestPduDirection = TRANSMIT
              PduRDestPduRoutingType = API_FORWARDING
              PduRDestPduDataProvision = PDUR_TRIGGERTRANSMIT
              PduRTransmissionConfirmation = false
              PduRDestPduRef = pduTrig_ENGTORQ_EPS_pduPort_EPS_A_FlexRay_OUT_55c86d41_4f391dd1
              PduRDestPduPduRBswModulesRef = FrIf
            SRC_Fr_pduTrig_ENGTORQ_EPS_55c86d41 (PduRSrcPdu):
              PduRSourcePduHandleId = 22
              PduRSrcPduDirection = TRANSMIT
              PduRSrcPduRef = pduTrig_ENGTORQ_EPS_pduPort_EPS_A_FlexRay_OUT_55c86d41_4f391dd1
              PduRSrcPduPduRBswModulesRef = Com
          Fr_pduTrig_SU_CLE_DRDY_DXP_55c86d41: PduRRoutingPathCommunicationType=COMMUNICATION_INTERFACE  # SU_CLE_DRDY_DXP
            SRC_Fr_pduTrig_SU_CLE_DRDY_DXP_55c86d41 (PduRSrcPdu):
              PduRSourcePduHandleId = 22
              PduRSrcPduDirection = RECEIVE
              PduRSrcPduRef = pduTrig_SU_CLE_DRDY_DXP_pduPort_EPS_A_FlexRay_IN_55c86d41_4f391dd1
              PduRSrcPduPduRBswModulesRef = FrIf
            DST_Fr_pduTrig_SU_CLE_DRDY_DXP_55c86d41 (PduRDestPdu):
              PduRDestPduHandleId = 23
              PduRDestPduDirection = RECEIVE
              PduRDestPduRoutingType = API_FORWARDING
              PduRTransmissionConfirmation = false
              PduRDestPduRef = pduTrig_SU_CLE_DRDY_DXP_pduPort_EPS_A_FlexRay_IN_55c86d41_4f391dd1
              PduRDestPduPduRBswModulesRef = Com
          Fr_pduTrig_CTR_VIB_STW_DISP_EXMI_SP2015_55c86d41: PduRRoutingPathCommunicationType=COMMUNICATION_INTERFACE  # CTR_VIB_STW_DISP_EXMI_SP2015
            SRC_Fr_pduTrig_CTR_VIB_STW_DISP_EXMI_SP2015_55c86d41 (PduRSrcPdu):
              PduRSourcePduHandleId = 6
              PduRSrcPduDirection = RECEIVE
              PduRSrcPduRef = pduTrig_CTR_VIB_STW_DISP_EXMI_SP2015_pduPort_EPS_A_FlexRay_IN_55c86d41_4f391dd1
              PduRSrcPduPduRBswModulesRef = FrIf
            DST_Fr_pduTrig_CTR_VIB_STW_DISP_EXMI_SP2015_55c86d41 (PduRDestPdu):
              PduRDestPduHandleId = 7
              PduRDestPduDirection = RECEIVE
              PduRDestPduRoutingType = API_FORWARDING
              PduRTransmissionConfirmation = false
              PduRDestPduRef = pduTrig_CTR_VIB_STW_DISP_EXMI_SP2015_pduPort_EPS_A_FlexRay_IN_55c86d41_4f391dd1
              PduRDestPduPduRBswModulesRef = Com
          Fr_pduTrig_STEA_OFFS_55c86d41: PduRRoutingPathCommunicationType=COMMUNICATION_INTERFACE  # STEA_OFFS
            SRC_Fr_pduTrig_STEA_OFFS_55c86d41 (PduRSrcPdu):
              PduRSourcePduHandleId = 18
              PduRSrcPduDirection = RECEIVE
              PduRSrcPduRef = pduTrig_STEA_OFFS_pduPort_EPS_A_FlexRay_IN_55c86d41_4f391dd1
              PduRSrcPduPduRBswModulesRef = FrIf
            DST_Fr_pduTrig_STEA_OFFS_55c86d41 (PduRDestPdu):
              PduRDestPduHandleId = 19
              PduRDestPduDirection = RECEIVE
              PduRDestPduRoutingType = API_FORWARDING
              PduRTransmissionConfirmation = false
              PduRDestPduRef = pduTrig_STEA_OFFS_pduPort_EPS_A_FlexRay_IN_55c86d41_4f391dd1
              PduRDestPduPduRBswModulesRef = Com
          SVC_fbd80461_In: PduRRoutingPathCommunicationType=COMMUNICATION_INTERFACE
            DST_SVC_fbd80461_In (PduRDestPdu):
              PduRDestPduHandleId = 1
              PduRDestPduDirection = RECEIVE
              PduRDestPduRoutingType = API_FORWARDING
              PduRTransmissionConfirmation = false
              PduRDestPduRef = SVC_fbd80461_In
              PduRDestPduPduRBswModulesRef = IpduM
            SRC_SVC_fbd80461_In (PduRSrcPdu): PduRSourcePduHandleId=28, PduRSrcPduDirection=RECEIVE, PduRSrcPduRef=SVC_fbd80461_In, PduRSrcPduPduRBswModulesRef=FrIf
          Fr_pduTrig_DIAG_OBD_ENG_55c86d41: PduRRoutingPathCommunicationType=COMMUNICATION_INTERFACE  # DIAG_OBD_ENG
            SRC_Fr_pduTrig_DIAG_OBD_ENG_55c86d41 (PduRSrcPdu):
              PduRSourcePduHandleId = 7
              PduRSrcPduDirection = RECEIVE
              PduRSrcPduRef = pduTrig_DIAG_OBD_ENG_pduPort_EPS_A_FlexRay_IN_55c86d41_4f391dd1
              PduRSrcPduPduRBswModulesRef = FrIf
            DST_Fr_pduTrig_DIAG_OBD_ENG_55c86d41 (PduRDestPdu):
              PduRDestPduHandleId = 8
              PduRDestPduDirection = RECEIVE
              PduRDestPduRoutingType = API_FORWARDING
              PduRTransmissionConfirmation = false
              PduRDestPduRef = pduTrig_DIAG_OBD_ENG_pduPort_EPS_A_FlexRay_IN_55c86d41_4f391dd1
              PduRDestPduPduRBswModulesRef = Com
          Fr_pduTrig_ST_CENG_55c86d41: PduRRoutingPathCommunicationType=COMMUNICATION_INTERFACE  # ST_CENG
            DST_Fr_pduTrig_ST_CENG_55c86d41 (PduRDestPdu):
              PduRDestPduHandleId = 20
              PduRDestPduDirection = RECEIVE
              PduRDestPduRoutingType = API_FORWARDING
              PduRTransmissionConfirmation = false
              PduRDestPduRef = pduTrig_ST_CENG_pduPort_EPS_A_FlexRay_IN_55c86d41_4f391dd1
              PduRDestPduPduRBswModulesRef = Com
            SRC_Fr_pduTrig_ST_CENG_55c86d41 (PduRSrcPdu):
              PduRSourcePduHandleId = 19
              PduRSrcPduDirection = RECEIVE
              PduRSrcPduRef = pduTrig_ST_CENG_pduPort_EPS_A_FlexRay_IN_55c86d41_4f391dd1
              PduRSrcPduPduRBswModulesRef = FrIf
          Fr_pduTrig_AVL_PO_EPS_55c86d41: PduRRoutingPathCommunicationType=COMMUNICATION_INTERFACE  # AVL_PO_EPS
            DST_Fr_pduTrig_AVL_PO_EPS_55c86d41 (PduRDestPdu):
              PduRDestPduHandleId = 3
              PduRDestPduDirection = TRANSMIT
              PduRDestPduRoutingType = API_FORWARDING
              PduRDestPduDataProvision = PDUR_TRIGGERTRANSMIT
              PduRTransmissionConfirmation = false
              PduRDestPduRef = pduTrig_AVL_PO_EPS_pduPort_EPS_A_FlexRay_OUT_55c86d41_4f391dd1
              PduRDestPduPduRBswModulesRef = FrIf
            SRC_Fr_pduTrig_AVL_PO_EPS_55c86d41 (PduRSrcPdu):
              PduRSourcePduHandleId = 16
              PduRSrcPduDirection = TRANSMIT
              PduRSrcPduRef = pduTrig_AVL_PO_EPS_pduPort_EPS_A_FlexRay_OUT_55c86d41_4f391dd1
              PduRSrcPduPduRBswModulesRef = Com
          Fr_pduTrig_KILOMETERSTAND_55c86d41: PduRRoutingPathCommunicationType=COMMUNICATION_INTERFACE  # KILOMETERSTAND
            SRC_Fr_pduTrig_KILOMETERSTAND_55c86d41 (PduRSrcPdu):
              PduRSourcePduHandleId = 13
              PduRSrcPduDirection = RECEIVE
              PduRSrcPduRef = pduTrig_KILOMETERSTAND_pduPort_EPS_A_FlexRay_IN_55c86d41_4f391dd1
              PduRSrcPduPduRBswModulesRef = FrIf
            DST_Fr_pduTrig_KILOMETERSTAND_55c86d41 (PduRDestPdu):
              PduRDestPduHandleId = 14
              PduRDestPduDirection = RECEIVE
              PduRDestPduRoutingType = API_FORWARDING
              PduRTransmissionConfirmation = false
              PduRDestPduRef = pduTrig_KILOMETERSTAND_pduPort_EPS_A_FlexRay_IN_55c86d41_4f391dd1
              PduRDestPduPduRBswModulesRef = Com
          Fr_pduTrig_ENSU_SFY_55c86d41: PduRRoutingPathCommunicationType=COMMUNICATION_INTERFACE  # ENSU_SFY
            DST_Fr_pduTrig_ENSU_SFY_55c86d41 (PduRDestPdu):
              PduRDestPduHandleId = 10
              PduRDestPduDirection = RECEIVE
              PduRDestPduRoutingType = API_FORWARDING
              PduRTransmissionConfirmation = false
              PduRDestPduRef = pduTrig_ENSU_SFY_pduPort_EPS_A_FlexRay_IN_55c86d41_4f391dd1
              PduRDestPduPduRBswModulesRef = Com
            SRC_Fr_pduTrig_ENSU_SFY_55c86d41 (PduRSrcPdu):
              PduRSourcePduHandleId = 9
              PduRSrcPduDirection = RECEIVE
              PduRSrcPduRef = pduTrig_ENSU_SFY_pduPort_EPS_A_FlexRay_IN_55c86d41_4f391dd1
              PduRSrcPduPduRBswModulesRef = FrIf
          Fr_pduTrig_ERRM_BN_U_55c86d41: PduRRoutingPathCommunicationType=COMMUNICATION_INTERFACE  # ERRM_BN_U
            SRC_Fr_pduTrig_ERRM_BN_U_55c86d41 (PduRSrcPdu):
              PduRSourcePduHandleId = 10
              PduRSrcPduDirection = RECEIVE
              PduRSrcPduRef = pduTrig_ERRM_BN_U_pduPort_EPS_A_FlexRay_IN_55c86d41_4f391dd1
              PduRSrcPduPduRBswModulesRef = FrIf
            DST_Fr_pduTrig_ERRM_BN_U_55c86d41 (PduRDestPdu):
              PduRDestPduHandleId = 11
              PduRDestPduDirection = RECEIVE
              PduRDestPduRoutingType = API_FORWARDING
              PduRTransmissionConfirmation = false
              PduRDestPduRef = pduTrig_ERRM_BN_U_pduPort_EPS_A_FlexRay_IN_55c86d41_4f391dd1
              PduRDestPduPduRBswModulesRef = Com
          Fr_pduTrig_AVL_RPM_WHL_55c86d41: PduRRoutingPathCommunicationType=COMMUNICATION_INTERFACE  # AVL_RPM_WHL
            DST_Fr_pduTrig_AVL_RPM_WHL_55c86d41 (PduRDestPdu):
              PduRDestPduHandleId = 3
              PduRDestPduDirection = RECEIVE
              PduRDestPduRoutingType = API_FORWARDING
              PduRTransmissionConfirmation = false
              PduRDestPduRef = pduTrig_AVL_RPM_WHL_pduPort_EPS_A_FlexRay_IN_55c86d41_4f391dd1
              PduRDestPduPduRBswModulesRef = Com
            SRC_Fr_pduTrig_AVL_RPM_WHL_55c86d41 (PduRSrcPdu):
              PduRSourcePduHandleId = 2
              PduRSrcPduDirection = RECEIVE
              PduRSrcPduRef = pduTrig_AVL_RPM_WHL_pduPort_EPS_A_FlexRay_IN_55c86d41_4f391dd1
              PduRSrcPduPduRBswModulesRef = FrIf
          Fr_pduTrig_SECU_RESP_55c86d41: PduRRoutingPathCommunicationType=COMMUNICATION_INTERFACE  # SECU_RESP
            DST_Fr_pduTrig_SECU_RESP_55c86d41 (PduRDestPdu):
              PduRDestPduHandleId = 18
              PduRDestPduDirection = RECEIVE
              PduRDestPduRoutingType = API_FORWARDING
              PduRTransmissionConfirmation = false
              PduRDestPduRef = pduTrig_SECU_RESP_pduPort_EPS_A_FlexRay_IN_55c86d41_4f391dd1
              PduRDestPduPduRBswModulesRef = Com
            SRC_Fr_pduTrig_SECU_RESP_55c86d41 (PduRSrcPdu):
              PduRSourcePduHandleId = 17
              PduRSrcPduDirection = RECEIVE
              PduRSrcPduRef = pduTrig_SECU_RESP_pduPort_EPS_A_FlexRay_IN_55c86d41_4f391dd1
              PduRSrcPduPduRBswModulesRef = IpduM
          Fr_pduTrig_ST_ENERG_GEN_55c86d41: PduRRoutingPathCommunicationType=COMMUNICATION_INTERFACE  # ST_ENERG_GEN
            DST_Fr_pduTrig_ST_ENERG_GEN_55c86d41 (PduRDestPdu):
              PduRDestPduHandleId = 21
              PduRDestPduDirection = RECEIVE
              PduRDestPduRoutingType = API_FORWARDING
              PduRTransmissionConfirmation = false
              PduRDestPduRef = pduTrig_ST_ENERG_GEN_pduPort_EPS_A_FlexRay_IN_55c86d41_4f391dd1
              PduRDestPduPduRBswModulesRef = Com
            SRC_Fr_pduTrig_ST_ENERG_GEN_55c86d41 (PduRSrcPdu):
              PduRSourcePduHandleId = 20
              PduRSrcPduDirection = RECEIVE
              PduRSrcPduRef = pduTrig_ST_ENERG_GEN_pduPort_EPS_A_FlexRay_IN_55c86d41_4f391dd1
              PduRSrcPduPduRBswModulesRef = FrIf
          Fr_pduTrig_ST_DIAG_OBD_3_DRDY_55c86d41: PduRRoutingPathCommunicationType=COMMUNICATION_INTERFACE  # ST_DIAG_OBD_3_DRDY
            SRC_Fr_pduTrig_ST_DIAG_OBD_3_DRDY_55c86d41 (PduRSrcPdu):
              PduRSourcePduHandleId = 26
              PduRSrcPduDirection = TRANSMIT
              PduRSrcPduRef = pduTrig_ST_DIAG_OBD_3_DRDY_pduPort_EPS_A_FlexRay_OUT_55c86d41_4f391dd1
              PduRSrcPduPduRBswModulesRef = Com
            DST_Fr_pduTrig_ST_DIAG_OBD_3_DRDY_55c86d41 (PduRDestPdu):
              PduRDestPduHandleId = 13
              PduRDestPduDirection = TRANSMIT
              PduRDestPduRoutingType = API_FORWARDING
              PduRDestPduDataProvision = PDUR_TRIGGERTRANSMIT
              PduRTransmissionConfirmation = true
              PduRDestPduRef = pduTrig_ST_DIAG_OBD_3_DRDY_pduPort_EPS_A_FlexRay_OUT_55c86d41_4f391dd1
              PduRDestPduPduRBswModulesRef = FrIf
          Fr_pduTrig_TAR_ESTP_VIRT_FTAX_55c86d41: PduRRoutingPathCommunicationType=COMMUNICATION_INTERFACE  # TAR_ESTP_VIRT_FTAX
            DST_Fr_pduTrig_TAR_ESTP_VIRT_FTAX_55c86d41 (PduRDestPdu):
              PduRDestPduHandleId = 24
              PduRDestPduDirection = RECEIVE
              PduRDestPduRoutingType = API_FORWARDING
              PduRTransmissionConfirmation = false
              PduRDestPduRef = pduTrig_TAR_ESTP_VIRT_FTAX_pduPort_EPS_A_FlexRay_IN_55c86d41_4f391dd1
              PduRDestPduPduRBswModulesRef = Com
            SRC_Fr_pduTrig_TAR_ESTP_VIRT_FTAX_55c86d41 (PduRSrcPdu):
              PduRSourcePduHandleId = 23
              PduRSrcPduDirection = RECEIVE
              PduRSrcPduRef = pduTrig_TAR_ESTP_VIRT_FTAX_pduPort_EPS_A_FlexRay_IN_55c86d41_4f391dd1
              PduRSrcPduPduRBswModulesRef = FrIf
          Fr_pduTrig_CON_VEH_55c86d41: PduRRoutingPathCommunicationType=COMMUNICATION_INTERFACE  # CON_VEH
            SRC_Fr_pduTrig_CON_VEH_55c86d41 (PduRSrcPdu):
              PduRSourcePduHandleId = 4
              PduRSrcPduDirection = RECEIVE
              PduRSrcPduRef = pduTrig_CON_VEH_pduPort_EPS_A_FlexRay_IN_55c86d41_4f391dd1
              PduRSrcPduPduRBswModulesRef = FrIf
            DST_Fr_pduTrig_CON_VEH_55c86d41 (PduRDestPdu):
              PduRDestPduHandleId = 5
              PduRDestPduDirection = RECEIVE
              PduRDestPduRoutingType = API_FORWARDING
              PduRTransmissionConfirmation = false
              PduRDestPduRef = pduTrig_CON_VEH_pduPort_EPS_A_FlexRay_IN_55c86d41_4f391dd1
              PduRDestPduPduRBswModulesRef = Com
          Fr_pduTrig_RELATIVZEIT_55c86d41: PduRRoutingPathCommunicationType=COMMUNICATION_INTERFACE  # RELATIVZEIT
            DST_Fr_pduTrig_RELATIVZEIT_55c86d41 (PduRDestPdu):
              PduRDestPduHandleId = 16
              PduRDestPduDirection = RECEIVE
              PduRDestPduRoutingType = API_FORWARDING
              PduRTransmissionConfirmation = false
              PduRDestPduRef = pduTrig_RELATIVZEIT_pduPort_EPS_A_FlexRay_IN_55c86d41_4f391dd1
              PduRDestPduPduRBswModulesRef = Com
            SRC_Fr_pduTrig_RELATIVZEIT_55c86d41 (PduRSrcPdu):
              PduRSourcePduHandleId = 15
              PduRSrcPduDirection = RECEIVE
              PduRSrcPduRef = pduTrig_RELATIVZEIT_pduPort_EPS_A_FlexRay_IN_55c86d41_4f391dd1
              PduRSrcPduPduRBswModulesRef = FrIf
          Fr_pduTrig_DT_EST_55c86d41: PduRRoutingPathCommunicationType=COMMUNICATION_INTERFACE  # DT_EST
            SRC_Fr_pduTrig_DT_EST_55c86d41 (PduRSrcPdu):
              PduRSourcePduHandleId = 21
              PduRSrcPduDirection = TRANSMIT
              PduRSrcPduRef = pduTrig_DT_EST_pduPort_EPS_A_FlexRay_OUT_55c86d41_4f391dd1
              PduRSrcPduPduRBswModulesRef = Com
            DST_Fr_pduTrig_DT_EST_55c86d41 (PduRDestPdu):
              PduRDestPduHandleId = 8
              PduRDestPduDirection = TRANSMIT
              PduRDestPduRoutingType = API_FORWARDING
              PduRDestPduDataProvision = PDUR_TRIGGERTRANSMIT
              PduRTransmissionConfirmation = false
              PduRDestPduRef = pduTrig_DT_EST_pduPort_EPS_A_FlexRay_OUT_55c86d41_4f391dd1
              PduRDestPduPduRBswModulesRef = FrIf
          Fr_pduTrig_TAR_STMOM_DV_ACT_55c86d41: PduRRoutingPathCommunicationType=COMMUNICATION_INTERFACE  # TAR_STMOM_DV_ACT
            SRC_Fr_pduTrig_TAR_STMOM_DV_ACT_55c86d41 (PduRSrcPdu):
              PduRSourcePduHandleId = 25
              PduRSrcPduDirection = RECEIVE
              PduRSrcPduRef = pduTrig_TAR_STMOM_DV_ACT_pduPort_EPS_A_FlexRay_IN_55c86d41_4f391dd1
              PduRSrcPduPduRBswModulesRef = FrIf
            DST_Fr_pduTrig_TAR_STMOM_DV_ACT_55c86d41 (PduRDestPdu):
              PduRDestPduHandleId = 26
              PduRDestPduDirection = RECEIVE
              PduRDestPduRoutingType = API_FORWARDING
              PduRTransmissionConfirmation = false
              PduRDestPduRef = pduTrig_TAR_STMOM_DV_ACT_pduPort_EPS_A_FlexRay_IN_55c86d41_4f391dd1
              PduRDestPduPduRBswModulesRef = Com
          Dcm_BRC_FR_32_0xF1: PduRRoutingPathCommunicationType=TRANSPORT_PROTOCOL
            DST_Dcm_BRC_FR_32_0xF1 (PduRDestPdu):
              PduRDestPduHandleId = 1
              PduRDestPduDirection = RECEIVE
              PduRDestPduRoutingType = API_FORWARDING
              PduRDestPduRef = Dcm_BRC_FR_32_0xF1
              PduRDestPduPduRBswModulesRef = Dcm
            SRC_Dcm_BRC_FR_32_0xF1 (PduRSrcPdu): PduRSourcePduHandleId=1, PduRSrcPduDirection=RECEIVE, PduRSrcPduRef=Dcm_BRC_FR_32_0xF1, PduRSrcPduPduRBswModulesRef=FrTp
          Dcm_BRC_FR_32_0xF2: PduRRoutingPathCommunicationType=TRANSPORT_PROTOCOL
            DST_Dcm_BRC_FR_32_0xF2 (PduRDestPdu):
              PduRDestPduHandleId = 2
              PduRDestPduDirection = RECEIVE
              PduRDestPduRoutingType = API_FORWARDING
              PduRDestPduRef = Dcm_BRC_FR_32_0xF2
              PduRDestPduPduRBswModulesRef = Dcm
            SRC_Dcm_BRC_FR_32_0xF2 (PduRSrcPdu): PduRSourcePduHandleId=2, PduRSrcPduDirection=RECEIVE, PduRSrcPduRef=Dcm_BRC_FR_32_0xF2, PduRSrcPduPduRBswModulesRef=FrTp
          Dcm_BRC_FR_32_0xF3: PduRRoutingPathCommunicationType=TRANSPORT_PROTOCOL
            DST_Dcm_BRC_FR_32_0xF3 (PduRDestPdu):
              PduRDestPduHandleId = 3
              PduRDestPduDirection = RECEIVE
              PduRDestPduRoutingType = API_FORWARDING
              PduRDestPduRef = Dcm_BRC_FR_32_0xF3
              PduRDestPduPduRBswModulesRef = Dcm
            SRC_Dcm_BRC_FR_32_0xF3 (PduRSrcPdu): PduRSourcePduHandleId=3, PduRSrcPduDirection=RECEIVE, PduRSrcPduRef=Dcm_BRC_FR_32_0xF3, PduRSrcPduPduRBswModulesRef=FrTp
          Dcm_BRC_FR_32_0xF4: PduRRoutingPathCommunicationType=TRANSPORT_PROTOCOL
            DST_Dcm_BRC_FR_32_0xF4 (PduRDestPdu):
              PduRDestPduHandleId = 4
              PduRDestPduDirection = RECEIVE
              PduRDestPduRoutingType = API_FORWARDING
              PduRDestPduRef = Dcm_BRC_FR_32_0xF4
              PduRDestPduPduRBswModulesRef = Dcm
            SRC_Dcm_BRC_FR_32_0xF4 (PduRSrcPdu): PduRSourcePduHandleId=4, PduRSrcPduDirection=RECEIVE, PduRSrcPduRef=Dcm_BRC_FR_32_0xF4, PduRSrcPduPduRBswModulesRef=FrTp
          Dcm_BRC_FR_32_0xF5: PduRRoutingPathCommunicationType=TRANSPORT_PROTOCOL
            DST_Dcm_BRC_FR_32_0xF5 (PduRDestPdu):
              PduRDestPduHandleId = 5
              PduRDestPduDirection = RECEIVE
              PduRDestPduRoutingType = API_FORWARDING
              PduRDestPduRef = Dcm_BRC_FR_32_0xF5
              PduRDestPduPduRBswModulesRef = Dcm
            SRC_Dcm_BRC_FR_32_0xF5 (PduRSrcPdu): PduRSourcePduHandleId=5, PduRSrcPduDirection=RECEIVE, PduRSrcPduRef=Dcm_BRC_FR_32_0xF5, PduRSrcPduPduRBswModulesRef=FrTp
          Dcm_BRC_FR_32_0xF6: PduRRoutingPathCommunicationType=TRANSPORT_PROTOCOL
            DST_Dcm_BRC_FR_32_0xF6 (PduRDestPdu):
              PduRDestPduHandleId = 6
              PduRDestPduDirection = RECEIVE
              PduRDestPduRoutingType = API_FORWARDING
              PduRDestPduRef = Dcm_BRC_FR_32_0xF6
              PduRDestPduPduRBswModulesRef = Dcm
            SRC_Dcm_BRC_FR_32_0xF6 (PduRSrcPdu): PduRSourcePduHandleId=6, PduRSrcPduDirection=RECEIVE, PduRSrcPduRef=Dcm_BRC_FR_32_0xF6, PduRSrcPduPduRBswModulesRef=FrTp
          Dcm_BRC_FR_32_0xF7: PduRRoutingPathCommunicationType=TRANSPORT_PROTOCOL
            DST_Dcm_BRC_FR_32_0xF7 (PduRDestPdu):
              PduRDestPduHandleId = 7
              PduRDestPduDirection = RECEIVE
              PduRDestPduRoutingType = API_FORWARDING
              PduRDestPduRef = Dcm_BRC_FR_32_0xF7
              PduRDestPduPduRBswModulesRef = Dcm
            SRC_Dcm_BRC_FR_32_0xF7 (PduRSrcPdu): PduRSourcePduHandleId=7, PduRSrcPduDirection=RECEIVE, PduRSrcPduRef=Dcm_BRC_FR_32_0xF7, PduRSrcPduPduRBswModulesRef=FrTp
          Dcm_BRC_FR_32_0xF8: PduRRoutingPathCommunicationType=TRANSPORT_PROTOCOL
            DST_Dcm_BRC_FR_32_0xF8 (PduRDestPdu):
              PduRDestPduHandleId = 8
              PduRDestPduDirection = RECEIVE
              PduRDestPduRoutingType = API_FORWARDING
              PduRDestPduRef = Dcm_BRC_FR_32_0xF8
              PduRDestPduPduRBswModulesRef = Dcm
            SRC_Dcm_BRC_FR_32_0xF8 (PduRSrcPdu): PduRSourcePduHandleId=8, PduRSrcPduDirection=RECEIVE, PduRSrcPduRef=Dcm_BRC_FR_32_0xF8, PduRSrcPduPduRBswModulesRef=FrTp
          Dcm_BRC_FR_32_0xF9: PduRRoutingPathCommunicationType=TRANSPORT_PROTOCOL
            DST_Dcm_BRC_FR_32_0xF9 (PduRDestPdu):
              PduRDestPduHandleId = 9
              PduRDestPduDirection = RECEIVE
              PduRDestPduRoutingType = API_FORWARDING
              PduRDestPduRef = Dcm_BRC_FR_32_0xF9
              PduRDestPduPduRBswModulesRef = Dcm
            SRC_Dcm_BRC_FR_32_0xF9 (PduRSrcPdu): PduRSourcePduHandleId=9, PduRSrcPduDirection=RECEIVE, PduRSrcPduRef=Dcm_BRC_FR_32_0xF9, PduRSrcPduPduRBswModulesRef=FrTp
          Dcm_BRC_FR_32_0xFA: PduRRoutingPathCommunicationType=TRANSPORT_PROTOCOL
            DST_Dcm_BRC_FR_32_0xFA (PduRDestPdu):
              PduRDestPduHandleId = 10
              PduRDestPduDirection = RECEIVE
              PduRDestPduRoutingType = API_FORWARDING
              PduRDestPduRef = Dcm_BRC_FR_32_0xFA
              PduRDestPduPduRBswModulesRef = Dcm
            SRC_Dcm_BRC_FR_32_0xFA (PduRSrcPdu): PduRSourcePduHandleId=10, PduRSrcPduDirection=RECEIVE, PduRSrcPduRef=Dcm_BRC_FR_32_0xFA, PduRSrcPduPduRBswModulesRef=FrTp
          Dcm_BRC_FR_32_0xFB: PduRRoutingPathCommunicationType=TRANSPORT_PROTOCOL
            DST_Dcm_BRC_FR_32_0xFB (PduRDestPdu):
              PduRDestPduHandleId = 11
              PduRDestPduDirection = RECEIVE
              PduRDestPduRoutingType = API_FORWARDING
              PduRDestPduRef = Dcm_BRC_FR_32_0xFB
              PduRDestPduPduRBswModulesRef = Dcm
            SRC_Dcm_BRC_FR_32_0xFB (PduRSrcPdu): PduRSourcePduHandleId=11, PduRSrcPduDirection=RECEIVE, PduRSrcPduRef=Dcm_BRC_FR_32_0xFB, PduRSrcPduPduRBswModulesRef=FrTp
          Dcm_BRC_FR_32_0xFC: PduRRoutingPathCommunicationType=TRANSPORT_PROTOCOL
            DST_Dcm_BRC_FR_32_0xFC (PduRDestPdu):
              PduRDestPduHandleId = 12
              PduRDestPduDirection = RECEIVE
              PduRDestPduRoutingType = API_FORWARDING
              PduRDestPduRef = Dcm_BRC_FR_32_0xFC
              PduRDestPduPduRBswModulesRef = Dcm
            SRC_Dcm_BRC_FR_32_0xFC (PduRSrcPdu): PduRSourcePduHandleId=12, PduRSrcPduDirection=RECEIVE, PduRSrcPduRef=Dcm_BRC_FR_32_0xFC, PduRSrcPduPduRBswModulesRef=FrTp
          Dcm_BRC_FR_32_0xFD: PduRRoutingPathCommunicationType=TRANSPORT_PROTOCOL
            DST_Dcm_BRC_FR_32_0xFD (PduRDestPdu):
              PduRDestPduHandleId = 13
              PduRDestPduDirection = RECEIVE
              PduRDestPduRoutingType = API_FORWARDING
              PduRDestPduRef = Dcm_BRC_FR_32_0xFD
              PduRDestPduPduRBswModulesRef = Dcm
            SRC_Dcm_BRC_FR_32_0xFD (PduRSrcPdu): PduRSourcePduHandleId=13, PduRSrcPduDirection=RECEIVE, PduRSrcPduRef=Dcm_BRC_FR_32_0xFD, PduRSrcPduPduRBswModulesRef=FrTp
          Dcm_ECU_TRNSM_FR_32_0xF1: PduRRoutingPathCommunicationType=TRANSPORT_PROTOCOL
            DST_Dcm_ECU_TRNSM_FR_32_0xF1 (PduRDestPdu):
              PduRDestPduHandleId = 1
              PduRDestPduDirection = TRANSMIT
              PduRDestPduRoutingType = API_FORWARDING
              PduRDestPduRef = Dcm_ECU_TRNSM_FR_32_0xF1
              PduRDestPduPduRBswModulesRef = FrTp
            SRC_Dcm_ECU_TRNSM_FR_32_0xF1 (PduRSrcPdu): PduRSourcePduHandleId=2, PduRSrcPduDirection=TRANSMIT, PduRSrcPduRef=Dcm_ECU_TRNSM_FR_32_0xF1, PduRSrcPduPduRBswModulesRef=Dcm
          Dcm_ECU_TRNSM_FR_32_0xF2: PduRRoutingPathCommunicationType=TRANSPORT_PROTOCOL
            DST_Dcm_ECU_TRNSM_FR_32_0xF2 (PduRDestPdu):
              PduRDestPduHandleId = 2
              PduRDestPduDirection = TRANSMIT
              PduRDestPduRoutingType = API_FORWARDING
              PduRDestPduRef = Dcm_ECU_TRNSM_FR_32_0xF2
              PduRDestPduPduRBswModulesRef = FrTp
            SRC_Dcm_ECU_TRNSM_FR_32_0xF2 (PduRSrcPdu): PduRSourcePduHandleId=3, PduRSrcPduDirection=TRANSMIT, PduRSrcPduRef=Dcm_ECU_TRNSM_FR_32_0xF2, PduRSrcPduPduRBswModulesRef=Dcm
          Dcm_ECU_TRNSM_FR_32_0xF3: PduRRoutingPathCommunicationType=TRANSPORT_PROTOCOL
            DST_Dcm_ECU_TRNSM_FR_32_0xF3 (PduRDestPdu):
              PduRDestPduHandleId = 3
              PduRDestPduDirection = TRANSMIT
              PduRDestPduRoutingType = API_FORWARDING
              PduRDestPduRef = Dcm_ECU_TRNSM_FR_32_0xF3
              PduRDestPduPduRBswModulesRef = FrTp
            SRC_Dcm_ECU_TRNSM_FR_32_0xF3 (PduRSrcPdu): PduRSourcePduHandleId=4, PduRSrcPduDirection=TRANSMIT, PduRSrcPduRef=Dcm_ECU_TRNSM_FR_32_0xF3, PduRSrcPduPduRBswModulesRef=Dcm
          Dcm_ECU_TRNSM_FR_32_0xF4: PduRRoutingPathCommunicationType=TRANSPORT_PROTOCOL
            DST_Dcm_ECU_TRNSM_FR_32_0xF4 (PduRDestPdu):
              PduRDestPduHandleId = 4
              PduRDestPduDirection = TRANSMIT
              PduRDestPduRoutingType = API_FORWARDING
              PduRDestPduRef = Dcm_ECU_TRNSM_FR_32_0xF4
              PduRDestPduPduRBswModulesRef = FrTp
            SRC_Dcm_ECU_TRNSM_FR_32_0xF4 (PduRSrcPdu): PduRSourcePduHandleId=5, PduRSrcPduDirection=TRANSMIT, PduRSrcPduRef=Dcm_ECU_TRNSM_FR_32_0xF4, PduRSrcPduPduRBswModulesRef=Dcm
          Dcm_ECU_TRNSM_FR_32_0xF5: PduRRoutingPathCommunicationType=TRANSPORT_PROTOCOL
            DST_Dcm_ECU_TRNSM_FR_32_0xF5 (PduRDestPdu):
              PduRDestPduHandleId = 5
              PduRDestPduDirection = TRANSMIT
              PduRDestPduRoutingType = API_FORWARDING
              PduRDestPduRef = Dcm_ECU_TRNSM_FR_32_0xF5
              PduRDestPduPduRBswModulesRef = FrTp
            SRC_Dcm_ECU_TRNSM_FR_32_0xF5 (PduRSrcPdu): PduRSourcePduHandleId=6, PduRSrcPduDirection=TRANSMIT, PduRSrcPduRef=Dcm_ECU_TRNSM_FR_32_0xF5, PduRSrcPduPduRBswModulesRef=Dcm
          Dcm_ECU_TRNSM_FR_32_0xF6: PduRRoutingPathCommunicationType=TRANSPORT_PROTOCOL
            DST_Dcm_ECU_TRNSM_FR_32_0xF6 (PduRDestPdu):
              PduRDestPduHandleId = 6
              PduRDestPduDirection = TRANSMIT
              PduRDestPduRoutingType = API_FORWARDING
              PduRDestPduRef = Dcm_ECU_TRNSM_FR_32_0xF6
              PduRDestPduPduRBswModulesRef = FrTp
            SRC_Dcm_ECU_TRNSM_FR_32_0xF6 (PduRSrcPdu): PduRSourcePduHandleId=7, PduRSrcPduDirection=TRANSMIT, PduRSrcPduRef=Dcm_ECU_TRNSM_FR_32_0xF6, PduRSrcPduPduRBswModulesRef=Dcm
          Dcm_ECU_TRNSM_FR_32_0xF7: PduRRoutingPathCommunicationType=TRANSPORT_PROTOCOL
            DST_Dcm_ECU_TRNSM_FR_32_0xF7 (PduRDestPdu):
              PduRDestPduHandleId = 7
              PduRDestPduDirection = TRANSMIT
              PduRDestPduRoutingType = API_FORWARDING
              PduRDestPduRef = Dcm_ECU_TRNSM_FR_32_0xF7
              PduRDestPduPduRBswModulesRef = FrTp
            SRC_Dcm_ECU_TRNSM_FR_32_0xF7 (PduRSrcPdu): PduRSourcePduHandleId=8, PduRSrcPduDirection=TRANSMIT, PduRSrcPduRef=Dcm_ECU_TRNSM_FR_32_0xF7, PduRSrcPduPduRBswModulesRef=Dcm
          Dcm_ECU_TRNSM_FR_32_0xF8: PduRRoutingPathCommunicationType=TRANSPORT_PROTOCOL
            DST_Dcm_ECU_TRNSM_FR_32_0xF8 (PduRDestPdu):
              PduRDestPduHandleId = 8
              PduRDestPduDirection = TRANSMIT
              PduRDestPduRoutingType = API_FORWARDING
              PduRDestPduRef = Dcm_ECU_TRNSM_FR_32_0xF8
              PduRDestPduPduRBswModulesRef = FrTp
            SRC_Dcm_ECU_TRNSM_FR_32_0xF8 (PduRSrcPdu): PduRSourcePduHandleId=9, PduRSrcPduDirection=TRANSMIT, PduRSrcPduRef=Dcm_ECU_TRNSM_FR_32_0xF8, PduRSrcPduPduRBswModulesRef=Dcm
          Dcm_ECU_TRNSM_FR_32_0xF9: PduRRoutingPathCommunicationType=TRANSPORT_PROTOCOL
            DST_Dcm_ECU_TRNSM_FR_32_0xF9 (PduRDestPdu):
              PduRDestPduHandleId = 9
              PduRDestPduDirection = TRANSMIT
              PduRDestPduRoutingType = API_FORWARDING
              PduRDestPduRef = Dcm_ECU_TRNSM_FR_32_0xF9
              PduRDestPduPduRBswModulesRef = FrTp
            SRC_Dcm_ECU_TRNSM_FR_32_0xF9 (PduRSrcPdu): PduRSourcePduHandleId=10, PduRSrcPduDirection=TRANSMIT, PduRSrcPduRef=Dcm_ECU_TRNSM_FR_32_0xF9, PduRSrcPduPduRBswModulesRef=Dcm
          Dcm_ECU_TRNSM_FR_32_0xFA: PduRRoutingPathCommunicationType=TRANSPORT_PROTOCOL
            DST_Dcm_ECU_TRNSM_FR_32_0xFA (PduRDestPdu):
              PduRDestPduHandleId = 10
              PduRDestPduDirection = TRANSMIT
              PduRDestPduRoutingType = API_FORWARDING
              PduRDestPduRef = Dcm_ECU_TRNSM_FR_32_0xFA
              PduRDestPduPduRBswModulesRef = FrTp
            SRC_Dcm_ECU_TRNSM_FR_32_0xFA (PduRSrcPdu): PduRSourcePduHandleId=11, PduRSrcPduDirection=TRANSMIT, PduRSrcPduRef=Dcm_ECU_TRNSM_FR_32_0xFA, PduRSrcPduPduRBswModulesRef=Dcm
          Dcm_ECU_TRNSM_FR_32_0xFB: PduRRoutingPathCommunicationType=TRANSPORT_PROTOCOL
            DST_Dcm_ECU_TRNSM_FR_32_0xFB (PduRDestPdu):
              PduRDestPduHandleId = 11
              PduRDestPduDirection = TRANSMIT
              PduRDestPduRoutingType = API_FORWARDING
              PduRDestPduRef = Dcm_ECU_TRNSM_FR_32_0xFB
              PduRDestPduPduRBswModulesRef = FrTp
            SRC_Dcm_ECU_TRNSM_FR_32_0xFB (PduRSrcPdu): PduRSourcePduHandleId=12, PduRSrcPduDirection=TRANSMIT, PduRSrcPduRef=Dcm_ECU_TRNSM_FR_32_0xFB, PduRSrcPduPduRBswModulesRef=Dcm
          Dcm_ECU_TRNSM_FR_32_0xFC: PduRRoutingPathCommunicationType=TRANSPORT_PROTOCOL
            DST_Dcm_ECU_TRNSM_FR_32_0xFC (PduRDestPdu):
              PduRDestPduHandleId = 12
              PduRDestPduDirection = TRANSMIT
              PduRDestPduRoutingType = API_FORWARDING
              PduRDestPduRef = Dcm_ECU_TRNSM_FR_32_0xFC
              PduRDestPduPduRBswModulesRef = FrTp
            SRC_Dcm_ECU_TRNSM_FR_32_0xFC (PduRSrcPdu): PduRSourcePduHandleId=13, PduRSrcPduDirection=TRANSMIT, PduRSrcPduRef=Dcm_ECU_TRNSM_FR_32_0xFC, PduRSrcPduPduRBswModulesRef=Dcm
          Dcm_ECU_TRNSM_FR_32_0xFD: PduRRoutingPathCommunicationType=TRANSPORT_PROTOCOL
            DST_Dcm_ECU_TRNSM_FR_32_0xFD (PduRDestPdu):
              PduRDestPduHandleId = 13
              PduRDestPduDirection = TRANSMIT
              PduRDestPduRoutingType = API_FORWARDING
              PduRDestPduRef = Dcm_ECU_TRNSM_FR_32_0xFD
              PduRDestPduPduRBswModulesRef = FrTp
            SRC_Dcm_ECU_TRNSM_FR_32_0xFD (PduRSrcPdu): PduRSourcePduHandleId=14, PduRSrcPduDirection=TRANSMIT, PduRSrcPduRef=Dcm_ECU_TRNSM_FR_32_0xFD, PduRSrcPduPduRBswModulesRef=Dcm
          Dcm_GW_TRNSM_FR_254_0xF1: PduRRoutingPathCommunicationType=TRANSPORT_PROTOCOL
            DST_Dcm_GW_TRNSM_FR_254_0xF1 (PduRDestPdu):
              PduRDestPduHandleId = 15
              PduRDestPduDirection = RECEIVE
              PduRDestPduRoutingType = API_FORWARDING
              PduRDestPduRef = Dcm_GW_TRNSM_FR_254_0xF1
              PduRDestPduPduRBswModulesRef = Dcm
            SRC_Dcm_GW_TRNSM_FR_254_0xF1 (PduRSrcPdu): PduRSourcePduHandleId=15, PduRSrcPduDirection=RECEIVE, PduRSrcPduRef=Dcm_GW_TRNSM_FR_254_0xF1, PduRSrcPduPduRBswModulesRef=FrTp
          Dcm_GW_TRNSM_FR_254_0xF2: PduRRoutingPathCommunicationType=TRANSPORT_PROTOCOL
            DST_Dcm_GW_TRNSM_FR_254_0xF2 (PduRDestPdu):
              PduRDestPduHandleId = 16
              PduRDestPduDirection = RECEIVE
              PduRDestPduRoutingType = API_FORWARDING
              PduRDestPduRef = Dcm_GW_TRNSM_FR_254_0xF2
              PduRDestPduPduRBswModulesRef = Dcm
            SRC_Dcm_GW_TRNSM_FR_254_0xF2 (PduRSrcPdu): PduRSourcePduHandleId=16, PduRSrcPduDirection=RECEIVE, PduRSrcPduRef=Dcm_GW_TRNSM_FR_254_0xF2, PduRSrcPduPduRBswModulesRef=FrTp
          Dcm_GW_TRNSM_FR_254_0xF3: PduRRoutingPathCommunicationType=TRANSPORT_PROTOCOL
            DST_Dcm_GW_TRNSM_FR_254_0xF3 (PduRDestPdu):
              PduRDestPduHandleId = 17
              PduRDestPduDirection = RECEIVE
              PduRDestPduRoutingType = API_FORWARDING
              PduRDestPduRef = Dcm_GW_TRNSM_FR_254_0xF3
              PduRDestPduPduRBswModulesRef = Dcm
            SRC_Dcm_GW_TRNSM_FR_254_0xF3 (PduRSrcPdu): PduRSourcePduHandleId=17, PduRSrcPduDirection=RECEIVE, PduRSrcPduRef=Dcm_GW_TRNSM_FR_254_0xF3, PduRSrcPduPduRBswModulesRef=FrTp
          Dcm_GW_TRNSM_FR_254_0xF4: PduRRoutingPathCommunicationType=TRANSPORT_PROTOCOL
            DST_Dcm_GW_TRNSM_FR_254_0xF4 (PduRDestPdu):
              PduRDestPduHandleId = 18
              PduRDestPduDirection = RECEIVE
              PduRDestPduRoutingType = API_FORWARDING
              PduRDestPduRef = Dcm_GW_TRNSM_FR_254_0xF4
              PduRDestPduPduRBswModulesRef = Dcm
            SRC_Dcm_GW_TRNSM_FR_254_0xF4 (PduRSrcPdu): PduRSourcePduHandleId=18, PduRSrcPduDirection=RECEIVE, PduRSrcPduRef=Dcm_GW_TRNSM_FR_254_0xF4, PduRSrcPduPduRBswModulesRef=FrTp
          Dcm_GW_TRNSM_FR_254_0xF5: PduRRoutingPathCommunicationType=TRANSPORT_PROTOCOL
            DST_Dcm_GW_TRNSM_FR_254_0xF5 (PduRDestPdu):
              PduRDestPduHandleId = 19
              PduRDestPduDirection = RECEIVE
              PduRDestPduRoutingType = API_FORWARDING
              PduRDestPduRef = Dcm_GW_TRNSM_FR_254_0xF5
              PduRDestPduPduRBswModulesRef = Dcm
            SRC_Dcm_GW_TRNSM_FR_254_0xF5 (PduRSrcPdu): PduRSourcePduHandleId=19, PduRSrcPduDirection=RECEIVE, PduRSrcPduRef=Dcm_GW_TRNSM_FR_254_0xF5, PduRSrcPduPduRBswModulesRef=FrTp
          Dcm_GW_TRNSM_FR_254_0xF6: PduRRoutingPathCommunicationType=TRANSPORT_PROTOCOL
            DST_Dcm_GW_TRNSM_FR_254_0xF6 (PduRDestPdu):
              PduRDestPduHandleId = 20
              PduRDestPduDirection = RECEIVE
              PduRDestPduRoutingType = API_FORWARDING
              PduRDestPduRef = Dcm_GW_TRNSM_FR_254_0xF6
              PduRDestPduPduRBswModulesRef = Dcm
            SRC_Dcm_GW_TRNSM_FR_254_0xF6 (PduRSrcPdu): PduRSourcePduHandleId=20, PduRSrcPduDirection=RECEIVE, PduRSrcPduRef=Dcm_GW_TRNSM_FR_254_0xF6, PduRSrcPduPduRBswModulesRef=FrTp
          Dcm_GW_TRNSM_FR_254_0xF7: PduRRoutingPathCommunicationType=TRANSPORT_PROTOCOL
            DST_Dcm_GW_TRNSM_FR_254_0xF7 (PduRDestPdu):
              PduRDestPduHandleId = 21
              PduRDestPduDirection = RECEIVE
              PduRDestPduRoutingType = API_FORWARDING
              PduRDestPduRef = Dcm_GW_TRNSM_FR_254_0xF7
              PduRDestPduPduRBswModulesRef = Dcm
            SRC_Dcm_GW_TRNSM_FR_254_0xF7 (PduRSrcPdu): PduRSourcePduHandleId=21, PduRSrcPduDirection=RECEIVE, PduRSrcPduRef=Dcm_GW_TRNSM_FR_254_0xF7, PduRSrcPduPduRBswModulesRef=FrTp
          Dcm_GW_TRNSM_FR_254_0xF8: PduRRoutingPathCommunicationType=TRANSPORT_PROTOCOL
            DST_Dcm_GW_TRNSM_FR_254_0xF8 (PduRDestPdu):
              PduRDestPduHandleId = 22
              PduRDestPduDirection = RECEIVE
              PduRDestPduRoutingType = API_FORWARDING
              PduRDestPduRef = Dcm_GW_TRNSM_FR_254_0xF8
              PduRDestPduPduRBswModulesRef = Dcm
            SRC_Dcm_GW_TRNSM_FR_254_0xF8 (PduRSrcPdu): PduRSourcePduHandleId=22, PduRSrcPduDirection=RECEIVE, PduRSrcPduRef=Dcm_GW_TRNSM_FR_254_0xF8, PduRSrcPduPduRBswModulesRef=FrTp
          Dcm_GW_TRNSM_FR_254_0xF9: PduRRoutingPathCommunicationType=TRANSPORT_PROTOCOL
            DST_Dcm_GW_TRNSM_FR_254_0xF9 (PduRDestPdu):
              PduRDestPduHandleId = 23
              PduRDestPduDirection = RECEIVE
              PduRDestPduRoutingType = API_FORWARDING
              PduRDestPduRef = Dcm_GW_TRNSM_FR_254_0xF9
              PduRDestPduPduRBswModulesRef = Dcm
            SRC_Dcm_GW_TRNSM_FR_254_0xF9 (PduRSrcPdu): PduRSourcePduHandleId=23, PduRSrcPduDirection=RECEIVE, PduRSrcPduRef=Dcm_GW_TRNSM_FR_254_0xF9, PduRSrcPduPduRBswModulesRef=FrTp
          Dcm_GW_TRNSM_FR_254_0xFA: PduRRoutingPathCommunicationType=TRANSPORT_PROTOCOL
            DST_Dcm_GW_TRNSM_FR_254_0xFA (PduRDestPdu):
              PduRDestPduHandleId = 24
              PduRDestPduDirection = RECEIVE
              PduRDestPduRoutingType = API_FORWARDING
              PduRDestPduRef = Dcm_GW_TRNSM_FR_254_0xFA
              PduRDestPduPduRBswModulesRef = Dcm
            SRC_Dcm_GW_TRNSM_FR_254_0xFA (PduRSrcPdu): PduRSourcePduHandleId=24, PduRSrcPduDirection=RECEIVE, PduRSrcPduRef=Dcm_GW_TRNSM_FR_254_0xFA, PduRSrcPduPduRBswModulesRef=FrTp
          Dcm_GW_TRNSM_FR_254_0xFB: PduRRoutingPathCommunicationType=TRANSPORT_PROTOCOL
            DST_Dcm_GW_TRNSM_FR_254_0xFB (PduRDestPdu):
              PduRDestPduHandleId = 25
              PduRDestPduDirection = RECEIVE
              PduRDestPduRoutingType = API_FORWARDING
              PduRDestPduRef = Dcm_GW_TRNSM_FR_254_0xFB
              PduRDestPduPduRBswModulesRef = Dcm
            SRC_Dcm_GW_TRNSM_FR_254_0xFB (PduRSrcPdu): PduRSourcePduHandleId=25, PduRSrcPduDirection=RECEIVE, PduRSrcPduRef=Dcm_GW_TRNSM_FR_254_0xFB, PduRSrcPduPduRBswModulesRef=FrTp
          Dcm_GW_TRNSM_FR_254_0xFC: PduRRoutingPathCommunicationType=TRANSPORT_PROTOCOL
            DST_Dcm_GW_TRNSM_FR_254_0xFC (PduRDestPdu):
              PduRDestPduHandleId = 26
              PduRDestPduDirection = RECEIVE
              PduRDestPduRoutingType = API_FORWARDING
              PduRDestPduRef = Dcm_GW_TRNSM_FR_254_0xFC
              PduRDestPduPduRBswModulesRef = Dcm
            SRC_Dcm_GW_TRNSM_FR_254_0xFC (PduRSrcPdu): PduRSourcePduHandleId=26, PduRSrcPduDirection=RECEIVE, PduRSrcPduRef=Dcm_GW_TRNSM_FR_254_0xFC, PduRSrcPduPduRBswModulesRef=FrTp
          Dcm_GW_TRNSM_FR_254_0xFD: PduRRoutingPathCommunicationType=TRANSPORT_PROTOCOL
            DST_Dcm_GW_TRNSM_FR_254_0xFD (PduRDestPdu):
              PduRDestPduHandleId = 27
              PduRDestPduDirection = RECEIVE
              PduRDestPduRoutingType = API_FORWARDING
              PduRDestPduRef = Dcm_GW_TRNSM_FR_254_0xFD
              PduRDestPduPduRBswModulesRef = Dcm
            SRC_Dcm_GW_TRNSM_FR_254_0xFD (PduRSrcPdu): PduRSourcePduHandleId=27, PduRSrcPduDirection=RECEIVE, PduRSrcPduRef=Dcm_GW_TRNSM_FR_254_0xFD, PduRSrcPduPduRBswModulesRef=FrTp
    5 x PduRBswModules, all with PduRCancelReceive=false, PduRCancelTransmit=false, PduRChangeParameterRequestApi=false:
      Com: PduRCommunicationInterface=true, PduRLowerModule=false, PduRTransportProtocol=false, PduRTriggertransmit=true, PduRTxConfirmation=true, PduRUpperModule=true, PduRUseTag=false, PduRBswModuleRef=Com
      FrIf: PduRCommunicationInterface=true, PduRLowerModule=true, PduRTransportProtocol=false, PduRTriggertransmit=true, PduRTxConfirmation=true, PduRUpperModule=false, PduRUseTag=false, PduRBswModuleRef=FrIf
      IpduM: PduRCommunicationInterface=true, PduRLowerModule=true, PduRTransportProtocol=false, PduRTriggertransmit=true, PduRTxConfirmation=true, PduRUpperModule=true, PduRUseTag=false, PduRBswModuleRef=IpduM
      FrTp: PduRCommunicationInterface=false, PduRLowerModule=true, PduRTransportProtocol=true, PduRTriggertransmit=false, PduRTxConfirmation=false, PduRUpperModule=false, PduRUseTag=false, PduRBswModuleRef=FrTp
      Dcm: PduRCommunicationInterface=false, PduRLowerModule=false, PduRTransportProtocol=true, PduRTriggertransmit=false, PduRTxConfirmation=false, PduRUpperModule=true, PduRUseTag=true, PduRBswModuleRef=Dcm
