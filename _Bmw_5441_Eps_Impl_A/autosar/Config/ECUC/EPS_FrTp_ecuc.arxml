AUTOSAR XML (schema 4-3-0)
package /ActiveEcuC
  module config FrTp: implementation-config-variant=VARIANT-PRE-COMPILE, module-description=FrTp_Impl
    FrTpGeneral:
      FrTpSafeBswChecks = true
      FrTpAckRt = false
      FrTpChanNum = 1
      FrTpChangeParamApi = false
      FrTpDevErrorDetect = true
      FrTpFullDuplexEnable = true
      FrTpMainFuncCycle = 0.005
      FrTpTransmitCancellation = false
      FrTpUnknownMsgLength = false
      FrTpVersionInfoApi = false
      FrTpRxIndEarlierThanTxConf = false
      FrTpInstanceId = 0
      FrTpMultiPurposeTp = false
      FrTpRxChanNum = 28
      FrTpTxChanNum = 14
      FrTpRuntimeMeasurementSupport = false
      FrTpReceiveCancellation = false
    FrTpMultipleConfig
      TL_BRC_FR_32_0xDF_0xF0 (FrTpConnection): FrTpLa=223, FrTpMultipleReceiverCon=true, FrTpRa=240, FrTpConCtrlRef=FrTpConnectionControl, FrTpRxPduPoolRef=RxPduPool_TL_BRC_FR_32
        FrTpRxBRC_0xF0 (FrTpRxSdu): FrTpRxSduId=0, FrTpRxSduRef=Dcm_BRC_FR_32_0xF0
      FrTpConnectionControl:
        FrTpAckType = FRTP_NO
        FrTpMaxAr = 0
        FrTpMaxAs = 0
        FrTpMaxBufferSize = 65535
        FrTpMaxFCWait = 19
        FrTpMaxFrIf = 0
        FrTpMaxNbrOfNPduPerCycle = 0
        FrTpMaxRn = 5
        FrTpSCexp = 0
        FrTpTimeBr = 0.05
        FrTpTimeBuffer = 0.02
        FrTpTimeFrIf = 0.02
        FrTpTimeoutAr = 0.15
        FrTpTimeoutAs = 0.15
        FrTpTimeoutBs = 0.5
        FrTpTimeoutCr = 0.6
        FrTpTimeCs = 0.05
      RxPduPool_TL_BRC_FR_32 (FrTpRxPduPool)
        FrTpRxPduBRC (FrTpRxPdu): FrTpRxPduId=0, FrTpRxPduRef=p2fmap_TL_BRC_FR_32_003b6d76
      TxPduPool_TL_ECU_TRNSM_FR_32 (FrTpTxPduPool)
        FrTpTxPduTRNSM (FrTpTxPdu): FrTpTxConfirmationPduId=0, FrTpTxPduRef=p2fmap_TL_ECU_TRNSM_FR_32_c9b68eba
      TL_MST_GW_TRNSM_FR_254_0xF0 (FrTpConnection):
        FrTpLa = 48
        FrTpMultipleReceiverCon = false
        FrTpRa = 240
        FrTpConCtrlRef = FrTpConnectionControl
        FrTpRxPduPoolRef = RxPduPool_GW_TRNSM_FR_254
        FrTpTxPduPoolRef = TxPduPool_TL_ECU_TRNSM_FR_32
        FrTpRxSduGwTrnsm254_0xF0 (FrTpRxSdu): FrTpRxSduId=14, FrTpRxSduRef=Dcm_GW_TRNSM_FR_254_0xF0
        FrTpTxSduEcuTrnsm32_0xF0 (FrTpTxSdu): FrTpTxSduId=0, FrTpTxSduRef=Dcm_ECU_TRNSM_FR_32_0xF0
      RxPduPool_GW_TRNSM_FR_254 (FrTpRxPduPool)
        FrTpRxPduTRNSM (FrTpRxPdu): FrTpRxPduId=1, FrTpRxPduRef=p2fmap_TL_MST_GW_TRNSM_FR_254_c761be43
      26 x FrTpConnection, all with FrTpConCtrlRef=FrTpConnectionControl:
        TL_BRC_FR_32_0xDF_0xF1: FrTpLa=223, FrTpMultipleReceiverCon=true, FrTpRa=241, FrTpRxPduPoolRef=RxPduPool_TL_BRC_FR_32
          FrTpRxBRC_0xF1 (FrTpRxSdu): FrTpRxSduId=1, FrTpRxSduRef=Dcm_BRC_FR_32_0xF1
        TL_BRC_FR_32_0xDF_0xF2: FrTpLa=223, FrTpMultipleReceiverCon=true, FrTpRa=242, FrTpRxPduPoolRef=RxPduPool_TL_BRC_FR_32
          FrTpRxBRC_0xF2 (FrTpRxSdu): FrTpRxSduId=2, FrTpRxSduRef=Dcm_BRC_FR_32_0xF2
        TL_BRC_FR_32_0xDF_0xF3: FrTpLa=223, FrTpMultipleReceiverCon=true, FrTpRa=243, FrTpRxPduPoolRef=RxPduPool_TL_BRC_FR_32
          FrTpRxBRC_0xF3 (FrTpRxSdu): FrTpRxSduId=3, FrTpRxSduRef=Dcm_BRC_FR_32_0xF3
        TL_BRC_FR_32_0xDF_0xF4: FrTpLa=223, FrTpMultipleReceiverCon=true, FrTpRa=244, FrTpRxPduPoolRef=RxPduPool_TL_BRC_FR_32
          FrTpRxBRC_0xF4 (FrTpRxSdu): FrTpRxSduId=4, FrTpRxSduRef=Dcm_BRC_FR_32_0xF4
        TL_BRC_FR_32_0xDF_0xF5: FrTpLa=223, FrTpMultipleReceiverCon=true, FrTpRa=245, FrTpRxPduPoolRef=RxPduPool_TL_BRC_FR_32
          FrTpRxBRC_0xF5 (FrTpRxSdu): FrTpRxSduId=5, FrTpRxSduRef=Dcm_BRC_FR_32_0xF5
        TL_BRC_FR_32_0xDF_0xF6: FrTpLa=223, FrTpMultipleReceiverCon=true, FrTpRa=246, FrTpRxPduPoolRef=RxPduPool_TL_BRC_FR_32
          FrTpRxBRC_0xF6 (FrTpRxSdu): FrTpRxSduId=6, FrTpRxSduRef=Dcm_BRC_FR_32_0xF6
        TL_BRC_FR_32_0xDF_0xF7: FrTpLa=223, FrTpMultipleReceiverCon=true, FrTpRa=247, FrTpRxPduPoolRef=RxPduPool_TL_BRC_FR_32
          FrTpRxBRC_0xF7 (FrTpRxSdu): FrTpRxSduId=7, FrTpRxSduRef=Dcm_BRC_FR_32_0xF7
        TL_BRC_FR_32_0xDF_0xF8: FrTpLa=223, FrTpMultipleReceiverCon=true, FrTpRa=248, FrTpRxPduPoolRef=RxPduPool_TL_BRC_FR_32
          FrTpRxBRC_0xF8 (FrTpRxSdu): FrTpRxSduId=8, FrTpRxSduRef=Dcm_BRC_FR_32_0xF8
        TL_BRC_FR_32_0xDF_0xF9: FrTpLa=223, FrTpMultipleReceiverCon=true, FrTpRa=249, FrTpRxPduPoolRef=RxPduPool_TL_BRC_FR_32
          FrTpRxBRC_0xF9 (FrTpRxSdu): FrTpRxSduId=9, FrTpRxSduRef=Dcm_BRC_FR_32_0xF9
        TL_BRC_FR_32_0xDF_0xFA: FrTpLa=223, FrTpMultipleReceiverCon=true, FrTpRa=250, FrTpRxPduPoolRef=RxPduPool_TL_BRC_FR_32
          FrTpRxBRC_0xFA (FrTpRxSdu): FrTpRxSduId=10, FrTpRxSduRef=Dcm_BRC_FR_32_0xFA
        TL_BRC_FR_32_0xDF_0xFB: FrTpLa=223, FrTpMultipleReceiverCon=true, FrTpRa=251, FrTpRxPduPoolRef=RxPduPool_TL_BRC_FR_32
          FrTpRxBRC_0xFB (FrTpRxSdu): FrTpRxSduId=11, FrTpRxSduRef=Dcm_BRC_FR_32_0xFB
        TL_BRC_FR_32_0xDF_0xFC: FrTpLa=223, FrTpMultipleReceiverCon=true, FrTpRa=252, FrTpRxPduPoolRef=RxPduPool_TL_BRC_FR_32
          FrTpRxBRC_0xFC (FrTpRxSdu): FrTpRxSduId=12, FrTpRxSduRef=Dcm_BRC_FR_32_0xFC
        TL_BRC_FR_32_0xDF_0xFD: FrTpLa=223, FrTpMultipleReceiverCon=true, FrTpRa=253, FrTpRxPduPoolRef=RxPduPool_TL_BRC_FR_32
          FrTpRxBRC_0xFD (FrTpRxSdu): FrTpRxSduId=13, FrTpRxSduRef=Dcm_BRC_FR_32_0xFD
        TL_MST_GW_TRNSM_FR_254_0xF1: FrTpLa=48, FrTpMultipleReceiverCon=false, FrTpRa=241, FrTpRxPduPoolRef=RxPduPool_GW_TRNSM_FR_254, FrTpTxPduPoolRef=TxPduPool_TL_ECU_TRNSM_FR_32
          FrTpRxSduGwTrnsm254_0xF1 (FrTpRxSdu): FrTpRxSduId=15, FrTpRxSduRef=Dcm_GW_TRNSM_FR_254_0xF1
          FrTpTxSduEcuTrnsm32_0xF1 (FrTpTxSdu): FrTpTxSduId=1, FrTpTxSduRef=Dcm_ECU_TRNSM_FR_32_0xF1
        TL_MST_GW_TRNSM_FR_254_0xF2: FrTpLa=48, FrTpMultipleReceiverCon=false, FrTpRa=242, FrTpRxPduPoolRef=RxPduPool_GW_TRNSM_FR_254, FrTpTxPduPoolRef=TxPduPool_TL_ECU_TRNSM_FR_32
          FrTpRxSduGwTrnsm254_0xF2 (FrTpRxSdu): FrTpRxSduId=16, FrTpRxSduRef=Dcm_GW_TRNSM_FR_254_0xF2
          FrTpTxSduEcuTrnsm32_0xF2 (FrTpTxSdu): FrTpTxSduId=2, FrTpTxSduRef=Dcm_ECU_TRNSM_FR_32_0xF2
        TL_MST_GW_TRNSM_FR_254_0xF3: FrTpLa=48, FrTpMultipleReceiverCon=false, FrTpRa=243, FrTpRxPduPoolRef=RxPduPool_GW_TRNSM_FR_254, FrTpTxPduPoolRef=TxPduPool_TL_ECU_TRNSM_FR_32
          FrTpRxSduGwTrnsm254_0xF3 (FrTpRxSdu): FrTpRxSduId=17, FrTpRxSduRef=Dcm_GW_TRNSM_FR_254_0xF3
          FrTpTxSduEcuTrnsm32_0xF3 (FrTpTxSdu): FrTpTxSduId=3, FrTpTxSduRef=Dcm_ECU_TRNSM_FR_32_0xF3
        TL_MST_GW_TRNSM_FR_254_0xF4: FrTpLa=48, FrTpMultipleReceiverCon=false, FrTpRa=244, FrTpRxPduPoolRef=RxPduPool_GW_TRNSM_FR_254, FrTpTxPduPoolRef=TxPduPool_TL_ECU_TRNSM_FR_32
          FrTpRxSduGwTrnsm254_0xF4 (FrTpRxSdu): FrTpRxSduId=18, FrTpRxSduRef=Dcm_GW_TRNSM_FR_254_0xF4
          FrTpTxSduEcuTrnsm32_0xF4 (FrTpTxSdu): FrTpTxSduId=4, FrTpTxSduRef=Dcm_ECU_TRNSM_FR_32_0xF4
        TL_MST_GW_TRNSM_FR_254_0xF5: FrTpLa=48, FrTpMultipleReceiverCon=false, FrTpRa=245, FrTpRxPduPoolRef=RxPduPool_GW_TRNSM_FR_254, FrTpTxPduPoolRef=TxPduPool_TL_ECU_TRNSM_FR_32
          FrTpRxSduGwTrnsm254_0xF5 (FrTpRxSdu): FrTpRxSduId=19, FrTpRxSduRef=Dcm_GW_TRNSM_FR_254_0xF5
          FrTpTxSduEcuTrnsm32_0xF5 (FrTpTxSdu): FrTpTxSduId=5, FrTpTxSduRef=Dcm_ECU_TRNSM_FR_32_0xF5
        TL_MST_GW_TRNSM_FR_254_0xF6: FrTpLa=48, FrTpMultipleReceiverCon=false, FrTpRa=246, FrTpRxPduPoolRef=RxPduPool_GW_TRNSM_FR_254, FrTpTxPduPoolRef=TxPduPool_TL_ECU_TRNSM_FR_32
          FrTpRxSduGwTrnsm254_0xF6 (FrTpRxSdu): FrTpRxSduId=20, FrTpRxSduRef=Dcm_GW_TRNSM_FR_254_0xF6
          FrTpTxSduEcuTrnsm32_0xF6 (FrTpTxSdu): FrTpTxSduId=6, FrTpTxSduRef=Dcm_ECU_TRNSM_FR_32_0xF6
        TL_MST_GW_TRNSM_FR_254_0xF7: FrTpLa=48, FrTpMultipleReceiverCon=false, FrTpRa=247, FrTpRxPduPoolRef=RxPduPool_GW_TRNSM_FR_254, FrTpTxPduPoolRef=TxPduPool_TL_ECU_TRNSM_FR_32
          FrTpRxSduGwTrnsm254_0xF7 (FrTpRxSdu): FrTpRxSduId=21, FrTpRxSduRef=Dcm_GW_TRNSM_FR_254_0xF7
          FrTpTxSduEcuTrnsm32_0xF7 (FrTpTxSdu): FrTpTxSduId=7, FrTpTxSduRef=Dcm_ECU_TRNSM_FR_32_0xF7
        TL_MST_GW_TRNSM_FR_254_0xF8: FrTpLa=48, FrTpMultipleReceiverCon=false, FrTpRa=248, FrTpRxPduPoolRef=RxPduPool_GW_TRNSM_FR_254, FrTpTxPduPoolRef=TxPduPool_TL_ECU_TRNSM_FR_32
          FrTpRxSduGwTrnsm254_0xF8 (FrTpRxSdu): FrTpRxSduId=22, FrTpRxSduRef=Dcm_GW_TRNSM_FR_254_0xF8
          FrTpTxSduEcuTrnsm32_0xF8 (FrTpTxSdu): FrTpTxSduId=8, FrTpTxSduRef=Dcm_ECU_TRNSM_FR_32_0xF8
        TL_MST_GW_TRNSM_FR_254_0xF9: FrTpLa=48, FrTpMultipleReceiverCon=false, FrTpRa=249, FrTpRxPduPoolRef=RxPduPool_GW_TRNSM_FR_254, FrTpTxPduPoolRef=TxPduPool_TL_ECU_TRNSM_FR_32
          FrTpRxSduGwTrnsm254_0xF9 (FrTpRxSdu): FrTpRxSduId=23, FrTpRxSduRef=Dcm_GW_TRNSM_FR_254_0xF9
          FrTpTxSduEcuTrnsm32_0xF9 (FrTpTxSdu): FrTpTxSduId=9, FrTpTxSduRef=Dcm_ECU_TRNSM_FR_32_0xF9
        TL_MST_GW_TRNSM_FR_254_0xFA: FrTpLa=48, FrTpMultipleReceiverCon=false, FrTpRa=250, FrTpRxPduPoolRef=RxPduPool_GW_TRNSM_FR_254, FrTpTxPduPoolRef=TxPduPool_TL_ECU_TRNSM_FR_32
          FrTpRxSduGwTrnsm254_0xFA (FrTpRxSdu): FrTpRxSduId=24, FrTpRxSduRef=Dcm_GW_TRNSM_FR_254_0xFA
          FrTpTxSduEcuTrnsm32_0xFA (FrTpTxSdu): FrTpTxSduId=10, FrTpTxSduRef=Dcm_ECU_TRNSM_FR_32_0xFA
        TL_MST_GW_TRNSM_FR_254_0xFB: FrTpLa=48, FrTpMultipleReceiverCon=false, FrTpRa=251, FrTpRxPduPoolRef=RxPduPool_GW_TRNSM_FR_254, FrTpTxPduPoolRef=TxPduPool_TL_ECU_TRNSM_FR_32
          FrTpRxSduGwTrnsm254_0xFB (FrTpRxSdu): FrTpRxSduId=25, FrTpRxSduRef=Dcm_GW_TRNSM_FR_254_0xFB
          FrTpTxSduEcuTrnsm32_0xFB (FrTpTxSdu): FrTpTxSduId=11, FrTpTxSduRef=Dcm_ECU_TRNSM_FR_32_0xFB
        TL_MST_GW_TRNSM_FR_254_0xFC: FrTpLa=48, FrTpMultipleReceiverCon=false, FrTpRa=252, FrTpRxPduPoolRef=RxPduPool_GW_TRNSM_FR_254, FrTpTxPduPoolRef=TxPduPool_TL_ECU_TRNSM_FR_32
          FrTpRxSduGwTrnsm254_0xFC (FrTpRxSdu): FrTpRxSduId=26, FrTpRxSduRef=Dcm_GW_TRNSM_FR_254_0xFC
          FrTpTxSduEcuTrnsm32_0xFC (FrTpTxSdu): FrTpTxSduId=12, FrTpTxSduRef=Dcm_ECU_TRNSM_FR_32_0xFC
        TL_MST_GW_TRNSM_FR_254_0xFD: FrTpLa=48, FrTpMultipleReceiverCon=false, FrTpRa=253, FrTpRxPduPoolRef=RxPduPool_GW_TRNSM_FR_254, FrTpTxPduPoolRef=TxPduPool_TL_ECU_TRNSM_FR_32
          FrTpRxSduGwTrnsm254_0xFD (FrTpRxSdu): FrTpRxSduId=27, FrTpRxSduRef=Dcm_GW_TRNSM_FR_254_0xFD
          FrTpTxSduEcuTrnsm32_0xFD (FrTpTxSdu): FrTpTxSduId=13, FrTpTxSduRef=Dcm_ECU_TRNSM_FR_32_0xFD
