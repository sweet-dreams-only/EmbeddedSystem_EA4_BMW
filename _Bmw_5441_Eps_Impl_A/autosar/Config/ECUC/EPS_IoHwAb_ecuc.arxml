AUTOSAR XML (schema 4-3-0)
package /ActiveEcuC
  module config IoHwAb: implementation-config-variant=VARIANT-PRE-COMPILE, module-description=IoHwAb_Impl
    IoHwAbDatatypes
      9 x IoHwAbBaseType:
        float64: IoHwAbBaseDataType=IOHWAB_FLOAT64
        float32: IoHwAbBaseDataType=IOHWAB_FLOAT32
        sint32: IoHwAbBaseDataType=IOHWAB_SINT32
        sint16: IoHwAbBaseDataType=IOHWAB_SINT16
        sint8: IoHwAbBaseDataType=IOHWAB_SINT8
        uint32: IoHwAbBaseDataType=IOHWAB_UINT32
        uint16: IoHwAbBaseDataType=IOHWAB_UINT16
        uint8: IoHwAbBaseDataType=IOHWAB_UINT8
        boolean: IoHwAbBaseDataType=IOHWAB_BOOL
      IoHwAbImplementationTypes
    IoHwAbGeneral: IoHwAbDevErrorDetect=true, IoHwAbVersionInfoApi=false, IoHwAbUseInitFunction=false, IoHwAbCfgIncludeList=Dio.h, IoHwAbCfgIncludeList=Port.h
    Per1 (IoHwAbRunnable): IoHwAbTriggerPeriod=100, IoHwAbTimebase=IoHwAbMSec
    4 x IoHwAbCSPortInterface, all with IoHwAbTemplate=IoHwAb_Template_None:
      GetGpio_PortIf1
        Oper (IoHwAbOperation)
          PinSt_Arg (IoHwAbOperationArgument): IoHwAbArgDirection=IOHWAB_OUT, IoHwAbOperationArgumentPosition=0, IoHwAbArgTypeRef=boolean
        E_NOT_OK (IoHwAbApplicationError): IoHwAbErrorCode=1
      SetFctGpio_PortIf1
        Oper (IoHwAbOperation)
        E_NOT_OK (IoHwAbApplicationError): IoHwAbErrorCode=1
      SetFctPeriph_PortIf1
        Oper (IoHwAbOperation)
        E_NOT_OK (IoHwAbApplicationError): IoHwAbErrorCode=1
      SetGpio_PortIf1
        Oper (IoHwAbOperation)
          PinSt_Arg (IoHwAbOperationArgument): IoHwAbArgDirection=IOHWAB_IN, IoHwAbOperationArgumentPosition=0, IoHwAbArgTypeRef=boolean
        E_NOT_OK (IoHwAbApplicationError): IoHwAbErrorCode=1
    40 x IoHwAbCSPortPrototype, all with IoHwAbCSDirection=IOHWAB_SERVER:
      SetGpioTmplMonrWdg: IoHwAbCSPortInterfaceRef=SetGpio_PortIf1
      SetGpioSysFlt2A: IoHwAbCSPortInterfaceRef=SetGpio_PortIf1
      GetGpioMcuEna: IoHwAbCSPortInterfaceRef=GetGpio_PortIf1
      GetGpioPwrOutpEnaFb: IoHwAbCSPortInterfaceRef=GetGpio_PortIf1
      GetGpioGateDrv0Diagc: IoHwAbCSPortInterfaceRef=GetGpio_PortIf1
      SetFctGpioPhaALowrCmd: IoHwAbCSPortInterfaceRef=SetFctGpio_PortIf1
      SetFctGpioPhaAUpprCmd: IoHwAbCSPortInterfaceRef=SetFctGpio_PortIf1
      SetFctGpioPhaBUpprCmd: IoHwAbCSPortInterfaceRef=SetFctGpio_PortIf1
      SetFctGpioPhaCLowrCmd: IoHwAbCSPortInterfaceRef=SetFctGpio_PortIf1
      SetFctGpioPhaCUpprCmd: IoHwAbCSPortInterfaceRef=SetFctGpio_PortIf1
      SetFctPeriphPhaALowrCmd: IoHwAbCSPortInterfaceRef=SetFctPeriph_PortIf1
      SetFctGpioPhaBLowrCmd: IoHwAbCSPortInterfaceRef=SetFctGpio_PortIf1
      SetFctPeriphPhaAUpprCmd: IoHwAbCSPortInterfaceRef=SetFctPeriph_PortIf1
      SetFctPeriphPhaBLowrCmd: IoHwAbCSPortInterfaceRef=SetFctPeriph_PortIf1
      SetFctPeriphPhaBUpprCmd: IoHwAbCSPortInterfaceRef=SetFctPeriph_PortIf1
      SetFctPeriphPhaCLowrCmd: IoHwAbCSPortInterfaceRef=SetFctPeriph_PortIf1
      SetFctPeriphPhaCUpprCmd: IoHwAbCSPortInterfaceRef=SetFctPeriph_PortIf1
      SetGpioGateDrv0Rst: IoHwAbCSPortInterfaceRef=SetGpio_PortIf1
      SetGpioPhaALowrCmd: IoHwAbCSPortInterfaceRef=SetGpio_PortIf1
      SetGpioPhaAUpprCmd: IoHwAbCSPortInterfaceRef=SetGpio_PortIf1
      SetGpioPhaBLowrCmd: IoHwAbCSPortInterfaceRef=SetGpio_PortIf1
      SetGpioPhaBUpprCmd: IoHwAbCSPortInterfaceRef=SetGpio_PortIf1
      SetGpioPhaCLowrCmd: IoHwAbCSPortInterfaceRef=SetGpio_PortIf1
      SetGpioPhaCUpprCmd: IoHwAbCSPortInterfaceRef=SetGpio_PortIf1
      SetGpioPwrTurnOffCtrl: IoHwAbCSPortInterfaceRef=SetGpio_PortIf1
      SetGpioPhaDiscnctA: IoHwAbCSPortInterfaceRef=SetGpio_PortIf1
      SetGpioPhaDiscnctB: IoHwAbCSPortInterfaceRef=SetGpio_PortIf1
      SetGpioPhaDiscnctC: IoHwAbCSPortInterfaceRef=SetGpio_PortIf1
      SetGpioMotAg0Mosi: IoHwAbCSPortInterfaceRef=SetGpio_PortIf1
      SetFctGpioMotAg0Mosi: IoHwAbCSPortInterfaceRef=SetFctGpio_PortIf1
      SetGpioMotAg0Clk: IoHwAbCSPortInterfaceRef=SetGpio_PortIf1
      SetFctGpioMotAg0Clk: IoHwAbCSPortInterfaceRef=SetFctGpio_PortIf1
      SetGpioMotAg0Cs: IoHwAbCSPortInterfaceRef=SetGpio_PortIf1
      SetFctGpioMotAg0Cs: IoHwAbCSPortInterfaceRef=SetFctGpio_PortIf1
      SetGpioMotAg1Mosi: IoHwAbCSPortInterfaceRef=SetGpio_PortIf1
      SetFctGpioMotAg1Mosi: IoHwAbCSPortInterfaceRef=SetFctGpio_PortIf1
      SetGpioMotAg1Clk: IoHwAbCSPortInterfaceRef=SetGpio_PortIf1
      SetFctGpioMotAg1Clk: IoHwAbCSPortInterfaceRef=SetFctGpio_PortIf1
      SetGpioMotAg1Cs: IoHwAbCSPortInterfaceRef=SetGpio_PortIf1
      SetFctGpioMotAg1Cs: IoHwAbCSPortInterfaceRef=SetFctGpio_PortIf1
