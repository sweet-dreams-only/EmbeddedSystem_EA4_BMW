AUTOSAR XML (schema 4-3-0)
package /ActiveEcuC
  module config FrIf: implementation-config-variant=VARIANT-PRE-COMPILE, module-description=FrIf_Impl
    FrIfGeneral:
      FrIfAbsTimerIdx = 1
      FrIfAllSlotsSupport = false
      FrIfCancelTransmitSupport = false
      FrIfDevErrorDetect = false
      FrIfDisableLPduSupport = false
      FrIfDisableTransceiverBranchSupport = false
      FrIfEnableTransceiverBranchSupport = false
      FrIfGetClockCorrectionSupport = false
      FrIfGetGetChannelStatusSupport = false
      FrIfGetNmVectorSupport = false
      FrIfGetNumOfStartupFramesSupport = false
      FrIfGetSyncFrameListSupport = false
      FrIfGetTransceiverErrorSupport = false
      FrIfGetWakeupRxStatusSupport = false
      FrIfNumClstSupported = 1
      FrIfNumCtrlSupported = 1
      FrIfReadCCConfigApi = false
      FrIfReconfigLPduSupport = false
      FrIfUnusedBitValue = 0
      FrIfVersionInfoApi = false
      FrIfFrameBufferLength = 254
      FrIfJobConcatenationEnable = false
      FrIfAbortCommunicationDisable = false
      FrIfCounterLimitDisable = false
      FrIfPduDirtyByteUsage = false
      FrIfSchedulingAlgorithm = Default
      FrIfSetWakeupChannelDisable = false
      FrIfSingleChannelAPI = false
      FrIfTxVirtualBufferIndexType = uint8
      FrIfRxVirtualBufferIndexType = uint8
      FrIfWrapperAPIsAsMacro = false
      FrIfUniformUpdateBytePos = false
      FrIfGlobalUniformUpdateBytePos = false
      FrIfFreeOpCallbackSupport = false
      FrIfJobsUseFreeOpCallback = false
      FrIfDualChannelRedundancySupport = false
      FrIfEnablePrepareLpdu = false
      FrIfDelayedTxConfirmationSupport = false
      FrIf3rdPartyDriverSupport = false
      FrIfSuppressProtectedRangeCheck = false
      FrIfRuntimeMeasurementSupport = false
      FrIfSafeBswChecks = true
    FrIfConfig
      TAR_QTA_STRMOM_DV (FrIfPdu)
        FrIfPduDirection
          FrIfRxPdu_TAR_QTA_STRMOM_DV (FrIfRxPdu): FrIfUserRxIndicationUL=PDUR, FrIfRxPduId=20, FrIfRxPduRef=pduTrig_TAR_QTA_STRMOM_DV_pduPort_EPS_A_FlexRay_IN_55c86d41_4f391dd1  # TAR_QTA_STRMOM_DV
      TL_BRC_FR_32 (FrIfPdu)
        FrIfPduDirection
          FrIfRxPdu_TL_BRC_FR_32 (FrIfRxPdu): FrIfUserRxIndicationUL=FR_TP, FrIfRxPduId=12, FrIfRxPduRef=p2fmap_TL_BRC_FR_32_003b6d76  # TL_BRC_FR_32
      FrStr_STEA_OFFS (FrIfFrameStructure): FrIfByteOrder=LITTLE_ENDIAN  # STEA_OFFS
        p2fmap_STEA_OFFS (FrIfPdusInFrame): FrIfPduOffset=0, FrIfMappedPduId=33, FrIfPduRef=STEA_OFFS
      dummy32bmaster (FrIfPdu)
        FrIfPduDirection
          FrIfRxPdu_dummy32bmaster (FrIfRxPdu): FrIfUserRxIndicationUL=XCP, FrIfRxPduId=10, FrIfRxPduRef=pduTrig_dummy32bmaster_pduPort_EPS_A_FlexRay_IN_55c86d41_4f391dd1  # dummy32bmaster
      ENERG_DGR_DRDY (FrIfPdu)
        FrIfPduDirection
          FrIfRxPdu_ENERG_DGR_DRDY (FrIfRxPdu): FrIfUserRxIndicationUL=PDUR, FrIfRxPduId=22, FrIfRxPduRef=pduTrig_ENERG_DGR_DRDY_pduPort_EPS_A_FlexRay_IN_55c86d41_4f391dd1  # ENERG_DGR_DRDY
      FrStr_AVL_STMOM_DV_ACT_AVL_FORC_GRD (FrIfFrameStructure): FrIfByteOrder=LITTLE_ENDIAN  # AVL_STMOM_DV_ACT_AVL_FORC_GRD
        p2fmap_AVL_FORC_GRD (FrIfPdusInFrame): FrIfPduOffset=8, FrIfMappedPduId=20, FrIfPduRef=AVL_FORC_GRD
        p2fmap_AVL_STMOM_DV_ACT (FrIfPdusInFrame): FrIfPduOffset=0, FrIfMappedPduId=19, FrIfPduRef=AVL_STMOM_DV_ACT
      AVL_STMOM_DV_ACT (FrIfPdu)
        FrIfPduDirection
          FrIfTxPdu_AVL_STMOM_DV_ACT (FrIfTxPdu):  # AVL_STMOM_DV_ACT
            FrIfUserTxUL = PDUR
            FrIfConfirm = false
            FrIfCounterLimit = 1
            FrIfImmediate = false
            FrIfNoneMode = false
            FrIfTxPduId = 19
            FrIfTxPduRef = pduTrig_AVL_STMOM_DV_ACT_pduPort_EPS_A_FlexRay_OUT_55c86d41_4f391dd1
      4 x FrIfFrameStructure, all with FrIfByteOrder=LITTLE_ENDIAN:
        FrStr_SU_EPS  # SU_EPS
          p2fmap_SU_EPS (FrIfPdusInFrame): FrIfPduOffset=0, FrIfMappedPduId=10, FrIfPduRef=SU_EPS
        FrStr_ST_EST  # ST_EST
          p2fmap_ST_EST (FrIfPdusInFrame): FrIfPduOffset=0, FrIfMappedPduId=12, FrIfPduRef=ST_EST
        FrStr_AVL_RPM_WHL  # AVL_RPM_WHL
          p2fmap_AVL_RPM_WHL (FrIfPdusInFrame): FrIfPduOffset=0, FrIfMappedPduId=45, FrIfPduRef=AVL_RPM_WHL
        FrStr_TL_MST_GW_TRNSM_FR_254  # TL_MST_GW_TRNSM_FR_254
          p2fmap_TL_MST_GW_TRNSM_FR_254 (FrIfPdusInFrame): FrIfPduOffset=0, FrIfMappedPduId=29, FrIfPduRef=TL_MST_GW_TRNSM_FR_254
      ENGTORQ_EPS (FrIfPdu)
        FrIfPduDirection
          FrIfTxPdu_ENGTORQ_EPS (FrIfTxPdu):  # ENGTORQ_EPS
            FrIfUserTxUL = PDUR
            FrIfConfirm = false
            FrIfCounterLimit = 1
            FrIfImmediate = false
            FrIfNoneMode = false
            FrIfTxPduId = 17
            FrIfTxPduRef = pduTrig_ENGTORQ_EPS_pduPort_EPS_A_FlexRay_OUT_55c86d41_4f391dd1
      FrStr_CTR_VIB_STW_DISP_EXMI_SP2015_FDBK_VIB_STW_DISP_EXMI (FrIfFrameStructure): FrIfByteOrder=LITTLE_ENDIAN  # CTR_VIB_STW_DISP_EXMI_SP2015_FDBK_VIB_STW_DISP_EXMI
        p2fmap_CTR_VIB_STW_DISP_EXMI_SP2015 (FrIfPdusInFrame): FrIfPduOffset=0, FrIfMappedPduId=4, FrIfPduRef=CTR_VIB_STW_DISP_EXMI_SP2015
      FrStr_RELATIVZEIT (FrIfFrameStructure): FrIfByteOrder=LITTLE_ENDIAN  # RELATIVZEIT
        p2fmap_RELATIVZEIT (FrIfPdusInFrame): FrIfPduOffset=0, FrIfMappedPduId=0, FrIfPduRef=RELATIVZEIT
      4 x FrIfPdu:
        SU_EPS
          FrIfPduDirection
            FrIfTxPdu_SU_EPS (FrIfTxPdu):  # SU_EPS
              FrIfUserTxUL = PDUR
              FrIfConfirm = true
              FrIfCounterLimit = 1
              FrIfImmediate = false
              FrIfNoneMode = false
              FrIfTxPduId = 10
              FrIfTxPduRef = pduTrig_SU_EPS_pduPort_EPS_A_FlexRay_OUT_55c86d41_4f391dd1
        ERRM_BN_U
          FrIfPduDirection
            FrIfRxPdu_ERRM_BN_U (FrIfRxPdu): FrIfUserRxIndicationUL=PDUR, FrIfRxPduId=19, FrIfRxPduRef=pduTrig_ERRM_BN_U_pduPort_EPS_A_FlexRay_IN_55c86d41_4f391dd1  # ERRM_BN_U
        dummy32bslave
          FrIfPduDirection
            FrIfTxPdu_dummy32bslave (FrIfTxPdu):  # dummy32bslave
              FrIfUserTxUL = XCP
              FrIfConfirm = true
              FrIfCounterLimit = 1
              FrIfImmediate = false
              FrIfNoneMode = false
              FrIfTxPduId = 13
              FrIfTxPduRef = pduTrig_dummy32bslave_pduPort_EPS_A_FlexRay_OUT_55c86d41_4f391dd1
        SVC_In
          FrIfPduDirection
            FrIfRxPdu_SVC (FrIfRxPdu): FrIfUserRxIndicationUL=PDUR, FrIfRxPduId=11, FrIfRxPduRef=SVC_fbd80461_In  # SVC
      FrStr_ENSU_SFY (FrIfFrameStructure): FrIfByteOrder=LITTLE_ENDIAN  # ENSU_SFY
        p2fmap_ENSU_SFY (FrIfPdusInFrame): FrIfPduOffset=0, FrIfMappedPduId=31, FrIfPduRef=ENSU_SFY
      A_FlexRay (FrIfCluster):
        FrIfDetectNITError = false
        FrIfGChannels = FR_CHANNEL_A
        FrIfGColdStartAttempts = 8
        FrIfGCycleCountMax = 63
        FrIfGListenNoise = 2
        FrIfGMacroPerCycle = 3636
        FrIfGMaxWithoutClockCorrectFatal = 2
        FrIfGMaxWithoutClockCorrectPassive = 2
        FrIfGNetworkManagementVectorLength = 0
        FrIfGNumberOfMinislots = 289
        FrIfGNumberOfStaticSlots = 91
        FrIfGPayloadLengthStatic = 8
        FrIfGSyncFrameIDCountMax = 15
        FrIfGdActionPointOffset = 2
        FrIfGdBit = T100NS
        FrIfGdCasRxLowMax = 79
        FrIfGdCycle = 0.005
        FrIfGdDynamicSlotIdlePhase = 1
        FrIfGdIgnoreAfterTx = 0
        FrIfGdMacrotick = 0.000001375
        FrIfGdMiniSlotActionPointOffset = 2
        FrIfGdMinislot = 5
        FrIfGdNit = 7
        FrIfGdSampleClockPeriod = T12_5NS
        FrIfGdStaticSlot = 24
        FrIfGdSymbolWindow = 0
        FrIfGdSymbolWindowActionPointOffset = 2
        FrIfGdTSSTransmitter = 9
        FrIfGdWakeupRxIdle = 59
        FrIfGdWakeupRxLow = 50
        FrIfGdWakeupRxWindow = 301
        FrIfGdWakeupTxActive = 60
        FrIfGdWakeupTxIdle = 180
        FrIfSafetyMargin = 100
        FrIfClstIdx = 0
        FrIfMainFunctionPeriod = 0.005
        FrIfMaxIsrDelay = 728
        FrIfJobList
          4 x FrIfJob, all with FrIfCycle=0:
            FrIf_TxJob_01: FrIfMacrotick=2273, FrIfStartSlot=1, FrIfEndSlot=76, FrIfMaxIsrDelay=909, FrIfIsRxJob=false, FrIfJobId=0, FrIfTxConfJobRef=FrIf_RxJob_01
              8 x FrIfCommunicationOperation, all with FrIfCommunicationAction=DECOUPLED_TRANSMISSION, FrIfRxComOpMaxLoop=512, FrIfManualAssignedLPdu=false:
                DECOUPLED_TRANSMISSION_LPdu_frTrig_FR_3a54c8219f12452dafc00b243d0703e0_1201_A_FlexRay_S_12_B_0_R_1_ChA_OUT: FrIfCommunicationOperationIdx=4, FrIfLPduIdxRef=LPdu_frTrig_1201_S_12_B_0_R_1_ChA_OUT
                DECOUPLED_TRANSMISSION_LPdu_frTrig_FR_3a54c8219f12452dafc00b243d0703e0_4912_A_FlexRay_S_49_B_1_R_2_ChA_OUT: FrIfCommunicationOperationIdx=8, FrIfLPduIdxRef=LPdu_frTrig_4912_S_49_B_1_R_2_ChA_OUT
                DECOUPLED_TRANSMISSION_LPdu_frTrig_FR_3a54c8219f12452dafc00b243d0703e0_1001_A_FlexRay_S_10_B_0_R_1_ChA_OUT: FrIfCommunicationOperationIdx=0, FrIfLPduIdxRef=LPdu_frTrig_1001_S_10_B_0_R_1_ChA_OUT
                DECOUPLED_TRANSMISSION_LPdu_frTrig_FR_3a54c8219f12452dafc00b243d0703e0_801_A_FlexRay_S_8_B_0_R_1_ChA_OUT: FrIfCommunicationOperationIdx=12, FrIfLPduIdxRef=LPdu_frTrig_801_S_8_B_0_R_1_ChA_OUT
                DECOUPLED_TRANSMISSION_LPdu_frTrig_FR_3a54c8219f12452dafc00b243d0703e0_901_A_FlexRay_S_9_B_0_R_1_ChA_OUT: FrIfCommunicationOperationIdx=14, FrIfLPduIdxRef=LPdu_frTrig_901_S_9_B_0_R_1_ChA_OUT
                DECOUPLED_TRANSMISSION_LPdu_frTrig_FR_3a54c8219f12452dafc00b243d0703e0_4902_A_FlexRay_S_49_B_0_R_2_ChA_OUT: FrIfCommunicationOperationIdx=6, FrIfLPduIdxRef=LPdu_frTrig_4902_S_49_B_0_R_2_ChA_OUT
                DECOUPLED_TRANSMISSION_LPdu_frTrig_FR_3a54c8219f12452dafc00b243d0703e0_5102_A_FlexRay_S_51_B_0_R_2_ChA_OUT: FrIfCommunicationOperationIdx=10, FrIfLPduIdxRef=LPdu_frTrig_5102_S_51_B_0_R_2_ChA_OUT
                DECOUPLED_TRANSMISSION_LPdu_frTrig_FR_3a54c8219f12452dafc00b243d0703e0_1101_A_FlexRay_S_11_B_0_R_1_ChA_OUT: FrIfCommunicationOperationIdx=2, FrIfLPduIdxRef=LPdu_frTrig_1101_S_11_B_0_R_1_ChA_OUT
            FrIf_TxJob_02: FrIfMacrotick=455, FrIfStartSlot=77, FrIfEndSlot=380, FrIfMaxIsrDelay=909, FrIfIsRxJob=false, FrIfJobId=1, FrIfTxConfJobRef=FrIf_RxJob_02
              16 x FrIfCommunicationOperation, all with FrIfCommunicationAction=DECOUPLED_TRANSMISSION, FrIfRxComOpMaxLoop=512, FrIfManualAssignedLPdu=false:
                DECOUPLED_TRANSMISSION_LPdu_frTrig_FR_3a54c8219f12452dafc00b243d0703e0_22001_A_FlexRay_S_220_B_0_R_1_ChA_OUT: FrIfCommunicationOperationIdx=4, FrIfLPduIdxRef=LPdu_frTrig_22001_S_220_B_0_R_1_ChA_OUT
                DECOUPLED_TRANSMISSION_LPdu_frTrig_FR_3a54c8219f12452dafc00b243d0703e0_31501_A_FlexRay_S_315_B_0_R_1_ChA_OUT: FrIfCommunicationOperationIdx=30, FrIfLPduIdxRef=LPdu_frTrig_31501_S_315_B_0_R_1_ChA_OUT
                DECOUPLED_TRANSMISSION_LPdu_frTrig_FR_3a54c8219f12452dafc00b243d0703e0_18301_A_FlexRay_S_183_B_0_R_1_ChA_OUT: FrIfCommunicationOperationIdx=0, FrIfLPduIdxRef=LPdu_frTrig_18301_S_183_B_0_R_1_ChA_OUT
                DECOUPLED_TRANSMISSION_LPdu_frTrig_FR_3a54c8219f12452dafc00b243d0703e0_27408_A_FlexRay_S_274_B_0_R_8_ChA_OUT: FrIfCommunicationOperationIdx=10, FrIfLPduIdxRef=LPdu_frTrig_27408_S_274_B_0_R_8_ChA_OUT
                DECOUPLED_TRANSMISSION_LPdu_frTrig_FR_3a54c8219f12452dafc00b243d0703e0_29901_A_FlexRay_S_299_B_0_R_1_ChA_OUT: FrIfCommunicationOperationIdx=24, FrIfLPduIdxRef=LPdu_frTrig_29901_S_299_B_0_R_1_ChA_OUT
                DECOUPLED_TRANSMISSION_LPdu_frTrig_FR_3a54c8219f12452dafc00b243d0703e0_29701_A_FlexRay_S_297_B_0_R_1_ChA_OUT: FrIfCommunicationOperationIdx=20, FrIfLPduIdxRef=LPdu_frTrig_29701_S_297_B_0_R_1_ChA_OUT
                DECOUPLED_TRANSMISSION_LPdu_frTrig_FR_3a54c8219f12452dafc00b243d0703e0_29801_A_FlexRay_S_298_B_0_R_1_ChA_OUT: FrIfCommunicationOperationIdx=22, FrIfLPduIdxRef=LPdu_frTrig_29801_S_298_B_0_R_1_ChA_OUT
                DECOUPLED_TRANSMISSION_LPdu_frTrig_FR_3a54c8219f12452dafc00b243d0703e0_23412_A_FlexRay_S_234_B_1_R_2_ChA_OUT: FrIfCommunicationOperationIdx=6, FrIfLPduIdxRef=LPdu_frTrig_23412_S_234_B_1_R_2_ChA_OUT
                DECOUPLED_TRANSMISSION_LPdu_frTrig_FR_3a54c8219f12452dafc00b243d0703e0_216916_A_FlexRay_S_216_B_9_R_16_ChA_OUT: FrIfCommunicationOperationIdx=2, FrIfLPduIdxRef=LPdu_frTrig_216916_S_216_B_9_R_16_ChA_OUT
                DECOUPLED_TRANSMISSION_LPdu_frTrig_FR_3a54c8219f12452dafc00b243d0703e0_29601_A_FlexRay_S_296_B_0_R_1_ChA_OUT: FrIfCommunicationOperationIdx=18, FrIfLPduIdxRef=LPdu_frTrig_29601_S_296_B_0_R_1_ChA_OUT
                DECOUPLED_TRANSMISSION_LPdu_frTrig_FR_3a54c8219f12452dafc00b243d0703e0_30001_A_FlexRay_S_300_B_0_R_1_ChA_OUT: FrIfCommunicationOperationIdx=26, FrIfLPduIdxRef=LPdu_frTrig_30001_S_300_B_0_R_1_ChA_OUT
                DECOUPLED_TRANSMISSION_LPdu_frTrig_FR_3a54c8219f12452dafc00b243d0703e0_29501_A_FlexRay_S_295_B_0_R_1_ChA_OUT: FrIfCommunicationOperationIdx=16, FrIfLPduIdxRef=LPdu_frTrig_29501_S_295_B_0_R_1_ChA_OUT
                DECOUPLED_TRANSMISSION_LPdu_frTrig_FR_3a54c8219f12452dafc00b243d0703e0_2481032_A_FlexRay_S_248_B_10_R_32_ChA_OUT: FrIfCommunicationOperationIdx=8, FrIfLPduIdxRef=LPdu_frTrig_2481032_S_248_B_10_R_32_ChA_OUT
                DECOUPLED_TRANSMISSION_LPdu_frTrig_FR_3a54c8219f12452dafc00b243d0703e0_29401_A_FlexRay_S_294_B_0_R_1_ChA_OUT: FrIfCommunicationOperationIdx=14, FrIfLPduIdxRef=LPdu_frTrig_29401_S_294_B_0_R_1_ChA_OUT
                DECOUPLED_TRANSMISSION_LPdu_frTrig_FR_3a54c8219f12452dafc00b243d0703e0_30101_A_FlexRay_S_301_B_0_R_1_ChA_OUT: FrIfCommunicationOperationIdx=28, FrIfLPduIdxRef=LPdu_frTrig_30101_S_301_B_0_R_1_ChA_OUT
                DECOUPLED_TRANSMISSION_LPdu_frTrig_FR_3a54c8219f12452dafc00b243d0703e0_27424_A_FlexRay_S_274_B_2_R_4_ChA_OUT: FrIfCommunicationOperationIdx=12, FrIfLPduIdxRef=LPdu_frTrig_27424_S_274_B_2_R_4_ChA_OUT
            FrIf_RxJob_02: FrIfMacrotick=17, FrIfStartSlot=77, FrIfEndSlot=380, FrIfMaxIsrDelay=1363, FrIfIsRxJob=true, FrIfJobId=1
              52 x FrIfCommunicationOperation, all with FrIfRxComOpMaxLoop=512, FrIfManualAssignedLPdu=false:
                RECEIVE_AND_INDICATE_LPdu_frTrig_FR_3a54c8219f12452dafc00b243d0703e0_215516_A_FlexRay_S_215_B_5_R_16_ChA_IN: FrIfCommunicationAction=RECEIVE_AND_INDICATE, FrIfCommunicationOperationIdx=30, FrIfLPduIdxRef=LPdu_frTrig_215516_S_215_B_5_R_16_ChA_IN
                RECEIVE_AND_INDICATE_LPdu_frTrig_FR_3a54c8219f12452dafc00b243d0703e0_24404_A_FlexRay_S_244_B_0_R_4_ChA_IN: FrIfCommunicationAction=RECEIVE_AND_INDICATE, FrIfCommunicationOperationIdx=54, FrIfLPduIdxRef=LPdu_frTrig_24404_S_244_B_0_R_4_ChA_IN
                RECEIVE_AND_INDICATE_LPdu_frTrig_FR_3a54c8219f12452dafc00b243d0703e0_2151016_A_FlexRay_S_215_B_10_R_16_ChA_IN: FrIfCommunicationAction=RECEIVE_AND_INDICATE, FrIfCommunicationOperationIdx=26, FrIfLPduIdxRef=LPdu_frTrig_2151016_S_215_B_10_R_16_ChA_IN
                RECEIVE_AND_INDICATE_LPdu_frTrig_FR_3a54c8219f12452dafc00b243d0703e0_25214_A_FlexRay_S_252_B_1_R_4_ChA_IN: FrIfCommunicationAction=RECEIVE_AND_INDICATE, FrIfCommunicationOperationIdx=60, FrIfLPduIdxRef=LPdu_frTrig_25214_S_252_B_1_R_4_ChA_IN
                RECEIVE_AND_INDICATE_LPdu_frTrig_FR_3a54c8219f12452dafc00b243d0703e0_11912_A_FlexRay_S_119_B_1_R_2_ChA_IN: FrIfCommunicationAction=RECEIVE_AND_INDICATE, FrIfCommunicationOperationIdx=8, FrIfLPduIdxRef=LPdu_frTrig_11912_S_119_B_1_R_2_ChA_IN
                RECEIVE_AND_INDICATE_LPdu_frTrig_FR_3a54c8219f12452dafc00b243d0703e0_2161216_A_FlexRay_S_216_B_12_R_16_ChA_IN: FrIfCommunicationAction=RECEIVE_AND_INDICATE, FrIfCommunicationOperationIdx=38, FrIfLPduIdxRef=LPdu_frTrig_2161216_S_216_B_12_R_16_ChA_IN
                RECEIVE_AND_INDICATE_LPdu_frTrig_FR_3a54c8219f12452dafc00b243d0703e0_24702_A_FlexRay_S_247_B_0_R_2_ChA_IN: FrIfCommunicationAction=RECEIVE_AND_INDICATE, FrIfCommunicationOperationIdx=56, FrIfLPduIdxRef=LPdu_frTrig_24702_S_247_B_0_R_2_ChA_IN
                RECEIVE_AND_INDICATE_LPdu_frTrig_FR_3a54c8219f12452dafc00b243d0703e0_27518_A_FlexRay_S_275_B_1_R_8_ChA_IN: FrIfCommunicationAction=RECEIVE_AND_INDICATE, FrIfCommunicationOperationIdx=64, FrIfLPduIdxRef=LPdu_frTrig_27518_S_275_B_1_R_8_ChA_IN
                RECEIVE_AND_INDICATE_LPdu_frTrig_FR_3a54c8219f12452dafc00b243d0703e0_12112_A_FlexRay_S_121_B_1_R_2_ChA_IN: FrIfCommunicationAction=RECEIVE_AND_INDICATE, FrIfCommunicationOperationIdx=10, FrIfLPduIdxRef=LPdu_frTrig_12112_S_121_B_1_R_2_ChA_IN
                TX_CONFIRMATION_LPdu_frTrig_FR_3a54c8219f12452dafc00b243d0703e0_29601_A_FlexRay_S_296_B_0_R_1_ChA_OUT: FrIfCommunicationAction=TX_CONFIRMATION, FrIfCommunicationOperationIdx=54, FrIfLPduIdxRef=LPdu_frTrig_29601_S_296_B_0_R_1_ChA_OUT
                RECEIVE_AND_INDICATE_LPdu_frTrig_FR_3a54c8219f12452dafc00b243d0703e0_215916_A_FlexRay_S_215_B_9_R_16_ChA_IN: FrIfCommunicationAction=RECEIVE_AND_INDICATE, FrIfCommunicationOperationIdx=34, FrIfLPduIdxRef=LPdu_frTrig_215916_S_215_B_9_R_16_ChA_IN
                TX_CONFIRMATION_LPdu_frTrig_FR_3a54c8219f12452dafc00b243d0703e0_29401_A_FlexRay_S_294_B_0_R_1_ChA_OUT: FrIfCommunicationAction=TX_CONFIRMATION, FrIfCommunicationOperationIdx=50, FrIfLPduIdxRef=LPdu_frTrig_29401_S_294_B_0_R_1_ChA_OUT
                TX_CONFIRMATION_LPdu_frTrig_FR_3a54c8219f12452dafc00b243d0703e0_30101_A_FlexRay_S_301_B_0_R_1_ChA_OUT: FrIfCommunicationAction=TX_CONFIRMATION, FrIfCommunicationOperationIdx=64, FrIfLPduIdxRef=LPdu_frTrig_30101_S_301_B_0_R_1_ChA_OUT
                RECEIVE_AND_INDICATE_LPdu_frTrig_FR_3a54c8219f12452dafc00b243d0703e0_20901_A_FlexRay_S_209_B_0_R_1_ChA_IN: FrIfCommunicationAction=RECEIVE_AND_INDICATE, FrIfCommunicationOperationIdx=14, FrIfLPduIdxRef=LPdu_frTrig_20901_S_209_B_0_R_1_ChA_IN
                TX_CONFIRMATION_LPdu_frTrig_FR_3a54c8219f12452dafc00b243d0703e0_2481032_A_FlexRay_S_248_B_10_R_32_ChA_OUT: FrIfCommunicationAction=TX_CONFIRMATION, FrIfCommunicationOperationIdx=44, FrIfLPduIdxRef=LPdu_frTrig_2481032_S_248_B_10_R_32_ChA_OUT
                RECEIVE_AND_INDICATE_LPdu_frTrig_FR_3a54c8219f12452dafc00b243d0703e0_216616_A_FlexRay_S_216_B_6_R_16_ChA_IN: FrIfCommunicationAction=RECEIVE_AND_INDICATE, FrIfCommunicationOperationIdx=46, FrIfLPduIdxRef=LPdu_frTrig_216616_S_216_B_6_R_16_ChA_IN
                RECEIVE_AND_INDICATE_LPdu_frTrig_FR_3a54c8219f12452dafc00b243d0703e0_21201_A_FlexRay_S_212_B_0_R_1_ChA_IN: FrIfCommunicationAction=RECEIVE_AND_INDICATE, FrIfCommunicationOperationIdx=20, FrIfLPduIdxRef=LPdu_frTrig_21201_S_212_B_0_R_1_ChA_IN
                RECEIVE_AND_INDICATE_LPdu_frTrig_FR_3a54c8219f12452dafc00b243d0703e0_11702_A_FlexRay_S_117_B_0_R_2_ChA_IN: FrIfCommunicationAction=RECEIVE_AND_INDICATE, FrIfCommunicationOperationIdx=6, FrIfLPduIdxRef=LPdu_frTrig_11702_S_117_B_0_R_2_ChA_IN
                RECEIVE_AND_INDICATE_LPdu_frTrig_FR_3a54c8219f12452dafc00b243d0703e0_21101_A_FlexRay_S_211_B_0_R_1_ChA_IN: FrIfCommunicationAction=RECEIVE_AND_INDICATE, FrIfCommunicationOperationIdx=18, FrIfLPduIdxRef=LPdu_frTrig_21101_S_211_B_0_R_1_ChA_IN
                RECEIVE_AND_INDICATE_LPdu_frTrig_FR_3a54c8219f12452dafc00b243d0703e0_2161016_A_FlexRay_S_216_B_10_R_16_ChA_IN: FrIfCommunicationAction=RECEIVE_AND_INDICATE, FrIfCommunicationOperationIdx=36, FrIfLPduIdxRef=LPdu_frTrig_2161016_S_216_B_10_R_16_ChA_IN
                TX_CONFIRMATION_LPdu_frTrig_FR_3a54c8219f12452dafc00b243d0703e0_27408_A_FlexRay_S_274_B_0_R_8_ChA_OUT: FrIfCommunicationAction=TX_CONFIRMATION, FrIfCommunicationOperationIdx=46, FrIfLPduIdxRef=LPdu_frTrig_27408_S_274_B_0_R_8_ChA_OUT
                RECEIVE_AND_INDICATE_LPdu_frTrig_FR_3a54c8219f12452dafc00b243d0703e0_24712_A_FlexRay_S_247_B_1_R_2_ChA_IN: FrIfCommunicationAction=RECEIVE_AND_INDICATE, FrIfCommunicationOperationIdx=58, FrIfLPduIdxRef=LPdu_frTrig_24712_S_247_B_1_R_2_ChA_IN
                TX_CONFIRMATION_LPdu_frTrig_FR_3a54c8219f12452dafc00b243d0703e0_29801_A_FlexRay_S_298_B_0_R_1_ChA_OUT: FrIfCommunicationAction=TX_CONFIRMATION, FrIfCommunicationOperationIdx=58, FrIfLPduIdxRef=LPdu_frTrig_29801_S_298_B_0_R_1_ChA_OUT
                RECEIVE_AND_INDICATE_LPdu_frTrig_FR_3a54c8219f12452dafc00b243d0703e0_2161316_A_FlexRay_S_216_B_13_R_16_ChA_IN: FrIfCommunicationAction=RECEIVE_AND_INDICATE, FrIfCommunicationOperationIdx=40, FrIfLPduIdxRef=LPdu_frTrig_2161316_S_216_B_13_R_16_ChA_IN
                RECEIVE_AND_INDICATE_LPdu_frTrig_FR_3a54c8219f12452dafc00b243d0703e0_10802_A_FlexRay_S_108_B_0_R_2_ChA_IN: FrIfCommunicationAction=RECEIVE_AND_INDICATE, FrIfCommunicationOperationIdx=4, FrIfLPduIdxRef=LPdu_frTrig_10802_S_108_B_0_R_2_ChA_IN
                RECEIVE_AND_INDICATE_LPdu_frTrig_FR_3a54c8219f12452dafc00b243d0703e0_14701_A_FlexRay_S_147_B_0_R_1_ChA_IN: FrIfCommunicationAction=RECEIVE_AND_INDICATE, FrIfCommunicationOperationIdx=12, FrIfLPduIdxRef=LPdu_frTrig_14701_S_147_B_0_R_1_ChA_IN
                RECEIVE_AND_INDICATE_LPdu_frTrig_FR_3a54c8219f12452dafc00b243d0703e0_26924_A_FlexRay_S_269_B_2_R_4_ChA_IN: FrIfCommunicationAction=RECEIVE_AND_INDICATE, FrIfCommunicationOperationIdx=62, FrIfLPduIdxRef=LPdu_frTrig_26924_S_269_B_2_R_4_ChA_IN
                TX_CONFIRMATION_LPdu_frTrig_FR_3a54c8219f12452dafc00b243d0703e0_23412_A_FlexRay_S_234_B_1_R_2_ChA_OUT: FrIfCommunicationAction=TX_CONFIRMATION, FrIfCommunicationOperationIdx=42, FrIfLPduIdxRef=LPdu_frTrig_23412_S_234_B_1_R_2_ChA_OUT
                RECEIVE_AND_INDICATE_LPdu_frTrig_FR_3a54c8219f12452dafc00b243d0703e0_216716_A_FlexRay_S_216_B_7_R_16_ChA_IN: FrIfCommunicationAction=RECEIVE_AND_INDICATE, FrIfCommunicationOperationIdx=48, FrIfLPduIdxRef=LPdu_frTrig_216716_S_216_B_7_R_16_ChA_IN
                RECEIVE_AND_INDICATE_LPdu_frTrig_FR_3a54c8219f12452dafc00b243d0703e0_21901_A_FlexRay_S_219_B_0_R_1_ChA_IN: FrIfCommunicationAction=RECEIVE_AND_INDICATE, FrIfCommunicationOperationIdx=50, FrIfLPduIdxRef=LPdu_frTrig_21901_S_219_B_0_R_1_ChA_IN
                TX_CONFIRMATION_LPdu_frTrig_FR_3a54c8219f12452dafc00b243d0703e0_30001_A_FlexRay_S_300_B_0_R_1_ChA_OUT: FrIfCommunicationAction=TX_CONFIRMATION, FrIfCommunicationOperationIdx=62, FrIfLPduIdxRef=LPdu_frTrig_30001_S_300_B_0_R_1_ChA_OUT
                RECEIVE_AND_INDICATE_LPdu_frTrig_FR_3a54c8219f12452dafc00b243d0703e0_27628_A_FlexRay_S_276_B_2_R_8_ChA_IN: FrIfCommunicationAction=RECEIVE_AND_INDICATE, FrIfCommunicationOperationIdx=68, FrIfLPduIdxRef=LPdu_frTrig_27628_S_276_B_2_R_8_ChA_IN
                RECEIVE_AND_INDICATE_LPdu_frTrig_FR_3a54c8219f12452dafc00b243d0703e0_10701_A_FlexRay_S_107_B_0_R_1_ChA_IN: FrIfCommunicationAction=RECEIVE_AND_INDICATE, FrIfCommunicationOperationIdx=2, FrIfLPduIdxRef=LPdu_frTrig_10701_S_107_B_0_R_1_ChA_IN
                RECEIVE_AND_INDICATE_LPdu_frTrig_FR_3a54c8219f12452dafc00b243d0703e0_10401_A_FlexRay_S_104_B_0_R_1_ChA_IN: FrIfCommunicationAction=RECEIVE_AND_INDICATE, FrIfCommunicationOperationIdx=0, FrIfLPduIdxRef=LPdu_frTrig_10401_S_104_B_0_R_1_ChA_IN
                TX_CONFIRMATION_LPdu_frTrig_FR_3a54c8219f12452dafc00b243d0703e0_22001_A_FlexRay_S_220_B_0_R_1_ChA_OUT: FrIfCommunicationAction=TX_CONFIRMATION, FrIfCommunicationOperationIdx=40, FrIfLPduIdxRef=LPdu_frTrig_22001_S_220_B_0_R_1_ChA_OUT
                TX_CONFIRMATION_LPdu_frTrig_FR_3a54c8219f12452dafc00b243d0703e0_216916_A_FlexRay_S_216_B_9_R_16_ChA_OUT: FrIfCommunicationAction=TX_CONFIRMATION, FrIfCommunicationOperationIdx=38, FrIfLPduIdxRef=LPdu_frTrig_216916_S_216_B_9_R_16_ChA_OUT
                TX_CONFIRMATION_LPdu_frTrig_FR_3a54c8219f12452dafc00b243d0703e0_29501_A_FlexRay_S_295_B_0_R_1_ChA_OUT: FrIfCommunicationAction=TX_CONFIRMATION, FrIfCommunicationOperationIdx=52, FrIfLPduIdxRef=LPdu_frTrig_29501_S_295_B_0_R_1_ChA_OUT
                RECEIVE_AND_INDICATE_LPdu_frTrig_FR_3a54c8219f12452dafc00b243d0703e0_21434_A_FlexRay_S_214_B_3_R_4_ChA_IN: FrIfCommunicationAction=RECEIVE_AND_INDICATE, FrIfCommunicationOperationIdx=24, FrIfLPduIdxRef=LPdu_frTrig_21434_S_214_B_3_R_4_ChA_IN
                RECEIVE_AND_INDICATE_LPdu_frTrig_FR_3a54c8219f12452dafc00b243d0703e0_23212_A_FlexRay_S_232_B_1_R_2_ChA_IN: FrIfCommunicationAction=RECEIVE_AND_INDICATE, FrIfCommunicationOperationIdx=52, FrIfLPduIdxRef=LPdu_frTrig_23212_S_232_B_1_R_2_ChA_IN
                RECEIVE_AND_INDICATE_LPdu_frTrig_FR_3a54c8219f12452dafc00b243d0703e0_2161416_A_FlexRay_S_216_B_14_R_16_ChA_IN: FrIfCommunicationAction=RECEIVE_AND_INDICATE, FrIfCommunicationOperationIdx=42, FrIfLPduIdxRef=LPdu_frTrig_2161416_S_216_B_14_R_16_ChA_IN
                TX_CONFIRMATION_LPdu_frTrig_FR_3a54c8219f12452dafc00b243d0703e0_27424_A_FlexRay_S_274_B_2_R_4_ChA_OUT: FrIfCommunicationAction=TX_CONFIRMATION, FrIfCommunicationOperationIdx=48, FrIfLPduIdxRef=LPdu_frTrig_27424_S_274_B_2_R_4_ChA_OUT
                RECEIVE_AND_INDICATE_LPdu_frTrig_FR_3a54c8219f12452dafc00b243d0703e0_27648_A_FlexRay_S_276_B_4_R_8_ChA_IN: FrIfCommunicationAction=RECEIVE_AND_INDICATE, FrIfCommunicationOperationIdx=70, FrIfLPduIdxRef=LPdu_frTrig_27648_S_276_B_4_R_8_ChA_IN
                TX_CONFIRMATION_LPdu_frTrig_FR_3a54c8219f12452dafc00b243d0703e0_29901_A_FlexRay_S_299_B_0_R_1_ChA_OUT: FrIfCommunicationAction=TX_CONFIRMATION, FrIfCommunicationOperationIdx=60, FrIfLPduIdxRef=LPdu_frTrig_29901_S_299_B_0_R_1_ChA_OUT
                TX_CONFIRMATION_LPdu_frTrig_FR_3a54c8219f12452dafc00b243d0703e0_29701_A_FlexRay_S_297_B_0_R_1_ChA_OUT: FrIfCommunicationAction=TX_CONFIRMATION, FrIfCommunicationOperationIdx=56, FrIfLPduIdxRef=LPdu_frTrig_29701_S_297_B_0_R_1_ChA_OUT
                RECEIVE_AND_INDICATE_LPdu_frTrig_FR_3a54c8219f12452dafc00b243d0703e0_27578_A_FlexRay_S_275_B_7_R_8_ChA_IN: FrIfCommunicationAction=RECEIVE_AND_INDICATE, FrIfCommunicationOperationIdx=66, FrIfLPduIdxRef=LPdu_frTrig_27578_S_275_B_7_R_8_ChA_IN
                RECEIVE_AND_INDICATE_LPdu_frTrig_FR_3a54c8219f12452dafc00b243d0703e0_21301_A_FlexRay_S_213_B_0_R_1_ChA_IN: FrIfCommunicationAction=RECEIVE_AND_INDICATE, FrIfCommunicationOperationIdx=22, FrIfLPduIdxRef=LPdu_frTrig_21301_S_213_B_0_R_1_ChA_IN
                TX_CONFIRMATION_LPdu_frTrig_FR_3a54c8219f12452dafc00b243d0703e0_31501_A_FlexRay_S_315_B_0_R_1_ChA_OUT: FrIfCommunicationAction=TX_CONFIRMATION, FrIfCommunicationOperationIdx=66, FrIfLPduIdxRef=LPdu_frTrig_31501_S_315_B_0_R_1_ChA_OUT
                RECEIVE_AND_INDICATE_LPdu_frTrig_FR_3a54c8219f12452dafc00b243d0703e0_215216_A_FlexRay_S_215_B_2_R_16_ChA_IN: FrIfCommunicationAction=RECEIVE_AND_INDICATE, FrIfCommunicationOperationIdx=28, FrIfLPduIdxRef=LPdu_frTrig_215216_S_215_B_2_R_16_ChA_IN
                RECEIVE_AND_INDICATE_LPdu_frTrig_FR_3a54c8219f12452dafc00b243d0703e0_21001_A_FlexRay_S_210_B_0_R_1_ChA_IN: FrIfCommunicationAction=RECEIVE_AND_INDICATE, FrIfCommunicationOperationIdx=16, FrIfLPduIdxRef=LPdu_frTrig_21001_S_210_B_0_R_1_ChA_IN
                TX_CONFIRMATION_LPdu_frTrig_FR_3a54c8219f12452dafc00b243d0703e0_18301_A_FlexRay_S_183_B_0_R_1_ChA_OUT: FrIfCommunicationAction=TX_CONFIRMATION, FrIfCommunicationOperationIdx=36, FrIfLPduIdxRef=LPdu_frTrig_18301_S_183_B_0_R_1_ChA_OUT
                RECEIVE_AND_INDICATE_LPdu_frTrig_FR_3a54c8219f12452dafc00b243d0703e0_215616_A_FlexRay_S_215_B_6_R_16_ChA_IN: FrIfCommunicationAction=RECEIVE_AND_INDICATE, FrIfCommunicationOperationIdx=32, FrIfLPduIdxRef=LPdu_frTrig_215616_S_215_B_6_R_16_ChA_IN
                RECEIVE_AND_INDICATE_LPdu_frTrig_FR_3a54c8219f12452dafc00b243d0703e0_2161516_A_FlexRay_S_216_B_15_R_16_ChA_IN: FrIfCommunicationAction=RECEIVE_AND_INDICATE, FrIfCommunicationOperationIdx=44, FrIfLPduIdxRef=LPdu_frTrig_2161516_S_216_B_15_R_16_ChA_IN
            FrIf_RxJob_01: FrIfMacrotick=1842, FrIfStartSlot=1, FrIfEndSlot=76, FrIfMaxIsrDelay=1363, FrIfIsRxJob=true, FrIfJobId=0
              17 x FrIfCommunicationOperation, all with FrIfRxComOpMaxLoop=512, FrIfManualAssignedLPdu=false:
                TX_CONFIRMATION_LPdu_frTrig_FR_3a54c8219f12452dafc00b243d0703e0_1101_A_FlexRay_S_11_B_0_R_1_ChA_OUT: FrIfCommunicationAction=TX_CONFIRMATION, FrIfCommunicationOperationIdx=11, FrIfLPduIdxRef=LPdu_frTrig_1101_S_11_B_0_R_1_ChA_OUT
                TX_CONFIRMATION_LPdu_frTrig_FR_3a54c8219f12452dafc00b243d0703e0_4902_A_FlexRay_S_49_B_0_R_2_ChA_OUT: FrIfCommunicationAction=TX_CONFIRMATION, FrIfCommunicationOperationIdx=15, FrIfLPduIdxRef=LPdu_frTrig_4902_S_49_B_0_R_2_ChA_OUT
                RECEIVE_AND_INDICATE_LPdu_frTrig_FR_3a54c8219f12452dafc00b243d0703e0_5534_A_FlexRay_S_55_B_3_R_4_ChA_IN: FrIfCommunicationAction=RECEIVE_AND_INDICATE, FrIfCommunicationOperationIdx=8, FrIfLPduIdxRef=LPdu_frTrig_5534_S_55_B_3_R_4_ChA_IN
                RECEIVE_AND_INDICATE_LPdu_frTrig_FR_3a54c8219f12452dafc00b243d0703e0_4601_A_FlexRay_S_46_B_0_R_1_ChA_IN: FrIfCommunicationAction=RECEIVE_AND_INDICATE, FrIfCommunicationOperationIdx=0, FrIfLPduIdxRef=LPdu_frTrig_4601_S_46_B_0_R_1_ChA_IN
                TX_CONFIRMATION_LPdu_frTrig_FR_3a54c8219f12452dafc00b243d0703e0_1201_A_FlexRay_S_12_B_0_R_1_ChA_OUT: FrIfCommunicationAction=TX_CONFIRMATION, FrIfCommunicationOperationIdx=13, FrIfLPduIdxRef=LPdu_frTrig_1201_S_12_B_0_R_1_ChA_OUT
                TX_CONFIRMATION_LPdu_frTrig_FR_3a54c8219f12452dafc00b243d0703e0_1001_A_FlexRay_S_10_B_0_R_1_ChA_OUT: FrIfCommunicationAction=TX_CONFIRMATION, FrIfCommunicationOperationIdx=9, FrIfLPduIdxRef=LPdu_frTrig_1001_S_10_B_0_R_1_ChA_OUT
                RECEIVE_AND_INDICATE_LPdu_frTrig_FR_3a54c8219f12452dafc00b243d0703e0_5602_A_FlexRay_S_56_B_0_R_2_ChA_IN: FrIfCommunicationAction=RECEIVE_AND_INDICATE, FrIfCommunicationOperationIdx=10, FrIfLPduIdxRef=LPdu_frTrig_5602_S_56_B_0_R_2_ChA_IN
                TX_CONFIRMATION_LPdu_frTrig_FR_3a54c8219f12452dafc00b243d0703e0_801_A_FlexRay_S_8_B_0_R_1_ChA_OUT: FrIfCommunicationAction=TX_CONFIRMATION, FrIfCommunicationOperationIdx=21, FrIfLPduIdxRef=LPdu_frTrig_801_S_8_B_0_R_1_ChA_OUT
                RECEIVE_AND_INDICATE_LPdu_frTrig_FR_3a54c8219f12452dafc00b243d0703e0_5502_A_FlexRay_S_55_B_0_R_2_ChA_IN: FrIfCommunicationAction=RECEIVE_AND_INDICATE, FrIfCommunicationOperationIdx=6, FrIfLPduIdxRef=LPdu_frTrig_5502_S_55_B_0_R_2_ChA_IN
                TX_CONFIRMATION_LPdu_frTrig_FR_3a54c8219f12452dafc00b243d0703e0_901_A_FlexRay_S_9_B_0_R_1_ChA_OUT: FrIfCommunicationAction=TX_CONFIRMATION, FrIfCommunicationOperationIdx=23, FrIfLPduIdxRef=LPdu_frTrig_901_S_9_B_0_R_1_ChA_OUT
                TX_CONFIRMATION_LPdu_frTrig_FR_3a54c8219f12452dafc00b243d0703e0_4912_A_FlexRay_S_49_B_1_R_2_ChA_OUT: FrIfCommunicationAction=TX_CONFIRMATION, FrIfCommunicationOperationIdx=17, FrIfLPduIdxRef=LPdu_frTrig_4912_S_49_B_1_R_2_ChA_OUT
                TX_CONFIRMATION_LPdu_frTrig_FR_3a54c8219f12452dafc00b243d0703e0_5102_A_FlexRay_S_51_B_0_R_2_ChA_OUT: FrIfCommunicationAction=TX_CONFIRMATION, FrIfCommunicationOperationIdx=19, FrIfLPduIdxRef=LPdu_frTrig_5102_S_51_B_0_R_2_ChA_OUT
                RECEIVE_AND_INDICATE_LPdu_frTrig_FR_3a54c8219f12452dafc00b243d0703e0_4712_A_FlexRay_S_47_B_1_R_2_ChA_IN: FrIfCommunicationAction=RECEIVE_AND_INDICATE, FrIfCommunicationOperationIdx=2, FrIfLPduIdxRef=LPdu_frTrig_4712_S_47_B_1_R_2_ChA_IN
                RECEIVE_AND_INDICATE_LPdu_frTrig_FR_3a54c8219f12452dafc00b243d0703e0_6512_A_FlexRay_S_65_B_1_R_2_ChA_IN: FrIfCommunicationAction=RECEIVE_AND_INDICATE, FrIfCommunicationOperationIdx=12, FrIfLPduIdxRef=LPdu_frTrig_6512_S_65_B_1_R_2_ChA_IN
                RECEIVE_AND_INDICATE_LPdu_frTrig_FR_3a54c8219f12452dafc00b243d0703e0_5338_A_FlexRay_S_53_B_3_R_8_ChA_IN: FrIfCommunicationAction=RECEIVE_AND_INDICATE, FrIfCommunicationOperationIdx=4, FrIfLPduIdxRef=LPdu_frTrig_5338_S_53_B_3_R_8_ChA_IN
                RECEIVE_AND_INDICATE_LPdu_frTrig_FR_3a54c8219f12452dafc00b243d0703e0_6802_A_FlexRay_S_68_B_0_R_2_ChA_IN: FrIfCommunicationAction=RECEIVE_AND_INDICATE, FrIfCommunicationOperationIdx=14, FrIfLPduIdxRef=LPdu_frTrig_6802_S_68_B_0_R_2_ChA_IN
                RECEIVE_AND_INDICATE_LPdu_frTrig_FR_3a54c8219f12452dafc00b243d0703e0_6812_A_FlexRay_S_68_B_1_R_2_ChA_IN: FrIfCommunicationAction=RECEIVE_AND_INDICATE, FrIfCommunicationOperationIdx=16, FrIfLPduIdxRef=LPdu_frTrig_6812_S_68_B_1_R_2_ChA_IN
        EPS_A_FlexRay (FrIfController): FrIfCtrlIdx=0, FrIfFrCtrlRef=EPS_A_FlexRay
          FrIfTransceiver: FrIfClusterChannel=FRIF_CHANNEL_A, FrIfFrTrcvChannelRef=FrTrcvChannel
          3 x FrIfLPdu, all with FrIfReconfigurable=false:
            LPdu_frTrig_2161316_S_216_B_13_R_16_ChA_IN: FrIfLPduIdx=39, FrIfVBTriggeringRef=frTrig_2161316_S_216_B_13_R_16_ChA_IN  # frTrig_2161316
            LPdu_frTrig_215516_S_215_B_5_R_16_ChA_IN: FrIfLPduIdx=43, FrIfVBTriggeringRef=frTrig_215516_S_215_B_5_R_16_ChA_IN  # frTrig_215516
            LPdu_frTrig_14701_S_147_B_0_R_1_ChA_IN: FrIfLPduIdx=53, FrIfVBTriggeringRef=frTrig_14701_S_147_B_0_R_1_ChA_IN  # frTrig_14701
          frTrig_31501_S_315_B_0_R_1_ChA_OUT (FrIfFrameTriggering):
            FrIfAllowDynamicLSduLength = false
            FrIfBaseCycle = 0
            FrIfChannel = FRIF_CHANNEL_A
            FrIfCycleRepetition = 1
            FrIfLSduLength = 58
            FrIfPayloadPreamble = false
            FrIfSlotId = 315
            FrIfAlwaysTransmit = false
            FrIfFrameStructureRef = FrStr_FR_DBG_EPS
          LPdu_frTrig_23412_S_234_B_1_R_2_ChA_OUT (FrIfLPdu): FrIfLPduIdx=12, FrIfReconfigurable=false, FrIfVBTriggeringRef=frTrig_23412_S_234_B_1_R_2_ChA_OUT  # frTrig_23412
          frTrig_21001_S_210_B_0_R_1_ChA_IN (FrIfFrameTriggering):
            FrIfAllowDynamicLSduLength = false
            FrIfBaseCycle = 0
            FrIfChannel = FRIF_CHANNEL_A
            FrIfCycleRepetition = 1
            FrIfLSduLength = 32
            FrIfPayloadPreamble = false
            FrIfSlotId = 210
            FrIfAlwaysTransmit = false
            FrIfFrameStructureRef = FrStr_TL_BRC_FR_32_43a846aa_In
          frTrig_1001_S_10_B_0_R_1_ChA_OUT (FrIfFrameTriggering):
            FrIfAllowDynamicLSduLength = false
            FrIfBaseCycle = 0
            FrIfChannel = FRIF_CHANNEL_A
            FrIfCycleRepetition = 1
            FrIfLSduLength = 16
            FrIfPayloadPreamble = false
            FrIfSlotId = 10
            FrIfAlwaysTransmit = false
            FrIfFrameStructureRef = FrStr_xcpstatic_aab54530_Out
          LPdu_frTrig_22001_S_220_B_0_R_1_ChA_OUT (FrIfLPdu): FrIfLPduIdx=13, FrIfReconfigurable=false, FrIfVBTriggeringRef=frTrig_22001_S_220_B_0_R_1_ChA_OUT  # frTrig_22001
          LPdu_frTrig_29801_S_298_B_0_R_1_ChA_OUT (FrIfLPdu): FrIfLPduIdx=4, FrIfReconfigurable=false, FrIfVBTriggeringRef=frTrig_29801_S_298_B_0_R_1_ChA_OUT  # frTrig_29801
          frTrig_25214_S_252_B_1_R_4_ChA_IN (FrIfFrameTriggering):
            FrIfAllowDynamicLSduLength = false
            FrIfBaseCycle = 1
            FrIfChannel = FRIF_CHANNEL_A
            FrIfCycleRepetition = 4
            FrIfLSduLength = 2
            FrIfPayloadPreamble = false
            FrIfSlotId = 252
            FrIfAlwaysTransmit = false
            FrIfFrameStructureRef = FrStr_A_TEMP
          LPdu_frTrig_30101_S_301_B_0_R_1_ChA_OUT (FrIfLPdu): FrIfLPduIdx=1, FrIfReconfigurable=false, FrIfVBTriggeringRef=frTrig_30101_S_301_B_0_R_1_ChA_OUT  # frTrig_30101
          LPdu_frTrig_901_S_9_B_0_R_1_ChA_OUT (FrIfLPdu): FrIfLPduIdx=22, FrIfReconfigurable=false, FrIfVBTriggeringRef=frTrig_901_S_9_B_0_R_1_ChA_OUT  # frTrig_901
          4 x FrIfFrameTriggering, all with FrIfAllowDynamicLSduLength=false, FrIfChannel=FRIF_CHANNEL_A, FrIfPayloadPreamble=false, FrIfAlwaysTransmit=false:
            frTrig_215516_S_215_B_5_R_16_ChA_IN: FrIfBaseCycle=5, FrIfCycleRepetition=16, FrIfLSduLength=8, FrIfSlotId=215, FrIfFrameStructureRef=FrStr_SVC_1aedaa7d_In
            frTrig_14701_S_147_B_0_R_1_ChA_IN: FrIfBaseCycle=0, FrIfCycleRepetition=1, FrIfLSduLength=254, FrIfSlotId=147, FrIfFrameStructureRef=FrStr_TL_MST_GW_TRNSM_FR_254
            frTrig_27408_S_274_B_0_R_8_ChA_OUT: FrIfBaseCycle=0, FrIfCycleRepetition=8, FrIfLSduLength=8, FrIfSlotId=274, FrIfFrameStructureRef=FrStr_SU_EPS
            frTrig_2161516_S_216_B_15_R_16_ChA_IN: FrIfBaseCycle=15, FrIfCycleRepetition=16, FrIfLSduLength=8, FrIfSlotId=216, FrIfFrameStructureRef=FrStr_SVC_b39c49a3_In
          LPdu_frTrig_25214_S_252_B_1_R_4_ChA_IN (FrIfLPdu): FrIfLPduIdx=29, FrIfReconfigurable=false, FrIfVBTriggeringRef=frTrig_25214_S_252_B_1_R_4_ChA_IN  # frTrig_25214
          frTrig_29501_S_295_B_0_R_1_ChA_OUT (FrIfFrameTriggering):
            FrIfAllowDynamicLSduLength = false
            FrIfBaseCycle = 0
            FrIfChannel = FRIF_CHANNEL_A
            FrIfCycleRepetition = 1
            FrIfLSduLength = 254
            FrIfPayloadPreamble = false
            FrIfSlotId = 295
            FrIfAlwaysTransmit = false
            FrIfFrameStructureRef = FrStr_xcpdynamic254_2
          4 x FrIfLPdu, all with FrIfReconfigurable=false:
            LPdu_frTrig_10401_S_104_B_0_R_1_ChA_IN: FrIfLPduIdx=59, FrIfVBTriggeringRef=frTrig_10401_S_104_B_0_R_1_ChA_IN  # frTrig_10401
            LPdu_frTrig_1001_S_10_B_0_R_1_ChA_OUT: FrIfLPduIdx=21, FrIfVBTriggeringRef=frTrig_1001_S_10_B_0_R_1_ChA_OUT  # frTrig_1001
            LPdu_frTrig_24702_S_247_B_0_R_2_ChA_IN: FrIfLPduIdx=30, FrIfVBTriggeringRef=frTrig_24702_S_247_B_0_R_2_ChA_IN  # frTrig_24702
            LPdu_frTrig_5502_S_55_B_0_R_2_ChA_IN: FrIfLPduIdx=64, FrIfVBTriggeringRef=frTrig_5502_S_55_B_0_R_2_ChA_IN  # frTrig_5502
          frTrig_2161216_S_216_B_12_R_16_ChA_IN (FrIfFrameTriggering):
            FrIfAllowDynamicLSduLength = false
            FrIfBaseCycle = 12
            FrIfChannel = FRIF_CHANNEL_A
            FrIfCycleRepetition = 16
            FrIfLSduLength = 8
            FrIfPayloadPreamble = false
            FrIfSlotId = 216
            FrIfAlwaysTransmit = false
            FrIfFrameStructureRef = FrStr_SVC_b6d35f26_In
          LPdu_frTrig_1101_S_11_B_0_R_1_ChA_OUT (FrIfLPdu): FrIfLPduIdx=20, FrIfReconfigurable=false, FrIfVBTriggeringRef=frTrig_1101_S_11_B_0_R_1_ChA_OUT  # frTrig_1101
          frTrig_215616_S_215_B_6_R_16_ChA_IN (FrIfFrameTriggering):
            FrIfAllowDynamicLSduLength = false
            FrIfBaseCycle = 6
            FrIfChannel = FRIF_CHANNEL_A
            FrIfCycleRepetition = 16
            FrIfLSduLength = 8
            FrIfPayloadPreamble = false
            FrIfSlotId = 215
            FrIfAlwaysTransmit = false
            FrIfFrameStructureRef = FrStr_SVC_18ab1424_In
          LPdu_frTrig_2151016_S_215_B_10_R_16_ChA_IN (FrIfLPdu): FrIfLPduIdx=46, FrIfReconfigurable=false, FrIfVBTriggeringRef=frTrig_2151016_S_215_B_10_R_16_ChA_IN  # frTrig_2151016
          LPdu_frTrig_5338_S_53_B_3_R_8_ChA_IN (FrIfLPdu): FrIfLPduIdx=66, FrIfReconfigurable=false, FrIfVBTriggeringRef=frTrig_5338_S_53_B_3_R_8_ChA_IN  # frTrig_5338
          frTrig_24702_S_247_B_0_R_2_ChA_IN (FrIfFrameTriggering):
            FrIfAllowDynamicLSduLength = false
            FrIfBaseCycle = 0
            FrIfChannel = FRIF_CHANNEL_A
            FrIfCycleRepetition = 2
            FrIfLSduLength = 2
            FrIfPayloadPreamble = false
            FrIfSlotId = 247
            FrIfAlwaysTransmit = false
            FrIfFrameStructureRef = FrStr_CTR_DIAG_OBD_DRDY
          5 x FrIfLPdu, all with FrIfReconfigurable=false:
            LPdu_frTrig_216716_S_216_B_7_R_16_ChA_IN: FrIfLPduIdx=36, FrIfVBTriggeringRef=frTrig_216716_S_216_B_7_R_16_ChA_IN  # frTrig_216716
            LPdu_frTrig_29701_S_297_B_0_R_1_ChA_OUT: FrIfLPduIdx=5, FrIfVBTriggeringRef=frTrig_29701_S_297_B_0_R_1_ChA_OUT  # frTrig_29701
            LPdu_frTrig_6812_S_68_B_1_R_2_ChA_IN: FrIfLPduIdx=61, FrIfVBTriggeringRef=frTrig_6812_S_68_B_1_R_2_ChA_IN  # frTrig_6812
            LPdu_frTrig_30001_S_300_B_0_R_1_ChA_OUT: FrIfLPduIdx=2, FrIfVBTriggeringRef=frTrig_30001_S_300_B_0_R_1_ChA_OUT  # frTrig_30001
            LPdu_frTrig_2161216_S_216_B_12_R_16_ChA_IN: FrIfLPduIdx=38, FrIfVBTriggeringRef=frTrig_2161216_S_216_B_12_R_16_ChA_IN  # frTrig_2161216
          3 x FrIfFrameTriggering, all with FrIfAllowDynamicLSduLength=false, FrIfBaseCycle=0, FrIfChannel=FRIF_CHANNEL_A, FrIfCycleRepetition=1, FrIfPayloadPreamble=false, FrIfAlwaysTransmit=false:
            frTrig_21101_S_211_B_0_R_1_ChA_IN: FrIfLSduLength=32, FrIfSlotId=211, FrIfFrameStructureRef=FrStr_TL_BRC_FR_32_426a2c9d_In
            frTrig_29601_S_296_B_0_R_1_ChA_OUT: FrIfLSduLength=254, FrIfSlotId=296, FrIfFrameStructureRef=FrStr_xcpdynamic254_3
            frTrig_29901_S_299_B_0_R_1_ChA_OUT: FrIfLSduLength=254, FrIfSlotId=299, FrIfFrameStructureRef=FrStr_xcpdynamic254_6
          4 x FrIfLPdu, all with FrIfReconfigurable=false:
            LPdu_frTrig_2161416_S_216_B_14_R_16_ChA_IN: FrIfLPduIdx=40, FrIfVBTriggeringRef=frTrig_2161416_S_216_B_14_R_16_ChA_IN  # frTrig_2161416
            LPdu_frTrig_215916_S_215_B_9_R_16_ChA_IN: FrIfLPduIdx=45, FrIfVBTriggeringRef=frTrig_215916_S_215_B_9_R_16_ChA_IN  # frTrig_215916
            LPdu_frTrig_4912_S_49_B_1_R_2_ChA_OUT: FrIfLPduIdx=17, FrIfVBTriggeringRef=frTrig_4912_S_49_B_1_R_2_ChA_OUT  # frTrig_4912
            LPdu_frTrig_2161016_S_216_B_10_R_16_ChA_IN: FrIfLPduIdx=37, FrIfVBTriggeringRef=frTrig_2161016_S_216_B_10_R_16_ChA_IN  # frTrig_2161016
          frTrig_21434_S_214_B_3_R_4_ChA_IN (FrIfFrameTriggering):
            FrIfAllowDynamicLSduLength = false
            FrIfBaseCycle = 3
            FrIfChannel = FRIF_CHANNEL_A
            FrIfCycleRepetition = 4
            FrIfLSduLength = 8
            FrIfPayloadPreamble = false
            FrIfSlotId = 214
            FrIfAlwaysTransmit = false
            FrIfFrameStructureRef = FrStr_SVC_1fe6493a_In
          LPdu_frTrig_27578_S_275_B_7_R_8_ChA_IN (FrIfLPdu): FrIfLPduIdx=27, FrIfReconfigurable=false, FrIfVBTriggeringRef=frTrig_27578_S_275_B_7_R_8_ChA_IN  # frTrig_27578
          frTrig_5602_S_56_B_0_R_2_ChA_IN (FrIfFrameTriggering):
            FrIfAllowDynamicLSduLength = false
            FrIfBaseCycle = 0
            FrIfChannel = FRIF_CHANNEL_A
            FrIfCycleRepetition = 2
            FrIfLSduLength = 14
            FrIfPayloadPreamble = false
            FrIfSlotId = 56
            FrIfAlwaysTransmit = false
            FrIfFrameStructureRef = FrStr_DT_DRDYSEN_EXT_VYAW_VEH
          LPdu_frTrig_27628_S_276_B_2_R_8_ChA_IN (FrIfLPdu): FrIfLPduIdx=24, FrIfReconfigurable=false, FrIfVBTriggeringRef=frTrig_27628_S_276_B_2_R_8_ChA_IN  # frTrig_27628
          LPdu_frTrig_27648_S_276_B_4_R_8_ChA_IN (FrIfLPdu): FrIfLPduIdx=25, FrIfReconfigurable=false, FrIfVBTriggeringRef=frTrig_27648_S_276_B_4_R_8_ChA_IN  # frTrig_27648
          4 x FrIfFrameTriggering, all with FrIfAllowDynamicLSduLength=false, FrIfChannel=FRIF_CHANNEL_A, FrIfPayloadPreamble=false, FrIfAlwaysTransmit=false:
            frTrig_216716_S_216_B_7_R_16_ChA_IN: FrIfBaseCycle=7, FrIfCycleRepetition=16, FrIfLSduLength=8, FrIfSlotId=216, FrIfFrameStructureRef=FrStr_SVC_0bdcd1fd_In
            frTrig_27518_S_275_B_1_R_8_ChA_IN: FrIfBaseCycle=1, FrIfCycleRepetition=8, FrIfLSduLength=8, FrIfSlotId=275, FrIfFrameStructureRef=FrStr_FZZSTD
            frTrig_6512_S_65_B_1_R_2_ChA_IN: FrIfBaseCycle=1, FrIfCycleRepetition=2, FrIfLSduLength=8, FrIfSlotId=65, FrIfFrameStructureRef=FrStr_TAR_ESTP_VIRT_FTAX
            frTrig_23412_S_234_B_1_R_2_ChA_OUT: FrIfBaseCycle=1, FrIfCycleRepetition=2, FrIfLSduLength=5, FrIfSlotId=234, FrIfFrameStructureRef=FrStr_ST_EST
          LPdu_frTrig_1201_S_12_B_0_R_1_ChA_OUT (FrIfLPdu): FrIfLPduIdx=19, FrIfReconfigurable=false, FrIfVBTriggeringRef=frTrig_1201_S_12_B_0_R_1_ChA_OUT  # frTrig_1201
          frTrig_2481032_S_248_B_10_R_32_ChA_OUT (FrIfFrameTriggering):
            FrIfAllowDynamicLSduLength = false
            FrIfBaseCycle = 10
            FrIfChannel = FRIF_CHANNEL_A
            FrIfCycleRepetition = 32
            FrIfLSduLength = 8
            FrIfPayloadPreamble = false
            FrIfSlotId = 248
            FrIfAlwaysTransmit = false
            FrIfFrameStructureRef = FrStr_ST_DIAG_OBD_3_DRDY
          frTrig_5338_S_53_B_3_R_8_ChA_IN (FrIfFrameTriggering):
            FrIfAllowDynamicLSduLength = false
            FrIfBaseCycle = 3
            FrIfChannel = FRIF_CHANNEL_A
            FrIfCycleRepetition = 8
            FrIfLSduLength = 16
            FrIfPayloadPreamble = false
            FrIfSlotId = 53
            FrIfAlwaysTransmit = false
            FrIfFrameStructureRef = FrStr_SU_CLE_DRDY_DXP_SPEC_ADPT_MOD_DXP_ST_IDLV_COOD_DBE_DXP
          5 x FrIfLPdu, all with FrIfReconfigurable=false:
            LPdu_frTrig_6512_S_65_B_1_R_2_ChA_IN: FrIfLPduIdx=62, FrIfVBTriggeringRef=frTrig_6512_S_65_B_1_R_2_ChA_IN  # frTrig_6512
            LPdu_frTrig_801_S_8_B_0_R_1_ChA_OUT: FrIfLPduIdx=23, FrIfVBTriggeringRef=frTrig_801_S_8_B_0_R_1_ChA_OUT  # frTrig_801
            LPdu_frTrig_216616_S_216_B_6_R_16_ChA_IN: FrIfLPduIdx=35, FrIfVBTriggeringRef=frTrig_216616_S_216_B_6_R_16_ChA_IN  # frTrig_216616
            LPdu_frTrig_11702_S_117_B_0_R_2_ChA_IN: FrIfLPduIdx=56, FrIfVBTriggeringRef=frTrig_11702_S_117_B_0_R_2_ChA_IN  # frTrig_11702
            LPdu_frTrig_29901_S_299_B_0_R_1_ChA_OUT: FrIfLPduIdx=3, FrIfVBTriggeringRef=frTrig_29901_S_299_B_0_R_1_ChA_OUT  # frTrig_29901
          3 x FrIfFrameTriggering, all with FrIfAllowDynamicLSduLength=false, FrIfBaseCycle=0, FrIfChannel=FRIF_CHANNEL_A, FrIfPayloadPreamble=false, FrIfAlwaysTransmit=false:
            frTrig_29701_S_297_B_0_R_1_ChA_OUT: FrIfCycleRepetition=1, FrIfLSduLength=254, FrIfSlotId=297, FrIfFrameStructureRef=FrStr_xcpdynamic254_4
            frTrig_29801_S_298_B_0_R_1_ChA_OUT: FrIfCycleRepetition=1, FrIfLSduLength=254, FrIfSlotId=298, FrIfFrameStructureRef=FrStr_xcpdynamic254_5
            frTrig_4902_S_49_B_0_R_2_ChA_OUT: FrIfCycleRepetition=2, FrIfLSduLength=16, FrIfSlotId=49, FrIfFrameStructureRef=FrStr_AVL_STMOM_DV_ACT_AVL_FORC_GRD
          LPdu_frTrig_11912_S_119_B_1_R_2_ChA_IN (FrIfLPdu): FrIfLPduIdx=55, FrIfReconfigurable=false, FrIfVBTriggeringRef=frTrig_11912_S_119_B_1_R_2_ChA_IN  # frTrig_11912
          frTrig_27628_S_276_B_2_R_8_ChA_IN (FrIfFrameTriggering):
            FrIfAllowDynamicLSduLength = false
            FrIfBaseCycle = 2
            FrIfChannel = FRIF_CHANNEL_A
            FrIfCycleRepetition = 8
            FrIfLSduLength = 6
            FrIfPayloadPreamble = false
            FrIfSlotId = 276
            FrIfAlwaysTransmit = false
            FrIfFrameStructureRef = FrStr_RELATIVZEIT
          frTrig_215916_S_215_B_9_R_16_ChA_IN (FrIfFrameTriggering):
            FrIfAllowDynamicLSduLength = false
            FrIfBaseCycle = 9
            FrIfChannel = FRIF_CHANNEL_A
            FrIfCycleRepetition = 16
            FrIfLSduLength = 8
            FrIfPayloadPreamble = false
            FrIfSlotId = 215
            FrIfAlwaysTransmit = false
            FrIfFrameStructureRef = FrStr_SVC_13f75319_In
          LPdu_frTrig_21434_S_214_B_3_R_4_ChA_IN (FrIfLPdu): FrIfLPduIdx=47, FrIfReconfigurable=false, FrIfVBTriggeringRef=frTrig_21434_S_214_B_3_R_4_ChA_IN  # frTrig_21434
          LPdu_frTrig_27518_S_275_B_1_R_8_ChA_IN (FrIfLPdu): FrIfLPduIdx=26, FrIfReconfigurable=false, FrIfVBTriggeringRef=frTrig_27518_S_275_B_1_R_8_ChA_IN  # frTrig_27518
          frTrig_27648_S_276_B_4_R_8_ChA_IN (FrIfFrameTriggering):
            FrIfAllowDynamicLSduLength = false
            FrIfBaseCycle = 4
            FrIfChannel = FRIF_CHANNEL_A
            FrIfCycleRepetition = 8
            FrIfLSduLength = 8
            FrIfPayloadPreamble = false
            FrIfSlotId = 276
            FrIfAlwaysTransmit = false
            FrIfFrameStructureRef = FrStr_KILOMETERSTAND
          LPdu_frTrig_2161516_S_216_B_15_R_16_ChA_IN (FrIfLPdu): FrIfLPduIdx=41, FrIfReconfigurable=false, FrIfVBTriggeringRef=frTrig_2161516_S_216_B_15_R_16_ChA_IN  # frTrig_2161516
          LPdu_frTrig_24404_S_244_B_0_R_4_ChA_IN (FrIfLPdu): FrIfLPduIdx=32, FrIfReconfigurable=false, FrIfVBTriggeringRef=frTrig_24404_S_244_B_0_R_4_ChA_IN  # frTrig_24404
          frTrig_11702_S_117_B_0_R_2_ChA_IN (FrIfFrameTriggering):
            FrIfAllowDynamicLSduLength = false
            FrIfBaseCycle = 0
            FrIfChannel = FRIF_CHANNEL_A
            FrIfCycleRepetition = 2
            FrIfLSduLength = 8
            FrIfPayloadPreamble = false
            FrIfSlotId = 117
            FrIfAlwaysTransmit = false
            FrIfFrameStructureRef = FrStr_ST_CENG
          4 x FrIfLPdu, all with FrIfReconfigurable=false:
            LPdu_frTrig_12112_S_121_B_1_R_2_ChA_IN: FrIfLPduIdx=54, FrIfVBTriggeringRef=frTrig_12112_S_121_B_1_R_2_ChA_IN  # frTrig_12112
            LPdu_frTrig_5602_S_56_B_0_R_2_ChA_IN: FrIfLPduIdx=63, FrIfVBTriggeringRef=frTrig_5602_S_56_B_0_R_2_ChA_IN  # frTrig_5602
            LPdu_frTrig_20901_S_209_B_0_R_1_ChA_IN: FrIfLPduIdx=52, FrIfVBTriggeringRef=frTrig_20901_S_209_B_0_R_1_ChA_IN  # frTrig_20901
            LPdu_frTrig_21201_S_212_B_0_R_1_ChA_IN: FrIfLPduIdx=49, FrIfVBTriggeringRef=frTrig_21201_S_212_B_0_R_1_ChA_IN  # frTrig_21201
          3 x FrIfFrameTriggering, all with FrIfAllowDynamicLSduLength=false, FrIfChannel=FRIF_CHANNEL_A, FrIfPayloadPreamble=false, FrIfAlwaysTransmit=false:
            frTrig_216616_S_216_B_6_R_16_ChA_IN: FrIfBaseCycle=6, FrIfCycleRepetition=16, FrIfLSduLength=8, FrIfSlotId=216, FrIfFrameStructureRef=FrStr_SVC_0a1ebbca_In
            frTrig_24712_S_247_B_1_R_2_ChA_IN: FrIfBaseCycle=1, FrIfCycleRepetition=2, FrIfLSduLength=7, FrIfSlotId=247, FrIfFrameStructureRef=FrStr_DIAG_OBD_ENG
            frTrig_1201_S_12_B_0_R_1_ChA_OUT: FrIfBaseCycle=0, FrIfCycleRepetition=1, FrIfLSduLength=16, FrIfSlotId=12, FrIfFrameStructureRef=FrStr_xcpstatic_a931915e_Out
          LPdu_frTrig_216916_S_216_B_9_R_16_ChA_OUT (FrIfLPdu): FrIfLPduIdx=14, FrIfReconfigurable=false, FrIfVBTriggeringRef=frTrig_216916_S_216_B_9_R_16_ChA_OUT  # frTrig_216916
          frTrig_216916_S_216_B_9_R_16_ChA_OUT (FrIfFrameTriggering):
            FrIfAllowDynamicLSduLength = false
            FrIfBaseCycle = 9
            FrIfChannel = FRIF_CHANNEL_A
            FrIfCycleRepetition = 16
            FrIfLSduLength = 8
            FrIfPayloadPreamble = false
            FrIfSlotId = 216
            FrIfAlwaysTransmit = false
            FrIfFrameStructureRef = FrStr_SVC_0142fcf7_Out
          LPdu_frTrig_215216_S_215_B_2_R_16_ChA_IN (FrIfLPdu): FrIfLPduIdx=42, FrIfReconfigurable=false, FrIfVBTriggeringRef=frTrig_215216_S_215_B_2_R_16_ChA_IN  # frTrig_215216
          7 x FrIfFrameTriggering, all with FrIfAllowDynamicLSduLength=false, FrIfChannel=FRIF_CHANNEL_A, FrIfPayloadPreamble=false, FrIfAlwaysTransmit=false:
            frTrig_22001_S_220_B_0_R_1_ChA_OUT: FrIfBaseCycle=0, FrIfCycleRepetition=1, FrIfLSduLength=32, FrIfSlotId=220, FrIfFrameStructureRef=FrStr_xcpslave
            frTrig_5102_S_51_B_0_R_2_ChA_OUT: FrIfBaseCycle=0, FrIfCycleRepetition=2, FrIfLSduLength=16, FrIfSlotId=51, FrIfFrameStructureRef=FrStr_AVL_PO_EPS_ENGTORQ_EPS
            frTrig_23212_S_232_B_1_R_2_ChA_IN: FrIfBaseCycle=1, FrIfCycleRepetition=2, FrIfLSduLength=8, FrIfSlotId=232, FrIfFrameStructureRef=FrStr_ST_ENERG_GEN
            frTrig_30001_S_300_B_0_R_1_ChA_OUT: FrIfBaseCycle=0, FrIfCycleRepetition=1, FrIfLSduLength=254, FrIfSlotId=300, FrIfFrameStructureRef=FrStr_xcpdynamic254_7
            frTrig_24404_S_244_B_0_R_4_ChA_IN: FrIfBaseCycle=0, FrIfCycleRepetition=4, FrIfLSduLength=8, FrIfSlotId=244, FrIfFrameStructureRef=FrStr_SECU_FAHRGESTELLNUMMER
            frTrig_2151016_S_215_B_10_R_16_ChA_IN: FrIfBaseCycle=10, FrIfCycleRepetition=16, FrIfLSduLength=8, FrIfSlotId=215, FrIfFrameStructureRef=FrStr_SVC_f2f7f198_In
            frTrig_27424_S_274_B_2_R_4_ChA_OUT: FrIfBaseCycle=2, FrIfCycleRepetition=4, FrIfLSduLength=5, FrIfSlotId=274, FrIfFrameStructureRef=FrStr_DISP_CC_EPS
          LPdu_frTrig_10802_S_108_B_0_R_2_ChA_IN (FrIfLPdu): FrIfLPduIdx=57, FrIfReconfigurable=false, FrIfVBTriggeringRef=frTrig_10802_S_108_B_0_R_2_ChA_IN  # frTrig_10802
          LPdu_frTrig_29601_S_296_B_0_R_1_ChA_OUT (FrIfLPdu): FrIfLPduIdx=6, FrIfReconfigurable=false, FrIfVBTriggeringRef=frTrig_29601_S_296_B_0_R_1_ChA_OUT  # frTrig_29601
          frTrig_2161416_S_216_B_14_R_16_ChA_IN (FrIfFrameTriggering):
            FrIfAllowDynamicLSduLength = false
            FrIfBaseCycle = 14
            FrIfChannel = FRIF_CHANNEL_A
            FrIfCycleRepetition = 16
            FrIfLSduLength = 8
            FrIfPayloadPreamble = false
            FrIfSlotId = 216
            FrIfAlwaysTransmit = false
            FrIfFrameStructureRef = FrStr_SVC_b25e2394_In
          frTrig_27578_S_275_B_7_R_8_ChA_IN (FrIfFrameTriggering):
            FrIfAllowDynamicLSduLength = false
            FrIfBaseCycle = 7
            FrIfChannel = FRIF_CHANNEL_A
            FrIfCycleRepetition = 8
            FrIfLSduLength = 7
            FrIfPayloadPreamble = false
            FrIfSlotId = 275
            FrIfAlwaysTransmit = false
            FrIfFrameStructureRef = FrStr_FAHRGESTELLNUMMER
          5 x FrIfLPdu, all with FrIfReconfigurable=false:
            LPdu_frTrig_24712_S_247_B_1_R_2_ChA_IN: FrIfLPduIdx=31, FrIfVBTriggeringRef=frTrig_24712_S_247_B_1_R_2_ChA_IN  # frTrig_24712
            LPdu_frTrig_10701_S_107_B_0_R_1_ChA_IN: FrIfLPduIdx=58, FrIfVBTriggeringRef=frTrig_10701_S_107_B_0_R_1_ChA_IN  # frTrig_10701
            LPdu_frTrig_5102_S_51_B_0_R_2_ChA_OUT: FrIfLPduIdx=16, FrIfVBTriggeringRef=frTrig_5102_S_51_B_0_R_2_ChA_OUT  # frTrig_5102
            LPdu_frTrig_23212_S_232_B_1_R_2_ChA_IN: FrIfLPduIdx=33, FrIfVBTriggeringRef=frTrig_23212_S_232_B_1_R_2_ChA_IN  # frTrig_23212
            LPdu_frTrig_31501_S_315_B_0_R_1_ChA_OUT: FrIfLPduIdx=0, FrIfVBTriggeringRef=frTrig_31501_S_315_B_0_R_1_ChA_OUT  # frTrig_31501
          frTrig_21201_S_212_B_0_R_1_ChA_IN (FrIfFrameTriggering):
            FrIfAllowDynamicLSduLength = false
            FrIfBaseCycle = 0
            FrIfChannel = FRIF_CHANNEL_A
            FrIfCycleRepetition = 1
            FrIfLSduLength = 32
            FrIfPayloadPreamble = false
            FrIfSlotId = 212
            FrIfAlwaysTransmit = false
            FrIfFrameStructureRef = FrStr_TL_BRC_FR_32_402c92c4_In
          frTrig_4601_S_46_B_0_R_1_ChA_IN (FrIfFrameTriggering):
            FrIfAllowDynamicLSduLength = false
            FrIfBaseCycle = 0
            FrIfChannel = FRIF_CHANNEL_A
            FrIfCycleRepetition = 1
            FrIfLSduLength = 12
            FrIfPayloadPreamble = false
            FrIfSlotId = 46
            FrIfAlwaysTransmit = false
            FrIfFrameStructureRef = FrStr_AVL_RPM_WHL
          LPdu_frTrig_4601_S_46_B_0_R_1_ChA_IN (FrIfLPdu): FrIfLPduIdx=68, FrIfReconfigurable=false, FrIfVBTriggeringRef=frTrig_4601_S_46_B_0_R_1_ChA_IN  # frTrig_4601
          frTrig_5502_S_55_B_0_R_2_ChA_IN (FrIfFrameTriggering):
            FrIfAllowDynamicLSduLength = false
            FrIfBaseCycle = 0
            FrIfChannel = FRIF_CHANNEL_A
            FrIfCycleRepetition = 2
            FrIfLSduLength = 14
            FrIfPayloadPreamble = false
            FrIfSlotId = 55
            FrIfAlwaysTransmit = false
            FrIfFrameStructureRef = FrStr_ACLNX_MASSCNTR_ACLNY_MASSCNTR
          frTrig_2161316_S_216_B_13_R_16_ChA_IN (FrIfFrameTriggering):
            FrIfAllowDynamicLSduLength = false
            FrIfBaseCycle = 13
            FrIfChannel = FRIF_CHANNEL_A
            FrIfCycleRepetition = 16
            FrIfLSduLength = 8
            FrIfPayloadPreamble = false
            FrIfSlotId = 216
            FrIfAlwaysTransmit = false
            FrIfFrameStructureRef = FrStr_SVC_b7113511_In
          LPdu_frTrig_21901_S_219_B_0_R_1_ChA_IN (FrIfLPdu): FrIfLPduIdx=34, FrIfReconfigurable=false, FrIfVBTriggeringRef=frTrig_21901_S_219_B_0_R_1_ChA_IN  # frTrig_21901
          frTrig_11912_S_119_B_1_R_2_ChA_IN (FrIfFrameTriggering):
            FrIfAllowDynamicLSduLength = false
            FrIfBaseCycle = 1
            FrIfChannel = FRIF_CHANNEL_A
            FrIfCycleRepetition = 2
            FrIfLSduLength = 8
            FrIfPayloadPreamble = false
            FrIfSlotId = 119
            FrIfAlwaysTransmit = false
            FrIfFrameStructureRef = FrStr_ENSU_SFY
          frTrig_2161016_S_216_B_10_R_16_ChA_IN (FrIfFrameTriggering):
            FrIfAllowDynamicLSduLength = false
            FrIfBaseCycle = 10
            FrIfChannel = FRIF_CHANNEL_A
            FrIfCycleRepetition = 16
            FrIfLSduLength = 8
            FrIfPayloadPreamble = false
            FrIfSlotId = 216
            FrIfAlwaysTransmit = false
            FrIfFrameStructureRef = FrStr_SVC_b5578b48_In
          3 x FrIfLPdu, all with FrIfReconfigurable=false:
            LPdu_frTrig_4712_S_47_B_1_R_2_ChA_IN: FrIfLPduIdx=67, FrIfVBTriggeringRef=frTrig_4712_S_47_B_1_R_2_ChA_IN  # frTrig_4712
            LPdu_frTrig_21101_S_211_B_0_R_1_ChA_IN: FrIfLPduIdx=50, FrIfVBTriggeringRef=frTrig_21101_S_211_B_0_R_1_ChA_IN  # frTrig_21101
            LPdu_frTrig_4902_S_49_B_0_R_2_ChA_OUT: FrIfLPduIdx=18, FrIfVBTriggeringRef=frTrig_4902_S_49_B_0_R_2_ChA_OUT  # frTrig_4902
          3 x FrIfFrameTriggering, all with FrIfAllowDynamicLSduLength=false, FrIfBaseCycle=0, FrIfChannel=FRIF_CHANNEL_A, FrIfCycleRepetition=1, FrIfPayloadPreamble=false, FrIfAlwaysTransmit=false:
            frTrig_10401_S_104_B_0_R_1_ChA_IN: FrIfLSduLength=2, FrIfSlotId=104, FrIfFrameStructureRef=FrStr_ERRM_BN_U
            frTrig_10701_S_107_B_0_R_1_ChA_IN: FrIfLSduLength=5, FrIfSlotId=107, FrIfFrameStructureRef=FrStr_OFFS_QUAD_EPS
            frTrig_1101_S_11_B_0_R_1_ChA_OUT: FrIfLSduLength=16, FrIfSlotId=11, FrIfFrameStructureRef=FrStr_xcpstatic_ab772f07_Out
          LPdu_frTrig_27424_S_274_B_2_R_4_ChA_OUT (FrIfLPdu): FrIfLPduIdx=9, FrIfReconfigurable=false, FrIfVBTriggeringRef=frTrig_27424_S_274_B_2_R_4_ChA_OUT  # frTrig_27424
          frTrig_801_S_8_B_0_R_1_ChA_OUT (FrIfFrameTriggering):
            FrIfAllowDynamicLSduLength = false
            FrIfBaseCycle = 0
            FrIfChannel = FRIF_CHANNEL_A
            FrIfCycleRepetition = 1
            FrIfLSduLength = 16
            FrIfPayloadPreamble = false
            FrIfSlotId = 8
            FrIfAlwaysTransmit = false
            FrIfFrameStructureRef = FrStr_xcpstatic_c8b51460_Out
          7 x FrIfLPdu, all with FrIfReconfigurable=false:
            LPdu_frTrig_5534_S_55_B_3_R_4_ChA_IN: FrIfLPduIdx=65, FrIfVBTriggeringRef=frTrig_5534_S_55_B_3_R_4_ChA_IN  # frTrig_5534
            LPdu_frTrig_26924_S_269_B_2_R_4_ChA_IN: FrIfLPduIdx=28, FrIfVBTriggeringRef=frTrig_26924_S_269_B_2_R_4_ChA_IN  # frTrig_26924
            LPdu_frTrig_18301_S_183_B_0_R_1_ChA_OUT: FrIfLPduIdx=15, FrIfVBTriggeringRef=frTrig_18301_S_183_B_0_R_1_ChA_OUT  # frTrig_18301
            LPdu_frTrig_215616_S_215_B_6_R_16_ChA_IN: FrIfLPduIdx=44, FrIfVBTriggeringRef=frTrig_215616_S_215_B_6_R_16_ChA_IN  # frTrig_215616
            LPdu_frTrig_21301_S_213_B_0_R_1_ChA_IN: FrIfLPduIdx=48, FrIfVBTriggeringRef=frTrig_21301_S_213_B_0_R_1_ChA_IN  # frTrig_21301
            LPdu_frTrig_29401_S_294_B_0_R_1_ChA_OUT: FrIfLPduIdx=8, FrIfVBTriggeringRef=frTrig_29401_S_294_B_0_R_1_ChA_OUT  # frTrig_29401
            LPdu_frTrig_27408_S_274_B_0_R_8_ChA_OUT: FrIfLPduIdx=10, FrIfVBTriggeringRef=frTrig_27408_S_274_B_0_R_8_ChA_OUT  # frTrig_27408
          3 x FrIfFrameTriggering, all with FrIfAllowDynamicLSduLength=false, FrIfChannel=FRIF_CHANNEL_A, FrIfCycleRepetition=2, FrIfLSduLength=16, FrIfPayloadPreamble=false, FrIfAlwaysTransmit=false:
            frTrig_6802_S_68_B_0_R_2_ChA_IN: FrIfBaseCycle=0, FrIfSlotId=68, FrIfFrameStructureRef=FrStr_TAR_QTA_STRMOM_DV_TAR_STMOM_DV_ACT
            frTrig_4912_S_49_B_1_R_2_ChA_OUT: FrIfBaseCycle=1, FrIfSlotId=49, FrIfFrameStructureRef=FrStr_DT_EST
            frTrig_4712_S_47_B_1_R_2_ChA_IN: FrIfBaseCycle=1, FrIfSlotId=47, FrIfFrameStructureRef=FrStr_ST_STAB_DSC_ST_STAB_DSC_2
          LPdu_frTrig_2481032_S_248_B_10_R_32_ChA_OUT (FrIfLPdu): FrIfLPduIdx=11, FrIfReconfigurable=false, FrIfVBTriggeringRef=frTrig_2481032_S_248_B_10_R_32_ChA_OUT  # frTrig_2481032
          4 x FrIfFrameTriggering, all with FrIfAllowDynamicLSduLength=false, FrIfChannel=FRIF_CHANNEL_A, FrIfPayloadPreamble=false, FrIfAlwaysTransmit=false:
            frTrig_20901_S_209_B_0_R_1_ChA_IN: FrIfBaseCycle=0, FrIfCycleRepetition=1, FrIfLSduLength=32, FrIfSlotId=209, FrIfFrameStructureRef=FrStr_TL_BRC_FR_32_f4c51a40_In
            frTrig_6812_S_68_B_1_R_2_ChA_IN: FrIfBaseCycle=1, FrIfCycleRepetition=2, FrIfLSduLength=8, FrIfSlotId=68, FrIfFrameStructureRef=FrStr_ENERG_DGR_DRDY
            frTrig_26924_S_269_B_2_R_4_ChA_IN: FrIfBaseCycle=2, FrIfCycleRepetition=4, FrIfLSduLength=16, FrIfSlotId=269, FrIfFrameStructureRef=FrStr_CTR_VIB_STW_DISP_EXMI_SP2015_FDBK_VIB_STW_DISP_EXMI
            frTrig_30101_S_301_B_0_R_1_ChA_OUT: FrIfBaseCycle=0, FrIfCycleRepetition=1, FrIfLSduLength=254, FrIfSlotId=301, FrIfFrameStructureRef=FrStr_xcpdynamic254_8
          LPdu_frTrig_6802_S_68_B_0_R_2_ChA_IN (FrIfLPdu): FrIfLPduIdx=60, FrIfReconfigurable=false, FrIfVBTriggeringRef=frTrig_6802_S_68_B_0_R_2_ChA_IN  # frTrig_6802
          4 x FrIfFrameTriggering, all with FrIfAllowDynamicLSduLength=false, FrIfBaseCycle=0, FrIfChannel=FRIF_CHANNEL_A, FrIfCycleRepetition=1, FrIfPayloadPreamble=false, FrIfAlwaysTransmit=false:
            frTrig_21301_S_213_B_0_R_1_ChA_IN: FrIfLSduLength=32, FrIfSlotId=213, FrIfFrameStructureRef=FrStr_TL_BRC_FR_32_41eef8f3_In
            frTrig_21901_S_219_B_0_R_1_ChA_IN: FrIfLSduLength=32, FrIfSlotId=219, FrIfFrameStructureRef=FrStr_xcpmaster
            frTrig_901_S_9_B_0_R_1_ChA_OUT: FrIfLSduLength=16, FrIfSlotId=9, FrIfFrameStructureRef=FrStr_xcpstatic_c9777e57_Out
            frTrig_18301_S_183_B_0_R_1_ChA_OUT: FrIfLSduLength=32, FrIfSlotId=183, FrIfFrameStructureRef=FrStr_TL_ECU_TRNSM_FR_32
          LPdu_frTrig_21001_S_210_B_0_R_1_ChA_IN (FrIfLPdu): FrIfLPduIdx=51, FrIfReconfigurable=false, FrIfVBTriggeringRef=frTrig_21001_S_210_B_0_R_1_ChA_IN  # frTrig_21001
          frTrig_5534_S_55_B_3_R_4_ChA_IN (FrIfFrameTriggering):
            FrIfAllowDynamicLSduLength = false
            FrIfBaseCycle = 3
            FrIfChannel = FRIF_CHANNEL_A
            FrIfCycleRepetition = 4
            FrIfLSduLength = 16
            FrIfPayloadPreamble = false
            FrIfSlotId = 55
            FrIfAlwaysTransmit = false
            FrIfFrameStructureRef = FrStr_V_VEH_V_VEH_2
          LPdu_frTrig_29501_S_295_B_0_R_1_ChA_OUT (FrIfLPdu): FrIfLPduIdx=7, FrIfReconfigurable=false, FrIfVBTriggeringRef=frTrig_29501_S_295_B_0_R_1_ChA_OUT  # frTrig_29501
          4 x FrIfFrameTriggering, all with FrIfAllowDynamicLSduLength=false, FrIfChannel=FRIF_CHANNEL_A, FrIfPayloadPreamble=false, FrIfAlwaysTransmit=false:
            frTrig_29401_S_294_B_0_R_1_ChA_OUT: FrIfBaseCycle=0, FrIfCycleRepetition=1, FrIfLSduLength=254, FrIfSlotId=294, FrIfFrameStructureRef=FrStr_xcpdynamic254_1
            frTrig_12112_S_121_B_1_R_2_ChA_IN: FrIfBaseCycle=1, FrIfCycleRepetition=2, FrIfLSduLength=8, FrIfSlotId=121, FrIfFrameStructureRef=FrStr_CON_VEH
            frTrig_10802_S_108_B_0_R_2_ChA_IN: FrIfBaseCycle=0, FrIfCycleRepetition=2, FrIfLSduLength=8, FrIfSlotId=108, FrIfFrameStructureRef=FrStr_STEA_OFFS
            frTrig_215216_S_215_B_2_R_16_ChA_IN: FrIfBaseCycle=2, FrIfCycleRepetition=16, FrIfLSduLength=8, FrIfSlotId=215, FrIfFrameStructureRef=FrStr_SVC_1fa2bcf8_In
      FrStr_KILOMETERSTAND (FrIfFrameStructure): FrIfByteOrder=LITTLE_ENDIAN  # KILOMETERSTAND
        p2fmap_KILOMETERSTAND (FrIfPdusInFrame): FrIfPduOffset=0, FrIfMappedPduId=1, FrIfPduRef=KILOMETERSTAND
      SU_CLE_DRDY_DXP (FrIfPdu)
        FrIfPduDirection
          FrIfRxPdu_SU_CLE_DRDY_DXP (FrIfRxPdu): FrIfUserRxIndicationUL=PDUR, FrIfRxPduId=27, FrIfRxPduRef=pduTrig_SU_CLE_DRDY_DXP_pduPort_EPS_A_FlexRay_IN_55c86d41_4f391dd1  # SU_CLE_DRDY_DXP
      FrStr_ACLNX_MASSCNTR_ACLNY_MASSCNTR (FrIfFrameStructure): FrIfByteOrder=LITTLE_ENDIAN  # ACLNX_MASSCNTR_ACLNY_MASSCNTR
        p2fmap_ACLNY_MASSCNTR (FrIfPdusInFrame): FrIfPduOffset=8, FrIfMappedPduId=41, FrIfPduRef=ACLNY_MASSCNTR
      FrStr_DISP_CC_EPS (FrIfFrameStructure): FrIfByteOrder=LITTLE_ENDIAN  # DISP_CC_EPS
        p2fmap_DISP_CC_EPS (FrIfPdusInFrame): FrIfPduOffset=0, FrIfMappedPduId=9, FrIfPduRef=DISP_CC_EPS
      5 x FrIfPdu:
        TL_ECU_TRNSM_FR_32
          FrIfPduDirection
            FrIfTxPdu_TL_ECU_TRNSM_FR_32 (FrIfTxPdu):  # TL_ECU_TRNSM_FR_32
              FrIfUserTxUL = FR_TP
              FrIfConfirm = true
              FrIfCounterLimit = 1
              FrIfImmediate = false
              FrIfNoneMode = false
              FrIfTxPduId = 15
              FrIfTxPduRef = p2fmap_TL_ECU_TRNSM_FR_32_c9b68eba
        AVL_PO_EPS
          FrIfPduDirection
            FrIfTxPdu_AVL_PO_EPS (FrIfTxPdu):  # AVL_PO_EPS
              FrIfUserTxUL = PDUR
              FrIfConfirm = false
              FrIfCounterLimit = 1
              FrIfImmediate = false
              FrIfNoneMode = false
              FrIfTxPduId = 16
              FrIfTxPduRef = pduTrig_AVL_PO_EPS_pduPort_EPS_A_FlexRay_OUT_55c86d41_4f391dd1
        CTR_VIB_STW_DISP_EXMI_SP2015
          FrIfPduDirection
            FrIfRxPdu_CTR_VIB_STW_DISP_EXMI_SP2015 (FrIfRxPdu): FrIfUserRxIndicationUL=PDUR, FrIfRxPduId=4, FrIfRxPduRef=pduTrig_CTR_VIB_STW_DISP_EXMI_SP2015_pduPort_EPS_A_FlexRay_IN_55c86d41_4f391dd1  # CTR_VIB_STW_DISP_EXMI_SP2015
        FR_DBG_EPS
          FrIfPduDirection
            FrIfTxPdu_FR_DBG_EPS (FrIfTxPdu):  # FR_DBG_EPS
              FrIfUserTxUL = PDUR
              FrIfConfirm = false
              FrIfCounterLimit = 1
              FrIfImmediate = false
              FrIfNoneMode = false
              FrIfTxPduId = 0
              FrIfTxPduRef = pduTrig_FR_DBG_EPS_pduPort_EPS_A_FlexRay_OUT_55c86d41_4f391dd1
        DT_EST
          FrIfPduDirection
            FrIfTxPdu_DT_EST (FrIfTxPdu):  # DT_EST
              FrIfUserTxUL = PDUR
              FrIfConfirm = false
              FrIfCounterLimit = 1
              FrIfImmediate = false
              FrIfNoneMode = false
              FrIfTxPduId = 18
              FrIfTxPduRef = pduTrig_DT_EST_pduPort_EPS_A_FlexRay_OUT_55c86d41_4f391dd1
      3 x FrIfFrameStructure, all with FrIfByteOrder=LITTLE_ENDIAN:
        FrStr_A_TEMP  # A_TEMP
          p2fmap_A_TEMP (FrIfPdusInFrame): FrIfPduOffset=0, FrIfMappedPduId=5, FrIfPduRef=A_TEMP
        FrStr_SECU_FAHRGESTELLNUMMER  # SECU_FAHRGESTELLNUMMER
          p2fmap_SECU_FAHRGESTELLNUMMER (FrIfPdusInFrame): FrIfPduOffset=0, FrIfMappedPduId=8, FrIfPduRef=SECU_FAHRGESTELLNUMMER
        FrStr_DT_DRDYSEN_EXT_VYAW_VEH  # DT_DRDYSEN_EXT_VYAW_VEH
          p2fmap_VYAW_VEH (FrIfPdusInFrame): FrIfPduOffset=8, FrIfMappedPduId=40, FrIfPduRef=VYAW_VEH
      STEA_OFFS (FrIfPdu)
        FrIfPduDirection
          FrIfRxPdu_STEA_OFFS (FrIfRxPdu): FrIfUserRxIndicationUL=PDUR, FrIfRxPduId=17, FrIfRxPduRef=pduTrig_STEA_OFFS_pduPort_EPS_A_FlexRay_IN_55c86d41_4f391dd1  # STEA_OFFS
      ST_EST (FrIfPdu)
        FrIfPduDirection
          FrIfTxPdu_ST_EST (FrIfTxPdu):  # ST_EST
            FrIfUserTxUL = PDUR
            FrIfConfirm = true
            FrIfCounterLimit = 1
            FrIfImmediate = false
            FrIfNoneMode = false
            FrIfTxPduId = 12
            FrIfTxPduRef = pduTrig_ST_EST_pduPort_EPS_A_FlexRay_OUT_55c86d41_4f391dd1
      FrStr_CON_VEH (FrIfFrameStructure): FrIfByteOrder=LITTLE_ENDIAN  # CON_VEH
        p2fmap_CON_VEH (FrIfPdusInFrame): FrIfPduOffset=0, FrIfMappedPduId=30, FrIfPduRef=CON_VEH
      SECU_FAHRGESTELLNUMMER (FrIfPdu)
        FrIfPduDirection
          FrIfRxPdu_SECU_FAHRGESTELLNUMMER (FrIfRxPdu): FrIfUserRxIndicationUL=PDUR, FrIfRxPduId=8, FrIfRxPduRef=pduTrig_SECU_FAHRGESTELLNUMMER_pduPort_EPS_A_FlexRay_IN_55c86d41_4f391dd1  # SECU_FAHRGESTELLNUMMER
      FrStr_OFFS_QUAD_EPS (FrIfFrameStructure): FrIfByteOrder=LITTLE_ENDIAN  # OFFS_QUAD_EPS
        p2fmap_OFFS_QUAD_EPS (FrIfPdusInFrame): FrIfPduOffset=0, FrIfMappedPduId=34, FrIfPduRef=OFFS_QUAD_EPS
      VYAW_VEH (FrIfPdu)
        FrIfPduDirection
          FrIfRxPdu_VYAW_VEH (FrIfRxPdu): FrIfUserRxIndicationUL=PDUR, FrIfRxPduId=24, FrIfRxPduRef=pduTrig_VYAW_VEH_pduPort_EPS_A_FlexRay_IN_55c86d41_4f391dd1  # VYAW_VEH
      KILOMETERSTAND (FrIfPdu)
        FrIfPduDirection
          FrIfRxPdu_KILOMETERSTAND (FrIfRxPdu): FrIfUserRxIndicationUL=PDUR, FrIfRxPduId=1, FrIfRxPduRef=pduTrig_KILOMETERSTAND_pduPort_EPS_A_FlexRay_IN_55c86d41_4f391dd1  # KILOMETERSTAND
      FrStr_TAR_ESTP_VIRT_FTAX (FrIfFrameStructure): FrIfByteOrder=LITTLE_ENDIAN  # TAR_ESTP_VIRT_FTAX
        p2fmap_TAR_ESTP_VIRT_FTAX (FrIfPdusInFrame): FrIfPduOffset=0, FrIfMappedPduId=39, FrIfPduRef=TAR_ESTP_VIRT_FTAX
      RELATIVZEIT (FrIfPdu)
        FrIfPduDirection
          FrIfRxPdu_RELATIVZEIT (FrIfRxPdu): FrIfUserRxIndicationUL=PDUR, FrIfRxPduId=0, FrIfRxPduRef=pduTrig_RELATIVZEIT_pduPort_EPS_A_FlexRay_IN_55c86d41_4f391dd1  # RELATIVZEIT
      xcpdynamic254_8 (FrIfPdu)
        FrIfPduDirection
          FrIfTxPdu_xcpdynamic254_8 (FrIfTxPdu):  # xcpdynamic254_8
            FrIfUserTxUL = XCP
            FrIfConfirm = true
            FrIfCounterLimit = 1
            FrIfImmediate = false
            FrIfNoneMode = false
            FrIfTxPduId = 1
            FrIfTxPduRef = pduTrig_xcpdynamic254_8_pduPort_EPS_A_FlexRay_OUT_55c86d41_4f391dd1
      FrStr_ST_ENERG_GEN (FrIfFrameStructure): FrIfByteOrder=LITTLE_ENDIAN  # ST_ENERG_GEN
        p2fmap_ST_ENERG_GEN (FrIfPdusInFrame): FrIfPduOffset=0, FrIfMappedPduId=9, FrIfPduRef=ST_ENERG_GEN
      FAHRGESTELLNUMMER (FrIfPdu)
        FrIfPduDirection
          FrIfRxPdu_FAHRGESTELLNUMMER (FrIfRxPdu): FrIfUserRxIndicationUL=PDUR, FrIfRxPduId=3, FrIfRxPduRef=pduTrig_FAHRGESTELLNUMMER_pduPort_EPS_A_FlexRay_IN_55c86d41_4f391dd1  # FAHRGESTELLNUMMER
      ST_CENG (FrIfPdu)
        FrIfPduDirection
          FrIfRxPdu_ST_CENG (FrIfRxPdu): FrIfUserRxIndicationUL=PDUR, FrIfRxPduId=16, FrIfRxPduRef=pduTrig_ST_CENG_pduPort_EPS_A_FlexRay_IN_55c86d41_4f391dd1  # ST_CENG
      FrStr_CTR_DIAG_OBD_DRDY (FrIfFrameStructure): FrIfByteOrder=LITTLE_ENDIAN  # CTR_DIAG_OBD_DRDY
        p2fmap_CTR_DIAG_OBD_DRDY (FrIfPdusInFrame): FrIfPduOffset=0, FrIfMappedPduId=6, FrIfPduRef=CTR_DIAG_OBD_DRDY
      DIAG_OBD_ENG (FrIfPdu)
        FrIfPduDirection
          FrIfRxPdu_DIAG_OBD_ENG (FrIfRxPdu): FrIfUserRxIndicationUL=PDUR, FrIfRxPduId=7, FrIfRxPduRef=pduTrig_DIAG_OBD_ENG_pduPort_EPS_A_FlexRay_IN_55c86d41_4f391dd1  # DIAG_OBD_ENG
      TL_MST_GW_TRNSM_FR_254 (FrIfPdu)
        FrIfPduDirection
          FrIfRxPdu_TL_MST_GW_TRNSM_FR_254 (FrIfRxPdu): FrIfUserRxIndicationUL=FR_TP, FrIfRxPduId=13, FrIfRxPduRef=p2fmap_TL_MST_GW_TRNSM_FR_254_c761be43  # TL_MST_GW_TRNSM_FR_254
      FrStr_xcpmaster (FrIfFrameStructure): FrIfByteOrder=LITTLE_ENDIAN  # xcpmaster
        p2fmap_dummy32bmaster (FrIfPdusInFrame): FrIfPduOffset=0, FrIfMappedPduId=10, FrIfPduRef=dummy32bmaster
      3 x FrIfPdu:
        xcpdynamic254_7
          FrIfPduDirection
            FrIfTxPdu_xcpdynamic254_7 (FrIfTxPdu):  # xcpdynamic254_7
              FrIfUserTxUL = XCP
              FrIfConfirm = true
              FrIfCounterLimit = 1
              FrIfImmediate = false
              FrIfNoneMode = false
              FrIfTxPduId = 2
              FrIfTxPduRef = pduTrig_xcpdynamic254_7_pduPort_EPS_A_FlexRay_OUT_55c86d41_4f391dd1
        xcpdynamic254_6
          FrIfPduDirection
            FrIfTxPdu_xcpdynamic254_6 (FrIfTxPdu):  # xcpdynamic254_6
              FrIfUserTxUL = XCP
              FrIfConfirm = true
              FrIfCounterLimit = 1
              FrIfImmediate = false
              FrIfNoneMode = false
              FrIfTxPduId = 3
              FrIfTxPduRef = pduTrig_xcpdynamic254_6_pduPort_EPS_A_FlexRay_OUT_55c86d41_4f391dd1
        xcpdynamic254_5
          FrIfPduDirection
            FrIfTxPdu_xcpdynamic254_5 (FrIfTxPdu):  # xcpdynamic254_5
              FrIfUserTxUL = XCP
              FrIfConfirm = true
              FrIfCounterLimit = 1
              FrIfImmediate = false
              FrIfNoneMode = false
              FrIfTxPduId = 4
              FrIfTxPduRef = pduTrig_xcpdynamic254_5_pduPort_EPS_A_FlexRay_OUT_55c86d41_4f391dd1
      FrStr_FR_DBG_EPS (FrIfFrameStructure): FrIfByteOrder=LITTLE_ENDIAN  # FR_DBG_EPS
        p2fmap_FR_DBG_EPS (FrIfPdusInFrame): FrIfPduOffset=0, FrIfMappedPduId=0, FrIfPduRef=FR_DBG_EPS
      6 x FrIfPdu:
        xcpdynamic254_4
          FrIfPduDirection
            FrIfTxPdu_xcpdynamic254_4 (FrIfTxPdu):  # xcpdynamic254_4
              FrIfUserTxUL = XCP
              FrIfConfirm = true
              FrIfCounterLimit = 1
              FrIfImmediate = false
              FrIfNoneMode = false
              FrIfTxPduId = 5
              FrIfTxPduRef = pduTrig_xcpdynamic254_4_pduPort_EPS_A_FlexRay_OUT_55c86d41_4f391dd1
        DISP_CC_EPS
          FrIfPduDirection
            FrIfTxPdu_DISP_CC_EPS (FrIfTxPdu):  # DISP_CC_EPS
              FrIfUserTxUL = PDUR
              FrIfConfirm = true
              FrIfCounterLimit = 1
              FrIfImmediate = false
              FrIfNoneMode = false
              FrIfTxPduId = 9
              FrIfTxPduRef = pduTrig_DISP_CC_EPS_pduPort_EPS_A_FlexRay_OUT_55c86d41_4f391dd1
        xcpdynamic254_3
          FrIfPduDirection
            FrIfTxPdu_xcpdynamic254_3 (FrIfTxPdu):  # xcpdynamic254_3
              FrIfUserTxUL = XCP
              FrIfConfirm = true
              FrIfCounterLimit = 1
              FrIfImmediate = false
              FrIfNoneMode = false
              FrIfTxPduId = 6
              FrIfTxPduRef = pduTrig_xcpdynamic254_3_pduPort_EPS_A_FlexRay_OUT_55c86d41_4f391dd1
        FZZSTD
          FrIfPduDirection
            FrIfRxPdu_FZZSTD (FrIfRxPdu): FrIfUserRxIndicationUL=PDUR, FrIfRxPduId=2, FrIfRxPduRef=pduTrig_FZZSTD_pduPort_EPS_A_FlexRay_IN_55c86d41_4f391dd1  # FZZSTD
        xcpdynamic254_2
          FrIfPduDirection
            FrIfTxPdu_xcpdynamic254_2 (FrIfTxPdu):  # xcpdynamic254_2
              FrIfUserTxUL = XCP
              FrIfConfirm = true
              FrIfCounterLimit = 1
              FrIfImmediate = false
              FrIfNoneMode = false
              FrIfTxPduId = 7
              FrIfTxPduRef = pduTrig_xcpdynamic254_2_pduPort_EPS_A_FlexRay_OUT_55c86d41_4f391dd1
        xcpdynamic254_1
          FrIfPduDirection
            FrIfTxPdu_xcpdynamic254_1 (FrIfTxPdu):  # xcpdynamic254_1
              FrIfUserTxUL = XCP
              FrIfConfirm = true
              FrIfCounterLimit = 1
              FrIfImmediate = false
              FrIfNoneMode = false
              FrIfTxPduId = 8
              FrIfTxPduRef = pduTrig_xcpdynamic254_1_pduPort_EPS_A_FlexRay_OUT_55c86d41_4f391dd1
      FrStr_AVL_PO_EPS_ENGTORQ_EPS (FrIfFrameStructure): FrIfByteOrder=LITTLE_ENDIAN  # AVL_PO_EPS_ENGTORQ_EPS
        p2fmap_ENGTORQ_EPS (FrIfPdusInFrame): FrIfPduOffset=8, FrIfMappedPduId=17, FrIfPduRef=ENGTORQ_EPS
        p2fmap_AVL_PO_EPS (FrIfPdusInFrame): FrIfPduOffset=0, FrIfMappedPduId=16, FrIfPduRef=AVL_PO_EPS
      FrStr_V_VEH_V_VEH_2 (FrIfFrameStructure): FrIfByteOrder=LITTLE_ENDIAN  # V_VEH_V_VEH_2
        p2fmap_V_VEH (FrIfPdusInFrame): FrIfPduOffset=0, FrIfMappedPduId=42, FrIfPduRef=V_VEH
      OFFS_QUAD_EPS (FrIfPdu)
        FrIfPduDirection
          FrIfRxPdu_OFFS_QUAD_EPS (FrIfRxPdu): FrIfUserRxIndicationUL=PDUR, FrIfRxPduId=18, FrIfRxPduRef=pduTrig_OFFS_QUAD_EPS_pduPort_EPS_A_FlexRay_IN_55c86d41_4f391dd1  # OFFS_QUAD_EPS
      4 x FrIfFrameStructure, all with FrIfByteOrder=LITTLE_ENDIAN:
        FrStr_ERRM_BN_U  # ERRM_BN_U
          p2fmap_ERRM_BN_U (FrIfPdusInFrame): FrIfPduOffset=0, FrIfMappedPduId=35, FrIfPduRef=ERRM_BN_U
        FrStr_xcpslave  # xcpslave
          p2fmap_dummy32bslave (FrIfPdusInFrame): FrIfPduOffset=0, FrIfMappedPduId=13, FrIfPduRef=dummy32bslave
        FrStr_DIAG_OBD_ENG  # DIAG_OBD_ENG
          p2fmap_DIAG_OBD_ENG (FrIfPdusInFrame): FrIfPduOffset=0, FrIfMappedPduId=7, FrIfPduRef=DIAG_OBD_ENG
        FrStr_ST_DIAG_OBD_3_DRDY  # ST_DIAG_OBD_3_DRDY
          p2fmap_ST_DIAG_OBD_3_DRDY (FrIfPdusInFrame): FrIfPduOffset=0, FrIfMappedPduId=11, FrIfPduRef=ST_DIAG_OBD_3_DRDY
      CTR_DIAG_OBD_DRDY (FrIfPdu)
        FrIfPduDirection
          FrIfRxPdu_CTR_DIAG_OBD_DRDY (FrIfRxPdu): FrIfUserRxIndicationUL=PDUR, FrIfRxPduId=6, FrIfRxPduRef=pduTrig_CTR_DIAG_OBD_DRDY_pduPort_EPS_A_FlexRay_IN_55c86d41_4f391dd1  # CTR_DIAG_OBD_DRDY
      FrStr_ST_STAB_DSC_ST_STAB_DSC_2 (FrIfFrameStructure): FrIfByteOrder=LITTLE_ENDIAN  # ST_STAB_DSC_ST_STAB_DSC_2
        p2fmap_ST_STAB_DSC (FrIfPdusInFrame): FrIfPduOffset=0, FrIfMappedPduId=44, FrIfPduRef=ST_STAB_DSC
      V_VEH (FrIfPdu)
        FrIfPduDirection
          FrIfRxPdu_V_VEH (FrIfRxPdu): FrIfUserRxIndicationUL=PDUR, FrIfRxPduId=26, FrIfRxPduRef=pduTrig_V_VEH_pduPort_EPS_A_FlexRay_IN_55c86d41_4f391dd1  # V_VEH
      ST_STAB_DSC (FrIfPdu)
        FrIfPduDirection
          FrIfRxPdu_ST_STAB_DSC (FrIfRxPdu): FrIfUserRxIndicationUL=PDUR, FrIfRxPduId=28, FrIfRxPduRef=pduTrig_ST_STAB_DSC_pduPort_EPS_A_FlexRay_IN_55c86d41_4f391dd1  # ST_STAB_DSC
      FrStr_ENERG_DGR_DRDY (FrIfFrameStructure): FrIfByteOrder=LITTLE_ENDIAN  # ENERG_DGR_DRDY
        p2fmap_ENERG_DGR_DRDY (FrIfPdusInFrame): FrIfPduOffset=0, FrIfMappedPduId=38, FrIfPduRef=ENERG_DGR_DRDY
      SVC_Out (FrIfPdu)
        FrIfPduDirection
          FrIfTxPdu_SVC (FrIfTxPdu): FrIfUserTxUL=PDUR, FrIfConfirm=true, FrIfCounterLimit=1, FrIfImmediate=false, FrIfNoneMode=false, FrIfTxPduId=14, FrIfTxPduRef=SVC_fbd80461_Out  # SVC
      FrStr_DT_EST (FrIfFrameStructure): FrIfByteOrder=LITTLE_ENDIAN  # DT_EST
        p2fmap_DT_EST (FrIfPdusInFrame): FrIfPduOffset=0, FrIfMappedPduId=18, FrIfPduRef=DT_EST
      CON_VEH (FrIfPdu)
        FrIfPduDirection
          FrIfRxPdu_CON_VEH (FrIfRxPdu): FrIfUserRxIndicationUL=PDUR, FrIfRxPduId=14, FrIfRxPduRef=pduTrig_CON_VEH_pduPort_EPS_A_FlexRay_IN_55c86d41_4f391dd1  # CON_VEH
      AVL_RPM_WHL (FrIfPdu)
        FrIfPduDirection
          FrIfRxPdu_AVL_RPM_WHL (FrIfRxPdu): FrIfUserRxIndicationUL=PDUR, FrIfRxPduId=29, FrIfRxPduRef=pduTrig_AVL_RPM_WHL_pduPort_EPS_A_FlexRay_IN_55c86d41_4f391dd1  # AVL_RPM_WHL
      FrStr_FAHRGESTELLNUMMER (FrIfFrameStructure): FrIfByteOrder=LITTLE_ENDIAN  # FAHRGESTELLNUMMER
        p2fmap_FAHRGESTELLNUMMER (FrIfPdusInFrame): FrIfPduOffset=0, FrIfMappedPduId=3, FrIfPduRef=FAHRGESTELLNUMMER
      3 x FrIfPdu:
        ST_ENERG_GEN
          FrIfPduDirection
            FrIfRxPdu_ST_ENERG_GEN (FrIfRxPdu): FrIfUserRxIndicationUL=PDUR, FrIfRxPduId=9, FrIfRxPduRef=pduTrig_ST_ENERG_GEN_pduPort_EPS_A_FlexRay_IN_55c86d41_4f391dd1  # ST_ENERG_GEN
        ENSU_SFY
          FrIfPduDirection
            FrIfRxPdu_ENSU_SFY (FrIfRxPdu): FrIfUserRxIndicationUL=PDUR, FrIfRxPduId=15, FrIfRxPduRef=pduTrig_ENSU_SFY_pduPort_EPS_A_FlexRay_IN_55c86d41_4f391dd1  # ENSU_SFY
        A_TEMP
          FrIfPduDirection
            FrIfRxPdu_A_TEMP (FrIfRxPdu): FrIfUserRxIndicationUL=PDUR, FrIfRxPduId=5, FrIfRxPduRef=pduTrig_A_TEMP_pduPort_EPS_A_FlexRay_IN_55c86d41_4f391dd1  # A_TEMP
      FrStr_ST_CENG (FrIfFrameStructure): FrIfByteOrder=LITTLE_ENDIAN  # ST_CENG
        p2fmap_ST_CENG (FrIfPdusInFrame): FrIfPduOffset=0, FrIfMappedPduId=32, FrIfPduRef=ST_CENG
      FrStr_xcpdynamic254_1 (FrIfFrameStructure): FrIfByteOrder=LITTLE_ENDIAN  # xcpdynamic254_1
        p2fmap_xcpdynamic254_1 (FrIfPdusInFrame): FrIfPduOffset=0, FrIfMappedPduId=8, FrIfPduRef=xcpdynamic254_1
      ST_DIAG_OBD_3_DRDY (FrIfPdu)
        FrIfPduDirection
          FrIfTxPdu_ST_DIAG_OBD_3_DRDY (FrIfTxPdu):  # ST_DIAG_OBD_3_DRDY
            FrIfUserTxUL = PDUR
            FrIfConfirm = true
            FrIfCounterLimit = 1
            FrIfImmediate = false
            FrIfNoneMode = false
            FrIfTxPduId = 11
            FrIfTxPduRef = pduTrig_ST_DIAG_OBD_3_DRDY_pduPort_EPS_A_FlexRay_OUT_55c86d41_4f391dd1
      9 x FrIfFrameStructure, all with FrIfByteOrder=LITTLE_ENDIAN:
        FrStr_xcpdynamic254_2  # xcpdynamic254_2
          p2fmap_xcpdynamic254_2 (FrIfPdusInFrame): FrIfPduOffset=0, FrIfMappedPduId=7, FrIfPduRef=xcpdynamic254_2
        FrStr_xcpdynamic254_3  # xcpdynamic254_3
          p2fmap_xcpdynamic254_3 (FrIfPdusInFrame): FrIfPduOffset=0, FrIfMappedPduId=6, FrIfPduRef=xcpdynamic254_3
        FrStr_xcpdynamic254_4  # xcpdynamic254_4
          p2fmap_xcpdynamic254_4 (FrIfPdusInFrame): FrIfPduOffset=0, FrIfMappedPduId=5, FrIfPduRef=xcpdynamic254_4
        FrStr_xcpdynamic254_5  # xcpdynamic254_5
          p2fmap_xcpdynamic254_5 (FrIfPdusInFrame): FrIfPduOffset=0, FrIfMappedPduId=4, FrIfPduRef=xcpdynamic254_5
        FrStr_TL_ECU_TRNSM_FR_32  # TL_ECU_TRNSM_FR_32
          p2fmap_TL_ECU_TRNSM_FR_32 (FrIfPdusInFrame): FrIfPduOffset=0, FrIfMappedPduId=15, FrIfPduRef=TL_ECU_TRNSM_FR_32
        FrStr_xcpdynamic254_6  # xcpdynamic254_6
          p2fmap_xcpdynamic254_6 (FrIfPdusInFrame): FrIfPduOffset=0, FrIfMappedPduId=3, FrIfPduRef=xcpdynamic254_6
        FrStr_xcpdynamic254_7  # xcpdynamic254_7
          p2fmap_xcpdynamic254_7 (FrIfPdusInFrame): FrIfPduOffset=0, FrIfMappedPduId=2, FrIfPduRef=xcpdynamic254_7
        FrStr_xcpdynamic254_8  # xcpdynamic254_8
          p2fmap_xcpdynamic254_8 (FrIfPdusInFrame): FrIfPduOffset=0, FrIfMappedPduId=1, FrIfPduRef=xcpdynamic254_8
        FrStr_SU_CLE_DRDY_DXP_SPEC_ADPT_MOD_DXP_ST_IDLV_COOD_DBE_DXP  # SU_CLE_DRDY_DXP_SPEC_ADPT_MOD_DXP_ST_IDLV_COOD_DBE_DXP
          p2fmap_SU_CLE_DRDY_DXP (FrIfPdusInFrame): FrIfPduOffset=0, FrIfMappedPduId=43, FrIfPduRef=SU_CLE_DRDY_DXP
      ACLNY_MASSCNTR (FrIfPdu)
        FrIfPduDirection
          FrIfRxPdu_ACLNY_MASSCNTR (FrIfRxPdu): FrIfUserRxIndicationUL=PDUR, FrIfRxPduId=25, FrIfRxPduRef=pduTrig_ACLNY_MASSCNTR_pduPort_EPS_A_FlexRay_IN_55c86d41_4f391dd1  # ACLNY_MASSCNTR
      FrStr_TAR_QTA_STRMOM_DV_TAR_STMOM_DV_ACT (FrIfFrameStructure): FrIfByteOrder=LITTLE_ENDIAN  # TAR_QTA_STRMOM_DV_TAR_STMOM_DV_ACT
        p2fmap_TAR_STMOM_DV_ACT (FrIfPdusInFrame): FrIfPduOffset=8, FrIfMappedPduId=37, FrIfPduRef=TAR_STMOM_DV_ACT
        p2fmap_TAR_QTA_STRMOM_DV (FrIfPdusInFrame): FrIfPduOffset=0, FrIfMappedPduId=36, FrIfPduRef=TAR_QTA_STRMOM_DV
      4 x FrIfPdu:
        TAR_STMOM_DV_ACT
          FrIfPduDirection
            FrIfRxPdu_TAR_STMOM_DV_ACT (FrIfRxPdu): FrIfUserRxIndicationUL=PDUR, FrIfRxPduId=21, FrIfRxPduRef=pduTrig_TAR_STMOM_DV_ACT_pduPort_EPS_A_FlexRay_IN_55c86d41_4f391dd1  # TAR_STMOM_DV_ACT
        dummy16bstatic
          FrIfPduDirection
            FrIfTxPdu_dummy16bstatic (FrIfTxPdu):  # dummy16bstatic
              FrIfUserTxUL = XCP
              FrIfConfirm = true
              FrIfCounterLimit = 1
              FrIfImmediate = false
              FrIfNoneMode = false
              FrIfTxPduId = 21
              FrIfTxPduRef = pduTrig_dummy16bstatic_pduPort_EPS_A_FlexRay_OUT_55c86d41_4f391dd1
        TAR_ESTP_VIRT_FTAX
          FrIfPduDirection
            FrIfRxPdu_TAR_ESTP_VIRT_FTAX (FrIfRxPdu): FrIfUserRxIndicationUL=PDUR, FrIfRxPduId=23, FrIfRxPduRef=pduTrig_TAR_ESTP_VIRT_FTAX_pduPort_EPS_A_FlexRay_IN_55c86d41_4f391dd1  # TAR_ESTP_VIRT_FTAX
        AVL_FORC_GRD
          FrIfPduDirection
            FrIfTxPdu_AVL_FORC_GRD (FrIfTxPdu):  # AVL_FORC_GRD
              FrIfUserTxUL = PDUR
              FrIfConfirm = false
              FrIfCounterLimit = 1
              FrIfImmediate = false
              FrIfNoneMode = false
              FrIfTxPduId = 20
              FrIfTxPduRef = pduTrig_AVL_FORC_GRD_pduPort_EPS_A_FlexRay_OUT_55c86d41_4f391dd1
      25 x FrIfFrameStructure, all with FrIfByteOrder=LITTLE_ENDIAN:
        FrStr_FZZSTD  # FZZSTD
          p2fmap_FZZSTD (FrIfPdusInFrame): FrIfPduOffset=0, FrIfMappedPduId=2, FrIfPduRef=FZZSTD
        FrStr_TL_BRC_FR_32_402c92c4_In  # TL_BRC_FR_32
          p2fmap_TL_BRC_FR_32 (FrIfPdusInFrame): FrIfPduOffset=0, FrIfMappedPduId=25, FrIfPduRef=TL_BRC_FR_32
        FrStr_SVC_b7113511_In  # SVC
          p2fmap_SVC (FrIfPdusInFrame): FrIfPduOffset=0, FrIfMappedPduId=15, FrIfPduRef=SVC_In
        FrStr_SVC_1fe6493a_In  # SVC
          p2fmap_SVC (FrIfPdusInFrame): FrIfPduOffset=0, FrIfMappedPduId=23, FrIfPduRef=SVC_In
        FrStr_SVC_b5578b48_In  # SVC
          p2fmap_SVC (FrIfPdusInFrame): FrIfPduOffset=0, FrIfMappedPduId=13, FrIfPduRef=SVC_In
        FrStr_SVC_b25e2394_In  # SVC
          p2fmap_SVC (FrIfPdusInFrame): FrIfPduOffset=0, FrIfMappedPduId=16, FrIfPduRef=SVC_In
        FrStr_SVC_f2f7f198_In  # SVC
          p2fmap_SVC (FrIfPdusInFrame): FrIfPduOffset=0, FrIfMappedPduId=22, FrIfPduRef=SVC_In
        FrStr_TL_BRC_FR_32_43a846aa_In  # TL_BRC_FR_32
          p2fmap_TL_BRC_FR_32 (FrIfPdusInFrame): FrIfPduOffset=0, FrIfMappedPduId=27, FrIfPduRef=TL_BRC_FR_32
        FrStr_TL_BRC_FR_32_426a2c9d_In  # TL_BRC_FR_32
          p2fmap_TL_BRC_FR_32 (FrIfPdusInFrame): FrIfPduOffset=0, FrIfMappedPduId=26, FrIfPduRef=TL_BRC_FR_32
        FrStr_xcpstatic_ab772f07_Out  # xcpstatic
          p2fmap_dummy16bstatic (FrIfPdusInFrame): FrIfPduOffset=0, FrIfMappedPduId=22, FrIfPduRef=dummy16bstatic
        FrStr_xcpstatic_c9777e57_Out  # xcpstatic
          p2fmap_dummy16bstatic (FrIfPdusInFrame): FrIfPduOffset=0, FrIfMappedPduId=24, FrIfPduRef=dummy16bstatic
        FrStr_xcpstatic_c8b51460_Out  # xcpstatic
          p2fmap_dummy16bstatic (FrIfPdusInFrame): FrIfPduOffset=0, FrIfMappedPduId=25, FrIfPduRef=dummy16bstatic
        FrStr_SVC_1aedaa7d_In  # SVC
          p2fmap_SVC (FrIfPdusInFrame): FrIfPduOffset=0, FrIfMappedPduId=19, FrIfPduRef=SVC_In
        FrStr_SVC_0142fcf7_Out  # SVC
          p2fmap_SVC (FrIfPdusInFrame): FrIfPduOffset=0, FrIfMappedPduId=14, FrIfPduRef=SVC_Out
        FrStr_SVC_b6d35f26_In  # SVC
          p2fmap_SVC (FrIfPdusInFrame): FrIfPduOffset=0, FrIfMappedPduId=14, FrIfPduRef=SVC_In
        FrStr_xcpstatic_a931915e_Out  # xcpstatic
          p2fmap_dummy16bstatic (FrIfPdusInFrame): FrIfPduOffset=0, FrIfMappedPduId=21, FrIfPduRef=dummy16bstatic
        FrStr_SVC_1fa2bcf8_In  # SVC
          p2fmap_SVC (FrIfPdusInFrame): FrIfPduOffset=0, FrIfMappedPduId=18, FrIfPduRef=SVC_In
        FrStr_SVC_0a1ebbca_In  # SVC
          p2fmap_SVC (FrIfPdusInFrame): FrIfPduOffset=0, FrIfMappedPduId=11, FrIfPduRef=SVC_In
        FrStr_SVC_18ab1424_In  # SVC
          p2fmap_SVC (FrIfPdusInFrame): FrIfPduOffset=0, FrIfMappedPduId=20, FrIfPduRef=SVC_In
        FrStr_xcpstatic_aab54530_Out  # xcpstatic
          p2fmap_dummy16bstatic (FrIfPdusInFrame): FrIfPduOffset=0, FrIfMappedPduId=23, FrIfPduRef=dummy16bstatic
        FrStr_SVC_0bdcd1fd_In  # SVC
          p2fmap_SVC (FrIfPdusInFrame): FrIfPduOffset=0, FrIfMappedPduId=12, FrIfPduRef=SVC_In
        FrStr_TL_BRC_FR_32_41eef8f3_In  # TL_BRC_FR_32
          p2fmap_TL_BRC_FR_32 (FrIfPdusInFrame): FrIfPduOffset=0, FrIfMappedPduId=24, FrIfPduRef=TL_BRC_FR_32
        FrStr_SVC_b39c49a3_In  # SVC
          p2fmap_SVC (FrIfPdusInFrame): FrIfPduOffset=0, FrIfMappedPduId=17, FrIfPduRef=SVC_In
        FrStr_TL_BRC_FR_32_f4c51a40_In  # TL_BRC_FR_32
          p2fmap_TL_BRC_FR_32 (FrIfPdusInFrame): FrIfPduOffset=0, FrIfMappedPduId=28, FrIfPduRef=TL_BRC_FR_32
        FrStr_SVC_13f75319_In  # SVC
          p2fmap_SVC (FrIfPdusInFrame): FrIfPduOffset=0, FrIfMappedPduId=21, FrIfPduRef=SVC_In
