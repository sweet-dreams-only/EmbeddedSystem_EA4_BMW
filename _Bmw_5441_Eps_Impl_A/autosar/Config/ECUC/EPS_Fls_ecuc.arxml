AUTOSAR XML (schema 4-3-0)
package /ActiveEcuC
  module config Fls: implementation-config-variant=VARIANT-POST-BUILD, module-description=Fls_Impl
    FlsGeneral:
      FlsVersionCheckExternalModules = false
      FlsDevErrorDetect = true
      FlsAcLoadOnJobStart = false
      FlsCancelApi = true
      FlsCompareApi = true
      FlsDriverIndex = 0
      FlsGetJobResultApi = true
      FlsGetStatusApi = true
      FlsSetModeApi = false
      FlsUseInterrupts = false
      FlsVersionInfoApi = false
      FlsCriticalSectionProtection = true
      FlsFaciEccCheck = false
      FlsInterruptConsistencyCheck = false
      FlsWriteVerify = WV_INIT_RUNTIME
      FlsUseWVErrorInterface = true
      FlsLoopCount = 32
      FlsVirtualBoundaryAddress = 65536
      FlsDeviceName = R7F701319
      FlsBaseAddress = 0
      FlsTotalSize = 32768
      FlsTimeoutMonitoring = false
      FlsWriteVerifyErrorInterface = HndlMcalWrVrfyErr
      FlsDataFlash:
        FlsDFBaseAddress = 4280287232
        FlsDFBlockSize = 64
        FlsDFTotalBlocks = 1024
        FlsDataFlashSize = 65536
        FlsBlankCheckApi = true
        FlsReadImmediateApi = false
        FlsSuspendApi = false
        FlsResumeApi = false
        FlsFdlCpuFrequency = McuClockSettingConfig
    FlsConfigSet:
      FlsAcErase = 0
      FlsAcWrite = 0
      FlsCallCycle = 0.01
      FlsDefaultMode = MEMIF_MODE_SLOW
      FlsMaxReadFastMode = 512
      FlsMaxReadNormalMode = 256
      FlsMaxWriteFastMode = 0
      FlsMaxWriteNormalMode = 4
      FlsMaxEraseNormalMode = 64
      FlsProtection = 0
      FlsSectorList
        FlsSector: FlsNumberOfSectors=512, FlsPageSize=4, FlsSectorIndex=0, FlsSectorSize=64, FlsSectorStartaddress=0
      FlsDemEventParameterRefs:
        FLS_E_COMPARE_FAILED = FLS_E_COMPARE_FAILED
        FLS_E_ERASE_FAILED = FLS_E_ERASE_FAILED
        FLS_E_READ_FAILED = FLS_E_READ_FAILED
        FLS_E_WRITE_FAILED = FLS_E_WRITE_FAILED
        FLS_E_READ_FAILED_DED = FLS_E_READ_FAILED_DED
        FLS_E_HW_FAILURE = FLS_E_HW_FAILURE
        FLS_E_UNEXPECTED_FLASH_ID = FLS_E_UNEXPECTED_FLASH_ID
        FLS_E_ECC_FAILED = FLS_E_ECC_FAILED
        FLS_E_INT_INCONSISTENT = FLS_E_INT_INCONSISTENT
        FLS_E_REG_WRITE_VERIFY = FLS_E_REG_WRITE_VERIFY
    FlsPublishedInformation:
      FlsAcLocationErase = 0
      FlsAcLocationWrite = 0
      FlsAcSizeErase = 0
      FlsAcSizeWrite = 0
      FlsEraseTime = 0.01
      FlsErasedValue = 4294967295
      FlsExpectedHwId = NULL
      FlsSpecifiedEraseCycles = 125000
      FlsWriteTime = 0.0017
      FlsBlankCheckTime = 0.000213
      FlsSuspendTime = 0.0003
      FlsCancelTime = 0.00005
