AUTOSAR XML (schema 4-3-0)
package /ActiveEcuC
  module config DarhClassic: implementation-config-variant=VARIANT-PRE-COMPILE
    CommonPublishedInformation: SwMajorVersion=5, SwMinorVersion=1, SwPatchVersion=0
    13 x DarhActiveReportedEvent:
      DarhActiveReportedEvent_DmTestCom: DarhDemEvent=DmTestCom
      DarhActiveReportedEvent_CodingEventWrongVehicle: DarhDemEvent=CodingEventWrongVehicle
      DarhActiveReportedEvent_FrsmEClusterSyncLoss: DarhDemEvent=FrsmEClusterSyncLoss
      DarhActiveReportedEvent_LocalOvervoltage: DarhDemEvent=LocalOvervoltage
      DarhActiveReportedEvent_GlobalOvervoltageInt: DarhDemEvent=GlobalOvervoltageInt
      DarhActiveReportedEvent_GlobalUndervoltageExt: DarhDemEvent=GlobalUndervoltageExt
      DarhActiveReportedEvent_CodingEventUnqualifiedData: DarhDemEvent=CodingEventUnqualifiedData
      DarhActiveReportedEvent_DmTestAppl: DarhDemEvent=DmTestAppl
      DarhActiveReportedEvent_LocalUndervoltage: DarhDemEvent=LocalUndervoltage
      DarhActiveReportedEvent_GlobalOvervoltageExt: DarhDemEvent=GlobalOvervoltageExt
      DarhActiveReportedEvent_FrtrcvEFrBuserrorTrcv0: DarhDemEvent=FrtrcvEFrBuserrorTrcv0
      DarhActiveReportedEvent_GlobalUndervoltageInt: DarhDemEvent=GlobalUndervoltageInt
      DarhActiveReportedEvent_CodingEventNotCoded: DarhDemEvent=CodingEventNotCoded
