AUTOSAR XML (schema 4-3-0)
package /ActiveEcuC
  module config WdgM: implementation-config-variant=VARIANT-PRE-COMPILE, module-description=WdgM_Impl
    WdgMConfigSet: WdgMInitialMode=WdgMMode
      WdgMMode:
        WdgMExpiredSupervisionCycleTol = 0
        WdgMModeId = 0
        WdgMSupervisionCycle = 0.004
        WdgMInitialTriggerModeId = 0
        WdgMModeCoreAssignment = 0
        WdgMTicksPerSecond = 250
        WdgMGlobalMemoryAppTaskRef = Appl10
        WdgMExternalLogicalSupervision: WdgMExternalCheckpointInitialRef=ChkPt_10ms_Appl10_End, WdgMExternalCheckpointFinalRef=ChkPt_GblFinal
          ExtTran_From10msAppl10_To10msBsw (WdgMExternalTransition): WdgMExternalTransitionDestRef=ChkPt_10msBsw_Appl10_Strt, WdgMExternalTransitionSourceRef=ChkPt_10ms_Appl10_End
        4 x WdgMAliveSupervision, all with WdgMMaxMargin=0, WdgMMinMargin=0:
          Alv_2ms_End: WdgMExpectedAliveIndications=2, WdgMSupervisionReferenceCycle=1, WdgMAliveSupervisionCheckpointRef=ChkPt_2msA_Appl10_End
          Alv_4ms_End: WdgMExpectedAliveIndications=1, WdgMSupervisionReferenceCycle=1, WdgMAliveSupervisionCheckpointRef=ChkPt_4ms_Appl10_End
          Alv_10ms_End: WdgMExpectedAliveIndications=2, WdgMSupervisionReferenceCycle=5, WdgMAliveSupervisionCheckpointRef=ChkPt_10msBsw_Appl10_End
          Alv_100ms_End: WdgMExpectedAliveIndications=1, WdgMSupervisionReferenceCycle=25, WdgMAliveSupervisionCheckpointRef=ChkPt_100ms_Appl10_End
        4 x WdgMLocalStatusParams, all with WdgMFailedAliveSupervisionRefCycleTol=0, WdgMSupervisedEntityInitialMode=WDGM_LOCAL_STATUS_OK, WdgMFailedDeadlineRefCycleTol=0, WdgMDeadlineReferenceCycle=0, WdgMFailedProgramFlowRefCycleTol=0, WdgMProgramFlowReferenceCycle=0:
          Sts_2msA_Appl10: WdgMLocalStatusSupervisedEntityRef=SE_2msA_Appl10
          Sts_4ms_Appl10: WdgMLocalStatusSupervisedEntityRef=SE_4ms_Appl10
          Sts_10ms_Appl10: WdgMLocalStatusSupervisedEntityRef=SE_10ms_Appl10
          Sts_100ms_Appl10: WdgMLocalStatusSupervisedEntityRef=SE_100ms_Appl10
        WdgMTrigger: WdgMWatchdogMode=WDGIF_SLOW_MODE, WdgMTriggerConditionValue=7, WdgMTriggerWindowStart=2, WdgMTriggerModeId=0, WdgMTriggerWatchdogRef=WdgMWatchdog
        11 x WdgMLocalStatusParams, all with WdgMFailedAliveSupervisionRefCycleTol=0, WdgMSupervisedEntityInitialMode=WDGM_LOCAL_STATUS_OK, WdgMFailedDeadlineRefCycleTol=0, WdgMDeadlineReferenceCycle=0, WdgMFailedProgramFlowRefCycleTol=0, WdgMProgramFlowReferenceCycle=0:
          Sts_10msBsw_Appl10: WdgMLocalStatusSupervisedEntityRef=SE_10msBsw_Appl10
          Sts_2ms_Appl9: WdgMLocalStatusSupervisedEntityRef=SE_2ms_Appl9
          Sts_10ms_Appl9: WdgMLocalStatusSupervisedEntityRef=SE_10ms_Appl9
          Sts_100ms_Appl9: WdgMLocalStatusSupervisedEntityRef=SE_100ms_Appl9
          Sts_2ms_Appl8: WdgMLocalStatusSupervisedEntityRef=SE_2ms_Appl8
          Sts_10ms_Appl8: WdgMLocalStatusSupervisedEntityRef=SE_10ms_Appl8
          Sts_2ms_Appl7: WdgMLocalStatusSupervisedEntityRef=SE_2ms_Appl7
          Sts_10ms_Appl7: WdgMLocalStatusSupervisedEntityRef=SE_10ms_Appl7
          Sts_4ms_Appl7: WdgMLocalStatusSupervisedEntityRef=SE_4ms_Appl7
          Sts_100ms_Appl7: WdgMLocalStatusSupervisedEntityRef=SE_100ms_Appl7
          Sts_2msB_Appl10: WdgMLocalStatusSupervisedEntityRef=SE_2msB_Appl10
      WdgMDemEventParameterRefs: WDGM_E_IMPROPER_CALLER=WDGM_E_IMPROPER_CALLER, WDGM_E_MONITORING=WDGM_E_MONITORING, WDGM_E_SET_MODE=WDGM_E_SET_MODE
    WdgMGeneral:
      WdgMDevErrorDetect = true
      WdgMDemReport = false
      WdgMImmediateReset = false
      WdgMOffModeEnabled = false
      WdgMVersionInfoApi = false
      WdgMDefensiveBehavior = false
      WdgMUseRte = true
      WdgMDemSupervisionReport = false
      WdgMFirstCycleAliveCounterReset = true
      WdgMAutosarDebugging = false
      WdgMUseOsSuspendInterrupt = true
      WdgMTimebaseSource = WDGM_INTERNAL_SOFTWARE_TICK
      WdgMSecondResetPath = false
      WdgMTickOverrunCorrection = false
      WdgMEntityDeactivationEnabled = true
      WdgMGenerateCPIdAsPortDefinedArgument = true
      WdgMStatusReportingMechanism = WDGM_USE_NO_STATUS_REPORTING
      WdgMUseOsCoreIdentification = false
      WdgMCallerIds: WdgMCallerId=0
      WdgMWatchdog: WdgMWatchdogName=, WdgMWatchdogDeviceRef=WdgIfDevice
      15 x WdgMSupervisedEntity, all with WdgMEnableEntityDeactivation=true:
        SE_2msA_Appl10: WdgMSupervisedEntityId=0, WdgMInternalCheckpointInitialRef=ChkPt_2msA_Appl10_Strt, WdgMAppTaskRef=Appl10, WdgMInternallCheckpointFinalRef=ChkPt_2msA_Appl10_End
          ChkPt_2msA_Appl10_Strt (WdgMCheckpoint): WdgMCheckpointId=0
          ChkPt_2msA_Appl10_End (WdgMCheckpoint): WdgMCheckpointId=1
          IntTran_2msA_Appl10 (WdgMInternalTransition): WdgMInternalTransitionDestRef=ChkPt_2msA_Appl10_End, WdgMInternalTransitionSourceRef=ChkPt_2msA_Appl10_Strt
          ChkPt_GblFinal (WdgMCheckpoint): WdgMCheckpointId=2
        SE_4ms_Appl10: WdgMSupervisedEntityId=1, WdgMInternalCheckpointInitialRef=ChkPt_4ms_Appl10_Strt, WdgMAppTaskRef=Appl10, WdgMInternallCheckpointFinalRef=ChkPt_4ms_Appl10_End
          ChkPt_4ms_Appl10_Strt (WdgMCheckpoint): WdgMCheckpointId=0
          ChkPt_4ms_Appl10_End (WdgMCheckpoint): WdgMCheckpointId=1
          IntTran_4ms_Appl10 (WdgMInternalTransition): WdgMInternalTransitionDestRef=ChkPt_4ms_Appl10_End, WdgMInternalTransitionSourceRef=ChkPt_4ms_Appl10_Strt
        SE_10ms_Appl10: WdgMSupervisedEntityId=3, WdgMInternalCheckpointInitialRef=ChkPt_10ms_Appl10_Strt, WdgMAppTaskRef=Appl10, WdgMInternallCheckpointFinalRef=ChkPt_10ms_Appl10_End
          ChkPt_10ms_Appl10_Strt (WdgMCheckpoint): WdgMCheckpointId=0
          ChkPt_10ms_Appl10_End (WdgMCheckpoint): WdgMCheckpointId=1
          IntTran_10ms_Appl10 (WdgMInternalTransition): WdgMInternalTransitionDestRef=ChkPt_10ms_Appl10_End, WdgMInternalTransitionSourceRef=ChkPt_10ms_Appl10_Strt
        SE_10msBsw_Appl10: WdgMSupervisedEntityId=4, WdgMInternalCheckpointInitialRef=ChkPt_10msBsw_Appl10_Strt, WdgMAppTaskRef=Appl10, WdgMInternallCheckpointFinalRef=ChkPt_10msBsw_Appl10_End
          ChkPt_10msBsw_Appl10_Strt (WdgMCheckpoint): WdgMCheckpointId=0
          ChkPt_10msBsw_Appl10_End (WdgMCheckpoint): WdgMCheckpointId=1
          IntTran_10msBsw_Appl10 (WdgMInternalTransition): WdgMInternalTransitionDestRef=ChkPt_10msBsw_Appl10_End, WdgMInternalTransitionSourceRef=ChkPt_10msBsw_Appl10_Strt
        SE_100ms_Appl10: WdgMSupervisedEntityId=2, WdgMInternalCheckpointInitialRef=ChkPt_100ms_Appl10_Strt, WdgMAppTaskRef=Appl10, WdgMInternallCheckpointFinalRef=ChkPt_100ms_Appl10_End
          ChkPt_100ms_Appl10_Strt (WdgMCheckpoint): WdgMCheckpointId=0
          ChkPt_100ms_Appl10_End (WdgMCheckpoint): WdgMCheckpointId=1
          IntTran_100ms_Appl10 (WdgMInternalTransition): WdgMInternalTransitionDestRef=ChkPt_100ms_Appl10_End, WdgMInternalTransitionSourceRef=ChkPt_100ms_Appl10_Strt
        SE_2ms_Appl9: WdgMSupervisedEntityId=5, WdgMInternalCheckpointInitialRef=ChkPt_2ms_Appl9_Strt, WdgMAppTaskRef=Appl9, WdgMInternallCheckpointFinalRef=ChkPt_2ms_Appl9_End
          ChkPt_2ms_Appl9_End (WdgMCheckpoint): WdgMCheckpointId=1
          ChkPt_2ms_Appl9_Strt (WdgMCheckpoint): WdgMCheckpointId=0
          WdgMInternalTransition: WdgMInternalTransitionDestRef=ChkPt_2ms_Appl9_End, WdgMInternalTransitionSourceRef=ChkPt_2ms_Appl9_Strt
        SE_10ms_Appl9: WdgMSupervisedEntityId=6, WdgMInternalCheckpointInitialRef=ChkPt_10ms_Appl9_Strt, WdgMAppTaskRef=Appl9, WdgMInternallCheckpointFinalRef=ChkPt_10ms_Appl9_End
          ChkPt_10ms_Appl9_End (WdgMCheckpoint): WdgMCheckpointId=1
          ChkPt_10ms_Appl9_Strt (WdgMCheckpoint): WdgMCheckpointId=0
          IntTran_10ms_Appl9 (WdgMInternalTransition): WdgMInternalTransitionDestRef=ChkPt_10ms_Appl9_End, WdgMInternalTransitionSourceRef=ChkPt_10ms_Appl9_Strt
        SE_100ms_Appl9: WdgMSupervisedEntityId=7, WdgMInternalCheckpointInitialRef=ChkPt_100ms_Appl9_Strt, WdgMAppTaskRef=Appl9, WdgMInternallCheckpointFinalRef=ChkPt_100ms_Appl9_End
          ChkPt_100ms_Appl9_End (WdgMCheckpoint): WdgMCheckpointId=1
          ChkPt_100ms_Appl9_Strt (WdgMCheckpoint): WdgMCheckpointId=0
          IntTran_100ms_Appl9 (WdgMInternalTransition): WdgMInternalTransitionDestRef=ChkPt_100ms_Appl9_End, WdgMInternalTransitionSourceRef=ChkPt_100ms_Appl9_Strt
        SE_2ms_Appl8: WdgMSupervisedEntityId=8, WdgMInternalCheckpointInitialRef=ChkPt_2ms_Appl8_Strt, WdgMAppTaskRef=Appl8, WdgMInternallCheckpointFinalRef=ChkPt_2ms_Appl8_End
          ChkPt_2ms_Appl8_End (WdgMCheckpoint): WdgMCheckpointId=1
          ChkPt_2ms_Appl8_Strt (WdgMCheckpoint): WdgMCheckpointId=0
          IntTran_2ms_Appl8 (WdgMInternalTransition): WdgMInternalTransitionDestRef=ChkPt_2ms_Appl8_End, WdgMInternalTransitionSourceRef=ChkPt_2ms_Appl8_Strt
        SE_10ms_Appl8: WdgMSupervisedEntityId=9, WdgMInternalCheckpointInitialRef=ChkPt_10ms_Appl8_Strt, WdgMAppTaskRef=Appl8, WdgMInternallCheckpointFinalRef=ChkPt_10ms_Appl8_End
          ChkPt_10ms_Appl8_End (WdgMCheckpoint): WdgMCheckpointId=1
          ChkPt_10ms_Appl8_Strt (WdgMCheckpoint): WdgMCheckpointId=0
          IntTran_10ms_Appl8 (WdgMInternalTransition): WdgMInternalTransitionDestRef=ChkPt_10ms_Appl8_End, WdgMInternalTransitionSourceRef=ChkPt_10ms_Appl8_Strt
        SE_2ms_Appl7: WdgMSupervisedEntityId=10, WdgMInternalCheckpointInitialRef=ChkPt_2ms_Appl7_Strt, WdgMAppTaskRef=Appl7, WdgMInternallCheckpointFinalRef=ChkPt_2ms_Appl7_End
          ChkPt_2ms_Appl7_End (WdgMCheckpoint): WdgMCheckpointId=1
          ChkPt_2ms_Appl7_Strt (WdgMCheckpoint): WdgMCheckpointId=0
          IntTran_2ms_Appl7 (WdgMInternalTransition): WdgMInternalTransitionDestRef=ChkPt_2ms_Appl7_End, WdgMInternalTransitionSourceRef=ChkPt_2ms_Appl7_Strt
        SE_10ms_Appl7: WdgMSupervisedEntityId=11, WdgMInternalCheckpointInitialRef=ChkPt_10ms_Appl7_Strt, WdgMAppTaskRef=Appl7, WdgMInternallCheckpointFinalRef=ChkPt_10ms_Appl7_End
          ChkPt_10ms_Appl7_End (WdgMCheckpoint): WdgMCheckpointId=1
          ChkPt_10ms_Appl7_Strt (WdgMCheckpoint): WdgMCheckpointId=0
          IntTran_10ms_Appl7 (WdgMInternalTransition): WdgMInternalTransitionDestRef=ChkPt_10ms_Appl7_End, WdgMInternalTransitionSourceRef=ChkPt_10ms_Appl7_Strt
        SE_4ms_Appl7: WdgMSupervisedEntityId=12, WdgMInternalCheckpointInitialRef=ChkPt_4ms_Appl7_Strt, WdgMAppTaskRef=Appl7, WdgMInternallCheckpointFinalRef=ChkPt_4ms_Appl7_End
          ChkPt_4ms_Appl7_End (WdgMCheckpoint): WdgMCheckpointId=1
          ChkPt_4ms_Appl7_Strt (WdgMCheckpoint): WdgMCheckpointId=0
          IntTran_4ms_Appl7 (WdgMInternalTransition): WdgMInternalTransitionDestRef=ChkPt_4ms_Appl7_End, WdgMInternalTransitionSourceRef=ChkPt_4ms_Appl7_Strt
        SE_100ms_Appl7: WdgMSupervisedEntityId=13, WdgMInternalCheckpointInitialRef=ChkPt_100ms_Appl7_Strt, WdgMAppTaskRef=Appl7, WdgMInternallCheckpointFinalRef=ChkPt_100ms_Appl7_End
          ChkPt_100ms_Appl7_End (WdgMCheckpoint): WdgMCheckpointId=1
          ChkPt_100ms_Appl7_Strt (WdgMCheckpoint): WdgMCheckpointId=0
          IntTran_100ms_Appl7 (WdgMInternalTransition): WdgMInternalTransitionDestRef=ChkPt_100ms_Appl7_End, WdgMInternalTransitionSourceRef=ChkPt_100ms_Appl7_Strt
        SE_2msB_Appl10: WdgMSupervisedEntityId=14, WdgMInternalCheckpointInitialRef=ChkPt_2msB_Appl10_Strt, WdgMAppTaskRef=Appl10, WdgMInternallCheckpointFinalRef=ChkPt_2msB_Appl10_End
          ChkPt_2msB_Appl10_Strt (WdgMCheckpoint): WdgMCheckpointId=0
          ChkPt_2msB_Appl10_End (WdgMCheckpoint): WdgMCheckpointId=1
          IntTran_2msB_Appl10 (WdgMInternalTransition): WdgMInternalTransitionDestRef=ChkPt_2msB_Appl10_End, WdgMInternalTransitionSourceRef=ChkPt_2msB_Appl10_Strt
