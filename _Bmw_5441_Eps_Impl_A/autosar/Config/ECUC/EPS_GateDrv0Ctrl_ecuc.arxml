AUTOSAR XML (schema 4-3-0)
package /ActiveEcuC
  module config GateDrv0Ctrl: implementation-config-variant=VARIANT-PRE-COMPILE
    GateDrv0CtrlGenCfg: GateDrv0FetFltMtgtnEna=true
