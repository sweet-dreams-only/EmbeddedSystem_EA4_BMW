AUTOSAR XML (schema 4-3-0)
package /ActiveEcuC
  module config Spi: implementation-config-variant=VARIANT-POST-BUILD, module-description=Spi_Impl
    SpiGeneral:
      SpiCancelApi = true
      SpiChannelBuffersAllowed = 0
      SpiDevErrorDetect = true
      SpiHwStatusApi = false
      SpiInterruptibleSeqAllowed = false
      SpiLevelDelivered = 1
      SpiSupportConcurrentSyncTransmit = false
      SpiVersionInfoApi = false
      SpiDmaMode = false
      SpiDmaTypeUsed = SPI_DMA_TYPE_TWO
      SpiDataConsistencyCheckEnable = true
      SpiDataWidthSelection = BITS_16
      SpiCriticalSectionProtection = true
      SpiVersionCheckExternalModules = false
      SpiHighPriorityHwHandlingEnable = false
      SpiDeviceName = R7F701319
      SpiAlreadyInitDetCheck = true
      SpiSeqStartNotificationEnable = false
      SpiSyncSeqEndNotificationEnable = false
      SpiPersistentHWConfiguration = true
      SpiMaxBaudrate = PCLK_DIV_BY_8
      SpiTimeOut = 65535
      SpiCSIGHWriteVerify = WV_INIT_RUNTIME
      SpiDMAWriteVerify = WV_DISABLE
      SpiECCSelfTest = ECC_None
      SpiInternalErrorBufferSize = 32
      SpiInterruptConsistencyCheck = true
      SpiLoopBackSelfTest = LoopBack_None
      Spi_UseWriteVerifyErrorInterface = true
      SpiWriteVerifyErrorInterface = HndlMcalWrVrfyErr
    SpiDriver: SpiMaxChannel=41, SpiMaxJob=27, SpiMaxSequence=27
      GateDrv0Cfg0Ch (SpiChannel): SpiChannelId=0, SpiChannelType=IB, SpiDataWidth=15, SpiEbMaxLength=1, SpiIbNBuffers=1, SpiTransferStart=MSB, SpiDefaultData=0
      SpiDemEventParameterRefs:
        SPI_E_HARDWARE_ERROR = SPI_E_HARDWARE_ERROR
        SPI_E_DATA_TX_TIMEOUT_FAILURE = SPI_E_DATA_TX_TIMEOUT_FAILURE
        SPI_E_INT_INCONSISTENT = SPI_E_INT_INCONSISTENT
        SPI_E_LOOPBACK_SELFTEST_FAILURE = SPI_E_LOOPBACK_SELFTEST_FAILURE
        SPI_E_REG_WRITE_VERIFY = SPI_E_REG_WRITE_VERIFY
        SPI_E_ECC_SELFTEST_FAILURE = SPI_E_ECC_SELFTEST_FAILURE
      GateDriver0 (SpiExternalDevice):
        SpiBaudrate = 0
        SpiBaudrateConfiguration = 10
        SpiCsIdentifier = NULL
        SpiCsPolarity = LOW
        SpiDataShiftEdge = LEADING
        SpiEnableCs = true
        SpiHwUnit = CSIH2
        SpiShiftClockIdleLevel = HIGH
        SpiTimeClk2Cs = 0
        SpiClk2CsCount = 5
        SpiInputClockSelect = PCLK_DIVBY_4
        SpiInterruptDelayMode = false
        SpiParitySelection = ODD_PARITY
        SpiBroadcastingPriority = DOMINANT
        SpiBaudrateRegisterSelect = CSIH_BAUDRATE_REGISTER_0
        SpiCsHoldTiming = HOLD_TIME_0_POINT_5
        SpiCsIdleEnforcement = true
        SpiCsIdleTiming = IDLE_TIME_3_POINT_5
        SpiCsInactiveAfterLastData = true
        SpiCsInterDataDelay = INTER_DATA_TIME_0_POINT_5
        SpiCsSetupTime = SETUP_TIME_0_POINT_5
        SpiCsSelection = CS_VIA_PERIPHERAL_ENGINE
        SpiClockFrequencyRef = McuHighspeedPeriClk0
      GateDriver0MemoryMode (SpiMemoryMode): SpiHwUnitSelection=CSIH2, SpiMemoryModeSelection=DIRECT_ACCESS_MODE
      25 x SpiChannel, all with SpiChannelType=IB, SpiDataWidth=15, SpiEbMaxLength=1, SpiIbNBuffers=1, SpiTransferStart=MSB, SpiDefaultData=0:
        GateDrv0Cfg{1..13}Ch: SpiChannelId={1..13}
        GateDrv0VrfyCmd0Ch: SpiChannelId=14
        GateDrv0VrfyCmd1Ch: SpiChannelId=15
        GateDrv0VrfyCmd2Ch: SpiChannelId=16
        GateDrv0VrfyRes0Ch: SpiChannelId=17
        GateDrv0Mask0Ch: SpiChannelId=19
        GateDrv0Mask1Ch: SpiChannelId=20
        GateDrv0Mask2Ch: SpiChannelId=21
        GateDrv0VrfyRes1Ch: SpiChannelId=18
        GateDrv0Diag0Ch: SpiChannelId=22
        GateDrv0Diag1Ch: SpiChannelId=23
        GateDrv0Diag2Ch: SpiChannelId=24
        GateDrv0CtrlCh: SpiChannelId=25
      10 x SpiJob, all with SpiJobPriority=3, SpiHwUnitSynchronous=ASYNCHRONOUS, SpiPortPinSelect=CSL0, SpiJobEndNotification=NULL, SpiDeviceAssignment=GateDriver0:
        GateDrv0Cfg9Job: SpiJobId=1
          SpiChannelList: SpiChannelIndex=0, SpiChannelAssignment=GateDrv0Cfg9Ch
        GateDrv0Cfg8Job: SpiJobId=0
          SpiChannelList: SpiChannelIndex=0, SpiChannelAssignment=GateDrv0Cfg8Ch
        GateDrv0Cfg10Job: SpiJobId=2
          SpiChannelList: SpiChannelIndex=0, SpiChannelAssignment=GateDrv0Cfg10Ch
        GateDrv0Cfg12Job: SpiJobId=4
          SpiChannelList: SpiChannelIndex=0, SpiChannelAssignment=GateDrv0Cfg12Ch
        GateDrv0Cfg11Job: SpiJobId=3
          SpiChannelList: SpiChannelIndex=0, SpiChannelAssignment=GateDrv0Cfg11Ch
        GateDrv0Cfg13Job: SpiJobId=5
          SpiChannelList: SpiChannelIndex=0, SpiChannelAssignment=GateDrv0Cfg13Ch
        GateDrv0VrfyCmd0Job: SpiJobId=6
          SpiChannelList: SpiChannelIndex=0, SpiChannelAssignment=GateDrv0VrfyCmd0Ch
        GateDrv0VrfyCmd1Job: SpiJobId=7
          SpiChannelList: SpiChannelIndex=0, SpiChannelAssignment=GateDrv0VrfyCmd1Ch
        GateDrv0VrfyCmd2Job: SpiJobId=8
          SpiChannelList: SpiChannelIndex=0, SpiChannelAssignment=GateDrv0VrfyCmd2Ch
        GateDrv0CtrlJob: SpiJobId=9
          SpiChannelList: SpiChannelIndex=0, SpiChannelAssignment=SpiDriver/GateDrv0CtrlCh
      10 x SpiSequence, all with SpiInterruptibleSequence=false, SpiSeqStartNotification=NULL, SpiHighPriorityHwSequence=false, SpiSeqEndNotification=NULL:
        GateDrv0Cfg8Seq: SpiSequenceId=0, SpiJobAssignment=GateDrv0Cfg8Job
        GateDrv0Cfg10Seq: SpiSequenceId=2, SpiJobAssignment=GateDrv0Cfg10Job
        GateDrv0Cfg9Seq: SpiSequenceId=1, SpiJobAssignment=GateDrv0Cfg9Job
        GateDrv0Cfg12Seq: SpiSequenceId=4, SpiJobAssignment=GateDrv0Cfg12Job
        GateDrv0Cfg11Seq: SpiSequenceId=3, SpiJobAssignment=GateDrv0Cfg11Job
        GateDrv0Cfg13Seq: SpiSequenceId=5, SpiJobAssignment=GateDrv0Cfg13Job
        GateDrv0VrfyCmd0Seq: SpiSequenceId=6, SpiJobAssignment=GateDrv0VrfyCmd0Job
        GateDrv0VrfyCmd2Seq: SpiSequenceId=8, SpiJobAssignment=GateDrv0VrfyCmd2Job
        GateDrv0VrfyCmd1Seq: SpiSequenceId=7, SpiJobAssignment=GateDrv0VrfyCmd1Job
        GateDrv0CtrlSeq: SpiSequenceId=26, SpiJobAssignment=GateDrv0CtrlJob
      15 x SpiChannel, all with SpiChannelType=IB, SpiDataWidth=15, SpiEbMaxLength=1, SpiIbNBuffers=1, SpiTransferStart=MSB, SpiDefaultData=0:
        TmplMonrCh1: SpiChannelId=26
        TmplMonrCh2: SpiChannelId=27
        TmplMonrCh3: SpiChannelId=28
        TmplMonrCh4: SpiChannelId=29
        TmplMonrCh5: SpiChannelId=30
        PwrSplyCh3: SpiChannelId=33
        PwrSplyCh1: SpiChannelId=31
        PwrSplyCh4: SpiChannelId=34
        PwrSplyCh2: SpiChannelId=32
        PwrSplyCh5: SpiChannelId=35
        PwrSplyCh6: SpiChannelId=36
        PwrSplyCh7: SpiChannelId=37
        PwrSplyCh8: SpiChannelId=38
        PwrSplyCh9: SpiChannelId=39
        PwrSplyCh10: SpiChannelId=40
      PwrSplyTmplMonr (SpiExternalDevice):
        SpiBaudrate = 0
        SpiBaudrateConfiguration = 10
        SpiCsIdentifier = NULL
        SpiCsPolarity = LOW
        SpiDataShiftEdge = LEADING
        SpiEnableCs = true
        SpiHwUnit = CSIG0
        SpiShiftClockIdleLevel = HIGH
        SpiTimeClk2Cs = 0
        SpiClk2CsCount = 5
        SpiInputClockSelect = PCLK_DIVBY_4
        SpiInterruptDelayMode = false
        SpiParitySelection = ODD_PARITY
        SpiBroadcastingPriority = DOMINANT
        SpiCsHoldTiming = HOLD_TIME_0_POINT_5
        SpiCsIdleEnforcement = true
        SpiCsIdleTiming = IDLE_TIME_3_POINT_5
        SpiCsInactiveAfterLastData = true
        SpiCsInterDataDelay = INTER_DATA_TIME_0_POINT_5
        SpiCsSelection = CS_VIA_GPIO
        SpiCsSetupTime = SETUP_TIME_0_POINT_5
        SpiClockFrequencyRef = McuHighspeedPeriClk0
      15 x SpiJob, all with SpiJobPriority=3, SpiHwUnitSynchronous=ASYNCHRONOUS, SpiJobEndNotification=NULL, SpiPortPinSelect=PORTGROUP_5_PORTPIN_9, SpiDeviceAssignment=PwrSplyTmplMonr:
        TmplMonrJob1: SpiJobId=10
          SpiChannelList: SpiChannelIndex=0, SpiChannelAssignment=TmplMonrCh1
        TmplMonrJob2: SpiJobId=11
          SpiChannelList: SpiChannelIndex=0, SpiChannelAssignment=TmplMonrCh2
        TmplMonrJob3: SpiJobId=12
          SpiChannelList: SpiChannelIndex=0, SpiChannelAssignment=TmplMonrCh3
        TmplMonrJob4: SpiJobId=13
          SpiChannelList: SpiChannelIndex=0, SpiChannelAssignment=TmplMonrCh4
        TmplMonrJob5: SpiJobId=14
          SpiChannelList: SpiChannelIndex=0, SpiChannelAssignment=TmplMonrCh5
        PwrSplyJob1: SpiJobId=15
          SpiChannelList: SpiChannelIndex=0, SpiChannelAssignment=PwrSplyCh1
        PwrSplyJob2: SpiJobId=16
          SpiChannelList: SpiChannelIndex=0, SpiChannelAssignment=PwrSplyCh2
        PwrSplyJob3: SpiJobId=17
          SpiChannelList: SpiChannelIndex=0, SpiChannelAssignment=PwrSplyCh3
        PwrSplyJob4: SpiJobId=18
          SpiChannelList: SpiChannelIndex=0, SpiChannelAssignment=PwrSplyCh4
        PwrSplyJob5: SpiJobId=19
          SpiChannelList: SpiChannelIndex=0, SpiChannelAssignment=PwrSplyCh5
        PwrSplyJob6: SpiJobId=20
          SpiChannelList: SpiChannelIndex=0, SpiChannelAssignment=PwrSplyCh6
        PwrSplyJob7: SpiJobId=21
          SpiChannelList: SpiChannelIndex=0, SpiChannelAssignment=PwrSplyCh7
        PwrSplyJob8: SpiJobId=22
          SpiChannelList: SpiChannelIndex=0, SpiChannelAssignment=PwrSplyCh8
        PwrSplyJob9: SpiJobId=23
          SpiChannelList: SpiChannelIndex=0, SpiChannelAssignment=PwrSplyCh9
        PwrSplyJob10: SpiJobId=24
          SpiChannelList: SpiChannelIndex=0, SpiChannelAssignment=PwrSplyCh10
      15 x SpiSequence, all with SpiInterruptibleSequence=false, SpiSeqStartNotification=NULL, SpiHighPriorityHwSequence=false, SpiSeqEndNotification=NULL:
        TmplMonrSeq1: SpiSequenceId=9, SpiJobAssignment=TmplMonrJob1
        TmplMonrSeq2: SpiSequenceId=10, SpiJobAssignment=TmplMonrJob2
        TmplMonrSeq3: SpiSequenceId=11, SpiJobAssignment=TmplMonrJob3
        TmplMonrSeq4: SpiSequenceId=12, SpiJobAssignment=TmplMonrJob4
        TmplMonrSeq5: SpiSequenceId=13, SpiJobAssignment=TmplMonrJob5
        PwrSplySeq1: SpiSequenceId=14, SpiJobAssignment=PwrSplyJob1
        PwrSplySeq2: SpiSequenceId=15, SpiJobAssignment=PwrSplyJob2
        PwrSplySeq3: SpiSequenceId=16, SpiJobAssignment=PwrSplyJob3
        PwrSplySeq4: SpiSequenceId=17, SpiJobAssignment=PwrSplyJob4
        PwrSplySeq5: SpiSequenceId=18, SpiJobAssignment=PwrSplyJob5
        PwrSplySeq6: SpiSequenceId=19, SpiJobAssignment=PwrSplyJob6
        PwrSplySeq7: SpiSequenceId=20, SpiJobAssignment=PwrSplyJob7
        PwrSplySeq8: SpiSequenceId=21, SpiJobAssignment=PwrSplyJob8
        PwrSplySeq9: SpiSequenceId=22, SpiJobAssignment=PwrSplyJob9
        PwrSplySeq10: SpiSequenceId=23, SpiJobAssignment=PwrSplyJob10
      GateDrv0AllCfgJob (SpiJob): SpiJobId=25, SpiJobPriority=3, SpiHwUnitSynchronous=ASYNCHRONOUS, SpiPortPinSelect=CSL0, SpiJobEndNotification=NULL, SpiDeviceAssignment=GateDriver0
        11 x SpiChannelList:
          GateDrv0Cfg{0..7}Ch: SpiChannelIndex={0..7}, SpiChannelAssignment=SpiDriver/GateDrv0Cfg{0..7}Ch
          GateDrv0CtrlCh: SpiChannelIndex=8, SpiChannelAssignment=SpiDriver/GateDrv0CtrlCh
          GateDrv0Mask1Ch: SpiChannelIndex=9, SpiChannelAssignment=SpiDriver/GateDrv0Mask1Ch
          GateDrv0Mask2Ch: SpiChannelIndex=10, SpiChannelAssignment=SpiDriver/GateDrv0Mask2Ch
      GateDrv0CmnDiagJob (SpiJob): SpiJobId=26, SpiJobPriority=3, SpiHwUnitSynchronous=ASYNCHRONOUS, SpiPortPinSelect=CSL0, SpiJobEndNotification=NULL, SpiDeviceAssignment=GateDriver0
        6 x SpiChannelList:
          GateDrv0Mask0Ch: SpiChannelIndex=0, SpiChannelAssignment=SpiDriver/GateDrv0Mask0Ch
          GateDrv0Diag0Ch: SpiChannelIndex=1, SpiChannelAssignment=SpiDriver/GateDrv0Diag0Ch
          GateDrv0Diag1Ch: SpiChannelIndex=2, SpiChannelAssignment=SpiDriver/GateDrv0Diag1Ch
          GateDrv0Diag2Ch: SpiChannelIndex=3, SpiChannelAssignment=SpiDriver/GateDrv0Diag2Ch
          GateDrv0VrfyRes0Ch: SpiChannelIndex=4, SpiChannelAssignment=SpiDriver/GateDrv0VrfyRes0Ch
          GateDrv0VrfyRes1Ch: SpiChannelIndex=5, SpiChannelAssignment=SpiDriver/GateDrv0VrfyRes1Ch
      GateDrv0AllCfgSeq (SpiSequence):
        SpiInterruptibleSequence = false
        SpiSeqStartNotification = NULL
        SpiHighPriorityHwSequence = false
        SpiSequenceId = 24
        SpiSeqEndNotification = NULL
        SpiJobAssignment = GateDrv0AllCfgJob
      GateDrv0CmnDiagSeq (SpiSequence):
        SpiInterruptibleSequence = false
        SpiSeqStartNotification = NULL
        SpiHighPriorityHwSequence = false
        SpiSequenceId = 25
        SpiSeqEndNotification = NULL
        SpiJobAssignment = GateDrv0CmnDiagJob
    SpiPublishedInformation: SpiMaxHwUnit=5
