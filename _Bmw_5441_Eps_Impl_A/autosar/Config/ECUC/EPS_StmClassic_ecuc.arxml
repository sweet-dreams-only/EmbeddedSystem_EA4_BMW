AUTOSAR XML (schema 4-3-0)
package /ActiveEcuC
  module config StmClassic: implementation-config-variant=VARIANT-PRE-COMPILE
    CommonPublishedInformation: SwMajorVersion=5, SwMinorVersion=2, SwPatchVersion=0
    StmGeneral:
      StmInitialCentralErrorLockTimeout = 6
      StmCentralErrorLockTimeout = 21
      StmEnergyStateTimeout = 21
      StmVehicleStateTimeout = 0.5
      StmComVariant = STM_COM_CYCLIC_DATAELEMENTS
    StmFeatureActivation: StmCentralErrorLockEnabled=true, StmEnergyStateEnabled=true, StmVehicleStateEnabled=false
