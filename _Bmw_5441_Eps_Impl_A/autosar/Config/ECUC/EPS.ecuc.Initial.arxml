AUTOSAR XML (schema 4-3-0)
package /InitialEcuC
  ecuc value collection InitialEcuC: ecuc-values=[Com, ComM, Darh, DarhClassic, Dcm, Dem, EcuC, Fr, FrIf, FrSM, IpduM, PduR, StdDiag, StdDiagClassic, SysTime, SysTimeClassic, Xcp]
  module config Com
    ComConfig
      42 x ComIPdu, all with ComIPduType=NORMAL:
        ACLNY_MASSCNTR_19255f18: ComIPduDirection=RECEIVE, ComIPduSignalGroupRef=sigGroup_ACLNY_MASSCNTR_461c64b1, ComPduIdRef=pduTrig_ACLNY_MASSCNTR_pduPort_EPS_A_FlexRay_IN_55c86d41_4f391dd1
        ANFRAGE_fbd80461_In: ComIPduDirection=RECEIVE, ComIPduSignalRef=ANFRAGE_ID2_fbd80461_In, ComIPduSignalRef=ID_FN_INQY_fbd80461_In, ComPduIdRef=EcucPduCollection/ANFRAGE_fbd80461_In
        ANFRAGE_fbd80461_Out: ComIPduDirection=SEND, ComIPduSignalRef=ANFRAGE_ID2_fbd80461_Out, ComIPduSignalRef=ID_FN_INQY_fbd80461_Out, ComPduIdRef=EcucPduCollection/ANFRAGE_fbd80461_Out
          ComTxIPdu: ComMinimumDelayTime=0.5, ComTxIPduUnusedAreasDefault=255
            ComTxModeTrue
              ComTxMode: ComTxModeMode=DIRECT, ComTxModeNumberOfRepetitions=0
        AVL_FORC_GRD_19255f18: ComIPduDirection=SEND, ComIPduSignalGroupRef=sigGroup_AVL_FORC_GRD_19621f3f, ComPduIdRef=pduTrig_AVL_FORC_GRD_pduPort_EPS_A_FlexRay_OUT_55c86d41_4f391dd1
          ComTxIPdu: ComTxIPduUnusedAreasDefault=255
            ComTxModeTrue
              ComTxMode: ComTxModeMode=PERIODIC, ComTxModeTimePeriod=0.01
        AVL_PO_EPS_19255f18: ComIPduDirection=SEND, ComIPduSignalGroupRef=sigGroup_AVL_PO_EPS_290f0f6e, ComPduIdRef=pduTrig_AVL_PO_EPS_pduPort_EPS_A_FlexRay_OUT_55c86d41_4f391dd1
          ComTxIPdu: ComTxIPduUnusedAreasDefault=255
            ComTxModeTrue
              ComTxMode: ComTxModeMode=PERIODIC, ComTxModeTimePeriod=0.01
        AVL_RPM_WHL_19255f18: ComIPduDirection=RECEIVE, ComIPduSignalGroupRef=sigGroup_AVL_RPM_WHL_eba9ae07, ComPduIdRef=pduTrig_AVL_RPM_WHL_pduPort_EPS_A_FlexRay_IN_55c86d41_4f391dd1
        AVL_STMOM_DV_ACT_19255f18: ComIPduDirection=SEND, ComIPduSignalGroupRef=sigGroup_AVL_STMOM_DV_ACT_744f32e2, ComPduIdRef=pduTrig_AVL_STMOM_DV_ACT_pduPort_EPS_A_FlexRay_OUT_55c86d41_4f391dd1
          ComTxIPdu: ComTxIPduUnusedAreasDefault=255
            ComTxModeTrue
              ComTxMode: ComTxModeMode=PERIODIC, ComTxModeTimePeriod=0.01
        A_TEMP_19255f18: ComIPduDirection=RECEIVE, ComIPduSignalRef=TEMP_EX_4b857050, ComPduIdRef=pduTrig_A_TEMP_pduPort_EPS_A_FlexRay_IN_55c86d41_4f391dd1
        CON_VEH_19255f18: ComIPduDirection=RECEIVE, ComIPduSignalGroupRef=sigGroup_CON_VEH_675e7344, ComPduIdRef=pduTrig_CON_VEH_pduPort_EPS_A_FlexRay_IN_55c86d41_4f391dd1
        CTR_DIAG_OBD_DRDY_19255f18: ComIPduDirection=RECEIVE, ComIPduSignalRef=RQ_RST_OBD_DIAG_DRDY_85fd80d4, ComPduIdRef=pduTrig_CTR_DIAG_OBD_DRDY_pduPort_EPS_A_FlexRay_IN_55c86d41_4f391dd1
        CTR_VIB_STW_DISP_EXMI_SP2015_19255f18: ComIPduDirection=RECEIVE, ComIPduSignalRef=CTR_WARN_DIR_VIB_EPS_66c73f8f, ComIPduSignalRef=CTR_WARN_ILVL_VIB_EPS_66c73f8f, ComIPduSignalRef=CTR_WARN_PTRN_VIB_EPS_66c73f8f, ComPduIdRef=pduTrig_CTR_VIB_STW_DISP_EXMI_SP2015_pduPort_EPS_A_FlexRay_IN_55c86d41_4f391dd1
        DBG_EPS_BS_MOD_58_BYTE_19255f18: ComIPduDirection=SEND, ComIPduSignalRef=BATT_VLTG_EPS_df324712, ComIPduSignalRef=DBG_EPS_BS_MOD_58_BYTE_ID2_df324712, ComIPduSignalRef=ECU_TEMP_EPS_df324712, ComIPduSignalRef=ESTIMD_PEAK_MOT_CURR_EPS_df324712, ComIPduSignalRef=MOT_FET_TEMP_EPS_df324712, ComIPduSignalRef=MOT_MAG_TEMP_EPS_df324712, ComIPduSignalRef=MOT_TQ_CMD_EPS_df324712, ComIPduSignalRef=MOT_TQ_CMD_LIMD_EPS_df324712, ComIPduSignalRef=MOT_VEL_EPS_df324712, ComIPduSignalRef=MOT_WIDG_TEMP_EPS_df324712, ComIPduSignalRef=PRIM_HW_TQ_SNSR_VLTG_EPS_df324712, ComIPduSignalRef=SECDRY_HW_TQ_SNSR_VLTG_EPS_df324712, ComIPduSignalRef=ST_CON_VEH_EPS_df324712, ComIPduSignalRef=SYS_ST_EPS_df324712, ComIPduSignalRef=VEH_SPD_EPS_df324712, ComPduIdRef=pduTrig_DBG_EPS_BS_MOD_58_BYTE_pduPort_EPS_A_FlexRay_OUT_55c86d41_4f391dd1
          ComTxIPdu: ComTxIPduUnusedAreasDefault=255
            ComTxModeTrue
              ComTxMode: ComTxModeMode=PERIODIC, ComTxModeTimePeriod=0.02
        DBG_EPS_MOD_EXT_120_BYTE_19255f18: ComIPduDirection=SEND, ComIPduSignalRef=DBG_EPS_MOD_EXT_120_BYTE_58e47270, ComIPduSignalRef=DBG_EPS_MOD_EXT_120_BYTE_ID2_58e47270, ComPduIdRef=pduTrig_DBG_EPS_MOD_EXT_120_BYTE_pduPort_EPS_A_FlexRay_OUT_55c86d41_4f391dd1
          ComTxIPdu: ComTxIPduUnusedAreasDefault=255
            ComTxModeTrue
              ComTxMode: ComTxModeMode=PERIODIC, ComTxModeTimePeriod=0.005
        DIAG_OBD_ENG_19255f18: ComIPduDirection=RECEIVE, ComIPduSignalRef=ST_OBD_CYC_f0d11ff9, ComPduIdRef=pduTrig_DIAG_OBD_ENG_pduPort_EPS_A_FlexRay_IN_55c86d41_4f391dd1
        DISP_CC_EPS_19255f18: ComIPduDirection=SEND, ComIPduSignalGroupRef=sigGroup_DISP_CC_EPS_ad160a0a, ComPduIdRef=pduTrig_DISP_CC_EPS_pduPort_EPS_A_FlexRay_OUT_55c86d41_4f391dd1
          ComTxIPdu: ComMinimumDelayTime=0.06, ComTxIPduUnusedAreasDefault=255
            ComTxModeTrue
              ComTxMode: ComTxModeMode=MIXED, ComTxModeNumberOfRepetitions=0, ComTxModeTimePeriod=0.32
        DT_EST_19255f18: ComIPduDirection=SEND, ComIPduSignalGroupRef=sigGroup_DT_EST_68b5ac35, ComPduIdRef=pduTrig_DT_EST_pduPort_EPS_A_FlexRay_OUT_55c86d41_4f391dd1
          ComTxIPdu: ComTxIPduUnusedAreasDefault=255
            ComTxModeTrue
              ComTxMode: ComTxModeMode=PERIODIC, ComTxModeTimePeriod=0.01
        ENERG_DGR_DRDY_19255f18: ComIPduDirection=RECEIVE, ComIPduSignalGroupRef=sigGroup_ENERG_DGR_DRDY_3f76efd3, ComPduIdRef=pduTrig_ENERG_DGR_DRDY_pduPort_EPS_A_FlexRay_IN_55c86d41_4f391dd1
        ENGTORQ_EPS_19255f18: ComIPduDirection=SEND, ComIPduSignalRef=TRGG_ENGTORQ_EPS_4e565a26, ComPduIdRef=pduTrig_ENGTORQ_EPS_pduPort_EPS_A_FlexRay_OUT_55c86d41_4f391dd1
          ComTxIPdu: ComTxIPduUnusedAreasDefault=255
            ComTxModeTrue
              ComTxMode: ComTxModeMode=PERIODIC, ComTxModeTimePeriod=0.01
        ENSU_SFY_19255f18: ComIPduDirection=RECEIVE, ComIPduSignalGroupRef=sigGroup_ENSU_SFY_dfa36b36, ComPduIdRef=pduTrig_ENSU_SFY_pduPort_EPS_A_FlexRay_IN_55c86d41_4f391dd1
        ERRM_BN_U_19255f18: ComIPduDirection=RECEIVE, ComIPduSignalRef=CTR_ERRM_BN_U_d46c15e6, ComPduIdRef=pduTrig_ERRM_BN_U_pduPort_EPS_A_FlexRay_IN_55c86d41_4f391dd1
        FAHRGESTELLNUMMER_19255f18: ComIPduDirection=RECEIVE, ComIPduSignalRef=NO_VECH_1_13b7b7e4, ComIPduSignalRef=NO_VECH_2_13b7b7e4, ComIPduSignalRef=NO_VECH_3_13b7b7e4, ComIPduSignalRef=NO_VECH_4_13b7b7e4, ComIPduSignalRef=NO_VECH_5_13b7b7e4, ComIPduSignalRef=NO_VECH_6_13b7b7e4, ComIPduSignalRef=NO_VECH_7_13b7b7e4, ComPduIdRef=pduTrig_FAHRGESTELLNUMMER_pduPort_EPS_A_FlexRay_IN_55c86d41_4f391dd1
        FZZSTD_19255f18: ComIPduDirection=RECEIVE, ComIPduSignalRef=ST_ENERG_FZM_e7ce1a0c, ComIPduSignalRef=ST_ILK_ERRM_FZM_e7ce1a0c, ComPduIdRef=pduTrig_FZZSTD_pduPort_EPS_A_FlexRay_IN_55c86d41_4f391dd1
        KILOMETERSTAND_19255f18: ComIPduDirection=RECEIVE, ComIPduSignalRef=MILE_KM_a6dd5496, ComPduIdRef=pduTrig_KILOMETERSTAND_pduPort_EPS_A_FlexRay_IN_55c86d41_4f391dd1
        OFFS_QUAD_EPS_19255f18: ComIPduDirection=RECEIVE, ComIPduSignalGroupRef=sigGroup_OFFS_QUAD_EPS_cc150a52, ComPduIdRef=pduTrig_OFFS_QUAD_EPS_pduPort_EPS_A_FlexRay_IN_55c86d41_4f391dd1
        RELATIVZEIT_19255f18: ComIPduDirection=RECEIVE, ComIPduSignalRef=T_SEC_COU_REL_0b27fbfe, ComPduIdRef=pduTrig_RELATIVZEIT_pduPort_EPS_A_FlexRay_IN_55c86d41_4f391dd1
        RQ_STG_EFAN_19255f18: ComIPduDirection=SEND, ComIPduSignalRef=ID_FN_RQ_STG_EFAN_862c1b6d, ComIPduSignalRef=ID_TEMP_CPO_HET_MNG_862c1b6d, ComIPduSignalRef=RQ_STG_EFAN_862c1b6d, ComIPduSignalRef=RQ_STG_EFAN_ID2_862c1b6d, ComIPduSignalRef=TEMP_CPO_HET_MNG_862c1b6d, ComPduIdRef=pduTrig_RQ_STG_EFAN_pduPort_EPS_A_FlexRay_OUT_55c86d41_4f391dd1
          ComTxIPdu: ComTxIPduUnusedAreasDefault=255
            ComTxModeTrue
              ComTxMode: ComTxModeMode=PERIODIC, ComTxModeTimePeriod=1
        SECU_CHAL_19255f18: ComIPduDirection=SEND, ComIPduSignalRef=SECU_CHAL_5fff8d6b, ComIPduSignalRef=SECU_CHAL_ID2_5fff8d6b, ComIPduSignalRef=SSS_IDENT_CHAL_5fff8d6b, ComIPduSignalRef=SSV_IDENT_CHAL_5fff8d6b, ComPduIdRef=pduTrig_SECU_CHAL_pduPort_EPS_A_FlexRay_OUT_55c86d41_4f391dd1
          ComTxIPdu: ComMinimumDelayTime=0.05, ComTxIPduUnusedAreasDefault=255
            ComTxModeTrue
              ComTxMode: ComTxModeMode=DIRECT, ComTxModeNumberOfRepetitions=0
        SECU_FAHRGESTELLNUMMER_19255f18: ComIPduDirection=RECEIVE, ComIPduSignalRef=STU_8_BYTE_347be560, ComPduIdRef=pduTrig_SECU_FAHRGESTELLNUMMER_pduPort_EPS_A_FlexRay_IN_55c86d41_4f391dd1
        SECU_RESP_19255f18: ComIPduDirection=RECEIVE, ComIPduSignalRef=COU_BS_RESP_d377025e, ComIPduSignalRef=SECU_RESP_ID2_d377025e, ComIPduSignalRef=SSV_IDENT_RESP_d377025e, ComIPduSignalRef=STU_RESP_d377025e, ComPduIdRef=pduTrig_SECU_RESP_pduPort_EPS_A_FlexRay_IN_55c86d41_4f391dd1
        STEA_OFFS_19255f18: ComIPduDirection=RECEIVE, ComIPduSignalRef=AVL_STEA_PNI_OFFS_9678c0e9, ComPduIdRef=pduTrig_STEA_OFFS_pduPort_EPS_A_FlexRay_IN_55c86d41_4f391dd1
        ST_CENG_19255f18: ComIPduDirection=RECEIVE, ComIPduSignalRef=ALIV_ST_CENG_43f592b4, ComIPduSignalRef=ST_ANO_MSA_ENG_STOP_43f592b4, ComIPduSignalRef=ST_CENG_DRV_43f592b4, ComIPduSignalRef=ST_ENERG_SUPY_43f592b4, ComIPduSignalRef=ST_MOT_DRV_43f592b4, ComIPduSignalRef=ST_UDP_43f592b4, ComPduIdRef=pduTrig_ST_CENG_pduPort_EPS_A_FlexRay_IN_55c86d41_4f391dd1
        ST_DIAG_OBD_3_DRDY_19255f18: ComIPduDirection=SEND, ComIPduSignalRef=ALIV_ST_DIAG_OBD_3_DRDY_65e49c1b, ComIPduSignalRef=DIAG_ST_OBD_3_DRDY_1_65e49c1b, ComIPduSignalRef=DIAG_ST_OBD_3_DRDY_2_65e49c1b, ComIPduSignalRef=DIAG_ST_OBD_3_DRDY_3_65e49c1b, ComIPduSignalRef=DIAG_ST_OBD_3_DRDY_4_65e49c1b, ComIPduSignalRef=DIAG_ST_OBD_3_DRDY_5_65e49c1b, ComIPduSignalRef=DIAG_ST_OBD_3_DRDY_6_65e49c1b, ComIPduSignalRef=DIAG_ST_OBD_3_DRDY_7_65e49c1b, ComIPduSignalRef=DIAG_ST_OBD_3_DRDY_8_65e49c1b, ComIPduSignalRef=ST_DIAG_OBD_3_DRDY_IMME_MUX_65e49c1b, ComIPduSignalRef=ST_DIAG_OBD_3_DRDY_MAX_MUX_65e49c1b, ComPduIdRef=pduTrig_ST_DIAG_OBD_3_DRDY_pduPort_EPS_A_FlexRay_OUT_55c86d41_4f391dd1
          ComTxIPdu: ComMinimumDelayTime=0.16, ComTxIPduUnusedAreasDefault=255
            ComTxModeTrue
              ComTxMode: ComTxModeMode=DIRECT, ComTxModeNumberOfRepetitions=0
        ST_ENERG_GEN_19255f18: ComIPduDirection=RECEIVE, ComIPduSignalRef=ST_LDREL_GEN_3319a82a, ComIPduSignalRef=ST_SEP_STOR_3319a82a, ComPduIdRef=pduTrig_ST_ENERG_GEN_pduPort_EPS_A_FlexRay_IN_55c86d41_4f391dd1
        ST_EST_19255f18: ComIPduDirection=SEND, ComIPduSignalGroupRef=sigGroup_ST_EST_76669e16, ComPduIdRef=pduTrig_ST_EST_pduPort_EPS_A_FlexRay_OUT_55c86d41_4f391dd1
          ComTxIPdu: ComMinimumDelayTime=0.05, ComTxIPduUnusedAreasDefault=255
            ComTxModeTrue
              ComTxMode: ComTxModeMode=MIXED, ComTxModeNumberOfRepetitions=0, ComTxModeTimePeriod=0.5
        ST_STAB_DSC_19255f18: ComIPduDirection=RECEIVE, ComIPduSignalRef=QU_FN_FDR_d5c7d03c, ComPduIdRef=pduTrig_ST_STAB_DSC_pduPort_EPS_A_FlexRay_IN_55c86d41_4f391dd1
        SU_CLE_DRDY_DXP_19255f18: ComIPduDirection=RECEIVE, ComIPduSignalRef=FACT_MO_STE_SO_DXP_59dc6376, ComIPduSignalRef=SU_CLU_STMOM_SFE_DXP_59dc6376, ComPduIdRef=pduTrig_SU_CLE_DRDY_DXP_pduPort_EPS_A_FlexRay_IN_55c86d41_4f391dd1
        SU_EPS_19255f18: ComIPduDirection=SEND, ComIPduSignalGroupRef=sigGroup_SU_EPS_fe4f71c6, ComPduIdRef=pduTrig_SU_EPS_pduPort_EPS_A_FlexRay_OUT_55c86d41_4f391dd1
          ComTxIPdu: ComMinimumDelayTime=0.5, ComTxIPduUnusedAreasDefault=255
            ComTxModeTrue
              ComTxMode: ComTxModeMode=MIXED, ComTxModeNumberOfRepetitions=2, ComTxModeRepetitionPeriod=0.5, ComTxModeTimePeriod=5
        TAR_ESTP_VIRT_FTAX_19255f18: ComIPduDirection=RECEIVE, ComIPduSignalGroupRef=sigGroup_TAR_ESTP_VIRT_FTAX_7f6c789c, ComPduIdRef=pduTrig_TAR_ESTP_VIRT_FTAX_pduPort_EPS_A_FlexRay_IN_55c86d41_4f391dd1
        TAR_QTA_STRMOM_DV_19255f18: ComIPduDirection=RECEIVE, ComIPduSignalGroupRef=sigGroup_TAR_QTA_STRMOM_DV_231dfb08, ComPduIdRef=pduTrig_TAR_QTA_STRMOM_DV_pduPort_EPS_A_FlexRay_IN_55c86d41_4f391dd1
        TAR_STMOM_DV_ACT_19255f18: ComIPduDirection=RECEIVE, ComIPduSignalGroupRef=sigGroup_TAR_STMOM_DV_ACT_9a7b28d3, ComPduIdRef=pduTrig_TAR_STMOM_DV_ACT_pduPort_EPS_A_FlexRay_IN_55c86d41_4f391dd1
        VYAW_VEH_19255f18: ComIPduDirection=RECEIVE, ComIPduSignalGroupRef=sigGroup_VYAW_VEH_fc66be94, ComPduIdRef=pduTrig_VYAW_VEH_pduPort_EPS_A_FlexRay_IN_55c86d41_4f391dd1
        V_VEH_19255f18: ComIPduDirection=RECEIVE, ComIPduSignalGroupRef=sigGroup_V_VEH_2fe00c20, ComPduIdRef=pduTrig_V_VEH_pduPort_EPS_A_FlexRay_IN_55c86d41_4f391dd1
      77 x ComSignal:
        ALIV_ST_CENG_43f592b4: ComBitPosition=8, ComBitSize=4, ComSignalDataInvalidValue=15, ComSignalEndianness=LITTLE_ENDIAN, ComSignalType=UINT8, ComSystemTemplateSystemSignalRef=ALIV_ST_CENG
        ALIV_ST_DIAG_OBD_3_DRDY_65e49c1b: ComBitPosition=0, ComBitSize=4, ComSignalDataInvalidValue=15, ComSignalEndianness=LITTLE_ENDIAN, ComSignalType=UINT8, ComTransferProperty=TRIGGERED_ON_CHANGE, ComSystemTemplateSystemSignalRef=ALIV_ST_DIAG_OBD_3_DRDY
        ANFRAGE_ID2_fbd80461_In: ComBitPosition=0, ComBitSize=8, ComSignalEndianness=LITTLE_ENDIAN, ComSignalInitValue=1, ComSignalType=UINT8, ComSystemTemplateSystemSignalRef=ANFRAGE_ID2
        ANFRAGE_ID2_fbd80461_Out: ComBitPosition=0, ComBitSize=8, ComSignalEndianness=LITTLE_ENDIAN, ComSignalInitValue=1, ComSignalType=UINT8, ComTransferProperty=PENDING, ComSystemTemplateSystemSignalRef=ANFRAGE_ID2
        AVL_STEA_PNI_OFFS_9678c0e9: ComBitPosition=36, ComBitSize=12, ComSignalDataInvalidValue=4095, ComSignalEndianness=LITTLE_ENDIAN, ComSignalType=UINT16, ComSystemTemplateSystemSignalRef=AVL_STEA_PNI_OFFS
        BATT_VLTG_EPS_df324712: ComBitPosition=32, ComBitSize=16, ComSignalEndianness=LITTLE_ENDIAN, ComSignalType=UINT16, ComSystemTemplateSystemSignalRef=BATT_VLTG_EPS
        COU_BS_RESP_d377025e: ComBitPosition=16, ComBitSize=24, ComSignalDataInvalidValue=16777215, ComSignalEndianness=LITTLE_ENDIAN, ComSignalType=UINT32, ComSystemTemplateSystemSignalRef=COU_BS_RESP
        CTR_ERRM_BN_U_d46c15e6: ComBitPosition=0, ComBitSize=6, ComSignalDataInvalidValue=63, ComSignalEndianness=LITTLE_ENDIAN, ComSignalType=UINT8, ComSystemTemplateSystemSignalRef=CTR_ERRM_BN_U
        CTR_WARN_DIR_VIB_EPS_66c73f8f: ComBitPosition=54, ComBitSize=2, ComSignalDataInvalidValue=3, ComSignalEndianness=LITTLE_ENDIAN, ComSignalType=UINT8, ComSystemTemplateSystemSignalRef=CTR_WARN_DIR_VIB_EPS
        CTR_WARN_ILVL_VIB_EPS_66c73f8f: ComBitPosition=56, ComBitSize=4, ComSignalDataInvalidValue=15, ComSignalEndianness=LITTLE_ENDIAN, ComSignalType=UINT8, ComSystemTemplateSystemSignalRef=CTR_WARN_ILVL_VIB_EPS
        CTR_WARN_PTRN_VIB_EPS_66c73f8f: ComBitPosition=36, ComBitSize=4, ComSignalDataInvalidValue=15, ComSignalEndianness=LITTLE_ENDIAN, ComSignalType=UINT8, ComSystemTemplateSystemSignalRef=CTR_WARN_PTRN_VIB_EPS
        DBG_EPS_BS_MOD_58_BYTE_ID2_df324712: ComBitPosition=0, ComBitSize=8, ComSignalEndianness=LITTLE_ENDIAN, ComSignalInitValue=1, ComSignalType=UINT8, ComTransferProperty=PENDING, ComSystemTemplateSystemSignalRef=DBG_EPS_BS_MOD_58_BYTE_ID2
        DBG_EPS_MOD_EXT_120_BYTE_58e47270: ComBitPosition=8, ComBitSize=8, ComSignalEndianness=LITTLE_ENDIAN, ComSignalType=UINT8, ComSystemTemplateSystemSignalRef=DBG_EPS_MOD_EXT_120_BYTE
        DBG_EPS_MOD_EXT_120_BYTE_ID2_58e47270: ComBitPosition=0, ComBitSize=8, ComSignalEndianness=LITTLE_ENDIAN, ComSignalInitValue=2, ComSignalType=UINT8, ComTransferProperty=PENDING, ComSystemTemplateSystemSignalRef=DBG_EPS_MOD_EXT_120_BYTE_ID2
        DIAG_ST_OBD_3_DRDY_1_65e49c1b: ComBitPosition=16, ComBitSize=6, ComSignalDataInvalidValue=63, ComSignalEndianness=LITTLE_ENDIAN, ComSignalType=UINT8, ComTransferProperty=TRIGGERED_ON_CHANGE, ComSystemTemplateSystemSignalRef=DIAG_ST_OBD_3_DRDY_1
        DIAG_ST_OBD_3_DRDY_2_65e49c1b: ComBitPosition=22, ComBitSize=6, ComSignalDataInvalidValue=63, ComSignalEndianness=LITTLE_ENDIAN, ComSignalType=UINT8, ComTransferProperty=TRIGGERED_ON_CHANGE, ComSystemTemplateSystemSignalRef=DIAG_ST_OBD_3_DRDY_2
        DIAG_ST_OBD_3_DRDY_3_65e49c1b: ComBitPosition=28, ComBitSize=6, ComSignalDataInvalidValue=63, ComSignalEndianness=LITTLE_ENDIAN, ComSignalType=UINT8, ComTransferProperty=TRIGGERED_ON_CHANGE, ComSystemTemplateSystemSignalRef=DIAG_ST_OBD_3_DRDY_3
        DIAG_ST_OBD_3_DRDY_4_65e49c1b: ComBitPosition=34, ComBitSize=6, ComSignalDataInvalidValue=63, ComSignalEndianness=LITTLE_ENDIAN, ComSignalType=UINT8, ComTransferProperty=TRIGGERED_ON_CHANGE, ComSystemTemplateSystemSignalRef=DIAG_ST_OBD_3_DRDY_4
        DIAG_ST_OBD_3_DRDY_5_65e49c1b: ComBitPosition=40, ComBitSize=6, ComSignalDataInvalidValue=63, ComSignalEndianness=LITTLE_ENDIAN, ComSignalType=UINT8, ComTransferProperty=TRIGGERED_ON_CHANGE, ComSystemTemplateSystemSignalRef=DIAG_ST_OBD_3_DRDY_5
        DIAG_ST_OBD_3_DRDY_6_65e49c1b: ComBitPosition=46, ComBitSize=6, ComSignalDataInvalidValue=63, ComSignalEndianness=LITTLE_ENDIAN, ComSignalType=UINT8, ComTransferProperty=TRIGGERED_ON_CHANGE, ComSystemTemplateSystemSignalRef=DIAG_ST_OBD_3_DRDY_6
        DIAG_ST_OBD_3_DRDY_7_65e49c1b: ComBitPosition=52, ComBitSize=6, ComSignalDataInvalidValue=63, ComSignalEndianness=LITTLE_ENDIAN, ComSignalType=UINT8, ComTransferProperty=TRIGGERED_ON_CHANGE, ComSystemTemplateSystemSignalRef=DIAG_ST_OBD_3_DRDY_7
        DIAG_ST_OBD_3_DRDY_8_65e49c1b: ComBitPosition=58, ComBitSize=6, ComSignalDataInvalidValue=63, ComSignalEndianness=LITTLE_ENDIAN, ComSignalType=UINT8, ComTransferProperty=TRIGGERED_ON_CHANGE, ComSystemTemplateSystemSignalRef=DIAG_ST_OBD_3_DRDY_8
        ECU_TEMP_EPS_df324712: ComBitPosition=120, ComBitSize=8, ComSignalEndianness=LITTLE_ENDIAN, ComSignalType=UINT8, ComSystemTemplateSystemSignalRef=ECU_TEMP_EPS
        ESTIMD_PEAK_MOT_CURR_EPS_df324712: ComBitPosition=48, ComBitSize=24, ComSignalEndianness=LITTLE_ENDIAN, ComSignalType=UINT32, ComSystemTemplateSystemSignalRef=ESTIMD_PEAK_MOT_CURR_EPS
        FACT_MO_STE_SO_DXP_59dc6376: ComBitPosition=16, ComBitSize=8, ComSignalDataInvalidValue=255, ComSignalEndianness=LITTLE_ENDIAN, ComSignalType=UINT8, ComSystemTemplateSystemSignalRef=FACT_MO_STE_SO_DXP
        ID_FN_INQY_fbd80461_In: ComBitPosition=8, ComBitSize=16, ComSignalDataInvalidValue=65535, ComSignalEndianness=LITTLE_ENDIAN, ComSignalType=UINT16, ComSystemTemplateSystemSignalRef=ID_FN_INQY
        ID_FN_INQY_fbd80461_Out: ComBitPosition=8, ComBitSize=16, ComSignalDataInvalidValue=65535, ComSignalEndianness=LITTLE_ENDIAN, ComSignalType=UINT16, ComSystemTemplateSystemSignalRef=ID_FN_INQY
        ID_FN_RQ_STG_EFAN_862c1b6d: ComBitPosition=8, ComBitSize=8, ComSignalDataInvalidValue=255, ComSignalEndianness=LITTLE_ENDIAN, ComSignalType=UINT8, ComSystemTemplateSystemSignalRef=ID_FN_RQ_STG_EFAN
        ID_TEMP_CPO_HET_MNG_862c1b6d: ComBitPosition=20, ComBitSize=4, ComSignalDataInvalidValue=15, ComSignalEndianness=LITTLE_ENDIAN, ComSignalType=UINT8, ComSystemTemplateSystemSignalRef=ID_TEMP_CPO_HET_MNG
        MILE_KM_a6dd5496: ComBitPosition=0, ComBitSize=24, ComSignalDataInvalidValue=16777215, ComSignalEndianness=LITTLE_ENDIAN, ComSignalType=UINT32, ComSystemTemplateSystemSignalRef=MILE_KM
        MOT_FET_TEMP_EPS_df324712: ComBitPosition=128, ComBitSize=8, ComSignalEndianness=LITTLE_ENDIAN, ComSignalType=UINT8, ComSystemTemplateSystemSignalRef=MOT_FET_TEMP_EPS
        MOT_MAG_TEMP_EPS_df324712: ComBitPosition=136, ComBitSize=8, ComSignalEndianness=LITTLE_ENDIAN, ComSignalType=UINT8, ComSystemTemplateSystemSignalRef=MOT_MAG_TEMP_EPS
        MOT_TQ_CMD_EPS_df324712: ComBitPosition=160, ComBitSize=16, ComSignalEndianness=LITTLE_ENDIAN, ComSignalType=UINT16, ComSystemTemplateSystemSignalRef=MOT_TQ_CMD_EPS
        MOT_TQ_CMD_LIMD_EPS_df324712: ComBitPosition=88, ComBitSize=16, ComSignalEndianness=LITTLE_ENDIAN, ComSignalType=UINT16, ComSystemTemplateSystemSignalRef=MOT_TQ_CMD_LIMD_EPS
        MOT_VEL_EPS_df324712: ComBitPosition=72, ComBitSize=16, ComSignalEndianness=LITTLE_ENDIAN, ComSignalType=UINT16, ComSystemTemplateSystemSignalRef=MOT_VEL_EPS
        MOT_WIDG_TEMP_EPS_df324712: ComBitPosition=144, ComBitSize=16, ComSignalEndianness=LITTLE_ENDIAN, ComSignalType=UINT16, ComSystemTemplateSystemSignalRef=MOT_WIDG_TEMP_EPS
        NO_VECH_1_13b7b7e4: ComBitPosition=0, ComSignalDataInvalidValue=255, ComSignalEndianness=opaque, ComSignalLength=1, ComSignalType=UINT8_N, ComSystemTemplateSystemSignalRef=NO_VECH_1
        NO_VECH_2_13b7b7e4: ComBitPosition=8, ComSignalDataInvalidValue=255, ComSignalEndianness=opaque, ComSignalLength=1, ComSignalType=UINT8_N, ComSystemTemplateSystemSignalRef=NO_VECH_2
        NO_VECH_3_13b7b7e4: ComBitPosition=16, ComSignalDataInvalidValue=255, ComSignalEndianness=opaque, ComSignalLength=1, ComSignalType=UINT8_N, ComSystemTemplateSystemSignalRef=NO_VECH_3
        NO_VECH_4_13b7b7e4: ComBitPosition=24, ComSignalDataInvalidValue=255, ComSignalEndianness=opaque, ComSignalLength=1, ComSignalType=UINT8_N, ComSystemTemplateSystemSignalRef=NO_VECH_4
        NO_VECH_5_13b7b7e4: ComBitPosition=32, ComSignalDataInvalidValue=255, ComSignalEndianness=opaque, ComSignalLength=1, ComSignalType=UINT8_N, ComSystemTemplateSystemSignalRef=NO_VECH_5
        NO_VECH_6_13b7b7e4: ComBitPosition=40, ComSignalDataInvalidValue=255, ComSignalEndianness=opaque, ComSignalLength=1, ComSignalType=UINT8_N, ComSystemTemplateSystemSignalRef=NO_VECH_6
        NO_VECH_7_13b7b7e4: ComBitPosition=48, ComSignalDataInvalidValue=255, ComSignalEndianness=opaque, ComSignalLength=1, ComSignalType=UINT8_N, ComSystemTemplateSystemSignalRef=NO_VECH_7
        PRIM_HW_TQ_SNSR_VLTG_EPS_df324712: ComBitPosition=104, ComBitSize=8, ComSignalEndianness=LITTLE_ENDIAN, ComSignalType=UINT8, ComSystemTemplateSystemSignalRef=PRIM_HW_TQ_SNSR_VLTG_EPS
        QU_FN_FDR_d5c7d03c: ComBitPosition=16, ComBitSize=12, ComSignalDataInvalidValue=4095, ComSignalEndianness=LITTLE_ENDIAN, ComSignalType=UINT16, ComSystemTemplateSystemSignalRef=QU_FN_FDR
        RQ_RST_OBD_DIAG_DRDY_85fd80d4: ComBitPosition=2, ComBitSize=2, ComSignalDataInvalidValue=3, ComSignalEndianness=LITTLE_ENDIAN, ComSignalType=UINT8, ComSystemTemplateSystemSignalRef=RQ_RST_OBD_DIAG_DRDY
        RQ_STG_EFAN_862c1b6d: ComBitPosition=16, ComBitSize=4, ComSignalDataInvalidValue=15, ComSignalEndianness=LITTLE_ENDIAN, ComSignalType=UINT8, ComSystemTemplateSystemSignalRef=RQ_STG_EFAN
        RQ_STG_EFAN_ID2_862c1b6d: ComBitPosition=0, ComBitSize=8, ComSignalEndianness=LITTLE_ENDIAN, ComSignalInitValue=21, ComSignalType=UINT8, ComTransferProperty=PENDING, ComSystemTemplateSystemSignalRef=RQ_STG_EFAN_ID2
        SECDRY_HW_TQ_SNSR_VLTG_EPS_df324712: ComBitPosition=112, ComBitSize=8, ComSignalEndianness=LITTLE_ENDIAN, ComSignalType=UINT8, ComSystemTemplateSystemSignalRef=SECDRY_HW_TQ_SNSR_VLTG_EPS
        SECU_CHAL_5fff8d6b: ComBitPosition=24, ComBitSize=40, ComSignalDataInvalidValue=1099511627775, ComSignalEndianness=LITTLE_ENDIAN, ComSignalType=UINT64, ComSystemTemplateSystemSignalRef=SECU_CHAL
        SECU_CHAL_ID2_5fff8d6b: ComBitPosition=0, ComBitSize=8, ComSignalEndianness=LITTLE_ENDIAN, ComSignalInitValue=248, ComSignalType=UINT8, ComTransferProperty=PENDING, ComSystemTemplateSystemSignalRef=SECU_CHAL_ID2
        SECU_RESP_ID2_d377025e: ComBitPosition=0, ComBitSize=8, ComSignalEndianness=LITTLE_ENDIAN, ComSignalInitValue=247, ComSignalType=UINT8, ComSystemTemplateSystemSignalRef=SECU_RESP_ID2
        SSS_IDENT_CHAL_5fff8d6b: ComBitPosition=16, ComBitSize=8, ComSignalDataInvalidValue=255, ComSignalEndianness=LITTLE_ENDIAN, ComSignalType=UINT8, ComSystemTemplateSystemSignalRef=SSS_IDENT_CHAL
        SSV_IDENT_CHAL_5fff8d6b: ComBitPosition=8, ComBitSize=8, ComSignalDataInvalidValue=255, ComSignalEndianness=LITTLE_ENDIAN, ComSignalType=UINT8, ComSystemTemplateSystemSignalRef=SSV_IDENT_CHAL
        SSV_IDENT_RESP_d377025e: ComBitPosition=8, ComBitSize=8, ComSignalDataInvalidValue=255, ComSignalEndianness=LITTLE_ENDIAN, ComSignalType=UINT8, ComSystemTemplateSystemSignalRef=SSV_IDENT_RESP
        STU_8_BYTE_347be560: ComBitPosition=0, ComBitSize=64, ComSignalDataInvalidValue=18446744073709552000, ComSignalEndianness=LITTLE_ENDIAN, ComSignalType=UINT64, ComSystemTemplateSystemSignalRef=STU_8_BYTE
        STU_RESP_d377025e: ComBitPosition=40, ComBitSize=24, ComSignalDataInvalidValue=16777215, ComSignalEndianness=LITTLE_ENDIAN, ComSignalType=UINT32, ComSystemTemplateSystemSignalRef=STU_RESP
        ST_ANO_MSA_ENG_STOP_43f592b4: ComBitPosition=34, ComBitSize=2, ComSignalDataInvalidValue=3, ComSignalEndianness=LITTLE_ENDIAN, ComSignalType=UINT8, ComSystemTemplateSystemSignalRef=ST_ANO_MSA_ENG_STOP
        ST_CENG_DRV_43f592b4: ComBitPosition=16, ComBitSize=4, ComSignalDataInvalidValue=15, ComSignalEndianness=LITTLE_ENDIAN, ComSignalType=UINT8, ComSystemTemplateSystemSignalRef=ST_CENG_DRV
        ST_CON_VEH_EPS_df324712: ComBitPosition=12, ComBitSize=4, ComSignalEndianness=LITTLE_ENDIAN, ComSignalType=UINT8, ComSystemTemplateSystemSignalRef=ST_CON_VEH_EPS
        ST_DIAG_OBD_3_DRDY_IMME_MUX_65e49c1b: ComBitPosition=10, ComBitSize=6, ComSignalDataInvalidValue=63, ComSignalEndianness=LITTLE_ENDIAN, ComSignalType=UINT8, ComTransferProperty=TRIGGERED_ON_CHANGE, ComSystemTemplateSystemSignalRef=ST_DIAG_OBD_3_DRDY_IMME_MUX
        ST_DIAG_OBD_3_DRDY_MAX_MUX_65e49c1b: ComBitPosition=4, ComBitSize=6, ComSignalDataInvalidValue=63, ComSignalEndianness=LITTLE_ENDIAN, ComSignalType=UINT8, ComTransferProperty=TRIGGERED_ON_CHANGE, ComSystemTemplateSystemSignalRef=ST_DIAG_OBD_3_DRDY_MAX_MUX
        ST_ENERG_FZM_e7ce1a0c: ComBitPosition=16, ComBitSize=4, ComSignalDataInvalidValue=15, ComSignalEndianness=LITTLE_ENDIAN, ComSignalType=UINT8, ComSystemTemplateSystemSignalRef=ST_ENERG_FZM
        ST_ENERG_SUPY_43f592b4: ComBitPosition=24, ComBitSize=8, ComSignalDataInvalidValue=255, ComSignalEndianness=LITTLE_ENDIAN, ComSignalType=UINT8, ComSystemTemplateSystemSignalRef=ST_ENERG_SUPY
        ST_ILK_ERRM_FZM_e7ce1a0c: ComBitPosition=56, ComBitSize=2, ComSignalDataInvalidValue=3, ComSignalEndianness=LITTLE_ENDIAN, ComSignalType=UINT8, ComSystemTemplateSystemSignalRef=ST_ILK_ERRM_FZM
        ST_LDREL_GEN_3319a82a: ComBitPosition=56, ComBitSize=4, ComSignalDataInvalidValue=15, ComSignalEndianness=LITTLE_ENDIAN, ComSignalType=UINT8, ComSystemTemplateSystemSignalRef=ST_LDREL_GEN
        ST_MOT_DRV_43f592b4: ComBitPosition=32, ComBitSize=2, ComSignalDataInvalidValue=3, ComSignalEndianness=LITTLE_ENDIAN, ComSignalType=UINT8, ComSystemTemplateSystemSignalRef=ST_MOT_DRV
        ST_OBD_CYC_f0d11ff9: ComBitPosition=0, ComBitSize=6, ComSignalDataInvalidValue=63, ComSignalEndianness=LITTLE_ENDIAN, ComSignalType=UINT8, ComSystemTemplateSystemSignalRef=ST_OBD_CYC
        ST_SEP_STOR_3319a82a: ComBitPosition=40, ComBitSize=2, ComSignalDataInvalidValue=3, ComSignalEndianness=LITTLE_ENDIAN, ComSignalType=UINT8, ComSystemTemplateSystemSignalRef=ST_SEP_STOR
        ST_UDP_43f592b4: ComBitPosition=20, ComBitSize=4, ComSignalDataInvalidValue=15, ComSignalEndianness=LITTLE_ENDIAN, ComSignalType=UINT8, ComSystemTemplateSystemSignalRef=ST_UDP
        SU_CLU_STMOM_SFE_DXP_59dc6376: ComBitPosition=8, ComBitSize=4, ComSignalDataInvalidValue=15, ComSignalEndianness=LITTLE_ENDIAN, ComSignalType=UINT8, ComSystemTemplateSystemSignalRef=SU_CLU_STMOM_SFE_DXP
        SYS_ST_EPS_df324712: ComBitPosition=8, ComBitSize=4, ComSignalEndianness=LITTLE_ENDIAN, ComSignalType=UINT8, ComSystemTemplateSystemSignalRef=SYS_ST_EPS
        TEMP_CPO_HET_MNG_862c1b6d: ComBitPosition=24, ComBitSize=8, ComSignalDataInvalidValue=255, ComSignalEndianness=LITTLE_ENDIAN, ComSignalType=UINT8, ComSystemTemplateSystemSignalRef=TEMP_CPO_HET_MNG
        TEMP_EX_4b857050: ComBitPosition=0, ComBitSize=8, ComSignalDataInvalidValue=255, ComSignalEndianness=LITTLE_ENDIAN, ComSignalType=UINT8, ComSystemTemplateSystemSignalRef=TEMP_EX
        TRGG_ENGTORQ_EPS_4e565a26: ComBitPosition=16, ComBitSize=12, ComSignalDataInvalidValue=4095, ComSignalEndianness=LITTLE_ENDIAN, ComSignalType=UINT16, ComSystemTemplateSystemSignalRef=TRGG_ENGTORQ_EPS
        T_SEC_COU_REL_0b27fbfe: ComBitPosition=0, ComBitSize=32, ComSignalDataInvalidValue=4294967295, ComSignalEndianness=LITTLE_ENDIAN, ComSignalType=UINT32, ComSystemTemplateSystemSignalRef=T_SEC_COU_REL
        VEH_SPD_EPS_df324712: ComBitPosition=16, ComBitSize=16, ComSignalEndianness=LITTLE_ENDIAN, ComSignalType=UINT16, ComSystemTemplateSystemSignalRef=VEH_SPD_EPS
      18 x ComSignalGroup:
        sigGroup_ACLNY_MASSCNTR_461c64b1: ComSystemTemplateSignalGroupRef=sigGroup_ACLNY_MASSCNTR
          6 x ComGroupSignal, all with ComSignalEndianness=LITTLE_ENDIAN:
            ACLNY_COG_1311692d: ComBitPosition=16, ComBitSize=16, ComSignalDataInvalidValue=65535, ComSignalType=UINT16, ComSystemTemplateSystemSignalRef=ACLNY_COG
            ACLNY_COG_ERR_AMP_1311692d: ComBitPosition=32, ComBitSize=12, ComSignalDataInvalidValue=4095, ComSignalType=UINT16, ComSystemTemplateSystemSignalRef=ACLNY_COG_ERR_AMP
            ACLNY_MASSCNTR_dummy_12_15_1311692d: ComBitPosition=12, ComBitSize=4, ComSignalInitValue=15, ComSignalType=UINT8, ComSystemTemplateSystemSignalRef=ACLNY_MASSCNTR_dummy_12_15
            ALIV_ACLNY_COG_1311692d: ComBitPosition=8, ComBitSize=4, ComSignalDataInvalidValue=15, ComSignalType=UINT8, ComSystemTemplateSystemSignalRef=ALIV_ACLNY_COG
            CRC_ACLNY_COG_1311692d: ComBitPosition=0, ComBitSize=8, ComSignalType=UINT8, ComSystemTemplateSystemSignalRef=CRC_ACLNY_COG
            QU_ACLNY_COG_1311692d: ComBitPosition=44, ComBitSize=4, ComSignalDataInvalidValue=15, ComSignalType=UINT8, ComSystemTemplateSystemSignalRef=QU_ACLNY_COG
        sigGroup_AVL_FORC_GRD_19621f3f: ComSystemTemplateSignalGroupRef=sigGroup_AVL_FORC_GRD
          6 x ComGroupSignal, all with ComSignalEndianness=LITTLE_ENDIAN:
            ALIV_AVL_FORC_GRD_c0f3c255: ComBitPosition=8, ComBitSize=4, ComSignalDataInvalidValue=15, ComSignalType=UINT8, ComSystemTemplateSystemSignalRef=ALIV_AVL_FORC_GRD
            AVL_FORC_GRD_c0f3c255: ComBitPosition=16, ComBitSize=12, ComSignalDataInvalidValue=4095, ComSignalType=UINT16, ComSystemTemplateSystemSignalRef=AVL_FORC_GRD
            AVL_FORC_GRD_dummy_12_15_c0f3c255: ComBitPosition=12, ComBitSize=4, ComSignalInitValue=15, ComSignalType=UINT8, ComSystemTemplateSystemSignalRef=AVL_FORC_GRD_dummy_12_15
            AVL_PWR_EL_EPS_COOD_c0f3c255: ComBitPosition=32, ComBitSize=8, ComSignalDataInvalidValue=255, ComSignalType=UINT8, ComSystemTemplateSystemSignalRef=AVL_PWR_EL_EPS_COOD
            CRC_AVL_FORC_GRD_c0f3c255: ComBitPosition=0, ComBitSize=8, ComSignalType=UINT8, ComSystemTemplateSystemSignalRef=CRC_AVL_FORC_GRD
            QU_AVL_FORC_GRD_c0f3c255: ComBitPosition=28, ComBitSize=4, ComSignalDataInvalidValue=15, ComSignalType=UINT8, ComSystemTemplateSystemSignalRef=QU_AVL_FORC_GRD
        sigGroup_AVL_PO_EPS_290f0f6e: ComSystemTemplateSignalGroupRef=sigGroup_AVL_PO_EPS
          8 x ComGroupSignal, all with ComSignalEndianness=LITTLE_ENDIAN:
            ALIV_AVL_PO_EPS_4bf7fe20: ComBitPosition=8, ComBitSize=4, ComSignalDataInvalidValue=15, ComSignalType=UINT8, ComSystemTemplateSystemSignalRef=ALIV_AVL_PO_EPS
            AVL_PO_EPS_4bf7fe20: ComBitPosition=16, ComBitSize=16, ComSignalDataInvalidValue=65535, ComSignalType=UINT16, ComSystemTemplateSystemSignalRef=AVL_PO_EPS
            AVL_PO_IDX_EPS_4bf7fe20: ComBitPosition=32, ComBitSize=16, ComSignalDataInvalidValue=65535, ComSignalType=UINT16, ComSystemTemplateSystemSignalRef=AVL_PO_IDX_EPS
            CRC_AVL_PO_EPS_4bf7fe20: ComBitPosition=0, ComBitSize=8, ComSignalType=UINT8, ComSystemTemplateSystemSignalRef=CRC_AVL_PO_EPS
            IDX_TORQ_SEN_4bf7fe20: ComBitPosition=60, ComBitSize=2, ComSignalDataInvalidValue=3, ComSignalType=UINT8, ComSystemTemplateSystemSignalRef=IDX_TORQ_SEN
            OFFS_GRD_MID_EPS_4bf7fe20: ComBitPosition=48, ComBitSize=12, ComSignalDataInvalidValue=4095, ComSignalType=UINT16, ComSystemTemplateSystemSignalRef=OFFS_GRD_MID_EPS
            QU_AVL_PO_EPS_4bf7fe20: ComBitPosition=12, ComBitSize=4, ComSignalDataInvalidValue=15, ComSignalType=UINT8, ComSystemTemplateSystemSignalRef=QU_AVL_PO_EPS
            UN_PO_EPS_4bf7fe20: ComBitPosition=62, ComBitSize=2, ComSignalDataInvalidValue=3, ComSignalType=UINT8, ComSystemTemplateSystemSignalRef=UN_PO_EPS
        sigGroup_AVL_RPM_WHL_eba9ae07: ComSystemTemplateSignalGroupRef=sigGroup_AVL_RPM_WHL
          11 x ComGroupSignal, all with ComSignalEndianness=LITTLE_ENDIAN:
            ALIV_AVL_RPM_WHL_c59967bf: ComBitPosition=8, ComBitSize=4, ComSignalDataInvalidValue=15, ComSignalType=UINT8, ComSystemTemplateSystemSignalRef=ALIV_AVL_RPM_WHL
            AVL_RPM_WHL_FLH_c59967bf: ComBitPosition=48, ComBitSize=16, ComSignalDataInvalidValue=65535, ComSignalType=UINT16, ComSystemTemplateSystemSignalRef=AVL_RPM_WHL_FLH
            AVL_RPM_WHL_FRH_c59967bf: ComBitPosition=64, ComBitSize=16, ComSignalDataInvalidValue=65535, ComSignalType=UINT16, ComSystemTemplateSystemSignalRef=AVL_RPM_WHL_FRH
            AVL_RPM_WHL_RLH_c59967bf: ComBitPosition=16, ComBitSize=16, ComSignalDataInvalidValue=65535, ComSignalType=UINT16, ComSystemTemplateSystemSignalRef=AVL_RPM_WHL_RLH
            AVL_RPM_WHL_RRH_c59967bf: ComBitPosition=32, ComBitSize=16, ComSignalDataInvalidValue=65535, ComSignalType=UINT16, ComSystemTemplateSystemSignalRef=AVL_RPM_WHL_RRH
            AVL_RPM_WHL_dummy_12_15_c59967bf: ComBitPosition=12, ComBitSize=4, ComSignalInitValue=15, ComSignalType=UINT8, ComSystemTemplateSystemSignalRef=AVL_RPM_WHL_dummy_12_15
            CRC_AVL_RPM_WHL_c59967bf: ComBitPosition=0, ComBitSize=8, ComSignalType=UINT8, ComSystemTemplateSystemSignalRef=CRC_AVL_RPM_WHL
            QU_AVL_RPM_WHL_FLH_c59967bf: ComBitPosition=88, ComBitSize=4, ComSignalDataInvalidValue=15, ComSignalType=UINT8, ComSystemTemplateSystemSignalRef=QU_AVL_RPM_WHL_FLH
            QU_AVL_RPM_WHL_FRH_c59967bf: ComBitPosition=92, ComBitSize=4, ComSignalDataInvalidValue=15, ComSignalType=UINT8, ComSystemTemplateSystemSignalRef=QU_AVL_RPM_WHL_FRH
            QU_AVL_RPM_WHL_RLH_c59967bf: ComBitPosition=80, ComBitSize=4, ComSignalDataInvalidValue=15, ComSignalType=UINT8, ComSystemTemplateSystemSignalRef=QU_AVL_RPM_WHL_RLH
            QU_AVL_RPM_WHL_RRH_c59967bf: ComBitPosition=84, ComBitSize=4, ComSignalDataInvalidValue=15, ComSignalType=UINT8, ComSystemTemplateSystemSignalRef=QU_AVL_RPM_WHL_RRH
        sigGroup_AVL_STMOM_DV_ACT_744f32e2: ComSystemTemplateSignalGroupRef=sigGroup_AVL_STMOM_DV_ACT
          5 x ComGroupSignal, all with ComSignalEndianness=LITTLE_ENDIAN:
            ALIV_AVL_STMOM_DV_ACT_3ef6286e: ComBitPosition=8, ComBitSize=4, ComSignalDataInvalidValue=15, ComSignalType=UINT8, ComSystemTemplateSystemSignalRef=ALIV_AVL_STMOM_DV_ACT
            AVL_STMOM_DV_ACT_3ef6286e: ComBitPosition=16, ComBitSize=12, ComSignalDataInvalidValue=4095, ComSignalType=UINT16, ComSystemTemplateSystemSignalRef=AVL_STMOM_DV_ACT
            AVL_STMOM_DV_ACT_dummy_12_15_3ef6286e: ComBitPosition=12, ComBitSize=4, ComSignalInitValue=15, ComSignalType=UINT8, ComSystemTemplateSystemSignalRef=AVL_STMOM_DV_ACT_dummy_12_15
            CRC_AVL_STMOM_DV_ACT_3ef6286e: ComBitPosition=0, ComBitSize=8, ComSignalType=UINT8, ComSystemTemplateSystemSignalRef=CRC_AVL_STMOM_DV_ACT
            QU_AVL_STMOM_DV_ACT_3ef6286e: ComBitPosition=28, ComBitSize=4, ComSignalDataInvalidValue=15, ComSignalType=UINT8, ComSystemTemplateSystemSignalRef=QU_AVL_STMOM_DV_ACT
        sigGroup_CON_VEH_675e7344: ComSystemTemplateSignalGroupRef=sigGroup_CON_VEH
          7 x ComGroupSignal, all with ComSignalEndianness=LITTLE_ENDIAN:
            ALIV_CON_VEH_c1ae6ae9: ComBitPosition=8, ComBitSize=4, ComSignalDataInvalidValue=15, ComSignalType=UINT8, ComSystemTemplateSystemSignalRef=ALIV_CON_VEH
            CON_VEH_dummy_56_63_c1ae6ae9: ComBitPosition=56, ComBitSize=8, ComSignalInitValue=255, ComSignalType=UINT8, ComSystemTemplateSystemSignalRef=CON_VEH_dummy_56_63
            CRC_CON_VEH_c1ae6ae9: ComBitPosition=0, ComBitSize=8, ComSignalType=UINT8, ComSystemTemplateSystemSignalRef=CRC_CON_VEH
            CTR_BS_PRTNT_c1ae6ae9: ComBitPosition=12, ComBitSize=4, ComSignalDataInvalidValue=15, ComSignalType=UINT8, ComSystemTemplateSystemSignalRef=CTR_BS_PRTNT
            CTR_FKTN_PRTNT_c1ae6ae9: ComBitPosition=16, ComBitSize=32, ComSignalDataInvalidValue=4294967295, ComSignalType=UINT32, ComSystemTemplateSystemSignalRef=CTR_FKTN_PRTNT
            QU_ST_CON_VEH_c1ae6ae9: ComBitPosition=52, ComBitSize=4, ComSignalDataInvalidValue=15, ComSignalType=UINT8, ComSystemTemplateSystemSignalRef=QU_ST_CON_VEH
            ST_CON_VEH_c1ae6ae9: ComBitPosition=48, ComBitSize=4, ComSignalDataInvalidValue=15, ComSignalType=UINT8, ComSystemTemplateSystemSignalRef=ST_CON_VEH
        sigGroup_DISP_CC_EPS_ad160a0a: ComSystemTemplateSignalGroupRef=sigGroup_DISP_CC_EPS
          7 x ComGroupSignal, all with ComSignalEndianness=LITTLE_ENDIAN, ComTransferProperty=TRIGGERED_ON_CHANGE:
            ALIV_DISP_CC_EPS_8a192f9a: ComBitPosition=8, ComBitSize=4, ComSignalDataInvalidValue=15, ComSignalType=UINT8, ComSystemTemplateSystemSignalRef=ALIV_DISP_CC_EPS
            CHL_DISP_CC_EPS_8a192f9a: ComBitPosition=12, ComBitSize=4, ComSignalDataInvalidValue=15, ComSignalType=UINT8, ComSystemTemplateSystemSignalRef=CHL_DISP_CC_EPS
            CRC_DISP_CC_EPS_8a192f9a: ComBitPosition=0, ComBitSize=8, ComSignalType=UINT8, ComSystemTemplateSystemSignalRef=CRC_DISP_CC_EPS
            NO_CC_EPS_8a192f9a: ComBitPosition=16, ComBitSize=16, ComSignalDataInvalidValue=65535, ComSignalType=UINT16, ComSystemTemplateSystemSignalRef=NO_CC_EPS
            ST_CC_EPS_8a192f9a: ComBitPosition=32, ComBitSize=2, ComSignalDataInvalidValue=3, ComSignalType=UINT8, ComSystemTemplateSystemSignalRef=ST_CC_EPS
            ST_IDC_CC_EPS_8a192f9a: ComBitPosition=38, ComBitSize=2, ComSignalDataInvalidValue=3, ComSignalType=UINT8, ComSystemTemplateSystemSignalRef=ST_IDC_CC_EPS
            TRANF_CC_EPS_8a192f9a: ComBitPosition=34, ComBitSize=4, ComSignalDataInvalidValue=15, ComSignalType=UINT8, ComSystemTemplateSystemSignalRef=TRANF_CC_EPS
        sigGroup_DT_EST_68b5ac35: ComSystemTemplateSignalGroupRef=sigGroup_DT_EST
          9 x ComGroupSignal, all with ComSignalEndianness=LITTLE_ENDIAN:
            ALIV_DT_EST_dcba517d: ComBitPosition=8, ComBitSize=4, ComSignalDataInvalidValue=15, ComSignalType=UINT8, ComSystemTemplateSystemSignalRef=ALIV_DT_EST
            AVL_I_ACT_EST_dcba517d: ComBitPosition=48, ComBitSize=8, ComSignalDataInvalidValue=255, ComSignalType=UINT8, ComSystemTemplateSystemSignalRef=AVL_I_ACT_EST
            CRC_DT_EST_dcba517d: ComBitPosition=0, ComBitSize=8, ComSignalType=UINT8, ComSystemTemplateSystemSignalRef=CRC_DT_EST
            DT_EST_dummy_12_15_dcba517d: ComBitPosition=12, ComBitSize=4, ComSignalInitValue=15, ComSignalType=UINT8, ComSystemTemplateSystemSignalRef=DT_EST_dummy_12_15
            DT_EST_dummy_16_47_dcba517d: ComBitPosition=16, ComBitSize=32, ComSignalInitValue=4294967295, ComSignalType=UINT32, ComSystemTemplateSystemSignalRef=DT_EST_dummy_16_47
            DT_EST_dummy_64_95_dcba517d: ComBitPosition=64, ComBitSize=32, ComSignalInitValue=4294967295, ComSignalType=UINT32, ComSystemTemplateSystemSignalRef=DT_EST_dummy_64_95
            DT_EST_dummy_96_127_dcba517d: ComBitPosition=96, ComBitSize=32, ComSignalInitValue=4294967295, ComSignalType=UINT32, ComSystemTemplateSystemSignalRef=DT_EST_dummy_96_127
            QU_AVL_I_ACT_EST_dcba517d: ComBitPosition=60, ComBitSize=4, ComSignalDataInvalidValue=15, ComSignalType=UINT8, ComSystemTemplateSystemSignalRef=QU_AVL_I_ACT_EST
            ST_CULI_EST_dcba517d: ComBitPosition=56, ComBitSize=4, ComSignalDataInvalidValue=15, ComSignalType=UINT8, ComSystemTemplateSystemSignalRef=ST_CULI_EST
        sigGroup_ENERG_DGR_DRDY_3f76efd3: ComSystemTemplateSignalGroupRef=sigGroup_ENERG_DGR_DRDY
          10 x ComGroupSignal, all with ComSignalEndianness=LITTLE_ENDIAN, ComSignalType=UINT8:
            ALIV_ENERG_DGR_DRDY_6d50c911: ComBitPosition=52, ComBitSize=4, ComSignalDataInvalidValue=15, ComSystemTemplateSystemSignalRef=ALIV_ENERG_DGR_DRDY
            CRC_ENERG_DGR_DRDY_6d50c911: ComBitPosition=56, ComBitSize=8, ComSystemTemplateSystemSignalRef=CRC_ENERG_DGR_DRDY
            ENERG_AVAI_ARS_6d50c911: ComBitPosition=40, ComBitSize=8, ComSignalDataInvalidValue=255, ComSystemTemplateSystemSignalRef=ENERG_AVAI_ARS
            ENERG_DGR_DRDY_dummy_12_15_6d50c911: ComBitPosition=12, ComBitSize=4, ComSignalInitValue=15, ComSystemTemplateSystemSignalRef=ENERG_DGR_DRDY_dummy_12_15
            MAX_I_LD_SPEC_ARS_6d50c911: ComBitPosition=24, ComBitSize=8, ComSignalDataInvalidValue=255, ComSystemTemplateSystemSignalRef=MAX_I_LD_SPEC_ARS
            MAX_I_RECUP_SPEC_ARS_6d50c911: ComBitPosition=32, ComBitSize=8, ComSignalDataInvalidValue=255, ComSystemTemplateSystemSignalRef=MAX_I_RECUP_SPEC_ARS
            MAX_I_SPEC_BAX_STE_6d50c911: ComBitPosition=16, ComBitSize=8, ComSignalDataInvalidValue=255, ComSystemTemplateSystemSignalRef=MAX_I_SPEC_BAX_STE
            MAX_I_SPEC_EPS_6d50c911: ComBitPosition=0, ComBitSize=8, ComSignalDataInvalidValue=255, ComSystemTemplateSystemSignalRef=MAX_I_SPEC_EPS
            QU_DGR_AISP_ENERG_6d50c911: ComBitPosition=48, ComBitSize=4, ComSignalDataInvalidValue=15, ComSystemTemplateSystemSignalRef=QU_DGR_AISP_ENERG
            RQ_CULI_EST_SFY_6d50c911: ComBitPosition=8, ComBitSize=4, ComSignalDataInvalidValue=15, ComSystemTemplateSystemSignalRef=RQ_CULI_EST_SFY
        sigGroup_ENSU_SFY_dfa36b36: ComSystemTemplateSignalGroupRef=sigGroup_ENSU_SFY
          7 x ComGroupSignal, all with ComSignalEndianness=LITTLE_ENDIAN:
            ALIV_ENSU_SFY_db9b6687: ComBitPosition=8, ComBitSize=4, ComSignalDataInvalidValue=15, ComSignalType=UINT8, ComSystemTemplateSystemSignalRef=ALIV_ENSU_SFY
            CHL_ENSU_SFY_db9b6687: ComBitPosition=12, ComBitSize=4, ComSignalDataInvalidValue=15, ComSignalType=UINT8, ComSystemTemplateSystemSignalRef=CHL_ENSU_SFY
            CRC_ENSU_SFY_db9b6687: ComBitPosition=0, ComBitSize=8, ComSignalType=UINT8, ComSystemTemplateSystemSignalRef=CRC_ENSU_SFY
            ENSU_SFY_dummy_28_31_db9b6687: ComBitPosition=28, ComBitSize=4, ComSignalInitValue=15, ComSignalType=UINT8, ComSystemTemplateSystemSignalRef=ENSU_SFY_dummy_28_31
            ENSU_SFY_dummy_32_63_db9b6687: ComBitPosition=32, ComBitSize=32, ComSignalInitValue=4294967295, ComSignalType=UINT32, ComSystemTemplateSystemSignalRef=ENSU_SFY_dummy_32_63
            QU_FN_ENSU_SFY_db9b6687: ComBitPosition=16, ComBitSize=8, ComSignalDataInvalidValue=255, ComSignalType=UINT8, ComSystemTemplateSystemSignalRef=QU_FN_ENSU_SFY
            RQ_CULI_db9b6687: ComBitPosition=24, ComBitSize=4, ComSignalDataInvalidValue=15, ComSignalType=UINT8, ComSystemTemplateSystemSignalRef=RQ_CULI
        sigGroup_OFFS_QUAD_EPS_cc150a52: ComSystemTemplateSignalGroupRef=sigGroup_OFFS_QUAD_EPS
          5 x ComGroupSignal, all with ComSignalEndianness=LITTLE_ENDIAN:
            ALIV_OFFS_QUAD_EPS_1a5f7888: ComBitPosition=8, ComBitSize=4, ComSignalDataInvalidValue=15, ComSignalType=UINT8, ComSystemTemplateSystemSignalRef=ALIV_OFFS_QUAD_EPS
            AVL_PO_IDX_ICM_1a5f7888: ComBitPosition=24, ComBitSize=16, ComSignalDataInvalidValue=65535, ComSignalType=UINT16, ComSystemTemplateSystemSignalRef=AVL_PO_IDX_ICM
            CRC_OFFS_QUAD_EPS_1a5f7888: ComBitPosition=0, ComBitSize=8, ComSignalType=UINT8, ComSystemTemplateSystemSignalRef=CRC_OFFS_QUAD_EPS
            OFFS_QUAD_RTR_EPS_1a5f7888: ComBitPosition=16, ComBitSize=8, ComSignalDataInvalidValue=255, ComSignalType=UINT8, ComSystemTemplateSystemSignalRef=OFFS_QUAD_RTR_EPS
            ST_OFFS_QUAD_EPS_1a5f7888: ComBitPosition=12, ComBitSize=4, ComSignalDataInvalidValue=15, ComSignalType=UINT8, ComSystemTemplateSystemSignalRef=ST_OFFS_QUAD_EPS
        sigGroup_ST_EST_76669e16: ComSystemTemplateSignalGroupRef=sigGroup_ST_EST
          6 x ComGroupSignal, all with ComSignalEndianness=LITTLE_ENDIAN, ComSignalType=UINT8:
            ALIV_ST_EST_FTAX_eef8e21d: ComBitPosition=8, ComBitSize=4, ComSignalDataInvalidValue=15, ComTransferProperty=TRIGGERED_ON_CHANGE, ComSystemTemplateSystemSignalRef=ALIV_ST_EST_FTAX
            CRC_ST_EST_FTAX_eef8e21d: ComBitPosition=0, ComBitSize=8, ComTransferProperty=TRIGGERED_ON_CHANGE, ComSystemTemplateSystemSignalRef=CRC_ST_EST_FTAX
            QU_FN_EST_eef8e21d: ComBitPosition=32, ComBitSize=8, ComSignalDataInvalidValue=255, ComTransferProperty=TRIGGERED_ON_CHANGE, ComSystemTemplateSystemSignalRef=QU_FN_EST
            QU_FN_VIB_EPS_eef8e21d: ComBitPosition=12, ComBitSize=4, ComSignalDataInvalidValue=15, ComTransferProperty=TRIGGERED_ON_CHANGE, ComSystemTemplateSystemSignalRef=QU_FN_VIB_EPS
            QU_SER_STMOM_DV_ACT_eef8e21d: ComBitPosition=24, ComBitSize=8, ComSignalDataInvalidValue=255, ComTransferProperty=TRIGGERED_ON_CHANGE, ComSystemTemplateSystemSignalRef=QU_SER_STMOM_DV_ACT
            ST_EST_dummy_16_23_eef8e21d: ComBitPosition=16, ComBitSize=8, ComSignalInitValue=255, ComTransferProperty=PENDING, ComSystemTemplateSystemSignalRef=ST_EST_dummy_16_23
        sigGroup_SU_EPS_fe4f71c6: ComSystemTemplateSignalGroupRef=sigGroup_SU_EPS
          6 x ComGroupSignal, all with ComSignalEndianness=LITTLE_ENDIAN:
            ALIV_SU_EPS_f544de28: ComBitPosition=52, ComBitSize=4, ComSignalDataInvalidValue=15, ComSignalType=UINT8, ComSystemTemplateSystemSignalRef=ALIV_SU_EPS
            CRC_SU_EPS_f544de28: ComBitPosition=56, ComBitSize=8, ComSignalType=UINT8, ComSystemTemplateSystemSignalRef=CRC_SU_EPS
            SU_EPS_dummy_14_19_f544de28: ComBitPosition=14, ComBitSize=6, ComSignalInitValue=63, ComSignalType=UINT8, ComTransferProperty=PENDING, ComSystemTemplateSystemSignalRef=SU_EPS_dummy_14_19
            SU_EPS_dummy_20_51_f544de28: ComBitPosition=20, ComBitSize=32, ComSignalInitValue=4294967295, ComSignalType=UINT32, ComTransferProperty=PENDING, ComSystemTemplateSystemSignalRef=SU_EPS_dummy_20_51
            TOT_STR_EPS_f544de28: ComBitPosition=0, ComBitSize=12, ComSignalDataInvalidValue=4095, ComSignalType=UINT16, ComSystemTemplateSystemSignalRef=TOT_STR_EPS
            UN_TOT_STR_EPS_f544de28: ComBitPosition=12, ComBitSize=2, ComSignalDataInvalidValue=3, ComSignalType=UINT8, ComSystemTemplateSystemSignalRef=UN_TOT_STR_EPS
        sigGroup_TAR_ESTP_VIRT_FTAX_7f6c789c: ComSystemTemplateSignalGroupRef=sigGroup_TAR_ESTP_VIRT_FTAX
          5 x ComGroupSignal, all with ComSignalEndianness=LITTLE_ENDIAN:
            ACTVN_FN_ESTP_VIRT_FTAX_0f46fe9b: ComBitPosition=32, ComBitSize=4, ComSignalDataInvalidValue=15, ComSignalType=UINT8, ComSystemTemplateSystemSignalRef=ACTVN_FN_ESTP_VIRT_FTAX
            ALIV_TAR_ESTP_VIRT_FTAX_0f46fe9b: ComBitPosition=8, ComBitSize=4, ComSignalDataInvalidValue=15, ComSignalType=UINT8, ComSystemTemplateSystemSignalRef=ALIV_TAR_ESTP_VIRT_FTAX
            CRC_TAR_ESTP_VIRT_FTAX_0f46fe9b: ComBitPosition=0, ComBitSize=8, ComSignalType=UINT8, ComSystemTemplateSystemSignalRef=CRC_TAR_ESTP_VIRT_FTAX
            TAR_ESTP_VIRT_FTAX_dummy_12_31_0f46fe9b: ComBitPosition=12, ComBitSize=20, ComSignalInitValue=1048575, ComSignalType=UINT32, ComSystemTemplateSystemSignalRef=TAR_ESTP_VIRT_FTAX_dummy_12_31
            TAR_ESTP_VIRT_FTAX_dummy_36_63_0f46fe9b: ComBitPosition=36, ComBitSize=28, ComSignalInitValue=268435455, ComSignalType=UINT32, ComSystemTemplateSystemSignalRef=TAR_ESTP_VIRT_FTAX_dummy_36_63
        sigGroup_TAR_QTA_STRMOM_DV_231dfb08: ComSystemTemplateSignalGroupRef=sigGroup_TAR_QTA_STRMOM_DV
          10 x ComGroupSignal, all with ComSignalEndianness=LITTLE_ENDIAN:
            ALIV_TAR_QTA_STMOM_DV_54d7ae59: ComBitPosition=8, ComBitSize=4, ComSignalDataInvalidValue=15, ComSignalType=UINT8, ComSystemTemplateSystemSignalRef=ALIV_TAR_QTA_STMOM_DV
            CRC_TAR_QTA_STMOM_DV_54d7ae59: ComBitPosition=0, ComBitSize=8, ComSignalType=UINT8, ComSystemTemplateSystemSignalRef=CRC_TAR_QTA_STMOM_DV
            CTR_DEAC_EPS_FNS_54d7ae59: ComBitPosition=60, ComBitSize=4, ComSignalDataInvalidValue=15, ComSignalType=UINT8, ComSystemTemplateSystemSignalRef=CTR_DEAC_EPS_FNS
            FACT_ASS_STMOM_FTAX_54d7ae59: ComBitPosition=48, ComBitSize=8, ComSignalDataInvalidValue=255, ComSignalType=UINT8, ComSystemTemplateSystemSignalRef=FACT_ASS_STMOM_FTAX
            FACT_CTRR_STMOM_FTAX_54d7ae59: ComBitPosition=32, ComBitSize=8, ComSignalDataInvalidValue=255, ComSignalType=UINT8, ComSystemTemplateSystemSignalRef=FACT_CTRR_STMOM_FTAX
            FACT_DMPNG_STMOM_FTAX_54d7ae59: ComBitPosition=40, ComBitSize=8, ComSignalDataInvalidValue=255, ComSignalType=UINT8, ComSystemTemplateSystemSignalRef=FACT_DMPNG_STMOM_FTAX
            QU_TAR_FACT_STMOM_FTAX_54d7ae59: ComBitPosition=56, ComBitSize=4, ComSignalDataInvalidValue=15, ComSignalType=UINT8, ComSystemTemplateSystemSignalRef=QU_TAR_FACT_STMOM_FTAX
            QU_TAR_QTA_STMOM_DV_54d7ae59: ComBitPosition=28, ComBitSize=4, ComSignalDataInvalidValue=15, ComSignalType=UINT8, ComSystemTemplateSystemSignalRef=QU_TAR_QTA_STMOM_DV
            TAR_QTA_STMOM_DV_54d7ae59: ComBitPosition=16, ComBitSize=12, ComSignalDataInvalidValue=4095, ComSignalType=UINT16, ComSystemTemplateSystemSignalRef=TAR_QTA_STMOM_DV
            TAR_QTA_STRMOM_DV_dummy_12_15_54d7ae59: ComBitPosition=12, ComBitSize=4, ComSignalInitValue=15, ComSignalType=UINT8, ComSystemTemplateSystemSignalRef=TAR_QTA_STRMOM_DV_dummy_12_15
        sigGroup_TAR_STMOM_DV_ACT_9a7b28d3: ComSystemTemplateSignalGroupRef=sigGroup_TAR_STMOM_DV_ACT
          8 x ComGroupSignal, all with ComSignalEndianness=LITTLE_ENDIAN:
            ALIV_TAR_STMOM_DV_ACT_56e1c987: ComBitPosition=8, ComBitSize=4, ComSignalDataInvalidValue=15, ComSignalType=UINT8, ComSystemTemplateSystemSignalRef=ALIV_TAR_STMOM_DV_ACT
            CRC_TAR_STMOM_DV_ACT_56e1c987: ComBitPosition=0, ComBitSize=8, ComSignalType=UINT8, ComSystemTemplateSystemSignalRef=CRC_TAR_STMOM_DV_ACT
            FACT_DMPNG_ADDON_STMOM_FTAX_56e1c987: ComBitPosition=56, ComBitSize=8, ComSignalDataInvalidValue=255, ComSignalType=UINT8, ComSystemTemplateSystemSignalRef=FACT_DMPNG_ADDON_STMOM_FTAX
            QU_TAR_DMPNG_ADDON_STMOM_FTAX_56e1c987: ComBitPosition=52, ComBitSize=4, ComSignalDataInvalidValue=15, ComSignalType=UINT8, ComSystemTemplateSystemSignalRef=QU_TAR_DMPNG_ADDON_STMOM_FTAX
            QU_TAR_STMOM_DV_ACT_56e1c987: ComBitPosition=28, ComBitSize=4, ComSignalDataInvalidValue=15, ComSignalType=UINT8, ComSystemTemplateSystemSignalRef=QU_TAR_STMOM_DV_ACT
            TAR_STMOM_DV_ACT_56e1c987: ComBitPosition=16, ComBitSize=12, ComSignalDataInvalidValue=4095, ComSignalType=UINT16, ComSystemTemplateSystemSignalRef=TAR_STMOM_DV_ACT
            TAR_STMOM_DV_ACT_dummy_12_15_56e1c987: ComBitPosition=12, ComBitSize=4, ComSignalInitValue=15, ComSignalType=UINT8, ComSystemTemplateSystemSignalRef=TAR_STMOM_DV_ACT_dummy_12_15
            TAR_STMOM_DV_ACT_dummy_32_51_56e1c987: ComBitPosition=32, ComBitSize=20, ComSignalInitValue=1048575, ComSignalType=UINT32, ComSystemTemplateSystemSignalRef=TAR_STMOM_DV_ACT_dummy_32_51
        sigGroup_VYAW_VEH_fc66be94: ComSystemTemplateSignalGroupRef=sigGroup_VYAW_VEH
          6 x ComGroupSignal, all with ComSignalEndianness=LITTLE_ENDIAN:
            ALIV_VYAW_VEH_dc9eeb12: ComBitPosition=8, ComBitSize=4, ComSignalDataInvalidValue=15, ComSignalType=UINT8, ComSystemTemplateSystemSignalRef=ALIV_VYAW_VEH
            CRC_VYAW_VEH_dc9eeb12: ComBitPosition=0, ComBitSize=8, ComSignalType=UINT8, ComSystemTemplateSystemSignalRef=CRC_VYAW_VEH
            QU_VYAW_VEH_dc9eeb12: ComBitPosition=44, ComBitSize=4, ComSignalDataInvalidValue=15, ComSignalType=UINT8, ComSystemTemplateSystemSignalRef=QU_VYAW_VEH
            VYAW_VEH_ERR_AMP_dc9eeb12: ComBitPosition=32, ComBitSize=12, ComSignalDataInvalidValue=4095, ComSignalType=UINT16, ComSystemTemplateSystemSignalRef=VYAW_VEH_ERR_AMP
            VYAW_VEH_dc9eeb12: ComBitPosition=16, ComBitSize=16, ComSignalDataInvalidValue=65535, ComSignalType=UINT16, ComSystemTemplateSystemSignalRef=VYAW_VEH
            VYAW_VEH_dummy_12_15_dc9eeb12: ComBitPosition=12, ComBitSize=4, ComSignalInitValue=15, ComSignalType=UINT8, ComSystemTemplateSystemSignalRef=VYAW_VEH_dummy_12_15
        sigGroup_V_VEH_2fe00c20: ComSystemTemplateSignalGroupRef=sigGroup_V_VEH
          7 x ComGroupSignal, all with ComSignalEndianness=LITTLE_ENDIAN:
            ALIV_V_VEH_579a99a0: ComBitPosition=8, ComBitSize=4, ComSignalDataInvalidValue=15, ComSignalType=UINT8, ComSystemTemplateSystemSignalRef=ALIV_V_VEH
            CRC_V_VEH_579a99a0: ComBitPosition=0, ComBitSize=8, ComSignalType=UINT8, ComSystemTemplateSystemSignalRef=CRC_V_VEH
            DVCO_VEH_579a99a0: ComBitPosition=36, ComBitSize=3, ComSignalDataInvalidValue=7, ComSignalType=UINT8, ComSystemTemplateSystemSignalRef=DVCO_VEH
            QU_V_VEH_COG_579a99a0: ComBitPosition=32, ComBitSize=4, ComSignalDataInvalidValue=15, ComSignalType=UINT8, ComSystemTemplateSystemSignalRef=QU_V_VEH_COG
            ST_V_VEH_NSS_579a99a0: ComBitPosition=12, ComBitSize=4, ComSignalDataInvalidValue=15, ComSignalType=UINT8, ComSystemTemplateSystemSignalRef=ST_V_VEH_NSS
            V_VEH_COG_579a99a0: ComBitPosition=16, ComBitSize=16, ComSignalDataInvalidValue=65535, ComSignalType=UINT16, ComSystemTemplateSystemSignalRef=V_VEH_COG
            V_VEH_dummy_39_39_579a99a0: ComBitPosition=39, ComBitSize=1, ComSignalInitValue=1, ComSignalType=UINT8, ComSystemTemplateSystemSignalRef=V_VEH_dummy_39_39
    ComGeneral
  module config ComM
    ComMConfigSet: ComMPncEnabled=false
      A_FlexRay_372befd6 (ComMChannel): ComMBusType=COMM_BUS_TYPE_FR, ComMChannelId=0  # con_EPS_FibexID_0b7e5e09c061465d913e8968ece3cded
        ComMNetworkManagement: ComMNmVariant=NONE
        A_FlexRay_372befd6 (ComMUserPerChannel): ComMUserChannel=USR_A_FlexRay_372befd6  # con_EPS_FibexID_0b7e5e09c061465d913e8968ece3cded
      USR_A_FlexRay_372befd6 (ComMUser): ComMUserIdentifier=0  # con_EPS_FibexID_0b7e5e09c061465d913e8968ece3cded
    ComMGeneral: ComMPncIdCounting=COMM_PNC_ID_COUNT_FROM_NM_MESSAGE, ComMPncSupport=false
  module config Darh
    DarhGeneral: DarhActiveReportListType=POSITIVE_LIST  # Project Standard Configuration
  module config DarhClassic
    13 x DarhActiveReportedEvent:
      DarhActiveReportedEvent_CodingEventNotCoded: DarhDemEvent=CodingEventNotCoded  # Project Standard Configuration
      DarhActiveReportedEvent_CodingEventUnqualifiedData: DarhDemEvent=CodingEventUnqualifiedData  # Project Standard Configuration
      DarhActiveReportedEvent_CodingEventWrongVehicle: DarhDemEvent=CodingEventWrongVehicle  # Project Standard Configuration
      DarhActiveReportedEvent_DmTestAppl: DarhDemEvent=DmTestAppl  # Project Standard Configuration
      DarhActiveReportedEvent_DmTestCom: DarhDemEvent=DmTestCom  # Project Standard Configuration
      DarhActiveReportedEvent_FrsmEClusterSyncLoss: DarhDemEvent=FrsmEClusterSyncLoss  # Project Standard Configuration
      DarhActiveReportedEvent_FrtrcvEFrBuserrorTrcv0: DarhDemEvent=FrtrcvEFrBuserrorTrcv0  # Project Standard Configuration
      DarhActiveReportedEvent_GlobalOvervoltageExt: DarhDemEvent=GlobalOvervoltageExt  # Project Standard Configuration
      DarhActiveReportedEvent_GlobalOvervoltageInt: DarhDemEvent=GlobalOvervoltageInt  # Project Standard Configuration
      DarhActiveReportedEvent_GlobalUndervoltageExt: DarhDemEvent=GlobalUndervoltageExt  # Project Standard Configuration
      DarhActiveReportedEvent_GlobalUndervoltageInt: DarhDemEvent=GlobalUndervoltageInt  # Project Standard Configuration
      DarhActiveReportedEvent_LocalOvervoltage: DarhDemEvent=LocalOvervoltage  # Project Standard Configuration
      DarhActiveReportedEvent_LocalUndervoltage: DarhDemEvent=LocalUndervoltage  # Project Standard Configuration
  module config Dcm
    DcmConfigSet
      DcmDsd
        EPS_DCM_UDS_ON_FLEXRAY (DcmDsdServiceTable): DcmDsdSidTabId=0
          14 x DcmDsdService:
            ClearDiagnosticInformation: DcmDsdSidTabServiceId=20, DcmDsdSidTabSubfuncAvail=false, DcmDsdSidTabSessionLevelRef=DEFAULT_SESSION, DcmDsdSidTabSessionLevelRef=EXTENDED_DIAGNOSTIC_SESSION, DcmDsdSidTabSessionLevelRef=GarageMode
            CommunicationControl: DcmDsdSidTabServiceId=40, DcmDsdSidTabSubfuncAvail=true, DcmDsdSidTabSessionLevelRef=EXTENDED_DIAGNOSTIC_SESSION  # CommunicationControl_0x00
              4 x DcmDsdSubService, all with DcmDsdSubServiceSessionLevelRef=EXTENDED_DIAGNOSTIC_SESSION:
                CommunicationControl_0x00: DcmDsdSubServiceId=0
                CommunicationControl_0x01: DcmDsdSubServiceId=3
                CommunicationControl_0x02: DcmDsdSubServiceId=1
                CommunicationControl_0x03: DcmDsdSubServiceId=2
            ControlDTCSetting: DcmDsdSidTabServiceId=133, DcmDsdSidTabSubfuncAvail=true, DcmDsdSidTabSessionLevelRef=EXTENDED_DIAGNOSTIC_SESSION  # ControlDtcSetting_0x01
              ControlDtcSetting_0x01 (DcmDsdSubService): DcmDsdSubServiceId=1, DcmDsdSubServiceSessionLevelRef=EXTENDED_DIAGNOSTIC_SESSION
              ControlDtcSetting_0x02 (DcmDsdSubService): DcmDsdSubServiceId=2, DcmDsdSubServiceSessionLevelRef=EXTENDED_DIAGNOSTIC_SESSION
            EcuReset: DcmDsdSidTabServiceId=17, DcmDsdSidTabSubfuncAvail=true, DcmDsdSidTabSessionLevelRef=DEFAULT_SESSION, DcmDsdSidTabSessionLevelRef=EXTENDED_DIAGNOSTIC_SESSION  # EcuReset_0x01
              EcuReset_0x01 (DcmDsdSubService): DcmDsdSubServiceId=1, DcmDsdSubServiceSessionLevelRef=DEFAULT_SESSION, DcmDsdSubServiceSessionLevelRef=EXTENDED_DIAGNOSTIC_SESSION
            ReadDTCInformation: DcmDsdSidTabServiceId=25, DcmDsdSidTabSubfuncAvail=true, DcmDsdSidTabSessionLevelRef=CODING_SESSION, DcmDsdSidTabSessionLevelRef=DEFAULT_SESSION, DcmDsdSidTabSessionLevelRef=EXTENDED_DIAGNOSTIC_SESSION  # ReadDtcInformation_0x02
              7 x DcmDsdSubService, all with DcmDsdSubServiceSessionLevelRef=DEFAULT_SESSION, DcmDsdSubServiceSessionLevelRef=EXTENDED_DIAGNOSTIC_SESSION:
                ReadDtcInformation_0x02: DcmDsdSubServiceId=2
                ReadDtcInformation_0x04: DcmDsdSubServiceId=4
                ReadDtcInformation_0x06: DcmDsdSubServiceId=6
                ReadDtcInformation_0x0A: DcmDsdSubServiceId=10, DcmDsdSubServiceSessionLevelRef=CODING_SESSION
                ReadDtcInformation_0x17: DcmDsdSubServiceId=23
                ReadDtcInformation_0x18: DcmDsdSubServiceId=24
                ReadDtcInformation_0x19: DcmDsdSubServiceId=25
            ReadDataByIdentifier: DcmDsdSidTabServiceId=34, DcmDsdSidTabSubfuncAvail=false, DcmDsdSidTabSessionLevelRef=CODING_SESSION, DcmDsdSidTabSessionLevelRef=DEFAULT_SESSION, DcmDsdSidTabSessionLevelRef=EXTENDED_DIAGNOSTIC_SESSION, DcmDsdSidTabSessionLevelRef=GarageMode, DcmDsdSidTabSessionLevelRef=PROGRAMMING_SESSION  # RDBI_Readhwmodificationindex
            RequestDownload: DcmDsdSidTabServiceId=52, DcmDsdSidTabSubfuncAvail=false, DcmDsdSidTabSessionLevelRef=PROGRAMMING_SESSION
            RequestTransferExit: DcmDsdSidTabServiceId=55, DcmDsdSidTabSubfuncAvail=false, DcmDsdSidTabSessionLevelRef=PROGRAMMING_SESSION
            ResponseOnEvent: DcmDsdSidTabServiceId=134, DcmDsdSidTabSubfuncAvail=true, DcmDsdSidTabSessionLevelRef=DEFAULT_SESSION, DcmDsdSidTabSessionLevelRef=EXTENDED_DIAGNOSTIC_SESSION  # ResponseOnEvent_0x04
            RoutineControl: DcmDsdSidTabServiceId=49, DcmDsdSidTabSubfuncAvail=true, DcmDsdSidTabSessionLevelRef=CODING_SESSION, DcmDsdSidTabSessionLevelRef=DEFAULT_SESSION, DcmDsdSidTabSessionLevelRef=EXTENDED_DIAGNOSTIC_SESSION, DcmDsdSidTabSessionLevelRef=GarageMode, DcmDsdSidTabSessionLevelRef=PROGRAMMING_SESSION, DcmDsdSidTabSessionLevelRef=SYSTEM_SUPPLIER_SPECIFIC_61  # CheckNcd
            SessionControl: DcmDsdSidTabServiceId=16, DcmDsdSidTabSubfuncAvail=true, DcmDsdSidTabSessionLevelRef=CODING_SESSION, DcmDsdSidTabSessionLevelRef=DEFAULT_SESSION, DcmDsdSidTabSessionLevelRef=DEVELOPMENT_SESSION, DcmDsdSidTabSessionLevelRef=EXTENDED_DIAGNOSTIC_SESSION, DcmDsdSidTabSessionLevelRef=GarageMode, DcmDsdSidTabSessionLevelRef=PROGRAMMING_SESSION, DcmDsdSidTabSessionLevelRef=RSU_SESSION  # DiagnosticSessionControl_0x01
              6 x DcmDsdSubService:
                DiagnosticSessionControl_0x01: DcmDsdSubServiceId=1, DcmDsdSubServiceSessionLevelRef=DEFAULT_SESSION, DcmDsdSubServiceSessionLevelRef=DEVELOPMENT_SESSION, DcmDsdSubServiceSessionLevelRef=EXTENDED_DIAGNOSTIC_SESSION
                DiagnosticSessionControl_0x02: DcmDsdSubServiceId=2, DcmDsdSubServiceSessionLevelRef=EXTENDED_DIAGNOSTIC_SESSION, DcmDsdSubServiceSessionLevelRef=PROGRAMMING_SESSION
                DiagnosticSessionControl_0x03: DcmDsdSubServiceId=3, DcmDsdSubServiceSessionLevelRef=DEFAULT_SESSION, DcmDsdSubServiceSessionLevelRef=EXTENDED_DIAGNOSTIC_SESSION, DcmDsdSubServiceSessionLevelRef=GarageMode
                DiagnosticSessionControl_0x41: DcmDsdSubServiceId=65, DcmDsdSubServiceSessionLevelRef=CODING_SESSION, DcmDsdSubServiceSessionLevelRef=EXTENDED_DIAGNOSTIC_SESSION
                DiagnosticSessionControl_0x44: DcmDsdSubServiceId=68, DcmDsdSubServiceSessionLevelRef=EXTENDED_DIAGNOSTIC_SESSION, DcmDsdSubServiceSessionLevelRef=RSU_SESSION
                DiagnosticSessionControl_0x5F: DcmDsdSubServiceId=95, DcmDsdSubServiceSessionLevelRef=GarageMode
            TesterPresent: DcmDsdSidTabServiceId=62, DcmDsdSidTabSubfuncAvail=true
              TesterPresent (DcmDsdSubService): DcmDsdSubServiceId=0
            TransferData: DcmDsdSidTabServiceId=54, DcmDsdSidTabSubfuncAvail=false, DcmDsdSidTabSessionLevelRef=PROGRAMMING_SESSION
            WriteDataByIdentifier: DcmDsdSidTabServiceId=46, DcmDsdSidTabSubfuncAvail=false, DcmDsdSidTabSessionLevelRef=DEFAULT_SESSION, DcmDsdSidTabSessionLevelRef=EXTENDED_DIAGNOSTIC_SESSION, DcmDsdSidTabSessionLevelRef=GarageMode, DcmDsdSidTabSessionLevelRef=PROGRAMMING_SESSION  # WBDI_EpsLenkwinkelsensorKalibrierung
      DcmDsl
        DcmDslDiagResp: DcmDslDiagRespMaxNumRespPend=2, DcmDslDiagRespOnSecondDeclinedRequest=true
      DcmDsp: DcmDspMaxDidToRead=1
        DcmDspComControl
        DcmDspControlDTCSetting
        37 x DcmDspData:
          DID_1000_Pruefstempel: DcmDspDataSystemTemplateDiagnosticDataElementRef=Pruefstempel  # Pruefstempel
          DID_100A_EnergySavingState: DcmDspDataSystemTemplateDiagnosticDataElementRef=EnergySavingState  # EnergySavingState
          DID_100E_ExtendedEnergySavingState: DcmDspDataSystemTemplateDiagnosticDataElementRef=ExtendedEnergySavingState  # ExtendedEnergySavingState
          DID_1700_KmStand: DcmDspDataSystemTemplateDiagnosticDataElementRef=KmStand  # KmStand
          DID_1701_Systemzeit: DcmDspDataSystemTemplateDiagnosticDataElementRef=Systemzeit  # Systemzeit
          DID_1704_DmDtcAktiveMeldung: DcmDspDataSystemTemplateDiagnosticDataElementRef=DmDtcAktiveMeldung  # DmDtcAktiveMeldung
          DID_1723_DmIsDtcActiveResponse: DcmDspDataSystemTemplateDiagnosticDataElementRef=DmIsDtcActiveResponse  # DmIsDtcActiveResponse
          DID_1750_FUwBn: DcmDspDataSize=8, DcmDspDataType=UINT8, DcmDspDataInfoRef=DID_1750_DataInfo_FUwBn, DcmDspDataSystemTemplateDiagnosticDataElementRef=FUwBn  # FUwBn
          DID_2502_ProgrammingCounter: DcmDspDataSystemTemplateDiagnosticDataElementRef=ProgrammingCounter  # ProgrammingCounter
          DID_2503_ProgrammingCounterMaxValue: DcmDspDataSystemTemplateDiagnosticDataElementRef=ProgrammingCounterMaxValue  # ProgrammingCounterMaxValue
          DID_2504_FlashTimingParameter: DcmDspDataSystemTemplateDiagnosticDataElementRef=FlashTimingParameter  # FlashTimingParameter
          DID_2507_SwfkDeleteSupported: DcmDspDataSystemTemplateDiagnosticDataElementRef=SwfkDeleteSupported  # SwfkDeleteSupported
          DID_250B_ReadSwRevision: DcmDspDataSystemTemplateDiagnosticDataElementRef=ReadSwRevision  # ReadSwRevision
          DID_2540_MileKmEeprom: DcmDspDataSystemTemplateDiagnosticDataElementRef=MileKmEeprom  # MileKmEeprom
          DID_2541_StatusCalcvn: DcmDspDataSystemTemplateDiagnosticDataElementRef=StatusCalcvn  # StatusCalcvn
          DID_2805_Aussentemperatur: DcmDspDataSystemTemplateDiagnosticDataElementRef=Aussentemperatur  # Aussentemperatur
          DID_2866_Betriebsspannung: DcmDspDataSize=8, DcmDspDataType=UINT8, DcmDspDataInfoRef=DID_2866_DataInfo_Betriebsspannung, DcmDspDataSystemTemplateDiagnosticDataElementRef=Betriebsspannung  # Betriebsspannung
          DID_2867_Fahrzeuggeschwindigkeit: DcmDspDataSize=8, DcmDspDataType=UINT8, DcmDspDataInfoRef=DID_2867_DataInfo_Fahrzeuggeschwindigkeit, DcmDspDataSystemTemplateDiagnosticDataElementRef=Fahrzeuggeschwindigkeit  # Fahrzeuggeschwindigkeit
          DID_37FE_Cps: DcmDspDataSystemTemplateDiagnosticDataElementRef=Cps  # Cps
          DID_37FF_ReadProtocolData: DcmDspDataSystemTemplateDiagnosticDataElementRef=ReadProtocolData  # ReadProtocolData
          DID_DB3C_StatusFzgBordnetz: DcmDspDataSystemTemplateDiagnosticDataElementRef=StatusFzgBordnetz  # StatusFzgBordnetz
          DID_DB57_EpsRitzelwinkelsensor: DcmDspDataSystemTemplateDiagnosticDataElementRef=EpsRitzelwinkelsensor  # EpsRitzelwinkelsensor
          DID_DB5A_EpsLenkwinkelsensorKalibrierung: DcmDspDataSystemTemplateDiagnosticDataElementRef=EpsLenkwinkelsensorKalibrierung  # EpsLenkwinkelsensorKalibrierung
          DID_DB99_EpsMomentensensor: DcmDspDataSystemTemplateDiagnosticDataElementRef=EpsMomentensensor  # EpsMomentensensor
          DID_DC77_EpsZahnstangenmitte: DcmDspDataSystemTemplateDiagnosticDataElementRef=EpsZahnstangenmitte  # EpsZahnstangenmitte
          DID_DFDD_GelernterZahnstangenweg: DcmDspDataSystemTemplateDiagnosticDataElementRef=GelernterZahnstangenweg  # GelernterZahnstangenweg
          DID_F100_ReadActiveSessionState: DcmDspDataSystemTemplateDiagnosticDataElementRef=ReadActiveSessionState  # ReadActiveSessionState
          DID_F101_SvkAktuell: DcmDspDataSystemTemplateDiagnosticDataElementRef=SvkAktuell  # SvkAktuell
          DID_F102_SvkSysSupplier: DcmDspDataSystemTemplateDiagnosticDataElementRef=SvkSysSupplier  # SvkSysSupplier
          DID_F103_SvkWerk: DcmDspDataSystemTemplateDiagnosticDataElementRef=SvkWerk  # SvkWerk
          DID_F150_SgbdIdx: DcmDspDataSystemTemplateDiagnosticDataElementRef=SgbdIdx  # SgbdIdx
          DID_F152_Readhwmodificationindex: DcmDspDataSystemTemplateDiagnosticDataElementRef=Readhwmodificationindex  # Readhwmodificationindex
          DID_F15A_WdbiFp: DcmDspDataSystemTemplateDiagnosticDataElementRef=WdbiFp  # WdbiFp
          DID_F186_ActiveDiagnosticSession: DcmDspDataSystemTemplateDiagnosticDataElementRef=ActiveDiagnosticSession  # ActiveDiagnosticSession
          DID_F18A_SystemSupplierIdentifier: DcmDspDataSystemTemplateDiagnosticDataElementRef=SystemSupplierIdentifier  # SystemSupplierIdentifier
          DID_F18B_Herstelldatum: DcmDspDataSystemTemplateDiagnosticDataElementRef=Herstelldatum  # Herstelldatum
          DID_F18C_EcuSerialNumber: DcmDspDataSystemTemplateDiagnosticDataElementRef=EcuSerialNumber  # EcuSerialNumber
        3 x DcmDspDataInfo, all with DcmDspDataFixedLength=true:
          DID_1750_DataInfo_FUwBn  # FUwBn
          DID_2866_DataInfo_Betriebsspannung  # Betriebsspannung
          DID_2867_DataInfo_Fahrzeuggeschwindigkeit  # Fahrzeuggeschwindigkeit
        38 x DcmDspDid, all with DcmDspDidUsed=true:
          Aussentemperatur: DcmDspDidIdentifier=10245, DcmDspDidInfoRef=DidInfo_Aussentemperatur, DcmDspDidSystemTemplateDiagnosticDataIdentifierRef=Aussentemperatur
            Aussentemperatur (DcmDspDidSignal): DcmDspDidDataPos=0, DcmDspDidDataRef=DcmDsp/DID_2805_Aussentemperatur
          Betriebsspannung: DcmDspDidIdentifier=10342, DcmDspDidInfoRef=DidInfo_Betriebsspannung, DcmDspDidSystemTemplateDiagnosticDataIdentifierRef=Betriebsspannung
            Betriebsspannung (DcmDspDidSignal): DcmDspDidDataPos=0, DcmDspDidDataRef=DcmDsp/DID_2866_Betriebsspannung
          Did_ActiveDiagnosticSession: DcmDspDidIdentifier=61830, DcmDspDidInfoRef=DidInfo_Did_ActiveDiagnosticSession, DcmDspDidSystemTemplateDiagnosticDataIdentifierRef=Did_ActiveDiagnosticSession
            ActiveDiagnosticSession (DcmDspDidSignal): DcmDspDidDataPos=0, DcmDspDidDataRef=DID_F186_ActiveDiagnosticSession
          Did_Cps: DcmDspDidIdentifier=14334, DcmDspDidInfoRef=DidInfo_Did_Cps, DcmDspDidSystemTemplateDiagnosticDataIdentifierRef=Did_Cps
            Cps (DcmDspDidSignal): DcmDspDidDataPos=0, DcmDspDidDataRef=DID_37FE_Cps
          Did_DmDtcAktiveMeldung: DcmDspDidIdentifier=5892, DcmDspDidInfoRef=DidInfo_Did_DmDtcAktiveMeldung, DcmDspDidSystemTemplateDiagnosticDataIdentifierRef=Did_DmDtcAktiveMeldung
            DmDtcAktiveMeldung (DcmDspDidSignal): DcmDspDidDataPos=0, DcmDspDidDataRef=DID_1704_DmDtcAktiveMeldung
          Did_DmIsDtcActiveResponse: DcmDspDidIdentifier=5923, DcmDspDidInfoRef=DidInfo_Did_DmIsDtcActiveResponse, DcmDspDidSystemTemplateDiagnosticDataIdentifierRef=Did_DmIsDtcActiveResponse
            DmIsDtcActiveResponse (DcmDspDidSignal): DcmDspDidDataPos=0, DcmDspDidDataRef=DID_1723_DmIsDtcActiveResponse
          Did_EcuSerialNumber: DcmDspDidIdentifier=61836, DcmDspDidInfoRef=DidInfo_Did_EcuSerialNumber, DcmDspDidSystemTemplateDiagnosticDataIdentifierRef=Did_EcuSerialNumber
            EcuSerialNumber (DcmDspDidSignal): DcmDspDidDataPos=0, DcmDspDidDataRef=DID_F18C_EcuSerialNumber
          Did_EnergySavingState: DcmDspDidIdentifier=4106, DcmDspDidInfoRef=DidInfo_Did_EnergySavingState, DcmDspDidSystemTemplateDiagnosticDataIdentifierRef=Did_EnergySavingState
            EnergySavingState (DcmDspDidSignal): DcmDspDidDataPos=0, DcmDspDidDataRef=DID_100A_EnergySavingState
          Did_EpsLenkwinkelsensorKalibrierung: DcmDspDidIdentifier=56154, DcmDspDidInfoRef=DidInfo_Did_EpsLenkwinkelsensorKalibrierung, DcmDspDidSystemTemplateDiagnosticDataIdentifierRef=Did_EpsLenkwinkelsensorKalibrierung
            EpsLenkwinkelsensorKalibrierung (DcmDspDidSignal): DcmDspDidDataPos=0, DcmDspDidDataRef=DID_DB5A_EpsLenkwinkelsensorKalibrierung
          Did_EpsMomentensensor: DcmDspDidIdentifier=56217, DcmDspDidInfoRef=DidInfo_Did_EpsMomentensensor, DcmDspDidSystemTemplateDiagnosticDataIdentifierRef=Did_EpsMomentensensor
            EpsMomentensensor (DcmDspDidSignal): DcmDspDidDataPos=0, DcmDspDidDataRef=DID_DB99_EpsMomentensensor
          Did_EpsRitzelwinkelsensor: DcmDspDidIdentifier=56151, DcmDspDidInfoRef=DidInfo_Did_EpsRitzelwinkelsensor, DcmDspDidSystemTemplateDiagnosticDataIdentifierRef=Did_EpsRitzelwinkelsensor
            EpsRitzelwinkelsensor (DcmDspDidSignal): DcmDspDidDataPos=0, DcmDspDidDataRef=DID_DB57_EpsRitzelwinkelsensor
          Did_EpsZahnstangenmitte: DcmDspDidIdentifier=56439, DcmDspDidInfoRef=DidInfo_Did_EpsZahnstangenmitte, DcmDspDidSystemTemplateDiagnosticDataIdentifierRef=Did_EpsZahnstangenmitte
            EpsZahnstangenmitte (DcmDspDidSignal): DcmDspDidDataPos=0, DcmDspDidDataRef=DID_DC77_EpsZahnstangenmitte
          Did_ExtendedEnergySavingState: DcmDspDidIdentifier=4110, DcmDspDidInfoRef=DidInfo_Did_ExtendedEnergySavingState, DcmDspDidSystemTemplateDiagnosticDataIdentifierRef=Did_ExtendedEnergySavingState
            ExtendedEnergySavingState (DcmDspDidSignal): DcmDspDidDataPos=0, DcmDspDidDataRef=DID_100E_ExtendedEnergySavingState
          Did_FlashTimingParameter: DcmDspDidIdentifier=9476, DcmDspDidInfoRef=DidInfo_Did_FlashTimingParameter, DcmDspDidSystemTemplateDiagnosticDataIdentifierRef=Did_FlashTimingParameter
            FlashTimingParameter (DcmDspDidSignal): DcmDspDidDataPos=0, DcmDspDidDataRef=DID_2504_FlashTimingParameter
          Did_GelernterZahnstangenweg: DcmDspDidIdentifier=57309, DcmDspDidInfoRef=DidInfo_Did_GelernterZahnstangenweg, DcmDspDidSystemTemplateDiagnosticDataIdentifierRef=Did_GelernterZahnstangenweg
            GelernterZahnstangenweg (DcmDspDidSignal): DcmDspDidDataPos=0, DcmDspDidDataRef=DID_DFDD_GelernterZahnstangenweg
          Did_Herstelldatum: DcmDspDidIdentifier=61835, DcmDspDidInfoRef=DidInfo_Did_Herstelldatum, DcmDspDidSystemTemplateDiagnosticDataIdentifierRef=Did_Herstelldatum
            Herstelldatum (DcmDspDidSignal): DcmDspDidDataPos=0, DcmDspDidDataRef=DID_F18B_Herstelldatum
          Did_MileKmEeprom: DcmDspDidIdentifier=9536, DcmDspDidInfoRef=DidInfo_Did_MileKmEeprom, DcmDspDidSystemTemplateDiagnosticDataIdentifierRef=Did_MileKmEeprom
            MileKmEeprom (DcmDspDidSignal): DcmDspDidDataPos=0, DcmDspDidDataRef=DID_2540_MileKmEeprom
          Did_ProgrammingCounter: DcmDspDidIdentifier=9474, DcmDspDidInfoRef=DidInfo_Did_ProgrammingCounter, DcmDspDidSystemTemplateDiagnosticDataIdentifierRef=Did_ProgrammingCounter
            ProgrammingCounter (DcmDspDidSignal): DcmDspDidDataPos=0, DcmDspDidDataRef=DID_2502_ProgrammingCounter
          Did_ProgrammingCounterMaxValue: DcmDspDidIdentifier=9475, DcmDspDidInfoRef=DidInfo_Did_ProgrammingCounterMaxValue, DcmDspDidSystemTemplateDiagnosticDataIdentifierRef=Did_ProgrammingCounterMaxValue
            ProgrammingCounterMaxValue (DcmDspDidSignal): DcmDspDidDataPos=0, DcmDspDidDataRef=DID_2503_ProgrammingCounterMaxValue
          Did_Pruefstempel: DcmDspDidIdentifier=4096, DcmDspDidInfoRef=DidInfo_Did_Pruefstempel, DcmDspDidSystemTemplateDiagnosticDataIdentifierRef=Did_Pruefstempel
            Pruefstempel (DcmDspDidSignal): DcmDspDidDataPos=0, DcmDspDidDataRef=DID_1000_Pruefstempel
          Did_ReadActiveSessionState: DcmDspDidIdentifier=61696, DcmDspDidInfoRef=DidInfo_Did_ReadActiveSessionState, DcmDspDidSystemTemplateDiagnosticDataIdentifierRef=Did_ReadActiveSessionState
            ReadActiveSessionState (DcmDspDidSignal): DcmDspDidDataPos=0, DcmDspDidDataRef=DID_F100_ReadActiveSessionState
          Did_ReadProtocolData: DcmDspDidIdentifier=14335, DcmDspDidInfoRef=DidInfo_Did_ReadProtocolData, DcmDspDidSystemTemplateDiagnosticDataIdentifierRef=Did_ReadProtocolData
            ReadProtocolData (DcmDspDidSignal): DcmDspDidDataPos=0, DcmDspDidDataRef=DID_37FF_ReadProtocolData
          Did_ReadSwRevision: DcmDspDidIdentifier=9483, DcmDspDidInfoRef=DidInfo_Did_ReadSwRevision, DcmDspDidSystemTemplateDiagnosticDataIdentifierRef=Did_ReadSwRevision
            ReadSwRevision (DcmDspDidSignal): DcmDspDidDataPos=0, DcmDspDidDataRef=DID_250B_ReadSwRevision
          Did_Readhwmodificationindex: DcmDspDidIdentifier=61778, DcmDspDidInfoRef=DidInfo_Did_Readhwmodificationindex, DcmDspDidSystemTemplateDiagnosticDataIdentifierRef=Did_Readhwmodificationindex
            Readhwmodificationindex (DcmDspDidSignal): DcmDspDidDataPos=0, DcmDspDidDataRef=DID_F152_Readhwmodificationindex
          Did_SgbdIdx: DcmDspDidIdentifier=61776, DcmDspDidInfoRef=DidInfo_Did_SgbdIdx, DcmDspDidSystemTemplateDiagnosticDataIdentifierRef=Did_SgbdIdx
            SgbdIdx (DcmDspDidSignal): DcmDspDidDataPos=0, DcmDspDidDataRef=DID_F150_SgbdIdx
          Did_StatusCalcvn: DcmDspDidIdentifier=9537, DcmDspDidInfoRef=DidInfo_Did_StatusCalcvn, DcmDspDidSystemTemplateDiagnosticDataIdentifierRef=Did_StatusCalcvn
            StatusCalcvn (DcmDspDidSignal): DcmDspDidDataPos=0, DcmDspDidDataRef=DID_2541_StatusCalcvn
          Did_StatusFzgBordnetz: DcmDspDidIdentifier=56124, DcmDspDidInfoRef=DidInfo_Did_StatusFzgBordnetz, DcmDspDidSystemTemplateDiagnosticDataIdentifierRef=Did_StatusFzgBordnetz
            StatusFzgBordnetz (DcmDspDidSignal): DcmDspDidDataPos=0, DcmDspDidDataRef=DID_DB3C_StatusFzgBordnetz
          Did_SvkAktuell: DcmDspDidIdentifier=61697, DcmDspDidInfoRef=DidInfo_Did_SvkAktuell, DcmDspDidSystemTemplateDiagnosticDataIdentifierRef=Did_SvkAktuell
            SvkAktuell (DcmDspDidSignal): DcmDspDidDataPos=0, DcmDspDidDataRef=DID_F101_SvkAktuell
          Did_SvkSysSupplier: DcmDspDidIdentifier=61698, DcmDspDidInfoRef=DidInfo_Did_SvkSysSupplier, DcmDspDidSystemTemplateDiagnosticDataIdentifierRef=Did_SvkSysSupplier
            SvkSysSupplier (DcmDspDidSignal): DcmDspDidDataPos=0, DcmDspDidDataRef=DID_F102_SvkSysSupplier
          Did_SvkWerk: DcmDspDidIdentifier=61699, DcmDspDidInfoRef=DidInfo_Did_SvkWerk, DcmDspDidSystemTemplateDiagnosticDataIdentifierRef=Did_SvkWerk
            SvkWerk (DcmDspDidSignal): DcmDspDidDataPos=0, DcmDspDidDataRef=DID_F103_SvkWerk
          Did_SwfkDeleteSupported: DcmDspDidIdentifier=9479, DcmDspDidInfoRef=DidInfo_Did_SwfkDeleteSupported, DcmDspDidSystemTemplateDiagnosticDataIdentifierRef=Did_SwfkDeleteSupported
            SwfkDeleteSupported (DcmDspDidSignal): DcmDspDidDataPos=0, DcmDspDidDataRef=DID_2507_SwfkDeleteSupported
          Did_SystemSupplierIdentifier: DcmDspDidIdentifier=61834, DcmDspDidInfoRef=DidInfo_Did_SystemSupplierIdentifier, DcmDspDidSystemTemplateDiagnosticDataIdentifierRef=Did_SystemSupplierIdentifier
            SystemSupplierIdentifier (DcmDspDidSignal): DcmDspDidDataPos=0, DcmDspDidDataRef=DID_F18A_SystemSupplierIdentifier
          Did_Systemzeit: DcmDspDidIdentifier=5889, DcmDspDidInfoRef=DidInfo_Did_Systemzeit, DcmDspDidSystemTemplateDiagnosticDataIdentifierRef=Did_Systemzeit
            Systemzeit (DcmDspDidSignal): DcmDspDidDataPos=0
          Did_WdbiFp: DcmDspDidIdentifier=61786, DcmDspDidInfoRef=DidInfo_Did_WdbiFp, DcmDspDidSystemTemplateDiagnosticDataIdentifierRef=Did_WdbiFp
            WdbiFp (DcmDspDidSignal): DcmDspDidDataPos=0, DcmDspDidDataRef=DID_F15A_WdbiFp
          FUwBn: DcmDspDidIdentifier=5968, DcmDspDidInfoRef=DidInfo_FUwBn, DcmDspDidSystemTemplateDiagnosticDataIdentifierRef=FUwBn
            FUwBn (DcmDspDidSignal): DcmDspDidDataPos=0, DcmDspDidDataRef=DcmDsp/DID_1750_FUwBn
          Fahrzeuggeschwindigkeit: DcmDspDidIdentifier=10343, DcmDspDidInfoRef=DidInfo_Fahrzeuggeschwindigkeit, DcmDspDidSystemTemplateDiagnosticDataIdentifierRef=Fahrzeuggeschwindigkeit
            Fahrzeuggeschwindigkeit (DcmDspDidSignal): DcmDspDidDataPos=0, DcmDspDidDataRef=DcmDsp/DID_2867_Fahrzeuggeschwindigkeit
          KmStand: DcmDspDidIdentifier=5888, DcmDspDidInfoRef=DidInfo_KmStand, DcmDspDidSystemTemplateDiagnosticDataIdentifierRef=KmStand
            KmStand (DcmDspDidSignal): DcmDspDidDataPos=0, DcmDspDidDataRef=DcmDsp/DID_1700_KmStand
          Systemzeit: DcmDspDidIdentifier=5889, DcmDspDidInfoRef=DidInfo_Systemzeit, DcmDspDidSystemTemplateDiagnosticDataIdentifierRef=Systemzeit
            Systemzeit (DcmDspDidSignal): DcmDspDidDataPos=0, DcmDspDidDataRef=DcmDsp/DID_1701_Systemzeit
        38 x DcmDspDidInfo, all with DcmDspDidDynamicallyDefined=false:
          DidInfo_Aussentemperatur  # Aussentemperatur
          DidInfo_Betriebsspannung  # Betriebsspannung
          DidInfo_Did_ActiveDiagnosticSession  # Did_ActiveDiagnosticSession
            DcmDspDidAccess
              DcmDspDidRead:
                DcmDspDidReadSessionRef = DEFAULT_SESSION
                DcmDspDidReadSessionRef = EXTENDED_DIAGNOSTIC_SESSION
                DcmDspDidReadSessionRef = GarageMode
                DcmDspDidReadSessionRef = PROGRAMMING_SESSION
          DidInfo_Did_Cps  # Did_Cps
            DcmDspDidAccess
              DcmDspDidRead: DcmDspDidReadSessionRef=CODING_SESSION, DcmDspDidReadSessionRef=DEFAULT_SESSION, DcmDspDidReadSessionRef=EXTENDED_DIAGNOSTIC_SESSION
          DidInfo_Did_DmDtcAktiveMeldung  # Did_DmDtcAktiveMeldung
            DcmDspDidAccess
              DcmDspDidRead: DcmDspDidReadSessionRef=DEFAULT_SESSION, DcmDspDidReadSessionRef=EXTENDED_DIAGNOSTIC_SESSION
          DidInfo_Did_DmIsDtcActiveResponse  # Did_DmIsDtcActiveResponse
            DcmDspDidAccess
              DcmDspDidRead: DcmDspDidReadSessionRef=DEFAULT_SESSION, DcmDspDidReadSessionRef=EXTENDED_DIAGNOSTIC_SESSION
          DidInfo_Did_EcuSerialNumber  # Did_EcuSerialNumber
            DcmDspDidAccess
              DcmDspDidRead: DcmDspDidReadSessionRef=DEFAULT_SESSION, DcmDspDidReadSessionRef=EXTENDED_DIAGNOSTIC_SESSION, DcmDspDidReadSessionRef=PROGRAMMING_SESSION
          DidInfo_Did_EnergySavingState  # Did_EnergySavingState
            DcmDspDidAccess
              DcmDspDidRead: DcmDspDidReadSessionRef=DEFAULT_SESSION, DcmDspDidReadSessionRef=EXTENDED_DIAGNOSTIC_SESSION, DcmDspDidReadSessionRef=PROGRAMMING_SESSION
          DidInfo_Did_EpsLenkwinkelsensorKalibrierung  # Did_EpsLenkwinkelsensorKalibrierung
            DcmDspDidAccess
              DcmDspDidRead: DcmDspDidReadSessionRef=DEFAULT_SESSION, DcmDspDidReadSessionRef=EXTENDED_DIAGNOSTIC_SESSION, DcmDspDidReadSessionRef=GarageMode
              DcmDspDidWrite: DcmDspDidWriteSessionRef=DEFAULT_SESSION, DcmDspDidWriteSessionRef=EXTENDED_DIAGNOSTIC_SESSION, DcmDspDidWriteSessionRef=GarageMode
          DidInfo_Did_EpsMomentensensor  # Did_EpsMomentensensor
            DcmDspDidAccess
              DcmDspDidRead: DcmDspDidReadSessionRef=DEFAULT_SESSION, DcmDspDidReadSessionRef=EXTENDED_DIAGNOSTIC_SESSION, DcmDspDidReadSessionRef=GarageMode
          DidInfo_Did_EpsRitzelwinkelsensor  # Did_EpsRitzelwinkelsensor
            DcmDspDidAccess
              DcmDspDidRead: DcmDspDidReadSessionRef=DEFAULT_SESSION, DcmDspDidReadSessionRef=EXTENDED_DIAGNOSTIC_SESSION, DcmDspDidReadSessionRef=GarageMode
          DidInfo_Did_EpsZahnstangenmitte  # Did_EpsZahnstangenmitte
            DcmDspDidAccess
              DcmDspDidRead:
                DcmDspDidReadSessionRef = CODING_SESSION
                DcmDspDidReadSessionRef = DEFAULT_SESSION
                DcmDspDidReadSessionRef = EXTENDED_DIAGNOSTIC_SESSION
                DcmDspDidReadSessionRef = PROGRAMMING_SESSION
          DidInfo_Did_ExtendedEnergySavingState  # Did_ExtendedEnergySavingState
            DcmDspDidAccess
              DcmDspDidRead: DcmDspDidReadSessionRef=DEFAULT_SESSION, DcmDspDidReadSessionRef=EXTENDED_DIAGNOSTIC_SESSION, DcmDspDidReadSessionRef=PROGRAMMING_SESSION
          DidInfo_Did_FlashTimingParameter  # Did_FlashTimingParameter
            DcmDspDidAccess
              DcmDspDidRead: DcmDspDidReadSessionRef=DEFAULT_SESSION, DcmDspDidReadSessionRef=EXTENDED_DIAGNOSTIC_SESSION, DcmDspDidReadSessionRef=PROGRAMMING_SESSION
          DidInfo_Did_GelernterZahnstangenweg  # Did_GelernterZahnstangenweg
            DcmDspDidAccess
              DcmDspDidRead: DcmDspDidReadSessionRef=DEFAULT_SESSION, DcmDspDidReadSessionRef=EXTENDED_DIAGNOSTIC_SESSION
          DidInfo_Did_Herstelldatum  # Did_Herstelldatum
            DcmDspDidAccess
              DcmDspDidRead: DcmDspDidReadSessionRef=DEFAULT_SESSION, DcmDspDidReadSessionRef=EXTENDED_DIAGNOSTIC_SESSION, DcmDspDidReadSessionRef=PROGRAMMING_SESSION
          DidInfo_Did_MileKmEeprom  # Did_MileKmEeprom
            DcmDspDidAccess
              DcmDspDidRead: DcmDspDidReadSessionRef=DEFAULT_SESSION, DcmDspDidReadSessionRef=EXTENDED_DIAGNOSTIC_SESSION
          DidInfo_Did_ProgrammingCounter  # Did_ProgrammingCounter
            DcmDspDidAccess
              DcmDspDidRead: DcmDspDidReadSessionRef=DEFAULT_SESSION, DcmDspDidReadSessionRef=EXTENDED_DIAGNOSTIC_SESSION, DcmDspDidReadSessionRef=PROGRAMMING_SESSION
          DidInfo_Did_ProgrammingCounterMaxValue  # Did_ProgrammingCounterMaxValue
            DcmDspDidAccess
              DcmDspDidRead: DcmDspDidReadSessionRef=DEFAULT_SESSION, DcmDspDidReadSessionRef=EXTENDED_DIAGNOSTIC_SESSION, DcmDspDidReadSessionRef=PROGRAMMING_SESSION
          DidInfo_Did_Pruefstempel  # Did_Pruefstempel
            DcmDspDidAccess
              DcmDspDidRead: DcmDspDidReadSessionRef=DEFAULT_SESSION, DcmDspDidReadSessionRef=EXTENDED_DIAGNOSTIC_SESSION
              DcmDspDidWrite: DcmDspDidWriteSessionRef=DEFAULT_SESSION, DcmDspDidWriteSessionRef=EXTENDED_DIAGNOSTIC_SESSION
          DidInfo_Did_ReadActiveSessionState  # Did_ReadActiveSessionState
            DcmDspDidAccess
              DcmDspDidRead: DcmDspDidReadSessionRef=DEFAULT_SESSION, DcmDspDidReadSessionRef=EXTENDED_DIAGNOSTIC_SESSION, DcmDspDidReadSessionRef=PROGRAMMING_SESSION
          DidInfo_Did_ReadProtocolData  # Did_ReadProtocolData
            DcmDspDidAccess
              DcmDspDidRead: DcmDspDidReadSessionRef=CODING_SESSION, DcmDspDidReadSessionRef=DEFAULT_SESSION, DcmDspDidReadSessionRef=EXTENDED_DIAGNOSTIC_SESSION
          DidInfo_Did_ReadSwRevision  # Did_ReadSwRevision
            DcmDspDidAccess
              DcmDspDidRead: DcmDspDidReadSessionRef=DEFAULT_SESSION, DcmDspDidReadSessionRef=EXTENDED_DIAGNOSTIC_SESSION, DcmDspDidReadSessionRef=PROGRAMMING_SESSION
          DidInfo_Did_Readhwmodificationindex  # Did_Readhwmodificationindex
            DcmDspDidAccess
              DcmDspDidRead: DcmDspDidReadSessionRef=DEFAULT_SESSION, DcmDspDidReadSessionRef=EXTENDED_DIAGNOSTIC_SESSION, DcmDspDidReadSessionRef=PROGRAMMING_SESSION
          DidInfo_Did_SgbdIdx  # Did_SgbdIdx
            DcmDspDidAccess
              DcmDspDidRead: DcmDspDidReadSessionRef=DEFAULT_SESSION, DcmDspDidReadSessionRef=EXTENDED_DIAGNOSTIC_SESSION
          DidInfo_Did_StatusCalcvn  # Did_StatusCalcvn
            DcmDspDidAccess
              DcmDspDidRead: DcmDspDidReadSessionRef=DEFAULT_SESSION, DcmDspDidReadSessionRef=EXTENDED_DIAGNOSTIC_SESSION
          DidInfo_Did_StatusFzgBordnetz  # Did_StatusFzgBordnetz
            DcmDspDidAccess
              DcmDspDidRead: DcmDspDidReadSessionRef=DEFAULT_SESSION, DcmDspDidReadSessionRef=EXTENDED_DIAGNOSTIC_SESSION
          DidInfo_Did_SvkAktuell  # Did_SvkAktuell
            DcmDspDidAccess
              DcmDspDidRead:
                DcmDspDidReadSessionRef = DEFAULT_SESSION
                DcmDspDidReadSessionRef = EXTENDED_DIAGNOSTIC_SESSION
                DcmDspDidReadSessionRef = GarageMode
                DcmDspDidReadSessionRef = PROGRAMMING_SESSION
          DidInfo_Did_SvkSysSupplier  # Did_SvkSysSupplier
            DcmDspDidAccess
              DcmDspDidRead: DcmDspDidReadSessionRef=DEFAULT_SESSION, DcmDspDidReadSessionRef=EXTENDED_DIAGNOSTIC_SESSION, DcmDspDidReadSessionRef=PROGRAMMING_SESSION
          DidInfo_Did_SvkWerk  # Did_SvkWerk
            DcmDspDidAccess
              DcmDspDidRead: DcmDspDidReadSessionRef=DEFAULT_SESSION, DcmDspDidReadSessionRef=EXTENDED_DIAGNOSTIC_SESSION, DcmDspDidReadSessionRef=PROGRAMMING_SESSION
          DidInfo_Did_SwfkDeleteSupported  # Did_SwfkDeleteSupported
            DcmDspDidAccess
              DcmDspDidRead: DcmDspDidReadSessionRef=DEFAULT_SESSION, DcmDspDidReadSessionRef=EXTENDED_DIAGNOSTIC_SESSION, DcmDspDidReadSessionRef=PROGRAMMING_SESSION
          DidInfo_Did_SystemSupplierIdentifier  # Did_SystemSupplierIdentifier
            DcmDspDidAccess
              DcmDspDidRead: DcmDspDidReadSessionRef=DEFAULT_SESSION, DcmDspDidReadSessionRef=EXTENDED_DIAGNOSTIC_SESSION
          DidInfo_Did_Systemzeit  # Did_Systemzeit
            DcmDspDidAccess
              DcmDspDidRead: DcmDspDidReadSessionRef=DEFAULT_SESSION, DcmDspDidReadSessionRef=EXTENDED_DIAGNOSTIC_SESSION
          DidInfo_Did_WdbiFp  # Did_WdbiFp
            DcmDspDidAccess
              DcmDspDidWrite: DcmDspDidWriteSessionRef=PROGRAMMING_SESSION
          DidInfo_FUwBn  # FUwBn
          DidInfo_Fahrzeuggeschwindigkeit  # Fahrzeuggeschwindigkeit
          DidInfo_KmStand  # KmStand
          DidInfo_Systemzeit  # Systemzeit
        22 x DcmDspRoutine, all with DcmDspRoutineUsed=true:
          CheckNcd_Routine: DcmDspRequestResultsRoutineSupported=false, DcmDspRoutineIdentifier=14334, DcmDspStopRoutineSupported=false, DcmDspRoutineInfoRef=RoutineInfo_CheckNcd_Routine, DcmDspRoutineSystemTemplateDiagnosticRoutineRef=CheckNcd_Routine
          ControlExtendedEnergySavingState_Routine: DcmDspRequestResultsRoutineSupported=false, DcmDspRoutineIdentifier=4099, DcmDspStopRoutineSupported=false, DcmDspRoutineInfoRef=RoutineInfo_ControlExtendedEnergySavingState_Routine, DcmDspRoutineSystemTemplateDiagnosticRoutineRef=ControlExtendedEnergySavingState_Routine
          DeleteSwPackage_Routine: DcmDspRequestResultsRoutineSupported=false, DcmDspRoutineIdentifier=544, DcmDspStopRoutineSupported=false, DcmDspRoutineInfoRef=RoutineInfo_DeleteSwPackage_Routine, DcmDspRoutineSystemTemplateDiagnosticRoutineRef=DeleteSwPackage_Routine
          DiagCommLoopback_Routine: DcmDspRequestResultsRoutineSupported=false, DcmDspRoutineIdentifier=771, DcmDspStopRoutineSupported=false, DcmDspRoutineInfoRef=RoutineInfo_DiagCommLoopback_Routine, DcmDspRoutineSystemTemplateDiagnosticRoutineRef=DiagCommLoopback_Routine
          DmClientTriggerDtcEntry_Routine: DcmDspRequestResultsRoutineSupported=false, DcmDspRoutineIdentifier=772, DcmDspStopRoutineSupported=false, DcmDspRoutineInfoRef=RoutineInfo_DmClientTriggerDtcEntry_Routine, DcmDspRoutineSystemTemplateDiagnosticRoutineRef=DmClientTriggerDtcEntry_Routine
          Energiesparmode_Routine: DcmDspRequestResultsRoutineSupported=false, DcmDspRoutineIdentifier=3852, DcmDspStopRoutineSupported=false, DcmDspRoutineInfoRef=RoutineInfo_Energiesparmode_Routine, DcmDspRoutineSystemTemplateDiagnosticRoutineRef=Energiesparmode_Routine
          EpsInitialisierungService_Routine: DcmDspRequestResultsRoutineSupported=true, DcmDspRoutineIdentifier=43884, DcmDspStopRoutineSupported=true, DcmDspRoutineInfoRef=RoutineInfo_EpsInitialisierungService_Routine, DcmDspRoutineSystemTemplateDiagnosticRoutineRef=EpsInitialisierungService_Routine
          EpsInitialisierungWerk_Routine: DcmDspRequestResultsRoutineSupported=true, DcmDspRoutineIdentifier=43890, DcmDspStopRoutineSupported=false, DcmDspRoutineInfoRef=RoutineInfo_EpsInitialisierungWerk_Routine, DcmDspRoutineSystemTemplateDiagnosticRoutineRef=EpsInitialisierungWerk_Routine
          EpsLenkwinkelsensorKalibrierungReset_Routine: DcmDspRequestResultsRoutineSupported=false, DcmDspRoutineIdentifier=43881, DcmDspStopRoutineSupported=false, DcmDspRoutineInfoRef=RoutineInfo_EpsLenkwinkelsensorKalibrierungReset_Routine, DcmDspRoutineSystemTemplateDiagnosticRoutineRef=EpsLenkwinkelsensorKalibrierungReset_Routine
          EpsPendeln_Routine: DcmDspRequestResultsRoutineSupported=true, DcmDspRoutineIdentifier=43862, DcmDspStopRoutineSupported=false, DcmDspRoutineInfoRef=RoutineInfo_EpsPendeln_Routine, DcmDspRoutineSystemTemplateDiagnosticRoutineRef=EpsPendeln_Routine
          EpsVerfahren_Routine: DcmDspRequestResultsRoutineSupported=true, DcmDspRoutineIdentifier=43889, DcmDspStopRoutineSupported=false, DcmDspRoutineInfoRef=RoutineInfo_EpsVerfahren_Routine, DcmDspRoutineSystemTemplateDiagnosticRoutineRef=EpsVerfahren_Routine
          EpsZahnstangenmitteReset_Routine: DcmDspRequestResultsRoutineSupported=false, DcmDspRoutineIdentifier=43900, DcmDspStopRoutineSupported=false, DcmDspRoutineInfoRef=RoutineInfo_EpsZahnstangenmitteReset_Routine, DcmDspRoutineSystemTemplateDiagnosticRoutineRef=EpsZahnstangenmitteReset_Routine
          IsLoeschen_Routine: DcmDspRequestResultsRoutineSupported=false, DcmDspRoutineIdentifier=3846, DcmDspStopRoutineSupported=false, DcmDspRoutineInfoRef=RoutineInfo_IsLoeschen_Routine, DcmDspRoutineSystemTemplateDiagnosticRoutineRef=IsLoeschen_Routine
          RcCm_Routine: DcmDspRequestResultsRoutineSupported=false, DcmDspRoutineIdentifier=514, DcmDspStopRoutineSupported=false, DcmDspRoutineInfoRef=RoutineInfo_RcCm_Routine, DcmDspRoutineSystemTemplateDiagnosticRoutineRef=RcCm_Routine
          RcCpd_Routine: DcmDspRequestResultsRoutineSupported=false, DcmDspRoutineIdentifier=65281, DcmDspStopRoutineSupported=false, DcmDspRoutineInfoRef=RoutineInfo_RcCpd_Routine, DcmDspRoutineSystemTemplateDiagnosticRoutineRef=RcCpd_Routine
          RcCppc_Routine: DcmDspRequestResultsRoutineSupported=false, DcmDspRoutineIdentifier=515, DcmDspStopRoutineSupported=false, DcmDspRoutineInfoRef=RoutineInfo_RcCppc_Routine, DcmDspRoutineSystemTemplateDiagnosticRoutineRef=RcCppc_Routine
          RcEm_Routine: DcmDspRequestResultsRoutineSupported=false, DcmDspRoutineIdentifier=65280, DcmDspStopRoutineSupported=false, DcmDspRoutineInfoRef=RoutineInfo_RcEm_Routine, DcmDspRoutineSystemTemplateDiagnosticRoutineRef=RcEm_Routine
          RcRswedi_Routine: DcmDspRequestResultsRoutineSupported=false, DcmDspRoutineIdentifier=517, DcmDspStopRoutineSupported=false, DcmDspRoutineInfoRef=RoutineInfo_RcRswedi_Routine, DcmDspRoutineSystemTemplateDiagnosticRoutineRef=RcRswedi_Routine
          ReadNcd_Routine: DcmDspRequestResultsRoutineSupported=false, DcmDspRoutineIdentifier=14332, DcmDspStopRoutineSupported=false, DcmDspRoutineInfoRef=RoutineInfo_ReadNcd_Routine, DcmDspRoutineSystemTemplateDiagnosticRoutineRef=ReadNcd_Routine
          SteuernEpsMultiturnwertReset_Routine: DcmDspRequestResultsRoutineSupported=false, DcmDspRoutineIdentifier=43901, DcmDspStopRoutineSupported=false, DcmDspRoutineInfoRef=RoutineInfo_SteuernEpsMultiturnwertReset_Routine, DcmDspRoutineSystemTemplateDiagnosticRoutineRef=SteuernEpsMultiturnwertReset_Routine
          SteuernEpsPulldriftOffsetReset_Routine: DcmDspRequestResultsRoutineSupported=false, DcmDspRoutineIdentifier=41659, DcmDspStopRoutineSupported=false, DcmDspRoutineInfoRef=RoutineInfo_SteuernEpsPulldriftOffsetReset_Routine, DcmDspRoutineSystemTemplateDiagnosticRoutineRef=SteuernEpsPulldriftOffsetReset_Routine
          WriteNcd_Routine: DcmDspRequestResultsRoutineSupported=false, DcmDspRoutineIdentifier=14333, DcmDspStopRoutineSupported=false, DcmDspRoutineInfoRef=RoutineInfo_WriteNcd_Routine, DcmDspRoutineSystemTemplateDiagnosticRoutineRef=WriteNcd_Routine
        22 x DcmDspRoutineInfo:
          RoutineInfo_CheckNcd_Routine  # CheckNcd_Routine
            DcmDspRoutineAuthorization: DcmDspRoutineSessionRef=CODING_SESSION
            DcmDspStartRoutineIn
              Cps_In (DcmDspStartRoutineInSignal): DcmDspRoutineSignalPos=0
            DcmDspStartRoutineOut
              StatCheckNcdResult_Out (DcmDspStartRoutineOutSignal): DcmDspRoutineSignalLength=8, DcmDspRoutineSignalPos=0, DcmDspRoutineSignalType=UINT8
          RoutineInfo_ControlExtendedEnergySavingState_Routine  # ControlExtendedEnergySavingState_Routine
            DcmDspRoutineAuthorization: DcmDspRoutineSessionRef=DEFAULT_SESSION, DcmDspRoutineSessionRef=EXTENDED_DIAGNOSTIC_SESSION
            DcmDspStartRoutineIn
              dataIn_In (DcmDspStartRoutineInSignal): DcmDspRoutineSignalLength=8, DcmDspRoutineSignalPos=0, DcmDspRoutineSignalType=UINT8
          RoutineInfo_DeleteSwPackage_Routine  # DeleteSwPackage_Routine
            DcmDspRoutineAuthorization: DcmDspRoutineSessionRef=PROGRAMMING_SESSION
          RoutineInfo_DiagCommLoopback_Routine  # DiagCommLoopback_Routine
            DcmDspRoutineAuthorization: DcmDspRoutineSessionRef=DEFAULT_SESSION, DcmDspRoutineSessionRef=EXTENDED_DIAGNOSTIC_SESSION
            DcmDspStartRoutineIn
              dataIn_In (DcmDspStartRoutineInSignal): DcmDspRoutineSignalPos=0
            DcmDspStartRoutineOut
              dataOut_Out (DcmDspStartRoutineOutSignal): DcmDspRoutineSignalPos=0
          RoutineInfo_DmClientTriggerDtcEntry_Routine  # DmClientTriggerDtcEntry_Routine
            DcmDspRoutineAuthorization: DcmDspRoutineSessionRef=DEFAULT_SESSION, DcmDspRoutineSessionRef=EXTENDED_DIAGNOSTIC_SESSION
            DcmDspStartRoutineIn
              DTCType_In (DcmDspStartRoutineInSignal): DcmDspRoutineSignalLength=8, DcmDspRoutineSignalPos=0, DcmDspRoutineSignalType=UINT8
            DcmDspStartRoutineOut
              4 x DcmDspStartRoutineOutSignal, all with DcmDspRoutineSignalLength=8, DcmDspRoutineSignalType=UINT8:
                DTCByte1_Out: DcmDspRoutineSignalPos=8
                DTCByte2_Out: DcmDspRoutineSignalPos=16
                DTCByte3_Out: DcmDspRoutineSignalPos=24
                DTCTypeOut_Out: DcmDspRoutineSignalPos=0
          RoutineInfo_Energiesparmode_Routine  # Energiesparmode_Routine
            DcmDspRoutineAuthorization: DcmDspRoutineSessionRef=DEFAULT_SESSION, DcmDspRoutineSessionRef=EXTENDED_DIAGNOSTIC_SESSION
            DcmDspStartRoutineIn
              dataIn_In (DcmDspStartRoutineInSignal): DcmDspRoutineSignalLength=8, DcmDspRoutineSignalPos=0, DcmDspRoutineSignalType=UINT8
          RoutineInfo_EpsInitialisierungService_Routine  # EpsInitialisierungService_Routine
            DcmDspRoutineAuthorization: DcmDspRoutineSessionRef=DEFAULT_SESSION, DcmDspRoutineSessionRef=EXTENDED_DIAGNOSTIC_SESSION, DcmDspRoutineSessionRef=GarageMode
            DcmDspRoutineRequestResOut
              3 x DcmDspRoutineRequestResOutSignal:
                StatLenkradwinkelWert_Out: DcmDspRoutineSignalPos=8
                StatRoutineStatus_Out: DcmDspRoutineSignalLength=8, DcmDspRoutineSignalPos=0, DcmDspRoutineSignalType=UINT8
                StatSensorZustandNr_Out: DcmDspRoutineSignalLength=8, DcmDspRoutineSignalPos=24, DcmDspRoutineSignalType=UINT8
          RoutineInfo_EpsInitialisierungWerk_Routine  # EpsInitialisierungWerk_Routine
            DcmDspRoutineAuthorization: DcmDspRoutineSessionRef=GarageMode
            DcmDspRoutineRequestResOut
              StatRoutineStatus_Out (DcmDspRoutineRequestResOutSignal): DcmDspRoutineSignalLength=8, DcmDspRoutineSignalPos=0, DcmDspRoutineSignalType=UINT8
            DcmDspStartRoutineIn
              3 x DcmDspStartRoutineInSignal, all with DcmDspRoutineSignalLength=8, DcmDspRoutineSignalType=UINT8:
                Winkel_In: DcmDspRoutineSignalPos=0
                Winkelbeschleunigung_In: DcmDspRoutineSignalPos=16
                Winkelgeschwindigkeit_In: DcmDspRoutineSignalPos=8
          RoutineInfo_EpsLenkwinkelsensorKalibrierungReset_Routine  # EpsLenkwinkelsensorKalibrierungReset_Routine
            DcmDspRoutineAuthorization: DcmDspRoutineSessionRef=GarageMode
          RoutineInfo_EpsPendeln_Routine  # EpsPendeln_Routine
            DcmDspRoutineAuthorization: DcmDspRoutineSessionRef=GarageMode
            DcmDspRoutineRequestResOut
              StatEpsPendelnAktivNr_Out (DcmDspRoutineRequestResOutSignal): DcmDspRoutineSignalLength=8, DcmDspRoutineSignalPos=0, DcmDspRoutineSignalType=UINT8
            DcmDspStartRoutineIn
              3 x DcmDspStartRoutineInSignal, all with DcmDspRoutineSignalLength=8, DcmDspRoutineSignalType=UINT8:
                Frequenz_In: DcmDspRoutineSignalPos=0
                MaxAmplitude_In: DcmDspRoutineSignalPos=8
                NumberOfCycles_In: DcmDspRoutineSignalPos=16
          RoutineInfo_EpsVerfahren_Routine  # EpsVerfahren_Routine
            DcmDspRoutineAuthorization: DcmDspRoutineSessionRef=GarageMode
            DcmDspRoutineRequestResOut
              StatEpsVerfahrenAktivNr_Out (DcmDspRoutineRequestResOutSignal): DcmDspRoutineSignalLength=8, DcmDspRoutineSignalPos=0, DcmDspRoutineSignalType=UINT8
            DcmDspStartRoutineIn
              4 x DcmDspStartRoutineInSignal:
                AbsolutEin_In: DcmDspRoutineSignalLength=8, DcmDspRoutineSignalPos=32, DcmDspRoutineSignalType=UINT8
                Winkel_In: DcmDspRoutineSignalPos=0
                Winkelbeschleunigung_In: DcmDspRoutineSignalLength=8, DcmDspRoutineSignalPos=24, DcmDspRoutineSignalType=UINT8
                Winkelgeschwindigkeit_In: DcmDspRoutineSignalLength=8, DcmDspRoutineSignalPos=16, DcmDspRoutineSignalType=UINT8
          RoutineInfo_EpsZahnstangenmitteReset_Routine  # EpsZahnstangenmitteReset_Routine
            DcmDspRoutineAuthorization: DcmDspRoutineSessionRef=SYSTEM_SUPPLIER_SPECIFIC_61
          RoutineInfo_IsLoeschen_Routine  # IsLoeschen_Routine
            DcmDspRoutineAuthorization: DcmDspRoutineSessionRef=DEFAULT_SESSION, DcmDspRoutineSessionRef=EXTENDED_DIAGNOSTIC_SESSION, DcmDspRoutineSessionRef=GarageMode
          RoutineInfo_RcCm_Routine  # RcCm_Routine
            DcmDspRoutineAuthorization: DcmDspRoutineSessionRef=PROGRAMMING_SESSION
            DcmDspStartRoutineIn
              RcCmIcvRcoStruct_In (DcmDspStartRoutineInSignal): DcmDspRoutineSignalPos=0
            DcmDspStartRoutineOut
              StatRoutineStatus_Out (DcmDspStartRoutineOutSignal): DcmDspRoutineSignalLength=8, DcmDspRoutineSignalPos=0, DcmDspRoutineSignalType=UINT8
          RoutineInfo_RcCpd_Routine  # RcCpd_Routine
            DcmDspRoutineAuthorization: DcmDspRoutineSessionRef=PROGRAMMING_SESSION
            DcmDspStartRoutineOut
              StatRoutineStatus_Out (DcmDspStartRoutineOutSignal): DcmDspRoutineSignalLength=8, DcmDspRoutineSignalPos=0, DcmDspRoutineSignalType=UINT8
          RoutineInfo_RcCppc_Routine  # RcCppc_Routine
            DcmDspRoutineAuthorization: DcmDspRoutineSessionRef=DEFAULT_SESSION, DcmDspRoutineSessionRef=EXTENDED_DIAGNOSTIC_SESSION
            DcmDspStartRoutineOut
              dataOut_Out (DcmDspStartRoutineOutSignal): DcmDspRoutineSignalPos=0
          RoutineInfo_RcEm_Routine  # RcEm_Routine
            DcmDspRoutineAuthorization: DcmDspRoutineSessionRef=PROGRAMMING_SESSION
            DcmDspStartRoutineIn
              RcEmIeRco_In (DcmDspStartRoutineInSignal): DcmDspRoutineSignalPos=0
            DcmDspStartRoutineOut
              StatRoutineStatus_Out (DcmDspStartRoutineOutSignal): DcmDspRoutineSignalLength=8, DcmDspRoutineSignalPos=0, DcmDspRoutineSignalType=UINT8
          RoutineInfo_RcRswedi_Routine  # RcRswedi_Routine
            DcmDspRoutineAuthorization: DcmDspRoutineSessionRef=DEFAULT_SESSION, DcmDspRoutineSessionRef=EXTENDED_DIAGNOSTIC_SESSION
            DcmDspStartRoutineIn
              DataIn_In (DcmDspStartRoutineInSignal): DcmDspRoutineSignalPos=0
            DcmDspStartRoutineOut
              DataOut_Out (DcmDspStartRoutineOutSignal): DcmDspRoutineSignalPos=0
          RoutineInfo_ReadNcd_Routine  # ReadNcd_Routine
            DcmDspRoutineAuthorization: DcmDspRoutineSessionRef=CODING_SESSION, DcmDspRoutineSessionRef=DEFAULT_SESSION, DcmDspRoutineSessionRef=EXTENDED_DIAGNOSTIC_SESSION
            DcmDspStartRoutineIn
              ArgCodingArea_In (DcmDspStartRoutineInSignal): DcmDspRoutineSignalPos=0
            DcmDspStartRoutineOut
              StatCodingArea_Out (DcmDspStartRoutineOutSignal): DcmDspRoutineSignalPos=0
          RoutineInfo_SteuernEpsMultiturnwertReset_Routine  # SteuernEpsMultiturnwertReset_Routine
            DcmDspRoutineAuthorization: DcmDspRoutineSessionRef=DEFAULT_SESSION, DcmDspRoutineSessionRef=EXTENDED_DIAGNOSTIC_SESSION, DcmDspRoutineSessionRef=GarageMode
          RoutineInfo_SteuernEpsPulldriftOffsetReset_Routine  # SteuernEpsPulldriftOffsetReset_Routine
            DcmDspRoutineAuthorization: DcmDspRoutineSessionRef=GarageMode
          RoutineInfo_WriteNcd_Routine  # WriteNcd_Routine
            DcmDspRoutineAuthorization: DcmDspRoutineSessionRef=CODING_SESSION
            DcmDspStartRoutineIn
              ArgCodingArea_In (DcmDspStartRoutineInSignal): DcmDspRoutineSignalPos=0
        DcmDspSession
          8 x DcmDspSessionRow, all with DcmDspSessionP2ServerMax=0.05, DcmDspSessionP2StarServerMax=5:
            CODING_SESSION: DcmDspSessionForBoot=DCM_NO_BOOT, DcmDspSessionLevel=65
            DEFAULT_SESSION: DcmDspSessionForBoot=DCM_NO_BOOT, DcmDspSessionLevel=1
            DEVELOPMENT_SESSION: DcmDspSessionForBoot=DCM_NO_BOOT, DcmDspSessionLevel=79
            EXTENDED_DIAGNOSTIC_SESSION: DcmDspSessionForBoot=DCM_NO_BOOT, DcmDspSessionLevel=3
            GarageMode: DcmDspSessionForBoot=DCM_NO_BOOT, DcmDspSessionLevel=95
            PROGRAMMING_SESSION: DcmDspSessionForBoot=DCM_NO_BOOT, DcmDspSessionLevel=2
            RSU_SESSION: DcmDspSessionForBoot=DCM_NO_BOOT, DcmDspSessionLevel=68
            SYSTEM_SUPPLIER_SPECIFIC_61: DcmDspSessionLevel=97
      DcmGeneral: DcmRespondAllRequest=false
  module config Dem
    DemConfigSet
      14 x DemDTCClass:
        DTC_023000: DemUdsDTC=143360
        DTC_023008: DemUdsDTC=143368
        DTC_023009: DemUdsDTC=143369
        DTC_02300A: DemUdsDTC=143370
        DTC_023040: DemUdsDTC=143424
        DTC_023041: DemUdsDTC=143425
        DTC_023042: DemUdsDTC=143426
        DTC_023043: DemUdsDTC=143427
        DTC_023044: DemUdsDTC=143428
        DTC_023045: DemUdsDTC=143429
        DTC_02FF30: DemUdsDTC=196400
        DTC_D5041F: DemUdsDTC=13960223
        DTC_D50420: DemUdsDTC=13960224
        DTC_D50BFF: DemUdsDTC=13962239
      14 x DemEventParameter, all with DemEventKind=DEM_EVENT_KIND_SWC, DemMaxNumberFreezeFrameRecords=2, DemFreezeFrameRecNumClassRef=DemFreezeFrameRecNumClass:
        CodingEventNotCoded: DemDTCClassRef=DTC_023008, DemExtendedDataClassRef=ExtendedDataClass_DTC_023000_Props, DemFreezeFrameClassRef=FreezeFrameClass_DTC_023000_Props
          DemCallbackClearEventAllowed: DemClearEventAllowedBehavior=DEM_NO_STATUS_BYTE_CHANGE
          DemEventClass:
            DemAgingAllowed = false
            DemEventDestination = DEM_DTC_ORIGIN_PRIMARY_MEMORY
            DemEventFailureCycleCounterThreshold = 1
            DemEventSignificance = DEM_EVENT_SIGNIFICANCE_FAULT
            DemDebounceAlgorithmClass
        CodingEventUnqualifiedData: DemDTCClassRef=DTC_02300A, DemExtendedDataClassRef=ExtendedDataClass_DTC_023000_Props, DemFreezeFrameClassRef=FreezeFrameClass_DTC_023000_Props
          DemEventClass:
            DemAgingAllowed = false
            DemEventDestination = DEM_DTC_ORIGIN_PRIMARY_MEMORY
            DemEventFailureCycleCounterThreshold = 1
            DemEventSignificance = DEM_EVENT_SIGNIFICANCE_FAULT
            DemDebounceAlgorithmClass
        CodingEventWrongVehicle: DemDTCClassRef=DTC_023009, DemExtendedDataClassRef=ExtendedDataClass_DTC_023000_Props, DemFreezeFrameClassRef=FreezeFrameClass_DTC_023000_Props
          DemEventClass:
            DemAgingAllowed = false
            DemEventDestination = DEM_DTC_ORIGIN_PRIMARY_MEMORY
            DemEventFailureCycleCounterThreshold = 1
            DemEventSignificance = DEM_EVENT_SIGNIFICANCE_FAULT
            DemDebounceAlgorithmClass
        DmTestAppl: DemDTCClassRef=DTC_02FF30, DemExtendedDataClassRef=ExtendedDataClass_DTC_023000_Props, DemFreezeFrameClassRef=FreezeFrameClass_DTC_023000_Props
          DemEventClass:
            DemAgingAllowed = false
            DemEventDestination = DEM_DTC_ORIGIN_PRIMARY_MEMORY
            DemEventFailureCycleCounterThreshold = 1
            DemEventSignificance = DEM_EVENT_SIGNIFICANCE_OCCURRENCE
            DemDebounceAlgorithmClass
        DmTestCom: DemDTCClassRef=DTC_D50BFF, DemExtendedDataClassRef=ExtendedDataClass_DTC_023000_Props, DemFreezeFrameClassRef=FreezeFrameClass_DTC_023000_Props
          DemEventClass:
            DemAgingAllowed = false
            DemEventDestination = DEM_DTC_ORIGIN_PRIMARY_MEMORY
            DemEventFailureCycleCounterThreshold = 1
            DemEventSignificance = DEM_EVENT_SIGNIFICANCE_OCCURRENCE
            DemDebounceAlgorithmClass
        FrsmEClusterSyncLoss: DemDTCClassRef=DTC_D50420, DemExtendedDataClassRef=ExtendedDataClass_DTC_D5041F_Props, DemFreezeFrameClassRef=FreezeFrameClass_DTC_023000_Props
          DemEventClass: DemAgingAllowed=true, DemEventDestination=DEM_DTC_ORIGIN_PRIMARY_MEMORY, DemEventSignificance=DEM_EVENT_SIGNIFICANCE_FAULT
            DemDebounceAlgorithmClass
        FrtrcvEFrBuserrorTrcv0: DemDTCClassRef=DTC_D5041F, DemExtendedDataClassRef=ExtendedDataClass_DTC_D5041F_Props, DemFreezeFrameClassRef=FreezeFrameClass_DTC_023000_Props
          DemEventClass:
            DemAgingAllowed = true
            DemEventDestination = DEM_DTC_ORIGIN_PRIMARY_MEMORY
            DemEventFailureCycleCounterThreshold = 1
            DemEventSignificance = DEM_EVENT_SIGNIFICANCE_FAULT
            DemDebounceAlgorithmClass
        GlobalOvervoltageExt: DemDTCClassRef=DTC_023043, DemExtendedDataClassRef=ExtendedDataClass_DTC_023000_Props, DemFreezeFrameClassRef=FreezeFrameClass_DTC_023040_Props
          DemEventClass:
            DemAgingAllowed = false
            DemEventDestination = DEM_DTC_ORIGIN_PRIMARY_MEMORY
            DemEventFailureCycleCounterThreshold = 1
            DemEventSignificance = DEM_EVENT_SIGNIFICANCE_OCCURRENCE
            DemDebounceAlgorithmClass
        GlobalOvervoltageInt: DemDTCClassRef=DTC_023042, DemExtendedDataClassRef=ExtendedDataClass_DTC_023000_Props, DemFreezeFrameClassRef=FreezeFrameClass_DTC_023040_Props
          DemEventClass:
            DemAgingAllowed = false
            DemEventDestination = DEM_DTC_ORIGIN_PRIMARY_MEMORY
            DemEventFailureCycleCounterThreshold = 1
            DemEventSignificance = DEM_EVENT_SIGNIFICANCE_OCCURRENCE
            DemDebounceAlgorithmClass
        GlobalUndervoltageExt: DemDTCClassRef=DTC_023045, DemExtendedDataClassRef=ExtendedDataClass_DTC_023000_Props, DemFreezeFrameClassRef=FreezeFrameClass_DTC_023040_Props
          DemEventClass:
            DemAgingAllowed = false
            DemEventDestination = DEM_DTC_ORIGIN_PRIMARY_MEMORY
            DemEventFailureCycleCounterThreshold = 1
            DemEventSignificance = DEM_EVENT_SIGNIFICANCE_OCCURRENCE
            DemDebounceAlgorithmClass
        GlobalUndervoltageInt: DemDTCClassRef=DTC_023044, DemExtendedDataClassRef=ExtendedDataClass_DTC_023000_Props, DemFreezeFrameClassRef=FreezeFrameClass_DTC_023040_Props
          DemEventClass:
            DemAgingAllowed = false
            DemEventDestination = DEM_DTC_ORIGIN_PRIMARY_MEMORY
            DemEventFailureCycleCounterThreshold = 1
            DemEventSignificance = DEM_EVENT_SIGNIFICANCE_OCCURRENCE
            DemDebounceAlgorithmClass
        LocalOvervoltage: DemDTCClassRef=DTC_023040, DemExtendedDataClassRef=ExtendedDataClass_DTC_023000_Props, DemFreezeFrameClassRef=FreezeFrameClass_DTC_023040_Props
          DemEventClass:
            DemAgingAllowed = false
            DemEventDestination = DEM_DTC_ORIGIN_PRIMARY_MEMORY
            DemEventFailureCycleCounterThreshold = 1
            DemEventSignificance = DEM_EVENT_SIGNIFICANCE_FAULT
            DemDebounceAlgorithmClass
        LocalUndervoltage: DemDTCClassRef=DTC_023041, DemExtendedDataClassRef=ExtendedDataClass_DTC_023000_Props, DemFreezeFrameClassRef=FreezeFrameClass_DTC_023040_Props
          DemEventClass:
            DemAgingAllowed = false
            DemEventDestination = DEM_DTC_ORIGIN_PRIMARY_MEMORY
            DemEventFailureCycleCounterThreshold = 1
            DemEventSignificance = DEM_EVENT_SIGNIFICANCE_FAULT
            DemDebounceAlgorithmClass
        VsmEventOpmode: DemDTCClassRef=DTC_023000, DemExtendedDataClassRef=ExtendedDataClass_DTC_023000_Props, DemFreezeFrameClassRef=FreezeFrameClass_DTC_023000_Props
          DemCallbackClearEventAllowed: DemClearEventAllowedBehavior=DEM_NO_STATUS_BYTE_CHANGE
          DemEventClass:
            DemAgingAllowed = false
            DemEventDestination = DEM_DTC_ORIGIN_PRIMARY_MEMORY
            DemEventFailureCycleCounterThreshold = 1
            DemEventSignificance = DEM_EVENT_SIGNIFICANCE_FAULT
            DemDebounceAlgorithmClass
    DemGeneral:
      DemAgingRequieresTestedCycle = true
      DemClearDTCLimitation = DEM_ALL_SUPPORTED_DTCS
      DemDataElementDefaultEndianness = BIG_ENDIAN
      DemDcmSupport = true
      DemEventDisplacementStrategy = DEM_DISPLACEMENT_FULL
      DemEventMemoryEntryStorageTrigger = DEM_STORAGE_ON_TEST_FAILED
      DemOccurrenceCounterProcessing = DEM_PROCESS_OCCCTR_TF
      DemResetConfirmedBitOnOverflow = true
      DemStatusBitHandlingTestFailedSinceLastClear = DEM_STATUS_BIT_AGING_AND_DISPLACEMENT
      DemStatusBitStorageTestFailed = true
      DemTypeOfDTCSupported = DEM_DTC_TRANSLATION_ISO14229_1
      DemTypeOfFreezeFrameRecordNumeration = DEM_FF_RECNUM_CALCULATED
      9 x DemDataClass:
        DID_1700_KmStand  # KmStand
        DID_1701_Systemzeit  # Systemzeit
        DID_1750_FUwBn: DemDataElementDataSize=1, DemDataElementDataType=UINT8, DemDataElementSystemTemplateDiagnosticDataElementRef=FUwBn  # FUwBn
        DID_2805_Aussentemperatur  # Aussentemperatur
        DID_2866_Betriebsspannung: DemDataElementDataSize=1, DemDataElementDataType=UINT8, DemDataElementSystemTemplateDiagnosticDataElementRef=Betriebsspannung  # Betriebsspannung
        DID_2867_Fahrzeuggeschwindigkeit: DemDataElementDataSize=1, DemDataElementDataType=UINT8, DemDataElementSystemTemplateDiagnosticDataElementRef=Fahrzeuggeschwindigkeit  # Fahrzeuggeschwindigkeit
        EDR_01_ConditionByte: DemDataElementDataSize=1, DemDataElementDataType=UINT8, DemDataElementSystemTemplateDiagnosticDataElementRef=ConditionByte  # ConditionByte
        EDR_02_OccurrenceCounter: DemDataElementDataSize=1, DemDataElementDataType=UINT8, DemDataElementSystemTemplateDiagnosticDataElementRef=OccurrenceCounter  # OccurrenceCounter
        EDR_03_HealingCounter: DemDataElementDataSize=1, DemDataElementDataType=UINT8, DemDataElementSystemTemplateDiagnosticDataElementRef=HealingCounter  # HealingCounter
      6 x DemDidClass:
        Aussentemperatur: DemDidIdentifier=10245, DemDidSystemTemplateDiagnosticDataIdentifierRef=Aussentemperatur
        Betriebsspannung: DemDidIdentifier=10342, DemDidDataClassRef=DemGeneral/DID_2866_Betriebsspannung, DemDidSystemTemplateDiagnosticDataIdentifierRef=Betriebsspannung
        FUwBn: DemDidIdentifier=5968, DemDidDataClassRef=DemGeneral/DID_1750_FUwBn, DemDidSystemTemplateDiagnosticDataIdentifierRef=FUwBn
        Fahrzeuggeschwindigkeit: DemDidIdentifier=10343, DemDidDataClassRef=DemGeneral/DID_2867_Fahrzeuggeschwindigkeit, DemDidSystemTemplateDiagnosticDataIdentifierRef=Fahrzeuggeschwindigkeit
        KmStand: DemDidIdentifier=5888, DemDidSystemTemplateDiagnosticDataIdentifierRef=KmStand
        Systemzeit: DemDidIdentifier=5889, DemDidSystemTemplateDiagnosticDataIdentifierRef=Systemzeit
      ExtendedDataClass_DTC_023000_Props (DemExtendedDataClass): DemExtendedDataRecordClassRef=ConditionByte, DemExtendedDataRecordClassRef=OccurrenceCounter  # DTC_023000_Props
      ExtendedDataClass_DTC_D5041F_Props (DemExtendedDataClass): DemExtendedDataRecordClassRef=ConditionByte, DemExtendedDataRecordClassRef=HealingCounter, DemExtendedDataRecordClassRef=OccurrenceCounter  # DTC_D5041F_Props
      3 x DemExtendedDataRecordClass, all with DemExtendedDataRecordUpdate=DEM_UPDATE_RECORD_YES:
        ConditionByte: DemExtendedDataRecordNumber=1, DemDataClassRef=EDR_01_ConditionByte
        HealingCounter: DemExtendedDataRecordNumber=3, DemDataClassRef=EDR_03_HealingCounter
        OccurrenceCounter: DemExtendedDataRecordNumber=2, DemDataClassRef=EDR_02_OccurrenceCounter
      FreezeFrameClass_DTC_023000_Props (DemFreezeFrameClass): DemDidClassRef=DemGeneral/FUwBn, DemDidClassRef=DemGeneral/KmStand, DemDidClassRef=DemGeneral/Systemzeit  # DTC_023000_Props
      FreezeFrameClass_DTC_023040_Props (DemFreezeFrameClass):  # DTC_023040_Props
        DemDidClassRef = DemGeneral/Aussentemperatur
        DemDidClassRef = DemGeneral/Betriebsspannung
        DemDidClassRef = DemGeneral/FUwBn
        DemDidClassRef = DemGeneral/Fahrzeuggeschwindigkeit
        DemDidClassRef = DemGeneral/KmStand
        DemDidClassRef = DemGeneral/Systemzeit
      DemFreezeFrameRecNumClass
  module config EcuC
    EcucPduCollection: PduIdTypeEnum=UINT8, PduLengthTypeEnum=UINT8
      59 x Pdu:
        ANFRAGE_fbd80461_In: PduLength=8
        ANFRAGE_fbd80461_Out: PduLength=8
        SVC_fbd80461_In: PduLength=8, SysTPduToFrameMappingRef=p2fmap_SVC
        SVC_fbd80461_Out: PduLength=8, SysTPduToFrameMappingRef=p2fmap_SVC
        p2fmap_TL_BRC_FR_32_003b6d76: PduLength=32, SysTPduToFrameMappingRef=p2fmap_TL_BRC_FR_32  # TL_BRC_FR_32
        p2fmap_TL_ECU_TRNSM_FR_32_c9b68eba: PduLength=32, SysTPduToFrameMappingRef=p2fmap_TL_ECU_TRNSM_FR_32  # TL_ECU_TRNSM_FR_32
        p2fmap_TL_MST_GW_TRNSM_FR_254_c761be43: PduLength=254, SysTPduToFrameMappingRef=p2fmap_TL_MST_GW_TRNSM_FR_254  # TL_MST_GW_TRNSM_FR_254
        pduTrig_ACLNY_MASSCNTR_pduPort_EPS_A_FlexRay_IN_55c86d41_4f391dd1: PduLength=6, SysTPduToFrameMappingRef=p2fmap_ACLNY_MASSCNTR  # ACLNY_MASSCNTR
        pduTrig_AVL_FORC_GRD_pduPort_EPS_A_FlexRay_OUT_55c86d41_4f391dd1: PduLength=5, SysTPduToFrameMappingRef=p2fmap_AVL_FORC_GRD  # AVL_FORC_GRD
        pduTrig_AVL_PO_EPS_pduPort_EPS_A_FlexRay_OUT_55c86d41_4f391dd1: PduLength=8, SysTPduToFrameMappingRef=p2fmap_AVL_PO_EPS  # AVL_PO_EPS
        pduTrig_AVL_RPM_WHL_pduPort_EPS_A_FlexRay_IN_55c86d41_4f391dd1: PduLength=12, SysTPduToFrameMappingRef=p2fmap_AVL_RPM_WHL  # AVL_RPM_WHL
        pduTrig_AVL_STMOM_DV_ACT_pduPort_EPS_A_FlexRay_OUT_55c86d41_4f391dd1: PduLength=4, SysTPduToFrameMappingRef=p2fmap_AVL_STMOM_DV_ACT  # AVL_STMOM_DV_ACT
        pduTrig_A_TEMP_pduPort_EPS_A_FlexRay_IN_55c86d41_4f391dd1: PduLength=2, SysTPduToFrameMappingRef=p2fmap_A_TEMP  # A_TEMP
        pduTrig_CON_VEH_pduPort_EPS_A_FlexRay_IN_55c86d41_4f391dd1: PduLength=8, SysTPduToFrameMappingRef=p2fmap_CON_VEH  # CON_VEH
        pduTrig_CTR_DIAG_OBD_DRDY_pduPort_EPS_A_FlexRay_IN_55c86d41_4f391dd1: PduLength=2, SysTPduToFrameMappingRef=p2fmap_CTR_DIAG_OBD_DRDY  # CTR_DIAG_OBD_DRDY
        pduTrig_CTR_VIB_STW_DISP_EXMI_SP2015_pduPort_EPS_A_FlexRay_IN_55c86d41_4f391dd1: PduLength=8, SysTPduToFrameMappingRef=p2fmap_CTR_VIB_STW_DISP_EXMI_SP2015  # CTR_VIB_STW_DISP_EXMI_SP2015
        pduTrig_DBG_EPS_BS_MOD_58_BYTE_pduPort_EPS_A_FlexRay_OUT_55c86d41_4f391dd1: PduLength=58  # DBG_EPS_BS_MOD_58_BYTE
        pduTrig_DBG_EPS_MOD_EXT_120_BYTE_pduPort_EPS_A_FlexRay_OUT_55c86d41_4f391dd1: PduLength=58  # DBG_EPS_MOD_EXT_120_BYTE
        pduTrig_DIAG_OBD_ENG_pduPort_EPS_A_FlexRay_IN_55c86d41_4f391dd1: PduLength=7, SysTPduToFrameMappingRef=p2fmap_DIAG_OBD_ENG  # DIAG_OBD_ENG
        pduTrig_DISP_CC_EPS_pduPort_EPS_A_FlexRay_OUT_55c86d41_4f391dd1: PduLength=5, SysTPduToFrameMappingRef=p2fmap_DISP_CC_EPS  # DISP_CC_EPS
        pduTrig_DT_EST_pduPort_EPS_A_FlexRay_OUT_55c86d41_4f391dd1: PduLength=16, SysTPduToFrameMappingRef=p2fmap_DT_EST  # DT_EST
        pduTrig_ENERG_DGR_DRDY_pduPort_EPS_A_FlexRay_IN_55c86d41_4f391dd1: PduLength=8, SysTPduToFrameMappingRef=p2fmap_ENERG_DGR_DRDY  # ENERG_DGR_DRDY
        pduTrig_ENGTORQ_EPS_pduPort_EPS_A_FlexRay_OUT_55c86d41_4f391dd1: PduLength=8, SysTPduToFrameMappingRef=p2fmap_ENGTORQ_EPS  # ENGTORQ_EPS
        pduTrig_ENSU_SFY_pduPort_EPS_A_FlexRay_IN_55c86d41_4f391dd1: PduLength=8, SysTPduToFrameMappingRef=p2fmap_ENSU_SFY  # ENSU_SFY
        pduTrig_ERRM_BN_U_pduPort_EPS_A_FlexRay_IN_55c86d41_4f391dd1: PduLength=2, SysTPduToFrameMappingRef=p2fmap_ERRM_BN_U  # ERRM_BN_U
        pduTrig_FAHRGESTELLNUMMER_pduPort_EPS_A_FlexRay_IN_55c86d41_4f391dd1: PduLength=7, SysTPduToFrameMappingRef=p2fmap_FAHRGESTELLNUMMER  # FAHRGESTELLNUMMER
        pduTrig_FR_DBG_EPS_pduPort_EPS_A_FlexRay_OUT_55c86d41_4f391dd1: PduLength=58, SysTPduToFrameMappingRef=p2fmap_FR_DBG_EPS  # FR_DBG_EPS
        pduTrig_FZZSTD_pduPort_EPS_A_FlexRay_IN_55c86d41_4f391dd1: PduLength=8, SysTPduToFrameMappingRef=p2fmap_FZZSTD  # FZZSTD
        pduTrig_KILOMETERSTAND_pduPort_EPS_A_FlexRay_IN_55c86d41_4f391dd1: PduLength=8, SysTPduToFrameMappingRef=p2fmap_KILOMETERSTAND  # KILOMETERSTAND
        pduTrig_OFFS_QUAD_EPS_pduPort_EPS_A_FlexRay_IN_55c86d41_4f391dd1: PduLength=5, SysTPduToFrameMappingRef=p2fmap_OFFS_QUAD_EPS  # OFFS_QUAD_EPS
        pduTrig_RELATIVZEIT_pduPort_EPS_A_FlexRay_IN_55c86d41_4f391dd1: PduLength=6, SysTPduToFrameMappingRef=p2fmap_RELATIVZEIT  # RELATIVZEIT
        pduTrig_RQ_STG_EFAN_pduPort_EPS_A_FlexRay_OUT_55c86d41_4f391dd1: PduLength=8  # RQ_STG_EFAN
        pduTrig_SECU_CHAL_pduPort_EPS_A_FlexRay_OUT_55c86d41_4f391dd1: PduLength=8  # SECU_CHAL
        pduTrig_SECU_FAHRGESTELLNUMMER_pduPort_EPS_A_FlexRay_IN_55c86d41_4f391dd1: PduLength=8, SysTPduToFrameMappingRef=p2fmap_SECU_FAHRGESTELLNUMMER  # SECU_FAHRGESTELLNUMMER
        pduTrig_SECU_RESP_pduPort_EPS_A_FlexRay_IN_55c86d41_4f391dd1: PduLength=8  # SECU_RESP
        pduTrig_STEA_OFFS_pduPort_EPS_A_FlexRay_IN_55c86d41_4f391dd1: PduLength=8, SysTPduToFrameMappingRef=p2fmap_STEA_OFFS  # STEA_OFFS
        pduTrig_ST_CENG_pduPort_EPS_A_FlexRay_IN_55c86d41_4f391dd1: PduLength=8, SysTPduToFrameMappingRef=p2fmap_ST_CENG  # ST_CENG
        pduTrig_ST_DIAG_OBD_3_DRDY_pduPort_EPS_A_FlexRay_OUT_55c86d41_4f391dd1: PduLength=8, SysTPduToFrameMappingRef=p2fmap_ST_DIAG_OBD_3_DRDY  # ST_DIAG_OBD_3_DRDY
        pduTrig_ST_ENERG_GEN_pduPort_EPS_A_FlexRay_IN_55c86d41_4f391dd1: PduLength=8, SysTPduToFrameMappingRef=p2fmap_ST_ENERG_GEN  # ST_ENERG_GEN
        pduTrig_ST_EST_pduPort_EPS_A_FlexRay_OUT_55c86d41_4f391dd1: PduLength=5, SysTPduToFrameMappingRef=p2fmap_ST_EST  # ST_EST
        pduTrig_ST_STAB_DSC_pduPort_EPS_A_FlexRay_IN_55c86d41_4f391dd1: PduLength=8, SysTPduToFrameMappingRef=p2fmap_ST_STAB_DSC  # ST_STAB_DSC
        pduTrig_SU_CLE_DRDY_DXP_pduPort_EPS_A_FlexRay_IN_55c86d41_4f391dd1: PduLength=8, SysTPduToFrameMappingRef=p2fmap_SU_CLE_DRDY_DXP  # SU_CLE_DRDY_DXP
        pduTrig_SU_EPS_pduPort_EPS_A_FlexRay_OUT_55c86d41_4f391dd1: PduLength=8, SysTPduToFrameMappingRef=p2fmap_SU_EPS  # SU_EPS
        pduTrig_TAR_ESTP_VIRT_FTAX_pduPort_EPS_A_FlexRay_IN_55c86d41_4f391dd1: PduLength=8, SysTPduToFrameMappingRef=p2fmap_TAR_ESTP_VIRT_FTAX  # TAR_ESTP_VIRT_FTAX
        pduTrig_TAR_QTA_STRMOM_DV_pduPort_EPS_A_FlexRay_IN_55c86d41_4f391dd1: PduLength=8, SysTPduToFrameMappingRef=p2fmap_TAR_QTA_STRMOM_DV  # TAR_QTA_STRMOM_DV
        pduTrig_TAR_STMOM_DV_ACT_pduPort_EPS_A_FlexRay_IN_55c86d41_4f391dd1: PduLength=8, SysTPduToFrameMappingRef=p2fmap_TAR_STMOM_DV_ACT  # TAR_STMOM_DV_ACT
        pduTrig_VYAW_VEH_pduPort_EPS_A_FlexRay_IN_55c86d41_4f391dd1: PduLength=6, SysTPduToFrameMappingRef=p2fmap_VYAW_VEH  # VYAW_VEH
        pduTrig_V_VEH_pduPort_EPS_A_FlexRay_IN_55c86d41_4f391dd1: PduLength=5, SysTPduToFrameMappingRef=p2fmap_V_VEH  # V_VEH
        pduTrig_dummy16bstatic_pduPort_EPS_A_FlexRay_OUT_55c86d41_4f391dd1: PduLength=16, SysTPduToFrameMappingRef=p2fmap_dummy16bstatic  # dummy16bstatic
        pduTrig_dummy32bmaster_pduPort_EPS_A_FlexRay_IN_55c86d41_4f391dd1: PduLength=32, SysTPduToFrameMappingRef=p2fmap_dummy32bmaster  # dummy32bmaster
        pduTrig_dummy32bslave_pduPort_EPS_A_FlexRay_OUT_55c86d41_4f391dd1: PduLength=32, SysTPduToFrameMappingRef=p2fmap_dummy32bslave  # dummy32bslave
        pduTrig_xcpdynamic254_{1..8}_pduPort_EPS_A_FlexRay_OUT_55c86d41_4f391dd1: PduLength=254, SysTPduToFrameMappingRef=p2fmap_xcpdynamic254_{1..8}  # xcpdynamic254_{1..8}
  module config Fr
    FrGeneral
    FrMultipleConfiguration
      EPS_A_FlexRay (FrController):
        FrPAllowHaltDueToClock = true
        FrPAllowPassiveToActive = 0
        FrPChannels = FR_CHANNEL_A
        FrPClusterDriftDamping = 2
        FrPDecodingCorrection = 48
        FrPDelayCompensationA = 1
        FrPDelayCompensationB = 1
        FrPKeySlotId = 0
        FrPKeySlotOnlyEnabled = false
        FrPKeySlotUsedForStartup = false
        FrPKeySlotUsedForSync = false
        FrPLatestTx = 269
        FrPMacroInitialOffsetA = 3
        FrPMacroInitialOffsetB = 3
        FrPMicroInitialOffsetA = 6
        FrPMicroInitialOffsetB = 6
        FrPMicroPerCycle = 200000
        FrPOffsetCorrectionOut = 126
        FrPOffsetCorrectionStart = 3632
        FrPPayloadLengthDynMax = 60
        FrPRateCorrectionOut = 121
        FrPSamplesPerMicrotick = N2SAMPLES
        FrPWakeupChannel = FR_CHANNEL_A
        FrPWakeupPattern = 33
        FrPdAcceptedStartupRange = 212
        FrPdListenTimeout = 400242
        FrPdMicrotick = T25NS
  module config FrIf
    FrIfConfig
      A_FlexRay (FrIfCluster):
        FrIfDetectNITError = false
        FrIfGChannels = FR_CHANNEL_A
        FrIfGColdStartAttempts = 8
        FrIfGCycleCountMax = 63
        FrIfGListenNoise = 2
        FrIfGMacroPerCycle = 3636
        FrIfGMaxWithoutClockCorrectFatal = 2
        FrIfGMaxWithoutClockCorrectPassive = 2
        FrIfGNetworkManagementVectorLength = 0
        FrIfGNumberOfMinislots = 289
        FrIfGNumberOfStaticSlots = 91
        FrIfGPayloadLengthStatic = 8
        FrIfGSyncFrameIDCountMax = 15
        FrIfGdActionPointOffset = 2
        FrIfGdBit = T100NS
        FrIfGdCasRxLowMax = 79
        FrIfGdCycle = 0.005
        FrIfGdDynamicSlotIdlePhase = 1
        FrIfGdIgnoreAfterTx = 0
        FrIfGdMacrotick = 0.000001375
        FrIfGdMiniSlotActionPointOffset = 2
        FrIfGdMinislot = 5
        FrIfGdNit = 7
        FrIfGdSampleClockPeriod = T12_5NS
        FrIfGdStaticSlot = 24
        FrIfGdSymbolWindow = 0
        FrIfGdSymbolWindowActionPointOffset = 2
        FrIfGdTSSTransmitter = 9
        FrIfGdWakeupRxIdle = 59
        FrIfGdWakeupRxLow = 50
        FrIfGdWakeupRxWindow = 301
        FrIfGdWakeupTxActive = 60
        FrIfGdWakeupTxIdle = 180
        FrIfSafetyMargin = 100
        EPS_A_FlexRay (FrIfController): FrIfCtrlIdx=0, FrIfFrCtrlRef=FrMultipleConfiguration/EPS_A_FlexRay
          69 x FrIfFrameTriggering, all with FrIfAllowDynamicLSduLength=false, FrIfChannel=FRIF_CHANNEL_A, FrIfPayloadPreamble=false:
            frTrig_1001_S_10_B_0_R_1_ChA_OUT: FrIfBaseCycle=0, FrIfCycleRepetition=1, FrIfLSduLength=16, FrIfSlotId=10, FrIfFrameStructureRef=FrStr_xcpstatic_aab54530_Out
            frTrig_10401_S_104_B_0_R_1_ChA_IN: FrIfBaseCycle=0, FrIfCycleRepetition=1, FrIfLSduLength=2, FrIfSlotId=104, FrIfFrameStructureRef=FrStr_ERRM_BN_U
            frTrig_10701_S_107_B_0_R_1_ChA_IN: FrIfBaseCycle=0, FrIfCycleRepetition=1, FrIfLSduLength=5, FrIfSlotId=107, FrIfFrameStructureRef=FrStr_OFFS_QUAD_EPS
            frTrig_10802_S_108_B_0_R_2_ChA_IN: FrIfBaseCycle=0, FrIfCycleRepetition=2, FrIfLSduLength=8, FrIfSlotId=108, FrIfFrameStructureRef=FrStr_STEA_OFFS
            frTrig_1101_S_11_B_0_R_1_ChA_OUT: FrIfBaseCycle=0, FrIfCycleRepetition=1, FrIfLSduLength=16, FrIfSlotId=11, FrIfFrameStructureRef=FrStr_xcpstatic_ab772f07_Out
            frTrig_11702_S_117_B_0_R_2_ChA_IN: FrIfBaseCycle=0, FrIfCycleRepetition=2, FrIfLSduLength=8, FrIfSlotId=117, FrIfFrameStructureRef=FrStr_ST_CENG
            frTrig_11912_S_119_B_1_R_2_ChA_IN: FrIfBaseCycle=1, FrIfCycleRepetition=2, FrIfLSduLength=8, FrIfSlotId=119, FrIfFrameStructureRef=FrStr_ENSU_SFY
            frTrig_1201_S_12_B_0_R_1_ChA_OUT: FrIfBaseCycle=0, FrIfCycleRepetition=1, FrIfLSduLength=16, FrIfSlotId=12, FrIfFrameStructureRef=FrStr_xcpstatic_a931915e_Out
            frTrig_12112_S_121_B_1_R_2_ChA_IN: FrIfBaseCycle=1, FrIfCycleRepetition=2, FrIfLSduLength=8, FrIfSlotId=121, FrIfFrameStructureRef=FrStr_CON_VEH
            frTrig_14701_S_147_B_0_R_1_ChA_IN: FrIfBaseCycle=0, FrIfCycleRepetition=1, FrIfLSduLength=254, FrIfSlotId=147, FrIfFrameStructureRef=FrStr_TL_MST_GW_TRNSM_FR_254
            frTrig_18301_S_183_B_0_R_1_ChA_OUT: FrIfBaseCycle=0, FrIfCycleRepetition=1, FrIfLSduLength=32, FrIfSlotId=183, FrIfFrameStructureRef=FrStr_TL_ECU_TRNSM_FR_32
            frTrig_20901_S_209_B_0_R_1_ChA_IN: FrIfBaseCycle=0, FrIfCycleRepetition=1, FrIfLSduLength=32, FrIfSlotId=209, FrIfFrameStructureRef=FrStr_TL_BRC_FR_32_f4c51a40_In
            frTrig_21001_S_210_B_0_R_1_ChA_IN: FrIfBaseCycle=0, FrIfCycleRepetition=1, FrIfLSduLength=32, FrIfSlotId=210, FrIfFrameStructureRef=FrStr_TL_BRC_FR_32_43a846aa_In
            frTrig_21101_S_211_B_0_R_1_ChA_IN: FrIfBaseCycle=0, FrIfCycleRepetition=1, FrIfLSduLength=32, FrIfSlotId=211, FrIfFrameStructureRef=FrStr_TL_BRC_FR_32_426a2c9d_In
            frTrig_21201_S_212_B_0_R_1_ChA_IN: FrIfBaseCycle=0, FrIfCycleRepetition=1, FrIfLSduLength=32, FrIfSlotId=212, FrIfFrameStructureRef=FrStr_TL_BRC_FR_32_402c92c4_In
            frTrig_21301_S_213_B_0_R_1_ChA_IN: FrIfBaseCycle=0, FrIfCycleRepetition=1, FrIfLSduLength=32, FrIfSlotId=213, FrIfFrameStructureRef=FrStr_TL_BRC_FR_32_41eef8f3_In
            frTrig_21434_S_214_B_3_R_4_ChA_IN: FrIfBaseCycle=3, FrIfCycleRepetition=4, FrIfLSduLength=8, FrIfSlotId=214, FrIfFrameStructureRef=FrStr_SVC_1fe6493a_In
            frTrig_2151016_S_215_B_10_R_16_ChA_IN: FrIfBaseCycle=10, FrIfCycleRepetition=16, FrIfLSduLength=8, FrIfSlotId=215, FrIfFrameStructureRef=FrStr_SVC_f2f7f198_In
            frTrig_215216_S_215_B_2_R_16_ChA_IN: FrIfBaseCycle=2, FrIfCycleRepetition=16, FrIfLSduLength=8, FrIfSlotId=215, FrIfFrameStructureRef=FrStr_SVC_1fa2bcf8_In
            frTrig_215516_S_215_B_5_R_16_ChA_IN: FrIfBaseCycle=5, FrIfCycleRepetition=16, FrIfLSduLength=8, FrIfSlotId=215, FrIfFrameStructureRef=FrStr_SVC_1aedaa7d_In
            frTrig_215616_S_215_B_6_R_16_ChA_IN: FrIfBaseCycle=6, FrIfCycleRepetition=16, FrIfLSduLength=8, FrIfSlotId=215, FrIfFrameStructureRef=FrStr_SVC_18ab1424_In
            frTrig_215916_S_215_B_9_R_16_ChA_IN: FrIfBaseCycle=9, FrIfCycleRepetition=16, FrIfLSduLength=8, FrIfSlotId=215, FrIfFrameStructureRef=FrStr_SVC_13f75319_In
            frTrig_2161016_S_216_B_10_R_16_ChA_IN: FrIfBaseCycle=10, FrIfCycleRepetition=16, FrIfLSduLength=8, FrIfSlotId=216, FrIfFrameStructureRef=FrStr_SVC_b5578b48_In
            frTrig_2161216_S_216_B_12_R_16_ChA_IN: FrIfBaseCycle=12, FrIfCycleRepetition=16, FrIfLSduLength=8, FrIfSlotId=216, FrIfFrameStructureRef=FrStr_SVC_b6d35f26_In
            frTrig_2161316_S_216_B_13_R_16_ChA_IN: FrIfBaseCycle=13, FrIfCycleRepetition=16, FrIfLSduLength=8, FrIfSlotId=216, FrIfFrameStructureRef=FrStr_SVC_b7113511_In
            frTrig_2161416_S_216_B_14_R_16_ChA_IN: FrIfBaseCycle=14, FrIfCycleRepetition=16, FrIfLSduLength=8, FrIfSlotId=216, FrIfFrameStructureRef=FrStr_SVC_b25e2394_In
            frTrig_2161516_S_216_B_15_R_16_ChA_IN: FrIfBaseCycle=15, FrIfCycleRepetition=16, FrIfLSduLength=8, FrIfSlotId=216, FrIfFrameStructureRef=FrStr_SVC_b39c49a3_In
            frTrig_216616_S_216_B_6_R_16_ChA_IN: FrIfBaseCycle=6, FrIfCycleRepetition=16, FrIfLSduLength=8, FrIfSlotId=216, FrIfFrameStructureRef=FrStr_SVC_0a1ebbca_In
            frTrig_216716_S_216_B_7_R_16_ChA_IN: FrIfBaseCycle=7, FrIfCycleRepetition=16, FrIfLSduLength=8, FrIfSlotId=216, FrIfFrameStructureRef=FrStr_SVC_0bdcd1fd_In
            frTrig_216916_S_216_B_9_R_16_ChA_OUT: FrIfBaseCycle=9, FrIfCycleRepetition=16, FrIfLSduLength=8, FrIfSlotId=216, FrIfFrameStructureRef=FrStr_SVC_0142fcf7_Out
            frTrig_21901_S_219_B_0_R_1_ChA_IN: FrIfBaseCycle=0, FrIfCycleRepetition=1, FrIfLSduLength=32, FrIfSlotId=219, FrIfFrameStructureRef=FrStr_xcpmaster
            frTrig_22001_S_220_B_0_R_1_ChA_OUT: FrIfBaseCycle=0, FrIfCycleRepetition=1, FrIfLSduLength=32, FrIfSlotId=220, FrIfFrameStructureRef=FrStr_xcpslave
            frTrig_23212_S_232_B_1_R_2_ChA_IN: FrIfBaseCycle=1, FrIfCycleRepetition=2, FrIfLSduLength=8, FrIfSlotId=232, FrIfFrameStructureRef=FrStr_ST_ENERG_GEN
            frTrig_23412_S_234_B_1_R_2_ChA_OUT: FrIfBaseCycle=1, FrIfCycleRepetition=2, FrIfLSduLength=5, FrIfSlotId=234, FrIfFrameStructureRef=FrStr_ST_EST
            frTrig_24404_S_244_B_0_R_4_ChA_IN: FrIfBaseCycle=0, FrIfCycleRepetition=4, FrIfLSduLength=8, FrIfSlotId=244, FrIfFrameStructureRef=FrStr_SECU_FAHRGESTELLNUMMER
            frTrig_24702_S_247_B_0_R_2_ChA_IN: FrIfBaseCycle=0, FrIfCycleRepetition=2, FrIfLSduLength=2, FrIfSlotId=247, FrIfFrameStructureRef=FrStr_CTR_DIAG_OBD_DRDY
            frTrig_24712_S_247_B_1_R_2_ChA_IN: FrIfBaseCycle=1, FrIfCycleRepetition=2, FrIfLSduLength=7, FrIfSlotId=247, FrIfFrameStructureRef=FrStr_DIAG_OBD_ENG
            frTrig_2481032_S_248_B_10_R_32_ChA_OUT: FrIfBaseCycle=10, FrIfCycleRepetition=32, FrIfLSduLength=8, FrIfSlotId=248, FrIfFrameStructureRef=FrStr_ST_DIAG_OBD_3_DRDY
            frTrig_25214_S_252_B_1_R_4_ChA_IN: FrIfBaseCycle=1, FrIfCycleRepetition=4, FrIfLSduLength=2, FrIfSlotId=252, FrIfFrameStructureRef=FrStr_A_TEMP
            frTrig_26924_S_269_B_2_R_4_ChA_IN: FrIfBaseCycle=2, FrIfCycleRepetition=4, FrIfLSduLength=16, FrIfSlotId=269, FrIfFrameStructureRef=FrStr_CTR_VIB_STW_DISP_EXMI_SP2015_FDBK_VIB_STW_DISP_EXMI
            frTrig_27408_S_274_B_0_R_8_ChA_OUT: FrIfBaseCycle=0, FrIfCycleRepetition=8, FrIfLSduLength=8, FrIfSlotId=274, FrIfFrameStructureRef=FrStr_SU_EPS
            frTrig_27424_S_274_B_2_R_4_ChA_OUT: FrIfBaseCycle=2, FrIfCycleRepetition=4, FrIfLSduLength=5, FrIfSlotId=274, FrIfFrameStructureRef=FrStr_DISP_CC_EPS
            frTrig_27518_S_275_B_1_R_8_ChA_IN: FrIfBaseCycle=1, FrIfCycleRepetition=8, FrIfLSduLength=8, FrIfSlotId=275, FrIfFrameStructureRef=FrStr_FZZSTD
            frTrig_27578_S_275_B_7_R_8_ChA_IN: FrIfBaseCycle=7, FrIfCycleRepetition=8, FrIfLSduLength=7, FrIfSlotId=275, FrIfFrameStructureRef=FrStr_FAHRGESTELLNUMMER
            frTrig_27628_S_276_B_2_R_8_ChA_IN: FrIfBaseCycle=2, FrIfCycleRepetition=8, FrIfLSduLength=6, FrIfSlotId=276, FrIfFrameStructureRef=FrStr_RELATIVZEIT
            frTrig_27648_S_276_B_4_R_8_ChA_IN: FrIfBaseCycle=4, FrIfCycleRepetition=8, FrIfLSduLength=8, FrIfSlotId=276, FrIfFrameStructureRef=FrStr_KILOMETERSTAND
            frTrig_29401_S_294_B_0_R_1_ChA_OUT: FrIfBaseCycle=0, FrIfCycleRepetition=1, FrIfLSduLength=254, FrIfSlotId=294, FrIfFrameStructureRef=FrStr_xcpdynamic254_1
            frTrig_29501_S_295_B_0_R_1_ChA_OUT: FrIfBaseCycle=0, FrIfCycleRepetition=1, FrIfLSduLength=254, FrIfSlotId=295, FrIfFrameStructureRef=FrStr_xcpdynamic254_2
            frTrig_29601_S_296_B_0_R_1_ChA_OUT: FrIfBaseCycle=0, FrIfCycleRepetition=1, FrIfLSduLength=254, FrIfSlotId=296, FrIfFrameStructureRef=FrStr_xcpdynamic254_3
            frTrig_29701_S_297_B_0_R_1_ChA_OUT: FrIfBaseCycle=0, FrIfCycleRepetition=1, FrIfLSduLength=254, FrIfSlotId=297, FrIfFrameStructureRef=FrStr_xcpdynamic254_4
            frTrig_29801_S_298_B_0_R_1_ChA_OUT: FrIfBaseCycle=0, FrIfCycleRepetition=1, FrIfLSduLength=254, FrIfSlotId=298, FrIfFrameStructureRef=FrStr_xcpdynamic254_5
            frTrig_29901_S_299_B_0_R_1_ChA_OUT: FrIfBaseCycle=0, FrIfCycleRepetition=1, FrIfLSduLength=254, FrIfSlotId=299, FrIfFrameStructureRef=FrStr_xcpdynamic254_6
            frTrig_30001_S_300_B_0_R_1_ChA_OUT: FrIfBaseCycle=0, FrIfCycleRepetition=1, FrIfLSduLength=254, FrIfSlotId=300, FrIfFrameStructureRef=FrStr_xcpdynamic254_7
            frTrig_30101_S_301_B_0_R_1_ChA_OUT: FrIfBaseCycle=0, FrIfCycleRepetition=1, FrIfLSduLength=254, FrIfSlotId=301, FrIfFrameStructureRef=FrStr_xcpdynamic254_8
            frTrig_31501_S_315_B_0_R_1_ChA_OUT: FrIfBaseCycle=0, FrIfCycleRepetition=1, FrIfLSduLength=58, FrIfSlotId=315, FrIfFrameStructureRef=FrStr_FR_DBG_EPS
            frTrig_4601_S_46_B_0_R_1_ChA_IN: FrIfBaseCycle=0, FrIfCycleRepetition=1, FrIfLSduLength=12, FrIfSlotId=46, FrIfFrameStructureRef=FrStr_AVL_RPM_WHL
            frTrig_4712_S_47_B_1_R_2_ChA_IN: FrIfBaseCycle=1, FrIfCycleRepetition=2, FrIfLSduLength=16, FrIfSlotId=47, FrIfFrameStructureRef=FrStr_ST_STAB_DSC_ST_STAB_DSC_2
            frTrig_4902_S_49_B_0_R_2_ChA_OUT: FrIfBaseCycle=0, FrIfCycleRepetition=2, FrIfLSduLength=16, FrIfSlotId=49, FrIfFrameStructureRef=FrStr_AVL_STMOM_DV_ACT_AVL_FORC_GRD
            frTrig_4912_S_49_B_1_R_2_ChA_OUT: FrIfBaseCycle=1, FrIfCycleRepetition=2, FrIfLSduLength=16, FrIfSlotId=49, FrIfFrameStructureRef=FrStr_DT_EST
            frTrig_5102_S_51_B_0_R_2_ChA_OUT: FrIfBaseCycle=0, FrIfCycleRepetition=2, FrIfLSduLength=16, FrIfSlotId=51, FrIfFrameStructureRef=FrStr_AVL_PO_EPS_ENGTORQ_EPS
            frTrig_5338_S_53_B_3_R_8_ChA_IN: FrIfBaseCycle=3, FrIfCycleRepetition=8, FrIfLSduLength=16, FrIfSlotId=53, FrIfFrameStructureRef=FrStr_SU_CLE_DRDY_DXP_SPEC_ADPT_MOD_DXP_ST_IDLV_COOD_DBE_DXP
            frTrig_5502_S_55_B_0_R_2_ChA_IN: FrIfBaseCycle=0, FrIfCycleRepetition=2, FrIfLSduLength=14, FrIfSlotId=55, FrIfFrameStructureRef=FrStr_ACLNX_MASSCNTR_ACLNY_MASSCNTR
            frTrig_5534_S_55_B_3_R_4_ChA_IN: FrIfBaseCycle=3, FrIfCycleRepetition=4, FrIfLSduLength=16, FrIfSlotId=55, FrIfFrameStructureRef=FrStr_V_VEH_V_VEH_2
            frTrig_5602_S_56_B_0_R_2_ChA_IN: FrIfBaseCycle=0, FrIfCycleRepetition=2, FrIfLSduLength=14, FrIfSlotId=56, FrIfFrameStructureRef=FrStr_DT_DRDYSEN_EXT_VYAW_VEH
            frTrig_6512_S_65_B_1_R_2_ChA_IN: FrIfBaseCycle=1, FrIfCycleRepetition=2, FrIfLSduLength=8, FrIfSlotId=65, FrIfFrameStructureRef=FrStr_TAR_ESTP_VIRT_FTAX
            frTrig_6802_S_68_B_0_R_2_ChA_IN: FrIfBaseCycle=0, FrIfCycleRepetition=2, FrIfLSduLength=16, FrIfSlotId=68, FrIfFrameStructureRef=FrStr_TAR_QTA_STRMOM_DV_TAR_STMOM_DV_ACT
            frTrig_6812_S_68_B_1_R_2_ChA_IN: FrIfBaseCycle=1, FrIfCycleRepetition=2, FrIfLSduLength=8, FrIfSlotId=68, FrIfFrameStructureRef=FrStr_ENERG_DGR_DRDY
            frTrig_801_S_8_B_0_R_1_ChA_OUT: FrIfBaseCycle=0, FrIfCycleRepetition=1, FrIfLSduLength=16, FrIfSlotId=8, FrIfFrameStructureRef=FrStr_xcpstatic_c8b51460_Out
            frTrig_901_S_9_B_0_R_1_ChA_OUT: FrIfBaseCycle=0, FrIfCycleRepetition=1, FrIfLSduLength=16, FrIfSlotId=9, FrIfFrameStructureRef=FrStr_xcpstatic_c9777e57_Out
          69 x FrIfLPdu:
            LPdu_frTrig_1001_S_10_B_0_R_1_ChA_OUT: FrIfVBTriggeringRef=frTrig_1001_S_10_B_0_R_1_ChA_OUT  # frTrig_1001
            LPdu_frTrig_10401_S_104_B_0_R_1_ChA_IN: FrIfVBTriggeringRef=frTrig_10401_S_104_B_0_R_1_ChA_IN  # frTrig_10401
            LPdu_frTrig_10701_S_107_B_0_R_1_ChA_IN: FrIfVBTriggeringRef=frTrig_10701_S_107_B_0_R_1_ChA_IN  # frTrig_10701
            LPdu_frTrig_10802_S_108_B_0_R_2_ChA_IN: FrIfVBTriggeringRef=frTrig_10802_S_108_B_0_R_2_ChA_IN  # frTrig_10802
            LPdu_frTrig_1101_S_11_B_0_R_1_ChA_OUT: FrIfVBTriggeringRef=frTrig_1101_S_11_B_0_R_1_ChA_OUT  # frTrig_1101
            LPdu_frTrig_11702_S_117_B_0_R_2_ChA_IN: FrIfVBTriggeringRef=frTrig_11702_S_117_B_0_R_2_ChA_IN  # frTrig_11702
            LPdu_frTrig_11912_S_119_B_1_R_2_ChA_IN: FrIfVBTriggeringRef=frTrig_11912_S_119_B_1_R_2_ChA_IN  # frTrig_11912
            LPdu_frTrig_1201_S_12_B_0_R_1_ChA_OUT: FrIfVBTriggeringRef=frTrig_1201_S_12_B_0_R_1_ChA_OUT  # frTrig_1201
            LPdu_frTrig_12112_S_121_B_1_R_2_ChA_IN: FrIfVBTriggeringRef=frTrig_12112_S_121_B_1_R_2_ChA_IN  # frTrig_12112
            LPdu_frTrig_14701_S_147_B_0_R_1_ChA_IN: FrIfVBTriggeringRef=frTrig_14701_S_147_B_0_R_1_ChA_IN  # frTrig_14701
            LPdu_frTrig_18301_S_183_B_0_R_1_ChA_OUT: FrIfVBTriggeringRef=frTrig_18301_S_183_B_0_R_1_ChA_OUT  # frTrig_18301
            LPdu_frTrig_20901_S_209_B_0_R_1_ChA_IN: FrIfVBTriggeringRef=frTrig_20901_S_209_B_0_R_1_ChA_IN  # frTrig_20901
            LPdu_frTrig_21001_S_210_B_0_R_1_ChA_IN: FrIfVBTriggeringRef=frTrig_21001_S_210_B_0_R_1_ChA_IN  # frTrig_21001
            LPdu_frTrig_21101_S_211_B_0_R_1_ChA_IN: FrIfVBTriggeringRef=frTrig_21101_S_211_B_0_R_1_ChA_IN  # frTrig_21101
            LPdu_frTrig_21201_S_212_B_0_R_1_ChA_IN: FrIfVBTriggeringRef=frTrig_21201_S_212_B_0_R_1_ChA_IN  # frTrig_21201
            LPdu_frTrig_21301_S_213_B_0_R_1_ChA_IN: FrIfVBTriggeringRef=frTrig_21301_S_213_B_0_R_1_ChA_IN  # frTrig_21301
            LPdu_frTrig_21434_S_214_B_3_R_4_ChA_IN: FrIfVBTriggeringRef=frTrig_21434_S_214_B_3_R_4_ChA_IN  # frTrig_21434
            LPdu_frTrig_2151016_S_215_B_10_R_16_ChA_IN: FrIfVBTriggeringRef=frTrig_2151016_S_215_B_10_R_16_ChA_IN  # frTrig_2151016
            LPdu_frTrig_215216_S_215_B_2_R_16_ChA_IN: FrIfVBTriggeringRef=frTrig_215216_S_215_B_2_R_16_ChA_IN  # frTrig_215216
            LPdu_frTrig_215516_S_215_B_5_R_16_ChA_IN: FrIfVBTriggeringRef=frTrig_215516_S_215_B_5_R_16_ChA_IN  # frTrig_215516
            LPdu_frTrig_215616_S_215_B_6_R_16_ChA_IN: FrIfVBTriggeringRef=frTrig_215616_S_215_B_6_R_16_ChA_IN  # frTrig_215616
            LPdu_frTrig_215916_S_215_B_9_R_16_ChA_IN: FrIfVBTriggeringRef=frTrig_215916_S_215_B_9_R_16_ChA_IN  # frTrig_215916
            LPdu_frTrig_2161016_S_216_B_10_R_16_ChA_IN: FrIfVBTriggeringRef=frTrig_2161016_S_216_B_10_R_16_ChA_IN  # frTrig_2161016
            LPdu_frTrig_2161216_S_216_B_12_R_16_ChA_IN: FrIfVBTriggeringRef=frTrig_2161216_S_216_B_12_R_16_ChA_IN  # frTrig_2161216
            LPdu_frTrig_2161316_S_216_B_13_R_16_ChA_IN: FrIfVBTriggeringRef=frTrig_2161316_S_216_B_13_R_16_ChA_IN  # frTrig_2161316
            LPdu_frTrig_2161416_S_216_B_14_R_16_ChA_IN: FrIfVBTriggeringRef=frTrig_2161416_S_216_B_14_R_16_ChA_IN  # frTrig_2161416
            LPdu_frTrig_2161516_S_216_B_15_R_16_ChA_IN: FrIfVBTriggeringRef=frTrig_2161516_S_216_B_15_R_16_ChA_IN  # frTrig_2161516
            LPdu_frTrig_216616_S_216_B_6_R_16_ChA_IN: FrIfVBTriggeringRef=frTrig_216616_S_216_B_6_R_16_ChA_IN  # frTrig_216616
            LPdu_frTrig_216716_S_216_B_7_R_16_ChA_IN: FrIfVBTriggeringRef=frTrig_216716_S_216_B_7_R_16_ChA_IN  # frTrig_216716
            LPdu_frTrig_216916_S_216_B_9_R_16_ChA_OUT: FrIfVBTriggeringRef=frTrig_216916_S_216_B_9_R_16_ChA_OUT  # frTrig_216916
            LPdu_frTrig_21901_S_219_B_0_R_1_ChA_IN: FrIfVBTriggeringRef=frTrig_21901_S_219_B_0_R_1_ChA_IN  # frTrig_21901
            LPdu_frTrig_22001_S_220_B_0_R_1_ChA_OUT: FrIfVBTriggeringRef=frTrig_22001_S_220_B_0_R_1_ChA_OUT  # frTrig_22001
            LPdu_frTrig_23212_S_232_B_1_R_2_ChA_IN: FrIfVBTriggeringRef=frTrig_23212_S_232_B_1_R_2_ChA_IN  # frTrig_23212
            LPdu_frTrig_23412_S_234_B_1_R_2_ChA_OUT: FrIfVBTriggeringRef=frTrig_23412_S_234_B_1_R_2_ChA_OUT  # frTrig_23412
            LPdu_frTrig_24404_S_244_B_0_R_4_ChA_IN: FrIfVBTriggeringRef=frTrig_24404_S_244_B_0_R_4_ChA_IN  # frTrig_24404
            LPdu_frTrig_24702_S_247_B_0_R_2_ChA_IN: FrIfVBTriggeringRef=frTrig_24702_S_247_B_0_R_2_ChA_IN  # frTrig_24702
            LPdu_frTrig_24712_S_247_B_1_R_2_ChA_IN: FrIfVBTriggeringRef=frTrig_24712_S_247_B_1_R_2_ChA_IN  # frTrig_24712
            LPdu_frTrig_2481032_S_248_B_10_R_32_ChA_OUT: FrIfVBTriggeringRef=frTrig_2481032_S_248_B_10_R_32_ChA_OUT  # frTrig_2481032
            LPdu_frTrig_25214_S_252_B_1_R_4_ChA_IN: FrIfVBTriggeringRef=frTrig_25214_S_252_B_1_R_4_ChA_IN  # frTrig_25214
            LPdu_frTrig_26924_S_269_B_2_R_4_ChA_IN: FrIfVBTriggeringRef=frTrig_26924_S_269_B_2_R_4_ChA_IN  # frTrig_26924
            LPdu_frTrig_27408_S_274_B_0_R_8_ChA_OUT: FrIfVBTriggeringRef=frTrig_27408_S_274_B_0_R_8_ChA_OUT  # frTrig_27408
            LPdu_frTrig_27424_S_274_B_2_R_4_ChA_OUT: FrIfVBTriggeringRef=frTrig_27424_S_274_B_2_R_4_ChA_OUT  # frTrig_27424
            LPdu_frTrig_27518_S_275_B_1_R_8_ChA_IN: FrIfVBTriggeringRef=frTrig_27518_S_275_B_1_R_8_ChA_IN  # frTrig_27518
            LPdu_frTrig_27578_S_275_B_7_R_8_ChA_IN: FrIfVBTriggeringRef=frTrig_27578_S_275_B_7_R_8_ChA_IN  # frTrig_27578
            LPdu_frTrig_27628_S_276_B_2_R_8_ChA_IN: FrIfVBTriggeringRef=frTrig_27628_S_276_B_2_R_8_ChA_IN  # frTrig_27628
            LPdu_frTrig_27648_S_276_B_4_R_8_ChA_IN: FrIfVBTriggeringRef=frTrig_27648_S_276_B_4_R_8_ChA_IN  # frTrig_27648
            LPdu_frTrig_29401_S_294_B_0_R_1_ChA_OUT: FrIfVBTriggeringRef=frTrig_29401_S_294_B_0_R_1_ChA_OUT  # frTrig_29401
            LPdu_frTrig_29501_S_295_B_0_R_1_ChA_OUT: FrIfVBTriggeringRef=frTrig_29501_S_295_B_0_R_1_ChA_OUT  # frTrig_29501
            LPdu_frTrig_29601_S_296_B_0_R_1_ChA_OUT: FrIfVBTriggeringRef=frTrig_29601_S_296_B_0_R_1_ChA_OUT  # frTrig_29601
            LPdu_frTrig_29701_S_297_B_0_R_1_ChA_OUT: FrIfVBTriggeringRef=frTrig_29701_S_297_B_0_R_1_ChA_OUT  # frTrig_29701
            LPdu_frTrig_29801_S_298_B_0_R_1_ChA_OUT: FrIfVBTriggeringRef=frTrig_29801_S_298_B_0_R_1_ChA_OUT  # frTrig_29801
            LPdu_frTrig_29901_S_299_B_0_R_1_ChA_OUT: FrIfVBTriggeringRef=frTrig_29901_S_299_B_0_R_1_ChA_OUT  # frTrig_29901
            LPdu_frTrig_30001_S_300_B_0_R_1_ChA_OUT: FrIfVBTriggeringRef=frTrig_30001_S_300_B_0_R_1_ChA_OUT  # frTrig_30001
            LPdu_frTrig_30101_S_301_B_0_R_1_ChA_OUT: FrIfVBTriggeringRef=frTrig_30101_S_301_B_0_R_1_ChA_OUT  # frTrig_30101
            LPdu_frTrig_31501_S_315_B_0_R_1_ChA_OUT: FrIfVBTriggeringRef=frTrig_31501_S_315_B_0_R_1_ChA_OUT  # frTrig_31501
            LPdu_frTrig_4601_S_46_B_0_R_1_ChA_IN: FrIfVBTriggeringRef=frTrig_4601_S_46_B_0_R_1_ChA_IN  # frTrig_4601
            LPdu_frTrig_4712_S_47_B_1_R_2_ChA_IN: FrIfVBTriggeringRef=frTrig_4712_S_47_B_1_R_2_ChA_IN  # frTrig_4712
            LPdu_frTrig_4902_S_49_B_0_R_2_ChA_OUT: FrIfVBTriggeringRef=frTrig_4902_S_49_B_0_R_2_ChA_OUT  # frTrig_4902
            LPdu_frTrig_4912_S_49_B_1_R_2_ChA_OUT: FrIfVBTriggeringRef=frTrig_4912_S_49_B_1_R_2_ChA_OUT  # frTrig_4912
            LPdu_frTrig_5102_S_51_B_0_R_2_ChA_OUT: FrIfVBTriggeringRef=frTrig_5102_S_51_B_0_R_2_ChA_OUT  # frTrig_5102
            LPdu_frTrig_5338_S_53_B_3_R_8_ChA_IN: FrIfVBTriggeringRef=frTrig_5338_S_53_B_3_R_8_ChA_IN  # frTrig_5338
            LPdu_frTrig_5502_S_55_B_0_R_2_ChA_IN: FrIfVBTriggeringRef=frTrig_5502_S_55_B_0_R_2_ChA_IN  # frTrig_5502
            LPdu_frTrig_5534_S_55_B_3_R_4_ChA_IN: FrIfVBTriggeringRef=frTrig_5534_S_55_B_3_R_4_ChA_IN  # frTrig_5534
            LPdu_frTrig_5602_S_56_B_0_R_2_ChA_IN: FrIfVBTriggeringRef=frTrig_5602_S_56_B_0_R_2_ChA_IN  # frTrig_5602
            LPdu_frTrig_6512_S_65_B_1_R_2_ChA_IN: FrIfVBTriggeringRef=frTrig_6512_S_65_B_1_R_2_ChA_IN  # frTrig_6512
            LPdu_frTrig_6802_S_68_B_0_R_2_ChA_IN: FrIfVBTriggeringRef=frTrig_6802_S_68_B_0_R_2_ChA_IN  # frTrig_6802
            LPdu_frTrig_6812_S_68_B_1_R_2_ChA_IN: FrIfVBTriggeringRef=frTrig_6812_S_68_B_1_R_2_ChA_IN  # frTrig_6812
            LPdu_frTrig_801_S_8_B_0_R_1_ChA_OUT: FrIfVBTriggeringRef=frTrig_801_S_8_B_0_R_1_ChA_OUT  # frTrig_801
            LPdu_frTrig_901_S_9_B_0_R_1_ChA_OUT: FrIfVBTriggeringRef=frTrig_901_S_9_B_0_R_1_ChA_OUT  # frTrig_901
      69 x FrIfFrameStructure, all with FrIfByteOrder=LITTLE_ENDIAN:
        FrStr_ACLNX_MASSCNTR_ACLNY_MASSCNTR  # ACLNX_MASSCNTR_ACLNY_MASSCNTR
          p2fmap_ACLNY_MASSCNTR (FrIfPdusInFrame): FrIfPduOffset=8, FrIfPduRef=ACLNY_MASSCNTR
        FrStr_AVL_PO_EPS_ENGTORQ_EPS  # AVL_PO_EPS_ENGTORQ_EPS
          p2fmap_AVL_PO_EPS (FrIfPdusInFrame): FrIfPduOffset=0, FrIfPduRef=AVL_PO_EPS
          p2fmap_ENGTORQ_EPS (FrIfPdusInFrame): FrIfPduOffset=8, FrIfPduRef=ENGTORQ_EPS
        FrStr_AVL_RPM_WHL  # AVL_RPM_WHL
          p2fmap_AVL_RPM_WHL (FrIfPdusInFrame): FrIfPduOffset=0, FrIfPduRef=AVL_RPM_WHL
        FrStr_AVL_STMOM_DV_ACT_AVL_FORC_GRD  # AVL_STMOM_DV_ACT_AVL_FORC_GRD
          p2fmap_AVL_FORC_GRD (FrIfPdusInFrame): FrIfPduOffset=8, FrIfPduRef=AVL_FORC_GRD
          p2fmap_AVL_STMOM_DV_ACT (FrIfPdusInFrame): FrIfPduOffset=0, FrIfPduRef=AVL_STMOM_DV_ACT
        FrStr_A_TEMP  # A_TEMP
          p2fmap_A_TEMP (FrIfPdusInFrame): FrIfPduOffset=0, FrIfPduRef=A_TEMP
        FrStr_CON_VEH  # CON_VEH
          p2fmap_CON_VEH (FrIfPdusInFrame): FrIfPduOffset=0, FrIfPduRef=CON_VEH
        FrStr_CTR_DIAG_OBD_DRDY  # CTR_DIAG_OBD_DRDY
          p2fmap_CTR_DIAG_OBD_DRDY (FrIfPdusInFrame): FrIfPduOffset=0, FrIfPduRef=CTR_DIAG_OBD_DRDY
        FrStr_CTR_VIB_STW_DISP_EXMI_SP2015_FDBK_VIB_STW_DISP_EXMI  # CTR_VIB_STW_DISP_EXMI_SP2015_FDBK_VIB_STW_DISP_EXMI
          p2fmap_CTR_VIB_STW_DISP_EXMI_SP2015 (FrIfPdusInFrame): FrIfPduOffset=0, FrIfPduRef=CTR_VIB_STW_DISP_EXMI_SP2015
        FrStr_DIAG_OBD_ENG  # DIAG_OBD_ENG
          p2fmap_DIAG_OBD_ENG (FrIfPdusInFrame): FrIfPduOffset=0, FrIfPduRef=DIAG_OBD_ENG
        FrStr_DISP_CC_EPS  # DISP_CC_EPS
          p2fmap_DISP_CC_EPS (FrIfPdusInFrame): FrIfPduOffset=0, FrIfPduRef=DISP_CC_EPS
        FrStr_DT_DRDYSEN_EXT_VYAW_VEH  # DT_DRDYSEN_EXT_VYAW_VEH
          p2fmap_VYAW_VEH (FrIfPdusInFrame): FrIfPduOffset=8, FrIfPduRef=VYAW_VEH
        FrStr_DT_EST  # DT_EST
          p2fmap_DT_EST (FrIfPdusInFrame): FrIfPduOffset=0, FrIfPduRef=DT_EST
        FrStr_ENERG_DGR_DRDY  # ENERG_DGR_DRDY
          p2fmap_ENERG_DGR_DRDY (FrIfPdusInFrame): FrIfPduOffset=0, FrIfPduRef=ENERG_DGR_DRDY
        FrStr_ENSU_SFY  # ENSU_SFY
          p2fmap_ENSU_SFY (FrIfPdusInFrame): FrIfPduOffset=0, FrIfPduRef=ENSU_SFY
        FrStr_ERRM_BN_U  # ERRM_BN_U
          p2fmap_ERRM_BN_U (FrIfPdusInFrame): FrIfPduOffset=0, FrIfPduRef=ERRM_BN_U
        FrStr_FAHRGESTELLNUMMER  # FAHRGESTELLNUMMER
          p2fmap_FAHRGESTELLNUMMER (FrIfPdusInFrame): FrIfPduOffset=0, FrIfPduRef=FAHRGESTELLNUMMER
        FrStr_FR_DBG_EPS  # FR_DBG_EPS
          p2fmap_FR_DBG_EPS (FrIfPdusInFrame): FrIfPduOffset=0, FrIfPduRef=FR_DBG_EPS
        FrStr_FZZSTD  # FZZSTD
          p2fmap_FZZSTD (FrIfPdusInFrame): FrIfPduOffset=0, FrIfPduRef=FZZSTD
        FrStr_KILOMETERSTAND  # KILOMETERSTAND
          p2fmap_KILOMETERSTAND (FrIfPdusInFrame): FrIfPduOffset=0, FrIfPduRef=KILOMETERSTAND
        FrStr_OFFS_QUAD_EPS  # OFFS_QUAD_EPS
          p2fmap_OFFS_QUAD_EPS (FrIfPdusInFrame): FrIfPduOffset=0, FrIfPduRef=OFFS_QUAD_EPS
        FrStr_RELATIVZEIT  # RELATIVZEIT
          p2fmap_RELATIVZEIT (FrIfPdusInFrame): FrIfPduOffset=0, FrIfPduRef=RELATIVZEIT
        FrStr_SECU_FAHRGESTELLNUMMER  # SECU_FAHRGESTELLNUMMER
          p2fmap_SECU_FAHRGESTELLNUMMER (FrIfPdusInFrame): FrIfPduOffset=0, FrIfPduRef=SECU_FAHRGESTELLNUMMER
        FrStr_STEA_OFFS  # STEA_OFFS
          p2fmap_STEA_OFFS (FrIfPdusInFrame): FrIfPduOffset=0, FrIfPduRef=STEA_OFFS
        FrStr_ST_CENG  # ST_CENG
          p2fmap_ST_CENG (FrIfPdusInFrame): FrIfPduOffset=0, FrIfPduRef=ST_CENG
        FrStr_ST_DIAG_OBD_3_DRDY  # ST_DIAG_OBD_3_DRDY
          p2fmap_ST_DIAG_OBD_3_DRDY (FrIfPdusInFrame): FrIfPduOffset=0, FrIfPduRef=ST_DIAG_OBD_3_DRDY
        FrStr_ST_ENERG_GEN  # ST_ENERG_GEN
          p2fmap_ST_ENERG_GEN (FrIfPdusInFrame): FrIfPduOffset=0, FrIfPduRef=ST_ENERG_GEN
        FrStr_ST_EST  # ST_EST
          p2fmap_ST_EST (FrIfPdusInFrame): FrIfPduOffset=0, FrIfPduRef=ST_EST
        FrStr_ST_STAB_DSC_ST_STAB_DSC_2  # ST_STAB_DSC_ST_STAB_DSC_2
          p2fmap_ST_STAB_DSC (FrIfPdusInFrame): FrIfPduOffset=0, FrIfPduRef=ST_STAB_DSC
        FrStr_SU_CLE_DRDY_DXP_SPEC_ADPT_MOD_DXP_ST_IDLV_COOD_DBE_DXP  # SU_CLE_DRDY_DXP_SPEC_ADPT_MOD_DXP_ST_IDLV_COOD_DBE_DXP
          p2fmap_SU_CLE_DRDY_DXP (FrIfPdusInFrame): FrIfPduOffset=0, FrIfPduRef=SU_CLE_DRDY_DXP
        FrStr_SU_EPS  # SU_EPS
          p2fmap_SU_EPS (FrIfPdusInFrame): FrIfPduOffset=0, FrIfPduRef=SU_EPS
        FrStr_SVC_0142fcf7_Out  # SVC
          p2fmap_SVC (FrIfPdusInFrame): FrIfPduOffset=0, FrIfPduRef=SVC_Out
        FrStr_SVC_0a1ebbca_In  # SVC
          p2fmap_SVC (FrIfPdusInFrame): FrIfPduOffset=0, FrIfPduRef=SVC_In
        FrStr_SVC_0bdcd1fd_In  # SVC
          p2fmap_SVC (FrIfPdusInFrame): FrIfPduOffset=0, FrIfPduRef=SVC_In
        FrStr_SVC_13f75319_In  # SVC
          p2fmap_SVC (FrIfPdusInFrame): FrIfPduOffset=0, FrIfPduRef=SVC_In
        FrStr_SVC_18ab1424_In  # SVC
          p2fmap_SVC (FrIfPdusInFrame): FrIfPduOffset=0, FrIfPduRef=SVC_In
        FrStr_SVC_1aedaa7d_In  # SVC
          p2fmap_SVC (FrIfPdusInFrame): FrIfPduOffset=0, FrIfPduRef=SVC_In
        FrStr_SVC_1fa2bcf8_In  # SVC
          p2fmap_SVC (FrIfPdusInFrame): FrIfPduOffset=0, FrIfPduRef=SVC_In
        FrStr_SVC_1fe6493a_In  # SVC
          p2fmap_SVC (FrIfPdusInFrame): FrIfPduOffset=0, FrIfPduRef=SVC_In
        FrStr_SVC_b25e2394_In  # SVC
          p2fmap_SVC (FrIfPdusInFrame): FrIfPduOffset=0, FrIfPduRef=SVC_In
        FrStr_SVC_b39c49a3_In  # SVC
          p2fmap_SVC (FrIfPdusInFrame): FrIfPduOffset=0, FrIfPduRef=SVC_In
        FrStr_SVC_b5578b48_In  # SVC
          p2fmap_SVC (FrIfPdusInFrame): FrIfPduOffset=0, FrIfPduRef=SVC_In
        FrStr_SVC_b6d35f26_In  # SVC
          p2fmap_SVC (FrIfPdusInFrame): FrIfPduOffset=0, FrIfPduRef=SVC_In
        FrStr_SVC_b7113511_In  # SVC
          p2fmap_SVC (FrIfPdusInFrame): FrIfPduOffset=0, FrIfPduRef=SVC_In
        FrStr_SVC_f2f7f198_In  # SVC
          p2fmap_SVC (FrIfPdusInFrame): FrIfPduOffset=0, FrIfPduRef=SVC_In
        FrStr_TAR_ESTP_VIRT_FTAX  # TAR_ESTP_VIRT_FTAX
          p2fmap_TAR_ESTP_VIRT_FTAX (FrIfPdusInFrame): FrIfPduOffset=0, FrIfPduRef=TAR_ESTP_VIRT_FTAX
        FrStr_TAR_QTA_STRMOM_DV_TAR_STMOM_DV_ACT  # TAR_QTA_STRMOM_DV_TAR_STMOM_DV_ACT
          p2fmap_TAR_QTA_STRMOM_DV (FrIfPdusInFrame): FrIfPduOffset=0, FrIfPduRef=TAR_QTA_STRMOM_DV
          p2fmap_TAR_STMOM_DV_ACT (FrIfPdusInFrame): FrIfPduOffset=8, FrIfPduRef=TAR_STMOM_DV_ACT
        FrStr_TL_BRC_FR_32_402c92c4_In  # TL_BRC_FR_32
          p2fmap_TL_BRC_FR_32 (FrIfPdusInFrame): FrIfPduOffset=0, FrIfPduRef=TL_BRC_FR_32
        FrStr_TL_BRC_FR_32_41eef8f3_In  # TL_BRC_FR_32
          p2fmap_TL_BRC_FR_32 (FrIfPdusInFrame): FrIfPduOffset=0, FrIfPduRef=TL_BRC_FR_32
        FrStr_TL_BRC_FR_32_426a2c9d_In  # TL_BRC_FR_32
          p2fmap_TL_BRC_FR_32 (FrIfPdusInFrame): FrIfPduOffset=0, FrIfPduRef=TL_BRC_FR_32
        FrStr_TL_BRC_FR_32_43a846aa_In  # TL_BRC_FR_32
          p2fmap_TL_BRC_FR_32 (FrIfPdusInFrame): FrIfPduOffset=0, FrIfPduRef=TL_BRC_FR_32
        FrStr_TL_BRC_FR_32_f4c51a40_In  # TL_BRC_FR_32
          p2fmap_TL_BRC_FR_32 (FrIfPdusInFrame): FrIfPduOffset=0, FrIfPduRef=TL_BRC_FR_32
        FrStr_TL_ECU_TRNSM_FR_32  # TL_ECU_TRNSM_FR_32
          p2fmap_TL_ECU_TRNSM_FR_32 (FrIfPdusInFrame): FrIfPduOffset=0, FrIfPduRef=TL_ECU_TRNSM_FR_32
        FrStr_TL_MST_GW_TRNSM_FR_254  # TL_MST_GW_TRNSM_FR_254
          p2fmap_TL_MST_GW_TRNSM_FR_254 (FrIfPdusInFrame): FrIfPduOffset=0, FrIfPduRef=TL_MST_GW_TRNSM_FR_254
        FrStr_V_VEH_V_VEH_2  # V_VEH_V_VEH_2
          p2fmap_V_VEH (FrIfPdusInFrame): FrIfPduOffset=0, FrIfPduRef=V_VEH
        FrStr_xcpdynamic254_1  # xcpdynamic254_1
          p2fmap_xcpdynamic254_1 (FrIfPdusInFrame): FrIfPduOffset=0, FrIfPduRef=xcpdynamic254_1
        FrStr_xcpdynamic254_2  # xcpdynamic254_2
          p2fmap_xcpdynamic254_2 (FrIfPdusInFrame): FrIfPduOffset=0, FrIfPduRef=xcpdynamic254_2
        FrStr_xcpdynamic254_3  # xcpdynamic254_3
          p2fmap_xcpdynamic254_3 (FrIfPdusInFrame): FrIfPduOffset=0, FrIfPduRef=xcpdynamic254_3
        FrStr_xcpdynamic254_4  # xcpdynamic254_4
          p2fmap_xcpdynamic254_4 (FrIfPdusInFrame): FrIfPduOffset=0, FrIfPduRef=xcpdynamic254_4
        FrStr_xcpdynamic254_5  # xcpdynamic254_5
          p2fmap_xcpdynamic254_5 (FrIfPdusInFrame): FrIfPduOffset=0, FrIfPduRef=xcpdynamic254_5
        FrStr_xcpdynamic254_6  # xcpdynamic254_6
          p2fmap_xcpdynamic254_6 (FrIfPdusInFrame): FrIfPduOffset=0, FrIfPduRef=xcpdynamic254_6
        FrStr_xcpdynamic254_7  # xcpdynamic254_7
          p2fmap_xcpdynamic254_7 (FrIfPdusInFrame): FrIfPduOffset=0, FrIfPduRef=xcpdynamic254_7
        FrStr_xcpdynamic254_8  # xcpdynamic254_8
          p2fmap_xcpdynamic254_8 (FrIfPdusInFrame): FrIfPduOffset=0, FrIfPduRef=xcpdynamic254_8
        FrStr_xcpmaster  # xcpmaster
          p2fmap_dummy32bmaster (FrIfPdusInFrame): FrIfPduOffset=0, FrIfPduRef=dummy32bmaster
        FrStr_xcpslave  # xcpslave
          p2fmap_dummy32bslave (FrIfPdusInFrame): FrIfPduOffset=0, FrIfPduRef=dummy32bslave
        FrStr_xcpstatic_a931915e_Out  # xcpstatic
          p2fmap_dummy16bstatic (FrIfPdusInFrame): FrIfPduOffset=0, FrIfPduRef=dummy16bstatic
        FrStr_xcpstatic_aab54530_Out  # xcpstatic
          p2fmap_dummy16bstatic (FrIfPdusInFrame): FrIfPduOffset=0, FrIfPduRef=dummy16bstatic
        FrStr_xcpstatic_ab772f07_Out  # xcpstatic
          p2fmap_dummy16bstatic (FrIfPdusInFrame): FrIfPduOffset=0, FrIfPduRef=dummy16bstatic
        FrStr_xcpstatic_c8b51460_Out  # xcpstatic
          p2fmap_dummy16bstatic (FrIfPdusInFrame): FrIfPduOffset=0, FrIfPduRef=dummy16bstatic
        FrStr_xcpstatic_c9777e57_Out  # xcpstatic
          p2fmap_dummy16bstatic (FrIfPdusInFrame): FrIfPduOffset=0, FrIfPduRef=dummy16bstatic
      52 x FrIfPdu:
        ACLNY_MASSCNTR
          FrIfPduDirection
            FrIfRxPdu_ACLNY_MASSCNTR (FrIfRxPdu): FrIfUserRxIndicationUL=PDUR, FrIfRxPduRef=pduTrig_ACLNY_MASSCNTR_pduPort_EPS_A_FlexRay_IN_55c86d41_4f391dd1  # ACLNY_MASSCNTR
        AVL_FORC_GRD
          FrIfPduDirection
            FrIfTxPdu_AVL_FORC_GRD (FrIfTxPdu): FrIfUserTxUL=PDUR, FrIfTxPduRef=pduTrig_AVL_FORC_GRD_pduPort_EPS_A_FlexRay_OUT_55c86d41_4f391dd1  # AVL_FORC_GRD
        AVL_PO_EPS
          FrIfPduDirection
            FrIfTxPdu_AVL_PO_EPS (FrIfTxPdu): FrIfUserTxUL=PDUR, FrIfTxPduRef=pduTrig_AVL_PO_EPS_pduPort_EPS_A_FlexRay_OUT_55c86d41_4f391dd1  # AVL_PO_EPS
        AVL_RPM_WHL
          FrIfPduDirection
            FrIfRxPdu_AVL_RPM_WHL (FrIfRxPdu): FrIfUserRxIndicationUL=PDUR, FrIfRxPduRef=pduTrig_AVL_RPM_WHL_pduPort_EPS_A_FlexRay_IN_55c86d41_4f391dd1  # AVL_RPM_WHL
        AVL_STMOM_DV_ACT
          FrIfPduDirection
            FrIfTxPdu_AVL_STMOM_DV_ACT (FrIfTxPdu): FrIfUserTxUL=PDUR, FrIfTxPduRef=pduTrig_AVL_STMOM_DV_ACT_pduPort_EPS_A_FlexRay_OUT_55c86d41_4f391dd1  # AVL_STMOM_DV_ACT
        A_TEMP
          FrIfPduDirection
            FrIfRxPdu_A_TEMP (FrIfRxPdu): FrIfUserRxIndicationUL=PDUR, FrIfRxPduRef=pduTrig_A_TEMP_pduPort_EPS_A_FlexRay_IN_55c86d41_4f391dd1  # A_TEMP
        CON_VEH
          FrIfPduDirection
            FrIfRxPdu_CON_VEH (FrIfRxPdu): FrIfUserRxIndicationUL=PDUR, FrIfRxPduRef=pduTrig_CON_VEH_pduPort_EPS_A_FlexRay_IN_55c86d41_4f391dd1  # CON_VEH
        CTR_DIAG_OBD_DRDY
          FrIfPduDirection
            FrIfRxPdu_CTR_DIAG_OBD_DRDY (FrIfRxPdu): FrIfUserRxIndicationUL=PDUR, FrIfRxPduRef=pduTrig_CTR_DIAG_OBD_DRDY_pduPort_EPS_A_FlexRay_IN_55c86d41_4f391dd1  # CTR_DIAG_OBD_DRDY
        CTR_VIB_STW_DISP_EXMI_SP2015
          FrIfPduDirection
            FrIfRxPdu_CTR_VIB_STW_DISP_EXMI_SP2015 (FrIfRxPdu): FrIfUserRxIndicationUL=PDUR, FrIfRxPduRef=pduTrig_CTR_VIB_STW_DISP_EXMI_SP2015_pduPort_EPS_A_FlexRay_IN_55c86d41_4f391dd1  # CTR_VIB_STW_DISP_EXMI_SP2015
        DIAG_OBD_ENG
          FrIfPduDirection
            FrIfRxPdu_DIAG_OBD_ENG (FrIfRxPdu): FrIfUserRxIndicationUL=PDUR, FrIfRxPduRef=pduTrig_DIAG_OBD_ENG_pduPort_EPS_A_FlexRay_IN_55c86d41_4f391dd1  # DIAG_OBD_ENG
        DISP_CC_EPS
          FrIfPduDirection
            FrIfTxPdu_DISP_CC_EPS (FrIfTxPdu): FrIfUserTxUL=PDUR, FrIfTxPduRef=pduTrig_DISP_CC_EPS_pduPort_EPS_A_FlexRay_OUT_55c86d41_4f391dd1  # DISP_CC_EPS
        DT_EST
          FrIfPduDirection
            FrIfTxPdu_DT_EST (FrIfTxPdu): FrIfUserTxUL=PDUR, FrIfTxPduRef=pduTrig_DT_EST_pduPort_EPS_A_FlexRay_OUT_55c86d41_4f391dd1  # DT_EST
        ENERG_DGR_DRDY
          FrIfPduDirection
            FrIfRxPdu_ENERG_DGR_DRDY (FrIfRxPdu): FrIfUserRxIndicationUL=PDUR, FrIfRxPduRef=pduTrig_ENERG_DGR_DRDY_pduPort_EPS_A_FlexRay_IN_55c86d41_4f391dd1  # ENERG_DGR_DRDY
        ENGTORQ_EPS
          FrIfPduDirection
            FrIfTxPdu_ENGTORQ_EPS (FrIfTxPdu): FrIfUserTxUL=PDUR, FrIfTxPduRef=pduTrig_ENGTORQ_EPS_pduPort_EPS_A_FlexRay_OUT_55c86d41_4f391dd1  # ENGTORQ_EPS
        ENSU_SFY
          FrIfPduDirection
            FrIfRxPdu_ENSU_SFY (FrIfRxPdu): FrIfUserRxIndicationUL=PDUR, FrIfRxPduRef=pduTrig_ENSU_SFY_pduPort_EPS_A_FlexRay_IN_55c86d41_4f391dd1  # ENSU_SFY
        ERRM_BN_U
          FrIfPduDirection
            FrIfRxPdu_ERRM_BN_U (FrIfRxPdu): FrIfUserRxIndicationUL=PDUR, FrIfRxPduRef=pduTrig_ERRM_BN_U_pduPort_EPS_A_FlexRay_IN_55c86d41_4f391dd1  # ERRM_BN_U
        FAHRGESTELLNUMMER
          FrIfPduDirection
            FrIfRxPdu_FAHRGESTELLNUMMER (FrIfRxPdu): FrIfUserRxIndicationUL=PDUR, FrIfRxPduRef=pduTrig_FAHRGESTELLNUMMER_pduPort_EPS_A_FlexRay_IN_55c86d41_4f391dd1  # FAHRGESTELLNUMMER
        FR_DBG_EPS
          FrIfPduDirection
            FrIfTxPdu_FR_DBG_EPS (FrIfTxPdu): FrIfUserTxUL=PDUR, FrIfTxPduRef=pduTrig_FR_DBG_EPS_pduPort_EPS_A_FlexRay_OUT_55c86d41_4f391dd1  # FR_DBG_EPS
        FZZSTD
          FrIfPduDirection
            FrIfRxPdu_FZZSTD (FrIfRxPdu): FrIfUserRxIndicationUL=PDUR, FrIfRxPduRef=pduTrig_FZZSTD_pduPort_EPS_A_FlexRay_IN_55c86d41_4f391dd1  # FZZSTD
        KILOMETERSTAND
          FrIfPduDirection
            FrIfRxPdu_KILOMETERSTAND (FrIfRxPdu): FrIfUserRxIndicationUL=PDUR, FrIfRxPduRef=pduTrig_KILOMETERSTAND_pduPort_EPS_A_FlexRay_IN_55c86d41_4f391dd1  # KILOMETERSTAND
        OFFS_QUAD_EPS
          FrIfPduDirection
            FrIfRxPdu_OFFS_QUAD_EPS (FrIfRxPdu): FrIfUserRxIndicationUL=PDUR, FrIfRxPduRef=pduTrig_OFFS_QUAD_EPS_pduPort_EPS_A_FlexRay_IN_55c86d41_4f391dd1  # OFFS_QUAD_EPS
        RELATIVZEIT
          FrIfPduDirection
            FrIfRxPdu_RELATIVZEIT (FrIfRxPdu): FrIfUserRxIndicationUL=PDUR, FrIfRxPduRef=pduTrig_RELATIVZEIT_pduPort_EPS_A_FlexRay_IN_55c86d41_4f391dd1  # RELATIVZEIT
        SECU_FAHRGESTELLNUMMER
          FrIfPduDirection
            FrIfRxPdu_SECU_FAHRGESTELLNUMMER (FrIfRxPdu): FrIfUserRxIndicationUL=PDUR, FrIfRxPduRef=pduTrig_SECU_FAHRGESTELLNUMMER_pduPort_EPS_A_FlexRay_IN_55c86d41_4f391dd1  # SECU_FAHRGESTELLNUMMER
        STEA_OFFS
          FrIfPduDirection
            FrIfRxPdu_STEA_OFFS (FrIfRxPdu): FrIfUserRxIndicationUL=PDUR, FrIfRxPduRef=pduTrig_STEA_OFFS_pduPort_EPS_A_FlexRay_IN_55c86d41_4f391dd1  # STEA_OFFS
        ST_CENG
          FrIfPduDirection
            FrIfRxPdu_ST_CENG (FrIfRxPdu): FrIfUserRxIndicationUL=PDUR, FrIfRxPduRef=pduTrig_ST_CENG_pduPort_EPS_A_FlexRay_IN_55c86d41_4f391dd1  # ST_CENG
        ST_DIAG_OBD_3_DRDY
          FrIfPduDirection
            FrIfTxPdu_ST_DIAG_OBD_3_DRDY (FrIfTxPdu): FrIfUserTxUL=PDUR, FrIfTxPduRef=pduTrig_ST_DIAG_OBD_3_DRDY_pduPort_EPS_A_FlexRay_OUT_55c86d41_4f391dd1  # ST_DIAG_OBD_3_DRDY
        ST_ENERG_GEN
          FrIfPduDirection
            FrIfRxPdu_ST_ENERG_GEN (FrIfRxPdu): FrIfUserRxIndicationUL=PDUR, FrIfRxPduRef=pduTrig_ST_ENERG_GEN_pduPort_EPS_A_FlexRay_IN_55c86d41_4f391dd1  # ST_ENERG_GEN
        ST_EST
          FrIfPduDirection
            FrIfTxPdu_ST_EST (FrIfTxPdu): FrIfUserTxUL=PDUR, FrIfTxPduRef=pduTrig_ST_EST_pduPort_EPS_A_FlexRay_OUT_55c86d41_4f391dd1  # ST_EST
        ST_STAB_DSC
          FrIfPduDirection
            FrIfRxPdu_ST_STAB_DSC (FrIfRxPdu): FrIfUserRxIndicationUL=PDUR, FrIfRxPduRef=pduTrig_ST_STAB_DSC_pduPort_EPS_A_FlexRay_IN_55c86d41_4f391dd1  # ST_STAB_DSC
        SU_CLE_DRDY_DXP
          FrIfPduDirection
            FrIfRxPdu_SU_CLE_DRDY_DXP (FrIfRxPdu): FrIfUserRxIndicationUL=PDUR, FrIfRxPduRef=pduTrig_SU_CLE_DRDY_DXP_pduPort_EPS_A_FlexRay_IN_55c86d41_4f391dd1  # SU_CLE_DRDY_DXP
        SU_EPS
          FrIfPduDirection
            FrIfTxPdu_SU_EPS (FrIfTxPdu): FrIfUserTxUL=PDUR, FrIfTxPduRef=pduTrig_SU_EPS_pduPort_EPS_A_FlexRay_OUT_55c86d41_4f391dd1  # SU_EPS
        SVC_In
          FrIfPduDirection
            FrIfRxPdu_SVC (FrIfRxPdu): FrIfUserRxIndicationUL=CDD, FrIfRxPduRef=EcucPduCollection/SVC_fbd80461_In  # SVC
        SVC_Out
          FrIfPduDirection
            FrIfTxPdu_SVC (FrIfTxPdu): FrIfUserTxUL=CDD, FrIfTxPduRef=EcucPduCollection/SVC_fbd80461_Out  # SVC
        TAR_ESTP_VIRT_FTAX
          FrIfPduDirection
            FrIfRxPdu_TAR_ESTP_VIRT_FTAX (FrIfRxPdu): FrIfUserRxIndicationUL=PDUR, FrIfRxPduRef=pduTrig_TAR_ESTP_VIRT_FTAX_pduPort_EPS_A_FlexRay_IN_55c86d41_4f391dd1  # TAR_ESTP_VIRT_FTAX
        TAR_QTA_STRMOM_DV
          FrIfPduDirection
            FrIfRxPdu_TAR_QTA_STRMOM_DV (FrIfRxPdu): FrIfUserRxIndicationUL=PDUR, FrIfRxPduRef=pduTrig_TAR_QTA_STRMOM_DV_pduPort_EPS_A_FlexRay_IN_55c86d41_4f391dd1  # TAR_QTA_STRMOM_DV
        TAR_STMOM_DV_ACT
          FrIfPduDirection
            FrIfRxPdu_TAR_STMOM_DV_ACT (FrIfRxPdu): FrIfUserRxIndicationUL=PDUR, FrIfRxPduRef=pduTrig_TAR_STMOM_DV_ACT_pduPort_EPS_A_FlexRay_IN_55c86d41_4f391dd1  # TAR_STMOM_DV_ACT
        TL_BRC_FR_32
          FrIfPduDirection
            FrIfRxPdu_TL_BRC_FR_32 (FrIfRxPdu): FrIfUserRxIndicationUL=CDD, FrIfRxPduRef=p2fmap_TL_BRC_FR_32_003b6d76  # TL_BRC_FR_32
        TL_ECU_TRNSM_FR_32
          FrIfPduDirection
            FrIfTxPdu_TL_ECU_TRNSM_FR_32 (FrIfTxPdu): FrIfUserTxUL=CDD, FrIfTxPduRef=p2fmap_TL_ECU_TRNSM_FR_32_c9b68eba  # TL_ECU_TRNSM_FR_32
        TL_MST_GW_TRNSM_FR_254
          FrIfPduDirection
            FrIfRxPdu_TL_MST_GW_TRNSM_FR_254 (FrIfRxPdu): FrIfUserRxIndicationUL=CDD, FrIfRxPduRef=p2fmap_TL_MST_GW_TRNSM_FR_254_c761be43  # TL_MST_GW_TRNSM_FR_254
        VYAW_VEH
          FrIfPduDirection
            FrIfRxPdu_VYAW_VEH (FrIfRxPdu): FrIfUserRxIndicationUL=PDUR, FrIfRxPduRef=pduTrig_VYAW_VEH_pduPort_EPS_A_FlexRay_IN_55c86d41_4f391dd1  # VYAW_VEH
        V_VEH
          FrIfPduDirection
            FrIfRxPdu_V_VEH (FrIfRxPdu): FrIfUserRxIndicationUL=PDUR, FrIfRxPduRef=pduTrig_V_VEH_pduPort_EPS_A_FlexRay_IN_55c86d41_4f391dd1  # V_VEH
        dummy16bstatic
          FrIfPduDirection
            FrIfTxPdu_dummy16bstatic (FrIfTxPdu): FrIfUserTxUL=XCP, FrIfTxPduRef=pduTrig_dummy16bstatic_pduPort_EPS_A_FlexRay_OUT_55c86d41_4f391dd1  # dummy16bstatic
        dummy32bmaster
          FrIfPduDirection
            FrIfRxPdu_dummy32bmaster (FrIfRxPdu): FrIfUserRxIndicationUL=XCP, FrIfRxPduRef=pduTrig_dummy32bmaster_pduPort_EPS_A_FlexRay_IN_55c86d41_4f391dd1  # dummy32bmaster
        dummy32bslave
          FrIfPduDirection
            FrIfTxPdu_dummy32bslave (FrIfTxPdu): FrIfUserTxUL=XCP, FrIfTxPduRef=pduTrig_dummy32bslave_pduPort_EPS_A_FlexRay_OUT_55c86d41_4f391dd1  # dummy32bslave
        xcpdynamic254_1
          FrIfPduDirection
            FrIfTxPdu_xcpdynamic254_1 (FrIfTxPdu): FrIfUserTxUL=XCP, FrIfTxPduRef=pduTrig_xcpdynamic254_1_pduPort_EPS_A_FlexRay_OUT_55c86d41_4f391dd1  # xcpdynamic254_1
        xcpdynamic254_2
          FrIfPduDirection
            FrIfTxPdu_xcpdynamic254_2 (FrIfTxPdu): FrIfUserTxUL=XCP, FrIfTxPduRef=pduTrig_xcpdynamic254_2_pduPort_EPS_A_FlexRay_OUT_55c86d41_4f391dd1  # xcpdynamic254_2
        xcpdynamic254_3
          FrIfPduDirection
            FrIfTxPdu_xcpdynamic254_3 (FrIfTxPdu): FrIfUserTxUL=XCP, FrIfTxPduRef=pduTrig_xcpdynamic254_3_pduPort_EPS_A_FlexRay_OUT_55c86d41_4f391dd1  # xcpdynamic254_3
        xcpdynamic254_4
          FrIfPduDirection
            FrIfTxPdu_xcpdynamic254_4 (FrIfTxPdu): FrIfUserTxUL=XCP, FrIfTxPduRef=pduTrig_xcpdynamic254_4_pduPort_EPS_A_FlexRay_OUT_55c86d41_4f391dd1  # xcpdynamic254_4
        xcpdynamic254_5
          FrIfPduDirection
            FrIfTxPdu_xcpdynamic254_5 (FrIfTxPdu): FrIfUserTxUL=XCP, FrIfTxPduRef=pduTrig_xcpdynamic254_5_pduPort_EPS_A_FlexRay_OUT_55c86d41_4f391dd1  # xcpdynamic254_5
        xcpdynamic254_6
          FrIfPduDirection
            FrIfTxPdu_xcpdynamic254_6 (FrIfTxPdu): FrIfUserTxUL=XCP, FrIfTxPduRef=pduTrig_xcpdynamic254_6_pduPort_EPS_A_FlexRay_OUT_55c86d41_4f391dd1  # xcpdynamic254_6
        xcpdynamic254_7
          FrIfPduDirection
            FrIfTxPdu_xcpdynamic254_7 (FrIfTxPdu): FrIfUserTxUL=XCP, FrIfTxPduRef=pduTrig_xcpdynamic254_7_pduPort_EPS_A_FlexRay_OUT_55c86d41_4f391dd1  # xcpdynamic254_7
        xcpdynamic254_8
          FrIfPduDirection
            FrIfTxPdu_xcpdynamic254_8 (FrIfTxPdu): FrIfUserTxUL=XCP, FrIfTxPduRef=pduTrig_xcpdynamic254_8_pduPort_EPS_A_FlexRay_OUT_55c86d41_4f391dd1  # xcpdynamic254_8
    FrIfGeneral
  module config FrSM
    FrSMConfig
      A_FlexRay_372befd6 (FrSMCluster): FrSMComMNetworkHandleRef=ComMConfigSet/A_FlexRay_372befd6, FrSMFrIfClusterRef=A_FlexRay
  module config IpduM
    IpduMConfig
      pduTrig_SVC_fbd80461_In (IpduMRxPathway)  # SVC
        pduTrig_SVC_fbd80461_In (IpduMRxIndication): IpduMByteOrder=LITTLE_ENDIAN, IpduMRxIndicationPduRef=EcucPduCollection/SVC_fbd80461_In
          ANFRAGE_19255f18 (IpduMRxDynamicPart): IpduMRxSelectorValue=1, IpduMOutgoingDynamicPduRef=EcucPduCollection/ANFRAGE_fbd80461_In
            SegmentPosition_0 (IpduMSegment): IpduMSegmentLength=64, IpduMSegmentPosition=0
          SECU_RESP_19255f18 (IpduMRxDynamicPart): IpduMRxSelectorValue=247, IpduMOutgoingDynamicPduRef=pduTrig_SECU_RESP_pduPort_EPS_A_FlexRay_IN_55c86d41_4f391dd1
            SegmentPosition_0 (IpduMSegment): IpduMSegmentLength=64, IpduMSegmentPosition=0
          IpduMSelectorFieldPosition: IpduMSelectorFieldLength=8, IpduMSelectorFieldPosition=0
      pduTrig_FR_DBG_EPS_55c86d41 (IpduMTxPathway)  # FR_DBG_EPS
        pduTrig_FR_DBG_EPS_55c86d41 (IpduMTxRequest):
          IpduMByteOrder = LITTLE_ENDIAN
          IpduMIPduUnusedAreasDefault = 255
          IpduMTxTriggerMode = DYNAMIC_PART_TRIGGER
          IpduMInitialDynamicPart = pduTrig_FR_DBG_EPS_55c86d41/DBG_EPS_BS_MOD_58_BYTE_19255f18
          IpduMOutgoingPduRef = pduTrig_FR_DBG_EPS_pduPort_EPS_A_FlexRay_OUT_55c86d41_4f391dd1
          IpduMSelectorFieldPosition: IpduMSelectorFieldLength=8, IpduMSelectorFieldPosition=0
          DBG_EPS_BS_MOD_58_BYTE_19255f18 (IpduMTxDynamicPart): IpduMTxDynamicPduRef=pduTrig_DBG_EPS_BS_MOD_58_BYTE_pduPort_EPS_A_FlexRay_OUT_55c86d41_4f391dd1
            SegmentPosition_0 (IpduMSegment): IpduMSegmentLength=464, IpduMSegmentPosition=0
          DBG_EPS_MOD_EXT_120_BYTE_19255f18 (IpduMTxDynamicPart): IpduMTxDynamicPduRef=pduTrig_DBG_EPS_MOD_EXT_120_BYTE_pduPort_EPS_A_FlexRay_OUT_55c86d41_4f391dd1
            SegmentPosition_0 (IpduMSegment): IpduMSegmentLength=464, IpduMSegmentPosition=0
      pduTrig_SVC_fbd80461_Out (IpduMTxPathway)  # SVC
        pduTrig_SVC_fbd80461_Out (IpduMTxRequest):
          IpduMByteOrder = LITTLE_ENDIAN
          IpduMIPduUnusedAreasDefault = 255
          IpduMTxTriggerMode = DYNAMIC_PART_TRIGGER
          IpduMInitialDynamicPart = pduTrig_SVC_fbd80461_Out/ANFRAGE_19255f18
          IpduMOutgoingPduRef = EcucPduCollection/SVC_fbd80461_Out
          IpduMSelectorFieldPosition: IpduMSelectorFieldLength=8, IpduMSelectorFieldPosition=0
          3 x IpduMTxDynamicPart:
            ANFRAGE_19255f18: IpduMTxDynamicPduRef=EcucPduCollection/ANFRAGE_fbd80461_Out
              SegmentPosition_0 (IpduMSegment): IpduMSegmentLength=64, IpduMSegmentPosition=0
            RQ_STG_EFAN_19255f18: IpduMTxDynamicPduRef=pduTrig_RQ_STG_EFAN_pduPort_EPS_A_FlexRay_OUT_55c86d41_4f391dd1
              SegmentPosition_0 (IpduMSegment): IpduMSegmentLength=64, IpduMSegmentPosition=0
            SECU_CHAL_19255f18: IpduMTxDynamicPduRef=pduTrig_SECU_CHAL_pduPort_EPS_A_FlexRay_OUT_55c86d41_4f391dd1
              SegmentPosition_0 (IpduMSegment): IpduMSegmentLength=64, IpduMSegmentPosition=0
    IPduMGeneral (IpduMGeneral): IpduMStaticPartExists=false
  module config PduR
    PduRGeneral
    PduRRoutingTables
      PduRRoutingTable
        45 x PduRRoutingPath:
          ANFRAGE_fbd80461_In
            DST_ANFRAGE_fbd80461_In (PduRDestPdu): PduRDestPduRef=EcucPduCollection/ANFRAGE_fbd80461_In
            SRC_ANFRAGE_fbd80461_In (PduRSrcPdu): PduRSrcPduRef=EcucPduCollection/ANFRAGE_fbd80461_In
          ANFRAGE_fbd80461_Out
            DST_ANFRAGE_fbd80461_Out (PduRDestPdu): PduRDestPduRef=EcucPduCollection/ANFRAGE_fbd80461_Out
            SRC_ANFRAGE_fbd80461_Out (PduRSrcPdu): PduRSrcPduRef=EcucPduCollection/ANFRAGE_fbd80461_Out
          Fr_pduTrig_ACLNY_MASSCNTR_55c86d41  # ACLNY_MASSCNTR
            DST_Fr_pduTrig_ACLNY_MASSCNTR_55c86d41 (PduRDestPdu): PduRDestPduRef=pduTrig_ACLNY_MASSCNTR_pduPort_EPS_A_FlexRay_IN_55c86d41_4f391dd1
            SRC_Fr_pduTrig_ACLNY_MASSCNTR_55c86d41 (PduRSrcPdu): PduRSrcPduRef=pduTrig_ACLNY_MASSCNTR_pduPort_EPS_A_FlexRay_IN_55c86d41_4f391dd1
          Fr_pduTrig_AVL_FORC_GRD_55c86d41  # AVL_FORC_GRD
            DST_Fr_pduTrig_AVL_FORC_GRD_55c86d41 (PduRDestPdu): PduRDestPduRef=pduTrig_AVL_FORC_GRD_pduPort_EPS_A_FlexRay_OUT_55c86d41_4f391dd1
            SRC_Fr_pduTrig_AVL_FORC_GRD_55c86d41 (PduRSrcPdu): PduRSrcPduRef=pduTrig_AVL_FORC_GRD_pduPort_EPS_A_FlexRay_OUT_55c86d41_4f391dd1
          Fr_pduTrig_AVL_PO_EPS_55c86d41  # AVL_PO_EPS
            DST_Fr_pduTrig_AVL_PO_EPS_55c86d41 (PduRDestPdu): PduRDestPduRef=pduTrig_AVL_PO_EPS_pduPort_EPS_A_FlexRay_OUT_55c86d41_4f391dd1
            SRC_Fr_pduTrig_AVL_PO_EPS_55c86d41 (PduRSrcPdu): PduRSrcPduRef=pduTrig_AVL_PO_EPS_pduPort_EPS_A_FlexRay_OUT_55c86d41_4f391dd1
          Fr_pduTrig_AVL_RPM_WHL_55c86d41  # AVL_RPM_WHL
            DST_Fr_pduTrig_AVL_RPM_WHL_55c86d41 (PduRDestPdu): PduRDestPduRef=pduTrig_AVL_RPM_WHL_pduPort_EPS_A_FlexRay_IN_55c86d41_4f391dd1
            SRC_Fr_pduTrig_AVL_RPM_WHL_55c86d41 (PduRSrcPdu): PduRSrcPduRef=pduTrig_AVL_RPM_WHL_pduPort_EPS_A_FlexRay_IN_55c86d41_4f391dd1
          Fr_pduTrig_AVL_STMOM_DV_ACT_55c86d41  # AVL_STMOM_DV_ACT
            DST_Fr_pduTrig_AVL_STMOM_DV_ACT_55c86d41 (PduRDestPdu): PduRDestPduRef=pduTrig_AVL_STMOM_DV_ACT_pduPort_EPS_A_FlexRay_OUT_55c86d41_4f391dd1
            SRC_Fr_pduTrig_AVL_STMOM_DV_ACT_55c86d41 (PduRSrcPdu): PduRSrcPduRef=pduTrig_AVL_STMOM_DV_ACT_pduPort_EPS_A_FlexRay_OUT_55c86d41_4f391dd1
          Fr_pduTrig_A_TEMP_55c86d41  # A_TEMP
            DST_Fr_pduTrig_A_TEMP_55c86d41 (PduRDestPdu): PduRDestPduRef=pduTrig_A_TEMP_pduPort_EPS_A_FlexRay_IN_55c86d41_4f391dd1
            SRC_Fr_pduTrig_A_TEMP_55c86d41 (PduRSrcPdu): PduRSrcPduRef=pduTrig_A_TEMP_pduPort_EPS_A_FlexRay_IN_55c86d41_4f391dd1
          Fr_pduTrig_CON_VEH_55c86d41  # CON_VEH
            DST_Fr_pduTrig_CON_VEH_55c86d41 (PduRDestPdu): PduRDestPduRef=pduTrig_CON_VEH_pduPort_EPS_A_FlexRay_IN_55c86d41_4f391dd1
            SRC_Fr_pduTrig_CON_VEH_55c86d41 (PduRSrcPdu): PduRSrcPduRef=pduTrig_CON_VEH_pduPort_EPS_A_FlexRay_IN_55c86d41_4f391dd1
          Fr_pduTrig_CTR_DIAG_OBD_DRDY_55c86d41  # CTR_DIAG_OBD_DRDY
            DST_Fr_pduTrig_CTR_DIAG_OBD_DRDY_55c86d41 (PduRDestPdu): PduRDestPduRef=pduTrig_CTR_DIAG_OBD_DRDY_pduPort_EPS_A_FlexRay_IN_55c86d41_4f391dd1
            SRC_Fr_pduTrig_CTR_DIAG_OBD_DRDY_55c86d41 (PduRSrcPdu): PduRSrcPduRef=pduTrig_CTR_DIAG_OBD_DRDY_pduPort_EPS_A_FlexRay_IN_55c86d41_4f391dd1
          Fr_pduTrig_CTR_VIB_STW_DISP_EXMI_SP2015_55c86d41  # CTR_VIB_STW_DISP_EXMI_SP2015
            DST_Fr_pduTrig_CTR_VIB_STW_DISP_EXMI_SP2015_55c86d41 (PduRDestPdu): PduRDestPduRef=pduTrig_CTR_VIB_STW_DISP_EXMI_SP2015_pduPort_EPS_A_FlexRay_IN_55c86d41_4f391dd1
            SRC_Fr_pduTrig_CTR_VIB_STW_DISP_EXMI_SP2015_55c86d41 (PduRSrcPdu): PduRSrcPduRef=pduTrig_CTR_VIB_STW_DISP_EXMI_SP2015_pduPort_EPS_A_FlexRay_IN_55c86d41_4f391dd1
          Fr_pduTrig_DBG_EPS_BS_MOD_58_BYTE_55c86d41  # DBG_EPS_BS_MOD_58_BYTE
            DST_Fr_pduTrig_DBG_EPS_BS_MOD_58_BYTE_55c86d41 (PduRDestPdu): PduRDestPduRef=pduTrig_DBG_EPS_BS_MOD_58_BYTE_pduPort_EPS_A_FlexRay_OUT_55c86d41_4f391dd1
            SRC_Fr_pduTrig_DBG_EPS_BS_MOD_58_BYTE_55c86d41 (PduRSrcPdu): PduRSrcPduRef=pduTrig_DBG_EPS_BS_MOD_58_BYTE_pduPort_EPS_A_FlexRay_OUT_55c86d41_4f391dd1
          Fr_pduTrig_DBG_EPS_MOD_EXT_120_BYTE_55c86d41  # DBG_EPS_MOD_EXT_120_BYTE
            DST_Fr_pduTrig_DBG_EPS_MOD_EXT_120_BYTE_55c86d41 (PduRDestPdu): PduRDestPduRef=pduTrig_DBG_EPS_MOD_EXT_120_BYTE_pduPort_EPS_A_FlexRay_OUT_55c86d41_4f391dd1
            SRC_Fr_pduTrig_DBG_EPS_MOD_EXT_120_BYTE_55c86d41 (PduRSrcPdu): PduRSrcPduRef=pduTrig_DBG_EPS_MOD_EXT_120_BYTE_pduPort_EPS_A_FlexRay_OUT_55c86d41_4f391dd1
          Fr_pduTrig_DIAG_OBD_ENG_55c86d41  # DIAG_OBD_ENG
            DST_Fr_pduTrig_DIAG_OBD_ENG_55c86d41 (PduRDestPdu): PduRDestPduRef=pduTrig_DIAG_OBD_ENG_pduPort_EPS_A_FlexRay_IN_55c86d41_4f391dd1
            SRC_Fr_pduTrig_DIAG_OBD_ENG_55c86d41 (PduRSrcPdu): PduRSrcPduRef=pduTrig_DIAG_OBD_ENG_pduPort_EPS_A_FlexRay_IN_55c86d41_4f391dd1
          Fr_pduTrig_DISP_CC_EPS_55c86d41  # DISP_CC_EPS
            DST_Fr_pduTrig_DISP_CC_EPS_55c86d41 (PduRDestPdu): PduRDestPduRef=pduTrig_DISP_CC_EPS_pduPort_EPS_A_FlexRay_OUT_55c86d41_4f391dd1
            SRC_Fr_pduTrig_DISP_CC_EPS_55c86d41 (PduRSrcPdu): PduRSrcPduRef=pduTrig_DISP_CC_EPS_pduPort_EPS_A_FlexRay_OUT_55c86d41_4f391dd1
          Fr_pduTrig_DT_EST_55c86d41  # DT_EST
            DST_Fr_pduTrig_DT_EST_55c86d41 (PduRDestPdu): PduRDestPduRef=pduTrig_DT_EST_pduPort_EPS_A_FlexRay_OUT_55c86d41_4f391dd1
            SRC_Fr_pduTrig_DT_EST_55c86d41 (PduRSrcPdu): PduRSrcPduRef=pduTrig_DT_EST_pduPort_EPS_A_FlexRay_OUT_55c86d41_4f391dd1
          Fr_pduTrig_ENERG_DGR_DRDY_55c86d41  # ENERG_DGR_DRDY
            DST_Fr_pduTrig_ENERG_DGR_DRDY_55c86d41 (PduRDestPdu): PduRDestPduRef=pduTrig_ENERG_DGR_DRDY_pduPort_EPS_A_FlexRay_IN_55c86d41_4f391dd1
            SRC_Fr_pduTrig_ENERG_DGR_DRDY_55c86d41 (PduRSrcPdu): PduRSrcPduRef=pduTrig_ENERG_DGR_DRDY_pduPort_EPS_A_FlexRay_IN_55c86d41_4f391dd1
          Fr_pduTrig_ENGTORQ_EPS_55c86d41  # ENGTORQ_EPS
            DST_Fr_pduTrig_ENGTORQ_EPS_55c86d41 (PduRDestPdu): PduRDestPduRef=pduTrig_ENGTORQ_EPS_pduPort_EPS_A_FlexRay_OUT_55c86d41_4f391dd1
            SRC_Fr_pduTrig_ENGTORQ_EPS_55c86d41 (PduRSrcPdu): PduRSrcPduRef=pduTrig_ENGTORQ_EPS_pduPort_EPS_A_FlexRay_OUT_55c86d41_4f391dd1
          Fr_pduTrig_ENSU_SFY_55c86d41  # ENSU_SFY
            DST_Fr_pduTrig_ENSU_SFY_55c86d41 (PduRDestPdu): PduRDestPduRef=pduTrig_ENSU_SFY_pduPort_EPS_A_FlexRay_IN_55c86d41_4f391dd1
            SRC_Fr_pduTrig_ENSU_SFY_55c86d41 (PduRSrcPdu): PduRSrcPduRef=pduTrig_ENSU_SFY_pduPort_EPS_A_FlexRay_IN_55c86d41_4f391dd1
          Fr_pduTrig_ERRM_BN_U_55c86d41  # ERRM_BN_U
            DST_Fr_pduTrig_ERRM_BN_U_55c86d41 (PduRDestPdu): PduRDestPduRef=pduTrig_ERRM_BN_U_pduPort_EPS_A_FlexRay_IN_55c86d41_4f391dd1
            SRC_Fr_pduTrig_ERRM_BN_U_55c86d41 (PduRSrcPdu): PduRSrcPduRef=pduTrig_ERRM_BN_U_pduPort_EPS_A_FlexRay_IN_55c86d41_4f391dd1
          Fr_pduTrig_FAHRGESTELLNUMMER_55c86d41  # FAHRGESTELLNUMMER
            DST_Fr_pduTrig_FAHRGESTELLNUMMER_55c86d41 (PduRDestPdu): PduRDestPduRef=pduTrig_FAHRGESTELLNUMMER_pduPort_EPS_A_FlexRay_IN_55c86d41_4f391dd1
            SRC_Fr_pduTrig_FAHRGESTELLNUMMER_55c86d41 (PduRSrcPdu): PduRSrcPduRef=pduTrig_FAHRGESTELLNUMMER_pduPort_EPS_A_FlexRay_IN_55c86d41_4f391dd1
          Fr_pduTrig_FR_DBG_EPS_55c86d41  # FR_DBG_EPS
            DST_Fr_pduTrig_FR_DBG_EPS_55c86d41 (PduRDestPdu): PduRDestPduRef=pduTrig_FR_DBG_EPS_pduPort_EPS_A_FlexRay_OUT_55c86d41_4f391dd1
            SRC_Fr_pduTrig_FR_DBG_EPS_55c86d41 (PduRSrcPdu): PduRSrcPduRef=pduTrig_FR_DBG_EPS_pduPort_EPS_A_FlexRay_OUT_55c86d41_4f391dd1
          Fr_pduTrig_FZZSTD_55c86d41  # FZZSTD
            DST_Fr_pduTrig_FZZSTD_55c86d41 (PduRDestPdu): PduRDestPduRef=pduTrig_FZZSTD_pduPort_EPS_A_FlexRay_IN_55c86d41_4f391dd1
            SRC_Fr_pduTrig_FZZSTD_55c86d41 (PduRSrcPdu): PduRSrcPduRef=pduTrig_FZZSTD_pduPort_EPS_A_FlexRay_IN_55c86d41_4f391dd1
          Fr_pduTrig_KILOMETERSTAND_55c86d41  # KILOMETERSTAND
            DST_Fr_pduTrig_KILOMETERSTAND_55c86d41 (PduRDestPdu): PduRDestPduRef=pduTrig_KILOMETERSTAND_pduPort_EPS_A_FlexRay_IN_55c86d41_4f391dd1
            SRC_Fr_pduTrig_KILOMETERSTAND_55c86d41 (PduRSrcPdu): PduRSrcPduRef=pduTrig_KILOMETERSTAND_pduPort_EPS_A_FlexRay_IN_55c86d41_4f391dd1
          Fr_pduTrig_OFFS_QUAD_EPS_55c86d41  # OFFS_QUAD_EPS
            DST_Fr_pduTrig_OFFS_QUAD_EPS_55c86d41 (PduRDestPdu): PduRDestPduRef=pduTrig_OFFS_QUAD_EPS_pduPort_EPS_A_FlexRay_IN_55c86d41_4f391dd1
            SRC_Fr_pduTrig_OFFS_QUAD_EPS_55c86d41 (PduRSrcPdu): PduRSrcPduRef=pduTrig_OFFS_QUAD_EPS_pduPort_EPS_A_FlexRay_IN_55c86d41_4f391dd1
          Fr_pduTrig_RELATIVZEIT_55c86d41  # RELATIVZEIT
            DST_Fr_pduTrig_RELATIVZEIT_55c86d41 (PduRDestPdu): PduRDestPduRef=pduTrig_RELATIVZEIT_pduPort_EPS_A_FlexRay_IN_55c86d41_4f391dd1
            SRC_Fr_pduTrig_RELATIVZEIT_55c86d41 (PduRSrcPdu): PduRSrcPduRef=pduTrig_RELATIVZEIT_pduPort_EPS_A_FlexRay_IN_55c86d41_4f391dd1
          Fr_pduTrig_RQ_STG_EFAN_55c86d41  # RQ_STG_EFAN
            DST_Fr_pduTrig_RQ_STG_EFAN_55c86d41 (PduRDestPdu): PduRDestPduRef=pduTrig_RQ_STG_EFAN_pduPort_EPS_A_FlexRay_OUT_55c86d41_4f391dd1
            SRC_Fr_pduTrig_RQ_STG_EFAN_55c86d41 (PduRSrcPdu): PduRSrcPduRef=pduTrig_RQ_STG_EFAN_pduPort_EPS_A_FlexRay_OUT_55c86d41_4f391dd1
          Fr_pduTrig_SECU_CHAL_55c86d41  # SECU_CHAL
            DST_Fr_pduTrig_SECU_CHAL_55c86d41 (PduRDestPdu): PduRDestPduRef=pduTrig_SECU_CHAL_pduPort_EPS_A_FlexRay_OUT_55c86d41_4f391dd1
            SRC_Fr_pduTrig_SECU_CHAL_55c86d41 (PduRSrcPdu): PduRSrcPduRef=pduTrig_SECU_CHAL_pduPort_EPS_A_FlexRay_OUT_55c86d41_4f391dd1
          Fr_pduTrig_SECU_FAHRGESTELLNUMMER_55c86d41  # SECU_FAHRGESTELLNUMMER
            DST_Fr_pduTrig_SECU_FAHRGESTELLNUMMER_55c86d41 (PduRDestPdu): PduRDestPduRef=pduTrig_SECU_FAHRGESTELLNUMMER_pduPort_EPS_A_FlexRay_IN_55c86d41_4f391dd1
            SRC_Fr_pduTrig_SECU_FAHRGESTELLNUMMER_55c86d41 (PduRSrcPdu): PduRSrcPduRef=pduTrig_SECU_FAHRGESTELLNUMMER_pduPort_EPS_A_FlexRay_IN_55c86d41_4f391dd1
          Fr_pduTrig_SECU_RESP_55c86d41  # SECU_RESP
            DST_Fr_pduTrig_SECU_RESP_55c86d41 (PduRDestPdu): PduRDestPduRef=pduTrig_SECU_RESP_pduPort_EPS_A_FlexRay_IN_55c86d41_4f391dd1
            SRC_Fr_pduTrig_SECU_RESP_55c86d41 (PduRSrcPdu): PduRSrcPduRef=pduTrig_SECU_RESP_pduPort_EPS_A_FlexRay_IN_55c86d41_4f391dd1
          Fr_pduTrig_STEA_OFFS_55c86d41  # STEA_OFFS
            DST_Fr_pduTrig_STEA_OFFS_55c86d41 (PduRDestPdu): PduRDestPduRef=pduTrig_STEA_OFFS_pduPort_EPS_A_FlexRay_IN_55c86d41_4f391dd1
            SRC_Fr_pduTrig_STEA_OFFS_55c86d41 (PduRSrcPdu): PduRSrcPduRef=pduTrig_STEA_OFFS_pduPort_EPS_A_FlexRay_IN_55c86d41_4f391dd1
          Fr_pduTrig_ST_CENG_55c86d41  # ST_CENG
            DST_Fr_pduTrig_ST_CENG_55c86d41 (PduRDestPdu): PduRDestPduRef=pduTrig_ST_CENG_pduPort_EPS_A_FlexRay_IN_55c86d41_4f391dd1
            SRC_Fr_pduTrig_ST_CENG_55c86d41 (PduRSrcPdu): PduRSrcPduRef=pduTrig_ST_CENG_pduPort_EPS_A_FlexRay_IN_55c86d41_4f391dd1
          Fr_pduTrig_ST_DIAG_OBD_3_DRDY_55c86d41  # ST_DIAG_OBD_3_DRDY
            DST_Fr_pduTrig_ST_DIAG_OBD_3_DRDY_55c86d41 (PduRDestPdu): PduRDestPduRef=pduTrig_ST_DIAG_OBD_3_DRDY_pduPort_EPS_A_FlexRay_OUT_55c86d41_4f391dd1
            SRC_Fr_pduTrig_ST_DIAG_OBD_3_DRDY_55c86d41 (PduRSrcPdu): PduRSrcPduRef=pduTrig_ST_DIAG_OBD_3_DRDY_pduPort_EPS_A_FlexRay_OUT_55c86d41_4f391dd1
          Fr_pduTrig_ST_ENERG_GEN_55c86d41  # ST_ENERG_GEN
            DST_Fr_pduTrig_ST_ENERG_GEN_55c86d41 (PduRDestPdu): PduRDestPduRef=pduTrig_ST_ENERG_GEN_pduPort_EPS_A_FlexRay_IN_55c86d41_4f391dd1
            SRC_Fr_pduTrig_ST_ENERG_GEN_55c86d41 (PduRSrcPdu): PduRSrcPduRef=pduTrig_ST_ENERG_GEN_pduPort_EPS_A_FlexRay_IN_55c86d41_4f391dd1
          Fr_pduTrig_ST_EST_55c86d41  # ST_EST
            DST_Fr_pduTrig_ST_EST_55c86d41 (PduRDestPdu): PduRDestPduRef=pduTrig_ST_EST_pduPort_EPS_A_FlexRay_OUT_55c86d41_4f391dd1
            SRC_Fr_pduTrig_ST_EST_55c86d41 (PduRSrcPdu): PduRSrcPduRef=pduTrig_ST_EST_pduPort_EPS_A_FlexRay_OUT_55c86d41_4f391dd1
          Fr_pduTrig_ST_STAB_DSC_55c86d41  # ST_STAB_DSC
            DST_Fr_pduTrig_ST_STAB_DSC_55c86d41 (PduRDestPdu): PduRDestPduRef=pduTrig_ST_STAB_DSC_pduPort_EPS_A_FlexRay_IN_55c86d41_4f391dd1
            SRC_Fr_pduTrig_ST_STAB_DSC_55c86d41 (PduRSrcPdu): PduRSrcPduRef=pduTrig_ST_STAB_DSC_pduPort_EPS_A_FlexRay_IN_55c86d41_4f391dd1
          Fr_pduTrig_SU_CLE_DRDY_DXP_55c86d41  # SU_CLE_DRDY_DXP
            DST_Fr_pduTrig_SU_CLE_DRDY_DXP_55c86d41 (PduRDestPdu): PduRDestPduRef=pduTrig_SU_CLE_DRDY_DXP_pduPort_EPS_A_FlexRay_IN_55c86d41_4f391dd1
            SRC_Fr_pduTrig_SU_CLE_DRDY_DXP_55c86d41 (PduRSrcPdu): PduRSrcPduRef=pduTrig_SU_CLE_DRDY_DXP_pduPort_EPS_A_FlexRay_IN_55c86d41_4f391dd1
          Fr_pduTrig_SU_EPS_55c86d41  # SU_EPS
            DST_Fr_pduTrig_SU_EPS_55c86d41 (PduRDestPdu): PduRDestPduRef=pduTrig_SU_EPS_pduPort_EPS_A_FlexRay_OUT_55c86d41_4f391dd1
            SRC_Fr_pduTrig_SU_EPS_55c86d41 (PduRSrcPdu): PduRSrcPduRef=pduTrig_SU_EPS_pduPort_EPS_A_FlexRay_OUT_55c86d41_4f391dd1
          Fr_pduTrig_TAR_ESTP_VIRT_FTAX_55c86d41  # TAR_ESTP_VIRT_FTAX
            DST_Fr_pduTrig_TAR_ESTP_VIRT_FTAX_55c86d41 (PduRDestPdu): PduRDestPduRef=pduTrig_TAR_ESTP_VIRT_FTAX_pduPort_EPS_A_FlexRay_IN_55c86d41_4f391dd1
            SRC_Fr_pduTrig_TAR_ESTP_VIRT_FTAX_55c86d41 (PduRSrcPdu): PduRSrcPduRef=pduTrig_TAR_ESTP_VIRT_FTAX_pduPort_EPS_A_FlexRay_IN_55c86d41_4f391dd1
          Fr_pduTrig_TAR_QTA_STRMOM_DV_55c86d41  # TAR_QTA_STRMOM_DV
            DST_Fr_pduTrig_TAR_QTA_STRMOM_DV_55c86d41 (PduRDestPdu): PduRDestPduRef=pduTrig_TAR_QTA_STRMOM_DV_pduPort_EPS_A_FlexRay_IN_55c86d41_4f391dd1
            SRC_Fr_pduTrig_TAR_QTA_STRMOM_DV_55c86d41 (PduRSrcPdu): PduRSrcPduRef=pduTrig_TAR_QTA_STRMOM_DV_pduPort_EPS_A_FlexRay_IN_55c86d41_4f391dd1
          Fr_pduTrig_TAR_STMOM_DV_ACT_55c86d41  # TAR_STMOM_DV_ACT
            DST_Fr_pduTrig_TAR_STMOM_DV_ACT_55c86d41 (PduRDestPdu): PduRDestPduRef=pduTrig_TAR_STMOM_DV_ACT_pduPort_EPS_A_FlexRay_IN_55c86d41_4f391dd1
            SRC_Fr_pduTrig_TAR_STMOM_DV_ACT_55c86d41 (PduRSrcPdu): PduRSrcPduRef=pduTrig_TAR_STMOM_DV_ACT_pduPort_EPS_A_FlexRay_IN_55c86d41_4f391dd1
          Fr_pduTrig_VYAW_VEH_55c86d41  # VYAW_VEH
            DST_Fr_pduTrig_VYAW_VEH_55c86d41 (PduRDestPdu): PduRDestPduRef=pduTrig_VYAW_VEH_pduPort_EPS_A_FlexRay_IN_55c86d41_4f391dd1
            SRC_Fr_pduTrig_VYAW_VEH_55c86d41 (PduRSrcPdu): PduRSrcPduRef=pduTrig_VYAW_VEH_pduPort_EPS_A_FlexRay_IN_55c86d41_4f391dd1
          Fr_pduTrig_V_VEH_55c86d41  # V_VEH
            DST_Fr_pduTrig_V_VEH_55c86d41 (PduRDestPdu): PduRDestPduRef=pduTrig_V_VEH_pduPort_EPS_A_FlexRay_IN_55c86d41_4f391dd1
            SRC_Fr_pduTrig_V_VEH_55c86d41 (PduRSrcPdu): PduRSrcPduRef=pduTrig_V_VEH_pduPort_EPS_A_FlexRay_IN_55c86d41_4f391dd1
          SVC_fbd80461_In
            DST_SVC_fbd80461_In (PduRDestPdu): PduRDestPduRef=EcucPduCollection/SVC_fbd80461_In
            SRC_SVC_fbd80461_In (PduRSrcPdu): PduRSrcPduRef=EcucPduCollection/SVC_fbd80461_In
          SVC_fbd80461_Out
            DST_SVC_fbd80461_Out (PduRDestPdu): PduRDestPduRef=EcucPduCollection/SVC_fbd80461_Out
            SRC_SVC_fbd80461_Out (PduRSrcPdu): PduRSrcPduRef=EcucPduCollection/SVC_fbd80461_Out
  module config StdDiag
    StdDiagGeneral: StdDiagUserActiveSessionState=true  # Project Standard Configuration
  module config StdDiagClassic
    StdDiagGeneral: StdDiagClearSecondaryErrorMemory=true  # Project Standard Configuration
    StdDiagSgbdIndex: SgbdIndex=993488  # Project Standard Configuration
    StdDiagUserDefinedMemory  # Project Standard Configuration
  module config SysTime
    SysTimeGeneral: SysTimeInitialTimeout=5  # Project Standard Configuration
  module config SysTimeClassic
    SysTimeGeneral: SysTimeEnableServiceInterface=false  # Project Standard Configuration
  module config Xcp
    XcpConfig
      11 x XcpPdu:
        dummy16bstatic_19255f18
          dummy16bstatic_19255f18 (XcpTxPdu): XcpTxPduRef=pduTrig_dummy16bstatic_pduPort_EPS_A_FlexRay_OUT_55c86d41_4f391dd1
        dummy32bmaster_19255f18
          dummy32bmaster_19255f18 (XcpRxPdu): XcpRxPduRef=pduTrig_dummy32bmaster_pduPort_EPS_A_FlexRay_IN_55c86d41_4f391dd1
        dummy32bslave_19255f18
          dummy32bslave_19255f18 (XcpTxPdu): XcpTxPduRef=pduTrig_dummy32bslave_pduPort_EPS_A_FlexRay_OUT_55c86d41_4f391dd1
        xcpdynamic254_1_19255f18
          xcpdynamic254_1_19255f18 (XcpTxPdu): XcpTxPduRef=pduTrig_xcpdynamic254_1_pduPort_EPS_A_FlexRay_OUT_55c86d41_4f391dd1
        xcpdynamic254_2_19255f18
          xcpdynamic254_2_19255f18 (XcpTxPdu): XcpTxPduRef=pduTrig_xcpdynamic254_2_pduPort_EPS_A_FlexRay_OUT_55c86d41_4f391dd1
        xcpdynamic254_3_19255f18
          xcpdynamic254_3_19255f18 (XcpTxPdu): XcpTxPduRef=pduTrig_xcpdynamic254_3_pduPort_EPS_A_FlexRay_OUT_55c86d41_4f391dd1
        xcpdynamic254_4_19255f18
          xcpdynamic254_4_19255f18 (XcpTxPdu): XcpTxPduRef=pduTrig_xcpdynamic254_4_pduPort_EPS_A_FlexRay_OUT_55c86d41_4f391dd1
        xcpdynamic254_5_19255f18
          xcpdynamic254_5_19255f18 (XcpTxPdu): XcpTxPduRef=pduTrig_xcpdynamic254_5_pduPort_EPS_A_FlexRay_OUT_55c86d41_4f391dd1
        xcpdynamic254_6_19255f18
          xcpdynamic254_6_19255f18 (XcpTxPdu): XcpTxPduRef=pduTrig_xcpdynamic254_6_pduPort_EPS_A_FlexRay_OUT_55c86d41_4f391dd1
        xcpdynamic254_7_19255f18
          xcpdynamic254_7_19255f18 (XcpTxPdu): XcpTxPduRef=pduTrig_xcpdynamic254_7_pduPort_EPS_A_FlexRay_OUT_55c86d41_4f391dd1
        xcpdynamic254_8_19255f18
          xcpdynamic254_8_19255f18 (XcpTxPdu): XcpTxPduRef=pduTrig_xcpdynamic254_8_pduPort_EPS_A_FlexRay_OUT_55c86d41_4f391dd1
    XcpGeneral: XcpOnFlexRayEnabled=true
