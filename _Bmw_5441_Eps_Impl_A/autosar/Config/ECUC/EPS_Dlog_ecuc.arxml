AUTOSAR XML (schema 4-3-0)
package /ActiveEcuC
  module config Dlog: implementation-config-variant=VARIANT-PRE-COMPILE
    CommonPublishedInformation: SwMajorVersion=5, SwMinorVersion=1, SwPatchVersion=1
    Features: EnableEcu=true, EnableSvkCurrent=true, EnableSvkHistory=true
      SvkHistory: MaxNumberOfHistorySgbmIds=6, NumberOfSvkBackups=0
    General: DevErrorDetect=false, MaxNumberOfSweGroups=8
