AUTOSAR XML (schema 4-3-0)
package /ActiveEcuC
  module config Os: implementation-config-variant=VARIANT-PRE-COMPILE, module-description=Os_Impl
    OsCounter:
      OsCounterMaxAllowedValue = 2147483647
      OsCounterMinCycle = 1
      OsCounterType = HARDWARE
      OsSecondsPerTick = 0.001
      OsCounterTicksPerBase = 80000
      OsCounterAccessingApplication = SystemApplication
      OsDriver: OsDriverHighResolution=false, OsDriverHardwareTimerChannelRef=OSTM0/OSTM0, OsDriverIsrRef=CounterIsr_OsCounter
    OsOS:
      OsStackMonitoring = true
      OsStatus = EXTENDED
      OsUseGetServiceId = false
      OsUseParameterAccess = false
      OsUseResScheduler = false
      OsForcibleTermination = false
      OsGenerateCalloutStubs = true
      OsGenerateMemMap = COMPLETE
      OsGenerateMemMapForThreads = false
      OsServiceProtection = false
      OsStackUsageMeasurement = false
      OsUseXSignalAsyncApiCalls = false
      OsScalabilityClass = SC3
      OsNumberOfCores = 1
      OsGenerateMemMapForNearAddressing = true
      OsMasterCore = OsCore_CORE0
      OsSystemTimer = OsCounter
      OsHooks: OsErrorHook=true, OsPostTaskHook=false, OsPreTaskHook=false, OsShutdownHook=true, OsStartupHook=false, OsPanicHook=false, OsProtectionHook=false
    OSDEFAULTAPPMODE (OsAppMode)
    OS_APPMODE_ANY (OsAppMode)
    OsPublishedInformation: OsKernelVersion=7, OsPlatformName=Rh850
      RH850P1M (OsDerivativeInformation):
        OsMpuAlignment = 4
        OsStackAlignment = 4
        OsExceptionVectorTableAlignment = 512
        OsInterruptVectorTableAlignment = 512
        OsHardwareManuals = RH850/P1x Group Users Manual: Hardware Rev.1.00 Jul, 2015 RH850G3M Users Manual: Software Rev.1.30 Jun 2016 RH850/P1M Safety Application Note Rev.2.00 Release May 19, 2016
        CORE0 (OsPhysicalCore):
          OsPhysicalCoreId = 0
          OsPhysicalCoreDefaultEntrySymbol = RESET_CORE0
          OsPhysicalCoreType = G3M
          OsPhysicalCoreExceptionSources = 16
          OsPhysicalCoreIsAutostart = true
          OsPhysicalCoreMasterStartAllowed = false
          OsPhysicalCorePrivelegedHwAccess = true
          OsPhysicalCoreStackProtectionUnit = MPU_CORE0
          MPU_CORE0 (OsPhysicalCoreMpu): OsPhysicalCoreMpuId=0, OsPhysicalCoreMpuMaxRegions=12, OsPhysicalCoreMpuType=CoreMpu
        4 x OsHardwareTimer, all with OsHardwareTimerSize=32:
          OSTM0: OsHardwareTimerBaseAddress=4292706304, OsHardwareTimerUnit=FRTPIT, OsHardwareTimerId=0, OsHardwareTimerType=OSTM
            OSTM0 (OsHardwareTimerChannel): OsHardwareTimerChannelIntSource=74, OsHardwareTimerChannelOffset=0, OsHardwareTimerChannelId=0
          OSTM1: OsHardwareTimerBaseAddress=4292710400, OsHardwareTimerUnit=FRTPIT, OsHardwareTimerId=1, OsHardwareTimerType=OSTM
            OSTM1 (OsHardwareTimerChannel): OsHardwareTimerChannelIntSource=75, OsHardwareTimerChannelOffset=0, OsHardwareTimerChannelId=0
          TAUJ0: OsHardwareTimerBaseAddress=4293197824, OsHardwareTimerUnit=PIT, OsHardwareTimerId=0, OsHardwareTimerType=TAUJ
            4 x OsHardwareTimerChannel:
              TAUJ0_CH0: OsHardwareTimerChannelIntSource=133, OsHardwareTimerChannelOffset=0, OsHardwareTimerChannelId=0
              TAUJ0_CH1: OsHardwareTimerChannelIntSource=134, OsHardwareTimerChannelOffset=1, OsHardwareTimerChannelId=1
              TAUJ0_CH2: OsHardwareTimerChannelIntSource=135, OsHardwareTimerChannelOffset=2, OsHardwareTimerChannelId=2
              TAUJ0_CH3: OsHardwareTimerChannelIntSource=136, OsHardwareTimerChannelOffset=3, OsHardwareTimerChannelId=3
          TAUJ1: OsHardwareTimerBaseAddress=4293201920, OsHardwareTimerUnit=PIT, OsHardwareTimerId=1, OsHardwareTimerType=TAUJ
            4 x OsHardwareTimerChannel:
              TAUJ1_CH0: OsHardwareTimerChannelIntSource=137, OsHardwareTimerChannelOffset=0, OsHardwareTimerChannelId=0
              TAUJ1_CH1: OsHardwareTimerChannelIntSource=138, OsHardwareTimerChannelOffset=1, OsHardwareTimerChannelId=1
              TAUJ1_CH2: OsHardwareTimerChannelIntSource=139, OsHardwareTimerChannelOffset=2, OsHardwareTimerChannelId=2
              TAUJ1_CH3: OsHardwareTimerChannelIntSource=140, OsHardwareTimerChannelOffset=3, OsHardwareTimerChannelId=3
        INTC (OsSystemIntCtrl): OsSystemIntCtrlBaseAddress=4294896128, OsSystemIntCtrlMaxPrios=16, OsSystemIntCtrlMaxSources=512, OsSystemIntCtrlPrioOrder=DESC
          5 x OsSystemIntCtrlAddress:
            INTC1: OsSystemIntCtrlAddressValue=4294896128
            INTC2: OsSystemIntCtrlAddressValue=4294946816
            EIBD1: OsSystemIntCtrlAddressValue=0
            EIBD2: OsSystemIntCtrlAddressValue=0
            IPIR: OsSystemIntCtrlAddressValue=0
        MPAT (OsMemoryRegionSpecifics)
          6 x OsMemoryRegionAccess:
            SR: OsMemoryRegionAccessRights=R, OsMemoryRegionAccessType=SUPERVISOR
            SW: OsMemoryRegionAccessRights=W, OsMemoryRegionAccessType=SUPERVISOR
            SX: OsMemoryRegionAccessRights=X, OsMemoryRegionAccessType=SUPERVISOR
            UR: OsMemoryRegionAccessRights=R, OsMemoryRegionAccessType=USER
            UW: OsMemoryRegionAccessRights=W, OsMemoryRegionAccessType=USER
            UX: OsMemoryRegionAccessRights=X, OsMemoryRegionAccessType=USER
        TAUJ2 (OsHardwareTimer): OsHardwareTimerBaseAddress=4293206016, OsHardwareTimerUnit=PIT, OsHardwareTimerSize=32, OsHardwareTimerId=2, OsHardwareTimerType=TAUJ
          4 x OsHardwareTimerChannel:
            TAUJ2_CH0: OsHardwareTimerChannelIntSource=168, OsHardwareTimerChannelOffset=0, OsHardwareTimerChannelId=0
            TAUJ2_CH1: OsHardwareTimerChannelIntSource=169, OsHardwareTimerChannelOffset=1, OsHardwareTimerChannelId=1
            TAUJ2_CH2: OsHardwareTimerChannelIntSource=170, OsHardwareTimerChannelOffset=2, OsHardwareTimerChannelId=2
            TAUJ2_CH3: OsHardwareTimerChannelIntSource=171, OsHardwareTimerChannelOffset=3, OsHardwareTimerChannelId=3
    OsCore_CORE0 (OsCore):
      OsCoreIsAutosar = true
      OsCoreIsAutostart = true
      OsCoreEntrySymbol = RESET_CORE0
      OsCorePhysicalCoreRef = CORE0
      OsCoreIdleTask = IdleTask_OsCore_CORE0
      OsCoreSystemApplication = SystemApplication
      OsCoreEcucCoreRef = EcucCore0
      OsCoreStacks:
        OsCoreKernelStackSize = 1024
        OsCoreStartupStackSize = 1024
        OsCoreShutdownStackSize = 1024
        OsCoreErrorStackSize = 1024
        OsCoreProtectionStackSize = 1024
        OsCoreInitStackSize = 1024
    IdleTask_OsCore_CORE0 (OsTask):
      OsTaskActivation = 1
      OsTaskPriority = 4294967295
      OsTaskSchedule = FULL
      OsTaskStackSharing = false
      OsTaskStackSize = 2048
      OsTaskType = AUTO
      OsTaskAccessingApplication = SystemApplication
      OsTaskAutostart: OsTaskAppModeRef=OS_APPMODE_ANY
    CounterIsr_OsCounter (OsIsr):
      OsIsrCategory = CATEGORY_2
      OsIsrInterruptType = EXTERNAL
      OsIsrInterruptSource = 74
      OsIsrInterruptPriority = 4
      OsIsrStackSize = 512
      OsIsrEnableNesting = true
      OsIsrSpecialFunctionName = Os_TimerPitIsr
    OsMemoryProtection
      InterruptController (OsPeripheralRegion):
        OsPeripheralRegionStartAddress = 0xFFFEEA00
        OsPeripheralRegionEndAddress = 0xFFFFF000
        OsPeripheralRegionAccessingApp = Os/Appl10
        OsPeripheralRegionAccessingApp = SystemApplication
      11 x OsMemoryRegion, all with OsMemoryRegionProtectionUnit=MPU_CORE0:
        CodeFlash_SX_SR_UX_UR: OsMemoryRegionStartAddress=0x0, OsMemoryRegionEndAddress=0x1FFFFF, OsMemoryRegionAccessRights=SR, OsMemoryRegionAccessRights=SX, OsMemoryRegionAccessRights=UR, OsMemoryRegionAccessRights=UX
        GeneralRAM_SW_SR_UR: OsMemoryRegionStartAddress=GeneralRam_StartAddr, OsMemoryRegionEndAddress=GeneralRam_EndAddr, OsMemoryRegionAccessRights=SR, OsMemoryRegionAccessRights=SW, OsMemoryRegionAccessRights=UR
        GlobalSharedRAM_SW_SR_UW_UR: OsMemoryRegionStartAddress=OS_GLOBALSHARED_VAR_START, OsMemoryRegionEndAddress=OS_GLOBALSHARED_VAR_FAST_NOCACHE_ZERO_INIT_END, OsMemoryRegionAccessRights=SR, OsMemoryRegionAccessRights=SW, OsMemoryRegionAccessRights=UR, OsMemoryRegionAccessRights=UW
        Registers_SW_SR_UW_UR: OsMemoryRegionStartAddress=0xFF000000, OsMemoryRegionEndAddress=0xFFFFFFFF, OsMemoryRegionAccessRights=SR, OsMemoryRegionAccessRights=SW, OsMemoryRegionAccessRights=UR, OsMemoryRegionAccessRights=UW
        StackRAM_SR_UR: OsMemoryRegionStartAddress=StackRam_StartAddr, OsMemoryRegionEndAddress=StackRam_EndAddr, OsMemoryRegionAccessRights=SR, OsMemoryRegionAccessRights=UR
        Appl10RAM_UW: OsMemoryRegionStartAddress=OS_Appl10_VAR_ALL_START, OsMemoryRegionEndAddress=ModifiedEndAddrForBAC_Appl10, OsMemoryRegionAccessRights=UW, OsMemoryRegionOwner=Os/Appl10
        FlexRayRegisters_SW_SR_UW_UR: OsMemoryRegionStartAddress=0x10020000, OsMemoryRegionEndAddress=0x10020847, OsMemoryRegionAccessRights=SR, OsMemoryRegionAccessRights=SW, OsMemoryRegionAccessRights=UR, OsMemoryRegionAccessRights=UW
        Appl9RAM_UW: OsMemoryRegionStartAddress=OS_Appl9_VAR_ALL_START, OsMemoryRegionEndAddress=OS_Appl9_VAR_ALL_END, OsMemoryRegionAccessRights=UW, OsMemoryRegionOwner=Os/Appl9
        Appl8RAM_UW: OsMemoryRegionStartAddress=OS_Appl8_VAR_ALL_START, OsMemoryRegionEndAddress=OS_Appl8_VAR_ALL_END, OsMemoryRegionAccessRights=UW, OsMemoryRegionOwner=Os/Appl8
        Appl7RAM_UW: OsMemoryRegionStartAddress=OS_Appl7_VAR_ALL_START, OsMemoryRegionEndAddress=OS_Appl7_VAR_ALL_END, OsMemoryRegionAccessRights=UW, OsMemoryRegionOwner=Os/Appl7
        DlogSharedData: OsMemoryRegionStartAddress=0xFEBFE800, OsMemoryRegionEndAddress=0xFEBFEFFF, OsMemoryRegionAccessRights=UW, OsMemoryRegionAccessRights=UR, OsMemoryRegionAccessRights=SR, OsMemoryRegionAccessRights=SW, OsMemoryRegionOwner=Os/Appl10
    OsResource: OsResourceProperty=STANDARD, OsResourceAccessingApplication=Os/Appl10, OsResourceAccessingApplication=SystemApplication
    3 x OsApplication, all with OsTrustedApplicationDelayTimingViolationCall=false, OsTrustedApplicationWithProtection=false, OsApplicationCoreRef=EcucCore0:
      SystemApplication: OsTrusted=true, OsApplicationIsPrivileged=true, OsAppUseTrustedFunctionStubs=false, OsAppIsrRef=CounterIsr_OsCounter, OsAppTaskRef=IdleTask_OsCore_CORE0
        OsApplicationHooks: OsAppErrorHook=false, OsAppShutdownHook=false, OsAppStartupHook=false
      Appl0: OsTrusted=true, OsApplicationIsPrivileged=true, OsAppUseTrustedFunctionStubs=true, OsAppCalloutStubsIncludeHeader=TrustdFctDefn.h, OsAppIsrRef=FpuErrIrq, OsAppIsrRef=SysErrIrq, OsAppIsrRef=MCU_FEINT_ISR, OsAppIsrRef=WDG_59_DRIVERA_TRIGGERFUNCTION_ISR, OsAppIsrRef=MotCtrlMgrIrq, OsAppIsrRef=SPI_CSIG0_TIC_CAT2_ISR, OsAppIsrRef=SPI_CSIG0_TIR_CAT2_ISR, OsAppIsrRef=SPI_CSIG0_TIRE_CAT2_ISR, OsAppIsrRef=SPI_CSIH2_TIC_CAT2_ISR, OsAppIsrRef=SPI_CSIH2_TIR_CAT2_ISR, OsAppIsrRef=SPI_CSIH2_TIRE_CAT2_ISR, OsAppIsrRef=MCU_ECM_EIC_CAT2_ISR, OsAppIsrRef=AlgnErrIrq, OsAppIsrRef=ResdOperIrq
        OsApplicationHooks: OsAppErrorHook=false, OsAppShutdownHook=false, OsAppStartupHook=false
        16 x OsApplicationTrustedFunction:
          NvM_MainFunction: OsTrustedFunctionName=NvM_MainFunction, OsTrustedFunctionReturnType=void
          Fls_MainFunction: OsTrustedFunctionName=Fls_MainFunction, OsTrustedFunctionReturnType=void
          IpgInin: OsTrustedFunctionName=IpgInin, OsTrustedFunctionReturnType=void
          DmaRegInin: OsTrustedFunctionName=DmaRegInin, OsTrustedFunctionReturnType=void
          Adc0OutpInin: OsTrustedFunctionName=Adc0OutpInin, OsTrustedFunctionReturnType=void
          DtsClnUp: OsTrustedFunctionName=DtsClnUp, OsTrustedFunctionReturnType=void
          DtsInin: OsTrustedFunctionName=DtsInin, OsTrustedFunctionReturnType=void
            CrcHwIdxInReg_T_u32 (OsTrustedFunctionParam): OsTrustedFunctionParamId=1, OsTrustedFunctionParamDataType=uint32, OsTrustedFunctionParamDirection=IN
            CrcHwIdxOutReg_T_u32 (OsTrustedFunctionParam): OsTrustedFunctionParamId=2, OsTrustedFunctionParamDataType=uint32, OsTrustedFunctionParamDirection=IN
          Spi_AsyncTransmit: OsTrustedFunctionName=Spi_AsyncTransmit, OsTrustedFunctionReturnType=Std_ReturnType
            Sequence (OsTrustedFunctionParam): OsTrustedFunctionParamId=1, OsTrustedFunctionParamDataType=Spi_SequenceType, OsTrustedFunctionParamDirection=IN
          XcpAppl_CalibrationWriteTrustd: OsTrustedFunctionName=XcpAppl_CalibrationWriteTrustd, OsTrustedFunctionReturnType=uint8
            3 x OsTrustedFunctionParam, all with OsTrustedFunctionParamDirection=IN:
              Dst: OsTrustedFunctionParamId=1, OsTrustedFunctionParamDataType=Xcp_AddressPtrType
              Src: OsTrustedFunctionParamId=2, OsTrustedFunctionParamDataType=const uint8*
              Size: OsTrustedFunctionParamId=3, OsTrustedFunctionParamDataType=uint8
          NxtrWdgM_Init: OsTrustedFunctionName=NxtrWdgM_Init, OsTrustedFunctionReturnType=void
          CritRegInitChk: OsTrustedFunctionName=CritRegInitChk, OsTrustedFunctionReturnType=uint8
          CritRegPerChk: OsTrustedFunctionName=CritRegPerChk, OsTrustedFunctionReturnType=uint8
          EcuM_GoDown: OsTrustedFunctionName=EcuM_GoDown, OsTrustedFunctionReturnType=Std_ReturnType
            Caller (OsTrustedFunctionParam): OsTrustedFunctionParamId=1, OsTrustedFunctionParamDataType=uint16, OsTrustedFunctionParamDirection=IN
          RstRackCentrMotAg_Oper: OsTrustedFunctionName=RstRackCentrMotAg_Oper, OsTrustedFunctionReturnType=void
          RstRackCentrMotRev_Oper: OsTrustedFunctionName=RstRackCentrMotRev_Oper, OsTrustedFunctionReturnType=void
          SetInpPrm_Oper: OsTrustedFunctionName=SetInpPrm_Oper, OsTrustedFunctionReturnType=void
            TarVel (OsTrustedFunctionParam): OsTrustedFunctionParamId=1, OsTrustedFunctionParamDataType=float32, OsTrustedFunctionParamDirection=IN
            TarA (OsTrustedFunctionParam): OsTrustedFunctionParamId=2, OsTrustedFunctionParamDataType=float32, OsTrustedFunctionParamDirection=IN
      Appl10: OsTrusted=false, OsApplicationIsPrivileged=false, OsAppUseTrustedFunctionStubs=false, OsAppCounterRef=OsCounter, OsAppTaskRef=Task_4msBsw_Appl10, OsAppTaskRef=Task_10ms_Appl10, OsAppTaskRef=Task_10msBsw_Appl10, OsAppTaskRef=Task_Init_Appl10, OsAppAlarmRef=Rte_Al_TE2_Task_10msBsw_Appl10_0_10ms, OsAppAlarmRef=Rte_Al_TE2_Task_4msBsw_Appl10_0_4ms, OsAppTaskRef=Task_2msA_Appl10, OsAppTaskRef=Task_100ms_Appl10, OsAppAlarmRef=Rte_Al_TE_Task_100ms_Appl10_0_100ms, OsAppAlarmRef=Rte_Al_TE_Task_10ms_Appl10_0_10ms, OsAppTaskRef=Task_4ms_Appl10, OsAppAlarmRef=Rte_Al_TE_Task_4ms_Appl10_0_4ms, OsAppIsrRef=Fr_IrqTimer0, OsAppIsrRef=Fr_IrqLine0, OsAppTaskRef=Task_5msBsw_Appl10, OsAppAlarmRef=Rte_Al_TE_Darh_QueueHandler, OsAppAlarmRef=Rte_Al_TE2_Task_5msBsw_Appl10_0_5ms, OsAppTaskRef=Task_2msTmplMonr_Appl10, OsAppAlarmRef=Rte_Al_TE_Task_2msTmplMonr_Appl10_0_2ms, OsAppCounterRef=FrCycleCounter, OsAppTaskRef=Task_2msB_Appl10, OsAppAlarmRef=Rte_Al_TE_Task_2msA_Appl10_0_2ms, OsAppAlarmRef=Rte_Al_TE_Task_2msB_Appl10_0_2ms, OsAppTaskRef=Task_InitBsw_Appl10, OsAppTaskRef=Task_ComBsw_Appl10, OsAppAlarmRef=Rte_Al_TE2_Task_ComBsw_Appl10_0_5ms, OsAppAlarmRef=Rte_Al_TE_Task_ComBsw_Appl10_0_10ms, OsAppTaskRef=Task_Coding_Appl10
        OsApplicationHooks: OsAppErrorHook=false, OsAppShutdownHook=false, OsAppStartupHook=false
        15 x OsApplicationNonTrustedFunction, all with OsNonTrustedFunctionStackSize=512:
          NtWrapS_NvM_EraseNvBlock: OsNonTrustedFunctionName=NtWrapS_NvM_EraseNvBlock, OsNonTrustedFunctionStacks=1
            3 x OsNonTrustedFunctionCaller, all with OsNonTrustedFunctionAppStacks=1:
              Appl{7..9}: OsNonTrustedFunctionAppRef=Os/Appl{7..9}
          NtWrapS_NvM_InvalidateNvBlock: OsNonTrustedFunctionName=NtWrapS_NvM_InvalidateNvBlock, OsNonTrustedFunctionStacks=1
            3 x OsNonTrustedFunctionCaller, all with OsNonTrustedFunctionAppStacks=1:
              Appl{7..9}: OsNonTrustedFunctionAppRef=Os/Appl{7..9}
          NtWrapS_NvM_SetBlockProtection: OsNonTrustedFunctionName=NtWrapS_NvM_SetBlockProtection, OsNonTrustedFunctionStacks=1
            3 x OsNonTrustedFunctionCaller, all with OsNonTrustedFunctionAppStacks=1:
              Appl{7..9}: OsNonTrustedFunctionAppRef=Os/Appl{7..9}
          NtWrapS_NvM_SetRamBlockStatus: OsNonTrustedFunctionName=NtWrapS_NvM_SetRamBlockStatus, OsNonTrustedFunctionStacks=1
            3 x OsNonTrustedFunctionCaller, all with OsNonTrustedFunctionAppStacks=1:
              Appl{7..9}: OsNonTrustedFunctionAppRef=Os/Appl{7..9}
          NtWrapS_NvM_SetDataIndex: OsNonTrustedFunctionName=NtWrapS_NvM_SetDataIndex, OsNonTrustedFunctionStacks=1
            3 x OsNonTrustedFunctionCaller, all with OsNonTrustedFunctionAppStacks=1:
              Appl{7..9}: OsNonTrustedFunctionAppRef=Os/Appl{7..9}
          NtWrapS_NvM_GetDataIndex: OsNonTrustedFunctionName=NtWrapS_NvM_GetDataIndex, OsNonTrustedFunctionStacks=1
            3 x OsNonTrustedFunctionCaller, all with OsNonTrustedFunctionAppStacks=1:
              Appl{7..9}: OsNonTrustedFunctionAppRef=Os/Appl{7..9}
          NtWrapS_NvM_GetErrorStatus: OsNonTrustedFunctionName=NtWrapS_NvM_GetErrorStatus, OsNonTrustedFunctionStacks=4
            3 x OsNonTrustedFunctionCaller, all with OsNonTrustedFunctionAppStacks=1:
              Appl{7..9}: OsNonTrustedFunctionAppRef=Os/Appl{7..9}
          NtWrapS_NvM_ReadBlock: OsNonTrustedFunctionName=NtWrapS_NvM_ReadBlock, OsNonTrustedFunctionStacks=1
            3 x OsNonTrustedFunctionCaller, all with OsNonTrustedFunctionAppStacks=1:
              Appl{7..9}: OsNonTrustedFunctionAppRef=Os/Appl{7..9}
          NtWrapS_NvM_WriteBlock: OsNonTrustedFunctionName=NtWrapS_NvM_WriteBlock, OsNonTrustedFunctionStacks=1
            3 x OsNonTrustedFunctionCaller, all with OsNonTrustedFunctionAppStacks=1:
              Appl{7..9}: OsNonTrustedFunctionAppRef=Os/Appl{7..9}
          NtWrapS_SyncCrc_GetAvlCrcHwUnit: OsNonTrustedFunctionName=NtWrapS_SyncCrc_GetAvlCrcHwUnit, OsNonTrustedFunctionStacks=1
            3 x OsNonTrustedFunctionCaller, all with OsNonTrustedFunctionAppStacks=1:
              Appl{7..9}: OsNonTrustedFunctionAppRef=Os/Appl{7..9}
          NtWrapS_SyncCrc_RelsCrcHwUnit: OsNonTrustedFunctionName=NtWrapS_SyncCrc_RelsCrcHwUnit, OsNonTrustedFunctionStacks=1
            3 x OsNonTrustedFunctionCaller, all with OsNonTrustedFunctionAppStacks=1:
              Appl{7..9}: OsNonTrustedFunctionAppRef=Os/Appl{7..9}
          NtWrapS_Xcp_Event: OsNonTrustedFunctionName=NtWrapS_Xcp_Event, OsNonTrustedFunctionStacks=1
          NtWrapS_Rte_Call_CopyCalPageReq_Oper: OsNonTrustedFunctionName=NtWrapS_Rte_Call_CopyCalPageReq_Oper, OsNonTrustedFunctionStacks=1
          NtWrapS_Rte_Call_SetCalPageReq_Oper: OsNonTrustedFunctionName=NtWrapS_Rte_Call_SetCalPageReq_Oper, OsNonTrustedFunctionStacks=1
          NtWrapS_CmnMfgSrv_CallSvc10: OsNonTrustedFunctionName=NtWrapS_CmnMfgSrv_CallSvc10, OsNonTrustedFunctionStacks=1
            4 x OsNonTrustedFunctionCaller, all with OsNonTrustedFunctionAppStacks=1:
              Appl10: OsNonTrustedFunctionAppRef=Os/Appl10
              Appl9: OsNonTrustedFunctionAppRef=Os/Appl9
              Appl8: OsNonTrustedFunctionAppRef=Os/Appl8
              Appl7: OsNonTrustedFunctionAppRef=Os/Appl7
    4 x OsTask, all with OsTaskActivation=1, OsTaskSchedule=FULL, OsTaskStackSharing=false, OsTaskType=AUTO, OsTaskAccessingApplication=SystemApplication:
      Task_4msBsw_Appl10: OsTaskPriority=80, OsTaskStackSize=1024, OsTaskResourceRef=OsResource
      Task_10ms_Appl10: OsTaskPriority=49, OsTaskStackSize=4096, OsTaskResourceRef=OsResource, OsTaskEventRef=Rte_Ev_Cyclic_Task_10ms_Appl10_0_10ms, OsTaskEventRef=Rte_Ev_MS_Task_10ms_Appl10, OsTaskEventRef=Rte_Ev_Run_Omc_LifeCycleHandler, OsTaskAccessingApplication=Os/Appl7, OsTaskEventRef=Rte_Ev_Run_BmwMsgSlot107Bas0Repn1BusFrChA_OFFS_QUAD_EPS_Missing_Oper, OsTaskEventRef=Rte_Ev_Run_BmwMsgSlot107Bas0Repn1BusFrChA_OFFS_QUAD_EPS_Received_Oper, OsTaskAccessingApplication=Os/Appl9, OsTaskEventRef=Rte_Ev_Run_Dlog_Dlog_ModeSwitchAckLifeCycle, OsTaskEventRef=Rte_Ev_Run_Dlog_Dlog_ModeSwitchRequestLifeCycle, OsTaskEventRef=Rte_Ev_Run_StdDiag_LifeCycleHandler, OsTaskEventRef=Rte_Ev_Run_StdDiag_SessionChange_DefaultSession, OsTaskEventRef=Rte_Ev_Run_StdDiag_SessionChange_OtherSession, OsTaskEventRef=Rte_Ev_Run1_Stm_Runnable_InitialCELSupervision, OsTaskEventRef=Rte_Ev_Run1_Stm_Runnable_StopCentralErrorLockSupervision, OsTaskEventRef=Rte_Ev_Run_Darh_LifeCycleHandler, OsTaskEventRef=Rte_Ev_Run_Stm_Runnable_ErrorCentralErrorLock, OsTaskEventRef=Rte_Ev_Run_Stm_Runnable_ErrorEnergyMode, OsTaskEventRef=Rte_Ev_Run_Stm_Runnable_ReceiveCentralErrorLock, OsTaskEventRef=Rte_Ev_Run_Stm_Runnable_ReceiveEnergyMode, OsTaskEventRef=Rte_Ev_Run_BswM_BswM_Read_StdDiag_ComControlModeRequest, OsTaskEventRef=Rte_Ev_Run1_SysTime_ReceiveSignal, OsTaskEventRef=Rte_Ev_Run_Coding_LifeCycleHandler, OsTaskEventRef=Rte_Ev_Run_Coding_SessionChange, OsTaskEventRef=Rte_Ev_Run_Coding_VinReceiveHandler, OsTaskEventRef=Rte_Ev_Run_Rmh_RxRequestMsg, OsTaskEventRef=Rte_Ev_Run_SysTime_LifeCycleHandler, OsTaskEventRef=Rte_Ev_Run_BmwMsgSlot276Bas4Repn8BusFrChA_MILE_KM_Missing_Oper, OsTaskEventRef=Rte_Ev_Run_BmwMsgSlot276Bas4Repn8BusFrChA_MILE_KM_Received_Oper, OsTaskEventRef=Rte_Ev_Run_BmwMsgSlot53Bas3Repn8BusFrChA_SU_CLE_DRDY_DXP_Miss, OsTaskEventRef=Rte_Ev_Run_BmwMsgSlot53Bas3Repn8BusFrChA_SU_CLE_DRDY_DXP_Rxd, OsTaskEventRef=Rte_Ev_Run_BmwMsgSlot55Bas0Repn2BusFrChA_ACLNY_MASSCNTR_Missing_Oper, OsTaskEventRef=Rte_Ev_Run_BmwMsgSlot55Bas0Repn2BusFrChA_ACLNY_MASSCNTR_Received_Oper, OsTaskEventRef=Rte_Ev_Run_BmwMsgSlot56Bas0Repn2BusFrChA_VYAW_VEH_Missing_Oper, OsTaskEventRef=Rte_Ev_Run_BmwMsgSlot56Bas0Repn2BusFrChA_VYAW_VEH_Received_Oper, OsTaskEventRef=Rte_Ev_Run_BmwMsgSlot68Bas0Repn2BusFrChA_TAR_QTA_STRMOM_DV_Miss, OsTaskEventRef=Rte_Ev_Run_BmwMsgSlot68Bas0Repn2BusFrChA_TAR_QTA_STRMOM_DV_Rxd, OsTaskEventRef=Rte_Ev_Run_BmwMsgSlot68Bas0Repn2BusFrChA_TAR_STMOM_DV_ACT_Miss, OsTaskEventRef=Rte_Ev_Run_BmwMsgSlot68Bas0Repn2BusFrChA_TAR_STMOM_DV_ACT_Rxd, OsTaskEventRef=Rte_Ev_Run_BmwMsgSlot108Bas0Repn2BusFrChA_STEA_OFFS_Missing_Oper, OsTaskEventRef=Rte_Ev_Run_BmwMsgSlot108Bas0Repn2BusFrChA_STEA_OFFS_Received_Oper, OsTaskEventRef=Rte_Ev_Run_BmwMsgSlot269Bas2Repn4BusFrChA_CTR_VIB_STW_DISP_EXMI_SP2015_Missing, OsTaskEventRef=Rte_Ev_Run_BmwMsgSlot269Bas2Repn4BusFrChA_CTR_VIB_STW_DISP_EXMI_SP2015_Received, OsTaskEventRef=Rte_Ev_Run_BmwMsgSlot68Bas1Repn2BusFrChA_ENERG_DGR_DRDY_Missing_Oper, OsTaskEventRef=Rte_Ev_Run_BmwMsgSlot68Bas1Repn2BusFrChA_ENERG_DGR_DRDY_Received_Oper, OsTaskAccessingApplication=Os/Appl8
      Task_10msBsw_Appl10: OsTaskPriority=44, OsTaskStackSize=4096, OsTaskResourceRef=Rte_Res_Vin_VinState, OsTaskAccessingApplication=Os/Appl7, OsTaskAccessingApplication=Os/Appl9
      Task_Init_Appl10: OsTaskPriority=100, OsTaskStackSize=2048, OsTaskAccessingApplication=Os/Appl7, OsTaskAccessingApplication=Os/Appl8, OsTaskAccessingApplication=Os/Appl9
    Rte_Al_TE2_Task_10msBsw_Appl10_0_10ms (OsAlarm): OsAlarmCounterRef=OsCounter, OsAlarmAccessingApplication=SystemApplication
      OsAlarmAction
        OsAlarmActivateTask: OsAlarmActivateTaskRef=Task_10msBsw_Appl10
    Rte_Al_TE2_Task_4msBsw_Appl10_0_4ms (OsAlarm): OsAlarmCounterRef=OsCounter, OsAlarmAccessingApplication=SystemApplication
      OsAlarmAction
        OsAlarmActivateTask: OsAlarmActivateTaskRef=Task_4msBsw_Appl10
    Task_2msA_Appl10 (OsTask):
      OsTaskActivation = 1
      OsTaskPriority = 78
      OsTaskSchedule = FULL
      OsTaskStackSharing = false
      OsTaskStackSize = 1024
      OsTaskType = AUTO
      OsTaskAccessingApplication = SystemApplication
      OsTaskAccessingApplication = Os/Appl{7..9}
    Task_100ms_Appl10 (OsTask):
      OsTaskActivation = 1
      OsTaskPriority = 39
      OsTaskSchedule = FULL
      OsTaskStackSharing = false
      OsTaskStackSize = 1024
      OsTaskType = AUTO
      OsTaskAccessingApplication = SystemApplication
      OsTaskEventRef = Rte_Ev_Cyclic_Task_100ms_Appl10_0_100ms
      OsTaskEventRef = Rte_Ev_MS_Task_100ms_Appl10
      OsTaskEventRef = Rte_Ev_Run_Vin_Vin_LifeCycleModeRequest
      OsTaskEventRef = Rte_Ev_Run_Vin_Vin_OnVinChangeIndicatorAck
      OsTaskEventRef = Rte_Ev_Run_Vin_Vin_ReceiveFromCom
      OsTaskResourceRef = Rte_Res_Vin_VinState
      OsTaskAccessingApplication = Os/Appl{7..9}
      OsTaskEventRef = Rte_Ev_Run_BmwMsgSlot121Bas1Repn2BusFrChA_CON_VEH_Missing_Oper
      OsTaskEventRef = Rte_Ev_Run_BmwMsgSlot121Bas1Repn2BusFrChA_CON_VEH_Received_Oper
      OsTaskEventRef = Rte_Ev_Run_BmwMsgSlot55Bas3Repn4BusFrChA_V_VEH_Missing_Oper
      OsTaskEventRef = Rte_Ev_Run_BmwMsgSlot55Bas3Repn4BusFrChA_V_VEH_Received_Oper
      OsTaskEventRef = Rte_Ev_Run_Vin_Vin_OnComOff
      OsTaskEventRef = Rte_Ev_Run_Vin_Vin_OnComOn
      OsTaskEventRef = Rte_Ev_Run1_Darh_QueueHandler
    Rte_Al_TE_Task_100ms_Appl10_0_100ms (OsAlarm): OsAlarmCounterRef=OsCounter, OsAlarmAccessingApplication=SystemApplication
      OsAlarmAction
        OsAlarmSetEvent: OsAlarmSetEventRef=Rte_Ev_Cyclic_Task_100ms_Appl10_0_100ms, OsAlarmSetEventTaskRef=Task_100ms_Appl10
    Rte_Al_TE_Task_10ms_Appl10_0_10ms (OsAlarm): OsAlarmCounterRef=OsCounter, OsAlarmAccessingApplication=SystemApplication
      OsAlarmAction
        OsAlarmSetEvent: OsAlarmSetEventRef=Rte_Ev_Cyclic_Task_10ms_Appl10_0_10ms, OsAlarmSetEventTaskRef=Task_10ms_Appl10
    3 x OsIsr, all with OsIsrCategory=CATEGORY_1, OsIsrInterruptType=EXCEPTION, OsIsrInterruptPriority=0, OsIsrStackSize=0, OsIsrEnableNesting=false:
      FpuErrIrq: OsIsrInterruptSource=7, OsIsrSpecialFunctionName=Patched_FpuErrIrq
      SysErrIrq: OsIsrInterruptSource=1, OsIsrSpecialFunctionName=Patched_SysErrIrq
      MCU_FEINT_ISR: OsIsrInterruptSource=14, OsIsrSpecialFunctionName=Patched_MCU_FEINT_ISR
    Task_4ms_Appl10 (OsTask):
      OsTaskActivation = 1
      OsTaskPriority = 69
      OsTaskSchedule = FULL
      OsTaskStackSharing = false
      OsTaskStackSize = 1024
      OsTaskType = AUTO
      OsTaskAccessingApplication = SystemApplication
      OsTaskAccessingApplication = Os/Appl{7..9}
    Rte_Al_TE_Task_4ms_Appl10_0_4ms (OsAlarm): OsAlarmCounterRef=OsCounter, OsAlarmAccessingApplication=SystemApplication
      OsAlarmAction
        OsAlarmActivateTask: OsAlarmActivateTaskRef=Task_4ms_Appl10
    3 x OsIsr, all with OsIsrInterruptType=EXTERNAL, OsIsrEnableNesting=false:
      WDG_59_DRIVERA_TRIGGERFUNCTION_ISR: OsIsrCategory=CATEGORY_1, OsIsrInterruptSource=9, OsIsrInterruptPriority=2, OsIsrStackSize=0
      Fr_IrqTimer0: OsIsrCategory=CATEGORY_2, OsIsrInterruptSource=196, OsIsrInterruptPriority=10, OsIsrStackSize=1024  # Os Interrupt Service Routine PLAIN_TEXT ISR that handles Timer0-interrupt for FlexRay.
      Fr_IrqLine0: OsIsrCategory=CATEGORY_2, OsIsrInterruptSource=194, OsIsrInterruptPriority=8, OsIsrStackSize=1024  # Os Interrupt Service Routine PLAIN_TEXT ISR that handles Cyclestart-interrupt for FlexRay.
    Task_5msBsw_Appl10 (OsTask):
      OsTaskActivation = 1
      OsTaskPriority = 59
      OsTaskSchedule = FULL
      OsTaskStackSharing = false
      OsTaskStackSize = 2048
      OsTaskType = AUTO
      OsTaskAccessingApplication = SystemApplication
      OsTaskEventRef = Rte_Ev_Cyclic2_Task_5msBsw_Appl10_0_5ms
      OsTaskEventRef = Rte_Ev_WP_Task_5msBsw_Appl10
    Rte_Al_TE_Darh_QueueHandler (OsAlarm): OsAlarmCounterRef=OsCounter, OsAlarmAccessingApplication=SystemApplication
      OsAlarmAction
        OsAlarmSetEvent: OsAlarmSetEventRef=Rte_Ev_Run1_Darh_QueueHandler, OsAlarmSetEventTaskRef=Task_100ms_Appl10
    Rte_Al_TE2_Task_5msBsw_Appl10_0_5ms (OsAlarm): OsAlarmCounterRef=OsCounter, OsAlarmAccessingApplication=SystemApplication
      OsAlarmAction
        OsAlarmSetEvent: OsAlarmSetEventRef=Rte_Ev_Cyclic2_Task_5msBsw_Appl10_0_5ms, OsAlarmSetEventTaskRef=Task_5msBsw_Appl10
    14 x OsEvent:
      Rte_Ev_Cyclic_Task_100ms_Appl10_0_100ms
      Rte_Ev_Cyclic_Task_10ms_Appl10_0_10ms
      Rte_Ev_MS_Task_100ms_Appl10: OsEventMask=4
      Rte_Ev_MS_Task_10ms_Appl10: OsEventMask=4
      Rte_Ev_Run1_Darh_QueueHandler
      Rte_Ev_Run_Darh_LifeCycleHandler
      Rte_Ev_Run_Dlog_Dlog_ModeSwitchAckLifeCycle
      Rte_Ev_Run_Dlog_Dlog_ModeSwitchRequestLifeCycle
      Rte_Ev_Run_Omc_LifeCycleHandler
      Rte_Ev_Run_StdDiag_LifeCycleHandler
      Rte_Ev_Run_Stm_Runnable_ErrorCentralErrorLock
      Rte_Ev_Run_Vin_Vin_LifeCycleModeRequest
      Rte_Ev_Run_Vin_Vin_OnVinChangeIndicatorAck
      Rte_Ev_Run_Vin_Vin_ReceiveFromCom
    Task_2msTmplMonr_Appl10 (OsTask):
      OsTaskActivation = 1
      OsTaskPriority = 79
      OsTaskSchedule = FULL
      OsTaskStackSharing = false
      OsTaskStackSize = 1024
      OsTaskType = AUTO
      OsTaskAccessingApplication = SystemApplication
    Rte_Al_TE_Task_2msTmplMonr_Appl10_0_2ms (OsAlarm): OsAlarmCounterRef=OsCounter, OsAlarmAccessingApplication=SystemApplication
      OsAlarmAction
        OsAlarmActivateTask: OsAlarmActivateTaskRef=Task_2msTmplMonr_Appl10
    7 x OsIsr, all with OsIsrInterruptType=EXTERNAL:
      MotCtrlMgrIrq: OsIsrCategory=CATEGORY_1, OsIsrInterruptSource=16, OsIsrInterruptPriority=1, OsIsrStackSize=0, OsIsrEnableNesting=false
      SPI_CSIG0_TIC_CAT2_ISR: OsIsrCategory=CATEGORY_2, OsIsrInterruptSource=175, OsIsrInterruptPriority=14, OsIsrStackSize=1024, OsIsrEnableNesting=true
      SPI_CSIG0_TIR_CAT2_ISR: OsIsrCategory=CATEGORY_2, OsIsrInterruptSource=176, OsIsrInterruptPriority=14, OsIsrStackSize=1024, OsIsrEnableNesting=false
      SPI_CSIG0_TIRE_CAT2_ISR: OsIsrCategory=CATEGORY_2, OsIsrInterruptSource=174, OsIsrInterruptPriority=14, OsIsrStackSize=1024, OsIsrEnableNesting=true
      SPI_CSIH2_TIC_CAT2_ISR: OsIsrCategory=CATEGORY_2, OsIsrInterruptSource=100, OsIsrInterruptPriority=14, OsIsrStackSize=1024, OsIsrEnableNesting=true
      SPI_CSIH2_TIR_CAT2_ISR: OsIsrCategory=CATEGORY_2, OsIsrInterruptSource=99, OsIsrInterruptPriority=14, OsIsrStackSize=1024, OsIsrEnableNesting=false
      SPI_CSIH2_TIRE_CAT2_ISR: OsIsrCategory=CATEGORY_2, OsIsrInterruptSource=98, OsIsrInterruptPriority=14, OsIsrStackSize=1024, OsIsrEnableNesting=true
    Rte_Ev_Run1_Stm_Runnable_InitialCELSupervision (OsEvent)
    Rte_Ev_Run1_Stm_Runnable_StopCentralErrorLockSupervision (OsEvent)
    Rte_Res_Vin_VinState (OsResource): OsResourceProperty=STANDARD, OsResourceAccessingApplication=Os/Appl10, OsResourceAccessingApplication=SystemApplication
    Appl7 (OsApplication):
      OsTrusted = false
      OsTrustedApplicationDelayTimingViolationCall = false
      OsTrustedApplicationWithProtection = false
      OsApplicationIsPrivileged = false
      OsAppUseTrustedFunctionStubs = false
      OsApplicationCoreRef = EcucCore0
      OsAppTaskRef = Task_2ms_Appl7
      OsAppTaskRef = Task_10ms_Appl7
      OsAppTaskRef = Task_4ms_Appl7
      OsAppTaskRef = Task_100ms_Appl7
      OsAppTaskRef = Task_Init_Appl7
      OsAppAlarmRef = Rte_Al_TE_Task_100ms_Appl7_0_100ms
      OsAppAlarmRef = Rte_Al_TE_Task_10ms_Appl7_0_10ms
      OsAppAlarmRef = Rte_Al_TE_Task_2ms_Appl7_0_2ms
      OsAppAlarmRef = Rte_Al_TE_Task_4ms_Appl7_0_4ms
      OsApplicationHooks: OsAppErrorHook=false, OsAppShutdownHook=false, OsAppStartupHook=false
      NtWrapS_CmnMfgSrv_CallSvc7 (OsApplicationNonTrustedFunction): OsNonTrustedFunctionName=NtWrapS_CmnMfgSrv_CallSvc7, OsNonTrustedFunctionStacks=1, OsNonTrustedFunctionStackSize=512
        Appl10 (OsNonTrustedFunctionCaller): OsNonTrustedFunctionAppStacks=1, OsNonTrustedFunctionAppRef=Os/Appl10
    4 x OsTask, all with OsTaskActivation=1, OsTaskSchedule=FULL, OsTaskStackSharing=false, OsTaskStackSize=1024, OsTaskType=AUTO, OsTaskAccessingApplication=SystemApplication, OsTaskAccessingApplication=Os/Appl10:
      Task_2ms_Appl7: OsTaskPriority=76, OsTaskAccessingApplication=Os/Appl9
      Task_10ms_Appl7: OsTaskPriority=45
      Task_4ms_Appl7: OsTaskPriority=66
      Task_100ms_Appl7: OsTaskPriority=36, OsTaskAccessingApplication=Os/Appl9
    Appl8 (OsApplication):
      OsTrusted = false
      OsTrustedApplicationDelayTimingViolationCall = false
      OsTrustedApplicationWithProtection = false
      OsApplicationIsPrivileged = false
      OsAppUseTrustedFunctionStubs = false
      OsApplicationCoreRef = EcucCore0
      OsAppTaskRef = Task_Init_Appl8
      OsAppTaskRef = Task_2ms_Appl8
      OsAppTaskRef = Task_10ms_Appl8
      OsAppAlarmRef = Rte_Al_TE_Task_10ms_Appl8_0_10ms
      OsAppAlarmRef = Rte_Al_TE_Task_2ms_Appl8_0_2ms
      OsApplicationHooks: OsAppErrorHook=false, OsAppShutdownHook=false, OsAppStartupHook=false
    4 x OsTask, all with OsTaskActivation=1, OsTaskSchedule=FULL, OsTaskStackSharing=false, OsTaskStackSize=1024, OsTaskType=AUTO, OsTaskAccessingApplication=SystemApplication, OsTaskAccessingApplication=Os/Appl10:
      Task_Init_Appl8: OsTaskPriority=97
      Task_2ms_Appl8: OsTaskPriority=77
      Task_10ms_Appl8: OsTaskPriority=46
      Task_Init_Appl7: OsTaskPriority=96, OsTaskAccessingApplication=Os/Appl9
    Appl9 (OsApplication):
      OsTrusted = false
      OsTrustedApplicationDelayTimingViolationCall = false
      OsTrustedApplicationWithProtection = false
      OsApplicationIsPrivileged = false
      OsAppUseTrustedFunctionStubs = false
      OsApplicationCoreRef = EcucCore0
      OsAppTaskRef = Task_Init_Appl9
      OsAppTaskRef = Task_2ms_Appl9
      OsAppTaskRef = Task_10ms_Appl9
      OsAppTaskRef = Task_100ms_Appl9
      OsAppAlarmRef = Rte_Al_TE_Task_100ms_Appl9_0_100ms
      OsAppAlarmRef = Rte_Al_TE_Task_10ms_Appl9_0_10ms
      OsAppAlarmRef = Rte_Al_TE_Task_2ms_Appl9_0_2ms
      OsApplicationHooks: OsAppErrorHook=false, OsAppShutdownHook=false, OsAppStartupHook=false
    4 x OsTask, all with OsTaskActivation=1, OsTaskSchedule=FULL, OsTaskStackSharing=false, OsTaskStackSize=1024, OsTaskType=AUTO, OsTaskAccessingApplication=SystemApplication, OsTaskAccessingApplication=Os/Appl10:
      Task_Init_Appl9: OsTaskPriority=98, OsTaskAccessingApplication=Os/Appl7
      Task_2ms_Appl9: OsTaskPriority=75, OsTaskAccessingApplication=Os/Appl7
      Task_10ms_Appl9: OsTaskPriority=47
      Task_100ms_Appl9: OsTaskPriority=38, OsTaskAccessingApplication=Os/Appl7
    9 x OsAlarm, all with OsAlarmCounterRef=OsCounter, OsAlarmAccessingApplication=Os/Appl10, OsAlarmAccessingApplication=SystemApplication:
      Rte_Al_TE_Task_100ms_Appl7_0_100ms
        OsAlarmAction
          OsAlarmActivateTask: OsAlarmActivateTaskRef=Task_100ms_Appl7
      Rte_Al_TE_Task_100ms_Appl9_0_100ms
        OsAlarmAction
          OsAlarmActivateTask: OsAlarmActivateTaskRef=Task_100ms_Appl9
      Rte_Al_TE_Task_10ms_Appl7_0_10ms
        OsAlarmAction
          OsAlarmActivateTask: OsAlarmActivateTaskRef=Task_10ms_Appl7
      Rte_Al_TE_Task_10ms_Appl8_0_10ms
        OsAlarmAction
          OsAlarmActivateTask: OsAlarmActivateTaskRef=Task_10ms_Appl8
      Rte_Al_TE_Task_10ms_Appl9_0_10ms
        OsAlarmAction
          OsAlarmActivateTask: OsAlarmActivateTaskRef=Task_10ms_Appl9
      Rte_Al_TE_Task_2ms_Appl7_0_2ms
        OsAlarmAction
          OsAlarmActivateTask: OsAlarmActivateTaskRef=Task_2ms_Appl7
      Rte_Al_TE_Task_2ms_Appl8_0_2ms
        OsAlarmAction
          OsAlarmActivateTask: OsAlarmActivateTaskRef=Task_2ms_Appl8
      Rte_Al_TE_Task_2ms_Appl9_0_2ms
        OsAlarmAction
          OsAlarmActivateTask: OsAlarmActivateTaskRef=Task_2ms_Appl9
      Rte_Al_TE_Task_4ms_Appl7_0_4ms
        OsAlarmAction
          OsAlarmActivateTask: OsAlarmActivateTaskRef=Task_4ms_Appl7
    FrCycleCounter (OsCounter):
      OsCounterMaxAllowedValue = 1073741823
      OsCounterMinCycle = 1
      OsCounterTicksPerBase = 1
      OsCounterType = SOFTWARE
      OsSecondsPerTick = 0.005
      OsCounterAccessingApplication = SystemApplication
    6 x OsEvent:
      Rte_Ev_Run_BmwMsgSlot121Bas1Repn2BusFrChA_CON_VEH_Missing_Oper
      Rte_Ev_Run_BmwMsgSlot121Bas1Repn2BusFrChA_CON_VEH_Received_Oper
      Rte_Ev_Run_BmwMsgSlot55Bas3Repn4BusFrChA_V_VEH_Missing_Oper
      Rte_Ev_Run_BmwMsgSlot55Bas3Repn4BusFrChA_V_VEH_Received_Oper
      Rte_Ev_Run_BmwMsgSlot107Bas0Repn1BusFrChA_OFFS_QUAD_EPS_Missing_Oper
      Rte_Ev_Run_BmwMsgSlot107Bas0Repn1BusFrChA_OFFS_QUAD_EPS_Received_Oper
    Task_2msB_Appl10 (OsTask):
      OsTaskActivation = 1
      OsTaskPriority = 74
      OsTaskSchedule = FULL
      OsTaskStackSharing = false
      OsTaskStackSize = 1024
      OsTaskType = AUTO
      OsTaskAccessingApplication = SystemApplication
      OsTaskAccessingApplication = Os/Appl{7..9}
    Rte_Al_TE_Task_2msA_Appl10_0_2ms (OsAlarm): OsAlarmCounterRef=OsCounter, OsAlarmAccessingApplication=SystemApplication
      OsAlarmAction
        OsAlarmActivateTask: OsAlarmActivateTaskRef=Task_2msA_Appl10
    Rte_Al_TE_Task_2msB_Appl10_0_2ms (OsAlarm): OsAlarmCounterRef=OsCounter, OsAlarmAccessingApplication=SystemApplication
      OsAlarmAction
        OsAlarmActivateTask: OsAlarmActivateTaskRef=Task_2msB_Appl10
    Task_InitBsw_Appl10 (OsTask):
      OsTaskActivation = 1
      OsTaskPriority = 95
      OsTaskSchedule = FULL
      OsTaskStackSharing = false
      OsTaskStackSize = 1024
      OsTaskType = AUTO
      OsTaskAccessingApplication = SystemApplication
      OsTaskAutostart: OsTaskAppModeRef=OSDEFAULTAPPMODE
    Task_ComBsw_Appl10 (OsTask):
      OsTaskActivation = 1
      OsTaskPriority = 60
      OsTaskSchedule = FULL
      OsTaskStackSharing = false
      OsTaskStackSize = 1024
      OsTaskType = AUTO
      OsTaskAccessingApplication = SystemApplication
      OsTaskEventRef = Rte_Ev_Cyclic2_Task_ComBsw_Appl10_0_5ms
      OsTaskEventRef = Rte_Ev_Cyclic_Task_ComBsw_Appl10_0_10ms
      OsTaskAccessingApplication = Os/Appl8
      OsTaskAccessingApplication = Os/Appl7
      OsTaskAccessingApplication = Os/Appl9
    Rte_Al_TE2_Task_ComBsw_Appl10_0_5ms (OsAlarm): OsAlarmCounterRef=FrCycleCounter, OsAlarmAccessingApplication=SystemApplication
      OsAlarmAction
        OsAlarmSetEvent: OsAlarmSetEventRef=Rte_Ev_Cyclic2_Task_ComBsw_Appl10_0_5ms, OsAlarmSetEventTaskRef=Task_ComBsw_Appl10
    Rte_Ev_Cyclic2_Task_ComBsw_Appl10_0_5ms (OsEvent)
    Rte_Al_TE_Task_ComBsw_Appl10_0_10ms (OsAlarm): OsAlarmCounterRef=FrCycleCounter, OsAlarmAccessingApplication=SystemApplication
      OsAlarmAction
        OsAlarmSetEvent: OsAlarmSetEventRef=Rte_Ev_Cyclic_Task_ComBsw_Appl10_0_10ms, OsAlarmSetEventTaskRef=Task_ComBsw_Appl10
    Rte_Ev_Cyclic_Task_ComBsw_Appl10_0_10ms (OsEvent)
    MCU_ECM_EIC_CAT2_ISR (OsIsr): OsIsrCategory=CATEGORY_2, OsIsrInterruptType=EXTERNAL, OsIsrInterruptSource=8, OsIsrInterruptPriority=3, OsIsrStackSize=1024, OsIsrEnableNesting=true
    32 x OsEvent:
      Rte_Ev_Run_StdDiag_SessionChange_DefaultSession
      Rte_Ev_Run_StdDiag_SessionChange_OtherSession
      Rte_Ev_Run_Stm_Runnable_ErrorEnergyMode
      Rte_Ev_Run_Stm_Runnable_ReceiveCentralErrorLock
      Rte_Ev_Run_Stm_Runnable_ReceiveEnergyMode
      Rte_Ev_Run_Vin_Vin_OnComOff
      Rte_Ev_Run_Vin_Vin_OnComOn
      Rte_Ev_Run_BswM_BswM_Read_StdDiag_ComControlModeRequest
      Rte_Ev_Run1_SysTime_ReceiveSignal
      Rte_Ev_Run_Coding_LifeCycleHandler
      Rte_Ev_Run_Coding_SessionChange
      Rte_Ev_Run_Coding_VinReceiveHandler
      Rte_Ev_Run_Rmh_RxRequestMsg
      Rte_Ev_Run_SysTime_LifeCycleHandler
      Rte_Ev_Run_BmwMsgSlot276Bas4Repn8BusFrChA_MILE_KM_Missing_Oper
      Rte_Ev_Run_BmwMsgSlot276Bas4Repn8BusFrChA_MILE_KM_Received_Oper
      Rte_Ev_Run_BmwMsgSlot53Bas3Repn8BusFrChA_SU_CLE_DRDY_DXP_Miss
      Rte_Ev_Run_BmwMsgSlot53Bas3Repn8BusFrChA_SU_CLE_DRDY_DXP_Rxd
      Rte_Ev_Run_BmwMsgSlot55Bas0Repn2BusFrChA_ACLNY_MASSCNTR_Missing_Oper
      Rte_Ev_Run_BmwMsgSlot55Bas0Repn2BusFrChA_ACLNY_MASSCNTR_Received_Oper
      Rte_Ev_Run_BmwMsgSlot56Bas0Repn2BusFrChA_VYAW_VEH_Missing_Oper
      Rte_Ev_Run_BmwMsgSlot56Bas0Repn2BusFrChA_VYAW_VEH_Received_Oper
      Rte_Ev_Run_BmwMsgSlot68Bas0Repn2BusFrChA_TAR_QTA_STRMOM_DV_Miss
      Rte_Ev_Run_BmwMsgSlot68Bas0Repn2BusFrChA_TAR_QTA_STRMOM_DV_Rxd
      Rte_Ev_Run_BmwMsgSlot68Bas0Repn2BusFrChA_TAR_STMOM_DV_ACT_Miss
      Rte_Ev_Run_BmwMsgSlot68Bas0Repn2BusFrChA_TAR_STMOM_DV_ACT_Rxd
      Rte_Ev_Run_BmwMsgSlot108Bas0Repn2BusFrChA_STEA_OFFS_Missing_Oper
      Rte_Ev_Run_BmwMsgSlot108Bas0Repn2BusFrChA_STEA_OFFS_Received_Oper
      Rte_Ev_Run_BmwMsgSlot269Bas2Repn4BusFrChA_CTR_VIB_STW_DISP_EXMI_SP2015_Missing
      Rte_Ev_Run_BmwMsgSlot269Bas2Repn4BusFrChA_CTR_VIB_STW_DISP_EXMI_SP2015_Received
      Rte_Ev_Run_BmwMsgSlot68Bas1Repn2BusFrChA_ENERG_DGR_DRDY_Missing_Oper
      Rte_Ev_Run_BmwMsgSlot68Bas1Repn2BusFrChA_ENERG_DGR_DRDY_Received_Oper
    Task_Coding_Appl10 (OsTask):
      OsTaskActivation = 1
      OsTaskPriority = 30
      OsTaskSchedule = FULL
      OsTaskStackSharing = false
      OsTaskStackSize = 8192
      OsTaskType = AUTO
      OsTaskAccessingApplication = SystemApplication
      OsTaskAccessingApplication = Os/Appl10
      OsTaskEventRef = Rte_Ev_Run_Coding_R_CheckNCD
      OsTaskEventRef = Rte_Ev_Run_Coding_R_ConditionCheckReadCPS
      OsTaskEventRef = Rte_Ev_Run_Coding_R_ReadCPS
      OsTaskEventRef = Rte_Ev_Run_Coding_R_ReadNCD
      OsTaskEventRef = Rte_Ev_Run_Coding_R_ReadProtocolData
      OsTaskEventRef = Rte_Ev_Run_Coding_R_WriteNCD
    8 x OsEvent:
      Rte_Ev_Cyclic2_Task_5msBsw_Appl10_0_5ms
      Rte_Ev_Run_Coding_R_CheckNCD
      Rte_Ev_Run_Coding_R_ConditionCheckReadCPS
      Rte_Ev_Run_Coding_R_ReadCPS
      Rte_Ev_Run_Coding_R_ReadNCD
      Rte_Ev_Run_Coding_R_ReadProtocolData
      Rte_Ev_Run_Coding_R_WriteNCD
      Rte_Ev_WP_Task_5msBsw_Appl10: OsEventMask=2
    AlgnErrIrq (OsIsr): OsIsrCategory=CATEGORY_1, OsIsrInterruptType=EXCEPTION, OsIsrInterruptSource=12, OsIsrInterruptPriority=0, OsIsrStackSize=0, OsIsrEnableNesting=false
    ResdOperIrq (OsIsr): OsIsrCategory=CATEGORY_1, OsIsrInterruptType=EXCEPTION, OsIsrInterruptSource=6, OsIsrInterruptPriority=0, OsIsrStackSize=0, OsIsrEnableNesting=false
