AUTOSAR XML (schema 4-3-0)
package /ActiveEcuC
  module config DlogShared: implementation-config-variant=VARIANT-PRE-COMPILE
    CommonPublishedInformation: SwMajorVersion=5, SwMinorVersion=0, SwPatchVersion=3
    DlogSharedGeneral
      Logistic:
        DlogEcuManufactoringDateDefault = 0x00,0x00,0x00
        DlogEcuSerialNumberDefault = 1234567890
        DlogEcuSerialNumberLength = 10
        DlogHweDevelopmentInfoLength = 10
        DlogHweTableInitFromRom = true
        DlogNumberOfSvkBackups = 0
        DlogProgrammingCounterMaxValue = 1000
        DlogSweDevelopmentInfoLength = 10
        ConfigSet
          HweData: DevelopmentInfo=HWEDATA, Id=1, ProcessClass=DLOG_PROCESSCLASS_HWEL, VersionMajor=1, VersionMinor=0, VersionPatch=0
        HWModificationIndex: HWModel=DLOG_HWM_A_MUSTER, HWModificationIndex=0, SupplierInfoFied=0
      MemorySegmentation
        Blocks_8k (Entry): NumberOfSegments=8, SegmentSize=8192, StartAddress=0
        Blocks_32k (Entry): NumberOfSegments=62, SegmentSize=32768, StartAddress=65536
      Swe: BluSweId=1, CrcSkipSize=255, MaxNumberOfSwes=16, SignatureLength=260
        Appl (SweConfiguration): CpuId=0, SweDescriptionTableAddress=1832960, SweId=1, SweSignatureAddress=1834496, SweGroup=ALL_OBLIGATORY
          LogisticData: DevelopmentInfo=SWFLAPPL, ProcessClass=DLOG_PROCESSCLASS_SWFL
          SignatureBlock: Size=1538048, StartAddress=294912
          SweBlock: BlockSize=1540096, BlockStartAddress=294912
        Fbl (SweConfiguration): CpuId=0, SweDescriptionTableAddress=292864, SweId=0, SweSignatureAddress=294400, SweGroup=ALL_OBLIGATORY
          LogisticData: DevelopmentInfo=BTLD, ProcessClass=DLOG_PROCESSCLASS_BTLD
          SignatureBlock: Size=276480, StartAddress=16384
          SweBlock: BlockSize=278528, BlockStartAddress=16384
        ALL_OBLIGATORY (SweGroupConfiguration): GroupType=ALLOBLIGATORY
        Cal1 (SweConfiguration): CpuId=0, SweDescriptionTableAddress=1964032, SweId=2, SweSignatureAddress=1965568, SweGroup=ALL_OBLIGATORY
          LogisticData: DevelopmentInfo=SWFL, ProcessClass=DLOG_PROCESSCLASS_SWFL
          SignatureBlock: Size=129024, StartAddress=1835008
          SweBlock: BlockSize=131072, BlockStartAddress=1835008
        Cal2 (SweConfiguration): CpuId=0, SweDescriptionTableAddress=2095104, SweId=3, SweSignatureAddress=2096640, SweGroup=OptionalSWEs
          LogisticData: DevelopmentInfo=SWFL, ProcessClass=DLOG_PROCESSCLASS_SWFL
          SignatureBlock: Size=129024, StartAddress=1966080
          SweBlock: BlockSize=131072, BlockStartAddress=1966080
        OptionalSWEs (SweGroupConfiguration): GroupType=OPTIONAL
      TimingParameter: AuthentificationTime=10, BootloaderInstallTime=100, CheckMemoryTime=60, EraseMemoryTime=100, ResetTime=10, TransferDataTime=60
    DlogSharedPlatform:
      ConvertExtAddress2IntPointer = ((uint32)extAddress)
      ConvertIntPointer2ExtAddress = ((uint32)intPointer)
      EccErrorState = INVALID
      FlashErasedByte = 255
      FlashPageSize = 256
      HandleEccRom = true
      MultiCpuEnable = false
    Dlog_MultiConfig: EcuId=48, ConfigSet=ConfigSet
