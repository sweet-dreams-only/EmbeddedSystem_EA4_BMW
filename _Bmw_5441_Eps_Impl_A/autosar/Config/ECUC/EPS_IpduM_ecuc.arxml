AUTOSAR XML (schema 4-3-0)
package /ActiveEcuC
  module config IpduM: implementation-config-variant=VARIANT-PRE-COMPILE, module-description=IpduM_Impl
    IPduMGeneral (IpduMGeneral):
      IpduMStaticPartExists = false
      IpduMConfigurationTimeBase = 0.005
      IpduMRxTimeBase = 0.005
      IpduMTxTimeBase = 0.005
      IpduMDevErrorDetect = true
      IpduMHeaderByteOrder = IPDUM_BIG_ENDIAN
      IpduMVersionInfoApi = false
      IpduMSafeBswChecks = true
    IpduMGeneration:
      IpduMOutOfBoundsWriteProtectionStrategy = NONE
      IpduMOutOfBoundsWriteSanitizer = false
      IpduMOutOfBoundsReadSanitizer = false
      IpduMReduceConstantData2Define = false
      IpduMBoolDataInArrayOfStructStrategy = BITMASKING
      IpduMDeduplicateIndirectedData = true
      IpduMDataDeduplicationStrategy = WITH_CAST
      IpduMReduceBoolDataByNegationThreshold = 2
      IpduMReduceBoolDataByNumericalComparisonThreshold = 2
      IpduMReduceBoolDataByNumericalRelationThreshold = 2
      IpduMReduceBoolDataByNumericalOperandStrategy = WITH_ANY_VALUE
      IpduMReduceNumericalDataByOffsetThreshold = 2
      IpduMReduceNumericalDataByArraySubtractionThreshold = 2
      IpduMReduceDataByStreaming = false
      IpduMShortSymbols = false
      IpduMInterfacesForDeactivatedData = false
      IpduMReferringKeysInComments = false
    IpduMConfig
      pduTrig_FR_DBG_EPS_55c86d41 (IpduMTxPathway)  # FR_DBG_EPS
        pduTrig_FR_DBG_EPS_55c86d41 (IpduMTxRequest):
          IpduMByteOrder = LITTLE_ENDIAN
          IpduMIPduUnusedAreasDefault = 255
          IpduMTxTriggerMode = DYNAMIC_PART_TRIGGER
          IpduMTxConfirmationPduId = 0
          IpduMInitialDynamicPart = DBG_EPS_BS_MOD_58_BYTE_19255f18
          IpduMOutgoingPduRef = pduTrig_FR_DBG_EPS_pduPort_EPS_A_FlexRay_OUT_55c86d41_4f391dd1
          IpduMSelectorFieldPosition: IpduMSelectorFieldLength=8, IpduMSelectorFieldPosition=0
          DBG_EPS_MOD_EXT_120_BYTE_19255f18 (IpduMTxDynamicPart):
            IpduMJitUpdate = true
            IpduMTxDynamicConfirmation = false
            IpduMTxDynamicHandleId = 2
            IpduMTxDynamicPduRef = pduTrig_DBG_EPS_MOD_EXT_120_BYTE_pduPort_EPS_A_FlexRay_OUT_55c86d41_4f391dd1
            SegmentPosition_0 (IpduMSegment): IpduMSegmentLength=464, IpduMSegmentPosition=0
          DBG_EPS_BS_MOD_58_BYTE_19255f18 (IpduMTxDynamicPart):
            IpduMJitUpdate = true
            IpduMTxDynamicConfirmation = false
            IpduMTxDynamicHandleId = 1
            IpduMTxDynamicPduRef = pduTrig_DBG_EPS_BS_MOD_58_BYTE_pduPort_EPS_A_FlexRay_OUT_55c86d41_4f391dd1
            SegmentPosition_0 (IpduMSegment): IpduMSegmentLength=464, IpduMSegmentPosition=0
      pduTrig_SVC_fbd80461_Out (IpduMTxPathway)  # SVC
        pduTrig_SVC_fbd80461_Out (IpduMTxRequest):
          IpduMByteOrder = LITTLE_ENDIAN
          IpduMIPduUnusedAreasDefault = 255
          IpduMTxTriggerMode = DYNAMIC_PART_TRIGGER
          IpduMTxConfirmationPduId = 1
          IpduMInitialDynamicPart = pduTrig_SVC_fbd80461_Out/ANFRAGE_19255f18
          IpduMOutgoingPduRef = SVC_fbd80461_Out
          IpduMSelectorFieldPosition: IpduMSelectorFieldLength=8, IpduMSelectorFieldPosition=0
          3 x IpduMTxDynamicPart, all with IpduMJitUpdate=true:
            ANFRAGE_19255f18: IpduMTxDynamicConfirmation=true, IpduMTxDynamicHandleId=0, IpduMTxDynamicPduRef=ANFRAGE_fbd80461_Out
              SegmentPosition_0 (IpduMSegment): IpduMSegmentLength=64, IpduMSegmentPosition=0
            SECU_CHAL_19255f18: IpduMTxDynamicConfirmation=true, IpduMTxDynamicHandleId=4, IpduMTxDynamicPduRef=pduTrig_SECU_CHAL_pduPort_EPS_A_FlexRay_OUT_55c86d41_4f391dd1
              SegmentPosition_0 (IpduMSegment): IpduMSegmentLength=64, IpduMSegmentPosition=0
            RQ_STG_EFAN_19255f18: IpduMTxDynamicConfirmation=false, IpduMTxDynamicHandleId=3, IpduMTxDynamicPduRef=pduTrig_RQ_STG_EFAN_pduPort_EPS_A_FlexRay_OUT_55c86d41_4f391dd1
              SegmentPosition_0 (IpduMSegment): IpduMSegmentLength=64, IpduMSegmentPosition=0
      pduTrig_SVC_fbd80461_In (IpduMRxPathway)  # SVC
        pduTrig_SVC_fbd80461_In (IpduMRxIndication): IpduMByteOrder=LITTLE_ENDIAN, IpduMRxHandleId=0, IpduMRxIndicationPduRef=SVC_fbd80461_In
          SECU_RESP_19255f18 (IpduMRxDynamicPart): IpduMRxSelectorValue=247, IpduMOutgoingDynamicPduRef=pduTrig_SECU_RESP_pduPort_EPS_A_FlexRay_IN_55c86d41_4f391dd1
            SegmentPosition_0 (IpduMSegment): IpduMSegmentLength=64, IpduMSegmentPosition=0
          ANFRAGE_19255f18 (IpduMRxDynamicPart): IpduMRxSelectorValue=1, IpduMOutgoingDynamicPduRef=ANFRAGE_fbd80461_In
            SegmentPosition_0 (IpduMSegment): IpduMSegmentLength=64, IpduMSegmentPosition=0
          IpduMSelectorFieldPosition: IpduMSelectorFieldLength=8, IpduMSelectorFieldPosition=0
    IpduMPublishedInformation: IpduMRxDirectComInvocation=true
