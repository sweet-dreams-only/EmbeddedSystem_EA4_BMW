AUTOSAR XML (schema 4-3-0)
package /ActiveEcuC
  module config BswM: implementation-config-variant=VARIANT-PRE-COMPILE, module-description=BswM_Impl
    BswMGeneral:
      BswMCanSMEnabled = false
      BswMComMEnabled = true
      BswMDcmEnabled = true
      BswMDevErrorDetect = true
      BswMEcuMEnabled = true
      BswMEthIfEnabled = false
      BswMEthSMEnabled = false
      BswMFrSMEnabled = true
      BswMGenericRequestEnabled = true
      BswMJ1939DcmEnabled = false
      BswMJ1939NmEnabled = false
      BswMLinSMEnabled = false
      BswMLinTPEnabled = false
      BswMNmEnabled = false
      BswMNvMEnabled = true
      BswMPduREnabled = false
      BswMRuleControlEnabled = true
      BswMSdEnabled = false
      BswMVersionInfoApi = false
      BswMWdgMEnabled = false
      BswMModeCheck = true
      BswMMainFunctionPeriod = 0.01
      BswMCommonData
      BswMGeneration:
        BswMOutOfBoundsWriteSanitizer = false
        BswMOutOfBoundsReadSanitizer = false
        BswMReduceConstantData2Define = true
        BswMReduceDataByStreaming = false
        BswMBoolDataInArrayOfStructStrategy = BITMASKING
        BswMInterfacesForDeactivatedData = false
      BswMUserIncludeFiles: BswMUserIncludeFile=BswM_UserTypes.h
    BswMConfig
      BswMArbitration
        4 x BswMRule, all with BswMNestedExecutionOnly=false, BswMRuleInitState=BSWM_FALSE:
          Rule_GoOffOne: BswMRuleId=14, BswMRuleExpressionRef=LogEx_GoOffOne, BswMRuleTrueActionList=AL_GoOffOne
          Rule_PrepShtdwn: BswMRuleId=20, BswMRuleExpressionRef=LogEx_PrepShtdwn, BswMRuleTrueActionList=AL_PrepShtdwn
          Rule_Rst: BswMRuleId=21, BswMRuleExpressionRef=LogEx_Restrt, BswMRuleTrueActionList=AL_Rstrt
          Rule_Run: BswMRuleId=22, BswMRuleExpressionRef=LogEx_Run, BswMRuleTrueActionList=AL_Run
        LogEx_GoOffOne (BswMLogicalExpression): BswMArgumentRef=BswMModeCondition
        BswMSt (BswMModeRequestPort): BswMArbitrateOnInit=false, BswMRequestProcessing=BSWM_FORCED_IMMEDIATE
          BswMModeRequestSource
            BswMGenericRequest: BswMModeRequesterId=0, BswMRequestedModeMax=9
              9 x BswMGenericRequestMode:
                GoOffOne: BswMGenericRequestModeValue=6
                GoOffOneA: BswMGenericRequestModeValue=5
                GoOffTwo: BswMGenericRequestModeValue=7
                PrepShtdwn: BswMGenericRequestModeValue=4
                Rst: BswMGenericRequestModeValue=8
                Run: BswMGenericRequestModeValue=3
                StrtUpOne: BswMGenericRequestModeValue=0
                StrtUpTwo: BswMGenericRequestModeValue=1
                StrtUpTwoA: BswMGenericRequestModeValue=2
          BswMModeInitValue
            BswMBswModeInitValue: BswMBswModeInitValueMode=StrtUpTwoA
        3 x BswMLogicalExpression:
          LogEx_Restrt: BswMArgumentRef=BswMModeCondition_007
          LogEx_Run: BswMArgumentRef=BswMModeCondition_006
          LogEx_PrepShtdwn: BswMLogicalOperator=BSWM_OR, BswMArgumentRef=BswMModeCondition_002, BswMArgumentRef=BswMModeCondition_009
        SysStMod (BswMModeRequestPort): BswMArbitrateOnInit=false, BswMRequestProcessing=BSWM_DEFERRED
          BswMModeRequestSource
            BswMUserConditionRequest: BswMUserCondition=Rte_SysStMod_SysSt_Val
        3 x BswMModeCondition, all with BswMConditionType=BSWM_EQUALS:
          BswMModeCondition_009: BswMConditionMode=SysStMod
            BswMConditionValue
              BswMBswMode: BswMBswRequestedMode=1
          BswMModeCondition_007: BswMConditionMode=BswMSt
            BswMConditionValue
              BswMBswMode: BswMBswRequestedMode=Rst
          BswMModeCondition_006: BswMConditionMode=BswMSt
            BswMConditionValue
              BswMBswMode: BswMBswRequestedMode=Run
        LogEx_StdDiag_IsInitialized (BswMLogicalExpression): BswMArgumentRef=BswMModeCondition_015
        Rule_OMC_INITIALIZE (BswMRule):
          BswMNestedExecutionOnly = false
          BswMRuleId = 19
          BswMRuleInitState = BSWM_FALSE
          BswMRuleExpressionRef = LogEx_Omc_IsInitialized
          BswMRuleTrueActionList = AL_Run_Omc
        LogEx_Vin_IsInitialized (BswMLogicalExpression): BswMArgumentRef=BswMModeCondition_014
        LogEx_Omc_IsInitialized (BswMLogicalExpression): BswMArgumentRef=BswMModeCondition_011
        Rule_Com_PduGroup3Enabled (BswMRule):
          BswMNestedExecutionOnly = false
          BswMRuleId = 5
          BswMRuleInitState = BSWM_FALSE
          BswMRuleExpressionRef = CC_LE_A_FlexRay_372befd6_RX
          BswMRuleTrueActionList = AL_COM_PDU_GROUP_3_ENABLED
          BswMRuleFalseActionList = AL_COM_PDU_GROUP_3_DISABLED
        CC_FrSMIndication_A_FlexRay_372befd6 (BswMModeRequestPort): BswMArbitrateOnInit=false, BswMRequestProcessing=BSWM_IMMEDIATE
          BswMModeRequestSource
            BswMFrSMIndication: BswMFrSMChannelRef=A_FlexRay_372befd6
          BswMModeInitValue
            BswMBswModeInitValue: BswMBswModeInitValueMode=FRSM_BSWM_READY
        BswMModeCondition_011 (BswMModeCondition): BswMConditionType=BSWM_EQUALS, BswMConditionMode=SwcModeNotification_Omc_LifeCycle
          BswMConditionValue
            BswMModeDeclaration: BswMModeValueRef=OMC_INITIALIZED
        Rule_NDC_Enable_Rx_Disable_Tx (BswMRule):
          BswMNestedExecutionOnly = false
          BswMRuleId = 17
          BswMRuleInitState = BSWM_FALSE
          BswMRuleExpressionRef = LogEx_NDC_Rx_Enabled_Tx_Disabled
          BswMRuleTrueActionList = AL_NDC_Enable_RX_Disable_TX_NORMAL
        CC_LE_A_FlexRay_372befd6_TX (BswMLogicalExpression): BswMLogicalOperator=BSWM_AND, BswMArgumentRef=CC_LE_FrSMIndication_A_FlexRay_372befd6_Online
        Rule_Start_StdDiag_Run_when_StdDiag_Init (BswMRule):
          BswMNestedExecutionOnly = false
          BswMRuleId = 25
          BswMRuleInitState = BSWM_FALSE
          BswMRuleExpressionRef = LogEx_StdDiag_IsInitialized
          BswMRuleTrueActionList = AL_Run_StdDiag
        Rule_Start_Systime_Run_when_Systime_Init (BswMRule):
          BswMNestedExecutionOnly = false
          BswMRuleId = 26
          BswMRuleInitState = BSWM_FALSE
          BswMRuleExpressionRef = LogEx_Start_Systime_Run_when_Systime_Init
          BswMRuleTrueActionList = AL_Rule_Start_Systime_Run_when_Systime_Init_True
        BswMModeCondition_027 (BswMModeCondition): BswMConditionType=BSWM_EQUALS, BswMConditionMode=StdDiag_ComControlModeRequest
          BswMConditionValue
            BswMBswMode: BswMBswRequestedMode=DISABLE_RX_ENABLE_TX_NORMAL
        BswMModeCondition_012 (BswMModeCondition): BswMConditionType=BSWM_EQUALS, BswMConditionMode=SwcModeNotification_Darh_LifeCycle
          BswMConditionValue
            BswMModeDeclaration: BswMModeValueRef=DARH_INITIALIZED
        Rule_Switch_StdDiagSessionChangeIndication (BswMRule):
          BswMNestedExecutionOnly = false
          BswMRuleId = 27
          BswMRuleInitState = BSWM_FALSE
          BswMRuleExpressionRef = LogEx_DiagSession_IsDefaultSession
          BswMRuleTrueActionList = AL_StdDiag_SessionChangeToDefaultSession
          BswMRuleFalseActionList = AL_StdDiag_SessionChangeToOtherSession
        BswMModeCondition_014 (BswMModeCondition): BswMConditionType=BSWM_EQUALS, BswMConditionMode=SwcModeNotification_Vin_LifeCycle
          BswMConditionValue
            BswMModeDeclaration: BswMModeValueRef=VIN_INITIALIZED
        LogEx_Dlog_IsInitialized (BswMLogicalExpression): BswMArgumentRef=BswMModeCondition_013
        BswMModeCondition_015 (BswMModeCondition): BswMConditionType=BSWM_EQUALS, BswMConditionMode=SwcModeNotification_StdDiag_LifeCycle
          BswMConditionValue
            BswMModeDeclaration: BswMModeValueRef=STDDIAG_INITIALIZED
        SwcModeNotification_Dlog_LifeCycle (BswMModeRequestPort): BswMArbitrateOnInit=false, BswMRequestProcessing=BSWM_DEFERRED
          BswMModeRequestSource
            BswMSwcModeNotification: BswMSwcModeNotificationModeDeclarationGroupPrototypeRef=Mode
          BswMModeInitValue
            BswMSwcModeInitValue: BswMSwcModeInitValueRef=DLOG_STOPPED
        BswMModeCondition_025 (BswMModeCondition): BswMConditionType=BSWM_EQUALS, BswMConditionMode=StdDiag_ComControlModeRequest
          BswMConditionValue
            BswMBswMode: BswMBswRequestedMode=ENABLE_RX_AND_TX_NORMAL
        SwcModeNotification_StdDiag_LifeCycle (BswMModeRequestPort): BswMArbitrateOnInit=false, BswMRequestProcessing=BSWM_DEFERRED
          BswMModeRequestSource
            BswMSwcModeNotification: BswMSwcModeNotificationModeDeclarationGroupPrototypeRef=Mode
          BswMModeInitValue
            BswMSwcModeInitValue: BswMSwcModeInitValueRef=STDDIAG_STOPPED
        CC_A_FlexRay_372befd6_TX (BswMRule):
          BswMNestedExecutionOnly = false
          BswMRuleId = 2
          BswMRuleInitState = BSWM_FALSE
          BswMRuleExpressionRef = CC_LE_A_FlexRay_372befd6_TX
          BswMRuleFalseActionList = CC_AL_A_FlexRay_372befd6_TX_Disable
          BswMRuleTrueActionList = CC_AL_A_FlexRay_372befd6_TX_EnableNoinit
        BswMModeCondition_013 (BswMModeCondition): BswMConditionType=BSWM_EQUALS, BswMConditionMode=SwcModeNotification_Dlog_LifeCycle
          BswMConditionValue
            BswMModeDeclaration: BswMModeValueRef=DLOG_INITIALIZED
        SwcModeNotification_SysTime_LifeCycle (BswMModeRequestPort): BswMArbitrateOnInit=false, BswMRequestProcessing=BSWM_DEFERRED
          BswMModeRequestSource
            BswMSwcModeNotification: BswMSwcModeNotificationModeDeclarationGroupPrototypeRef=Mode
          BswMModeInitValue
            BswMSwcModeInitValue: BswMSwcModeInitValueRef=SYSTIME_STOPPED
        LogEx_SysTime_IsInitialized (BswMLogicalExpression): BswMArgumentRef=BswMModeCondition_029
        BswMModeCondition_026 (BswMModeCondition): BswMConditionType=BSWM_EQUALS, BswMConditionMode=StdDiag_ComControlModeRequest
          BswMConditionValue
            BswMBswMode: BswMBswRequestedMode=ENABLE_RX_DISABLE_TX_NORMAL
        Rule_NDC_Enable_Rx_Enable_Tx (BswMRule):
          BswMNestedExecutionOnly = false
          BswMRuleId = 18
          BswMRuleInitState = BSWM_FALSE
          BswMRuleExpressionRef = LogEx_NDC_Rx_Enabled_Tx_Enabled
          BswMRuleTrueActionList = AL_NDC_Enable_RX_AND_TX_NORMAL
        CC_A_FlexRay_372befd6_RX (BswMRule):
          BswMNestedExecutionOnly = false
          BswMRuleId = 1
          BswMRuleInitState = BSWM_FALSE
          BswMRuleExpressionRef = CC_LE_A_FlexRay_372befd6_RX
          BswMRuleFalseActionList = CC_AL_A_FlexRay_372befd6_RX_Disable
          BswMRuleTrueActionList = CC_AL_A_FlexRay_372befd6_RX_EnableNoinit
        StdDiag_ComControlModeRequest (BswMModeRequestPort): BswMArbitrateOnInit=false, BswMRequestProcessing=BSWM_IMMEDIATE
          BswMModeRequestSource
            BswMSwcModeRequest: BswMSwcModeRequestPortInterfaceRef=StdDiag.ComControlModeRequestPort.requestedMode
          BswMModeInitValue
            BswMCompuScaleModeValue: BswMCompuConstText=DISABLE_RX_AND_TX_NORMAL, BswMCompuMethodRef=CM_NormalCommunicationModeType
        3 x BswMRule, all with BswMNestedExecutionOnly=false, BswMRuleInitState=BSWM_FALSE:
          Rule_Vin_Initialize: BswMRuleId=29, BswMRuleExpressionRef=LogEx_Vin_IsInitialized, BswMRuleTrueActionList=AL_Run_Vin
          Rule_NDC_Disable_Rx_Disable_Tx: BswMRuleId=15, BswMRuleExpressionRef=LogEx_NDC_Rx_Disabled_Tx_Disabled, BswMRuleTrueActionList=AL_NDC_Disable_Rx_And_Tx_Normal
          Rule_Com_PduGroup4Enabled: BswMRuleId=6, BswMRuleExpressionRef=CC_LE_A_FlexRay_372befd6_RX, BswMRuleTrueActionList=AL_COM_PDU_GROUP_4_ENABLED, BswMRuleFalseActionList=AL_COM_PDU_GROUP_4_DISABLED
        SwcModeNotification_Omc_LifeCycle (BswMModeRequestPort): BswMArbitrateOnInit=false, BswMRequestProcessing=BSWM_DEFERRED
          BswMModeRequestSource
            BswMSwcModeNotification: BswMSwcModeNotificationModeDeclarationGroupPrototypeRef=Mode
          BswMModeInitValue
            BswMSwcModeInitValue: BswMSwcModeInitValueRef=OMC_STOPPED
        SwcModeNotification_DcmDiagnosticSessionControl (BswMModeRequestPort): BswMArbitrateOnInit=false, BswMRequestProcessing=BSWM_DEFERRED
          BswMModeRequestSource
            BswMSwcModeNotification: BswMSwcModeNotificationModeDeclarationGroupPrototypeRef=DcmDiagnosticSessionControl
          BswMModeInitValue
            BswMSwcModeInitValue: BswMSwcModeInitValueRef=DEFAULT_SESSION
        LogEx_DiagSession_IsDefaultSession (BswMLogicalExpression): BswMArgumentRef=BswMModeCondition_028
        CC_Cond_FrSMIndication_A_FlexRay_372befd6_EQ_FRSM_BSWM_ONLINE_ECU_PASSIVE (BswMModeCondition): BswMConditionType=BSWM_EQUALS, BswMConditionMode=CC_FrSMIndication_A_FlexRay_372befd6
          BswMConditionValue
            BswMBswMode: BswMBswRequestedMode=FRSM_BSWM_ONLINE_ECU_PASSIVE
        LogEx_Darh_IsInitialized (BswMLogicalExpression): BswMArgumentRef=BswMModeCondition_012
        CC_LE_FrSMIndication_A_FlexRay_372befd6_Online (BswMLogicalExpression):
          BswMLogicalOperator = BSWM_OR
          BswMArgumentRef = CC_Cond_FrSMIndication_A_FlexRay_372befd6_EQ_FRSM_BSWM_ONLINE
          BswMArgumentRef = CC_Cond_FrSMIndication_A_FlexRay_372befd6_EQ_FRSM_BSWM_ONLINE_ECU_PASSIVE
        Rule_Dlog_Run (BswMRule):
          BswMNestedExecutionOnly = false
          BswMRuleId = 13
          BswMRuleInitState = BSWM_FALSE
          BswMRuleExpressionRef = LogEx_Dlog_IsInitialized
          BswMRuleTrueActionList = AL_Run_Dlog
        SwcModeNotification_Darh_LifeCycle (BswMModeRequestPort): BswMArbitrateOnInit=false, BswMRequestProcessing=BSWM_DEFERRED
          BswMModeRequestSource
            BswMSwcModeNotification: BswMSwcModeNotificationModeDeclarationGroupPrototypeRef=Mode
          BswMModeInitValue
            BswMSwcModeInitValue: BswMSwcModeInitValueRef=DARH_STOPPED
        Rule_NDC_Disable_Rx_Enable_Tx (BswMRule):
          BswMNestedExecutionOnly = false
          BswMRuleId = 16
          BswMRuleInitState = BSWM_FALSE
          BswMRuleExpressionRef = LogEx_NDC_Rx_Disabled_Tx_Enabled
          BswMRuleTrueActionList = AL_NDC_Disable_RX_Enable_TX_NORMAL
        SwcModeNotification_Vin_LifeCycle (BswMModeRequestPort): BswMArbitrateOnInit=false, BswMRequestProcessing=BSWM_DEFERRED
          BswMModeRequestSource
            BswMSwcModeNotification: BswMSwcModeNotificationModeDeclarationGroupPrototypeRef=Mode
          BswMModeInitValue
            BswMSwcModeInitValue: BswMSwcModeInitValueRef=VIN_STOPPED
        CC_Cond_FrSMIndication_A_FlexRay_372befd6_EQ_FRSM_BSWM_ONLINE (BswMModeCondition): BswMConditionType=BSWM_EQUALS, BswMConditionMode=CC_FrSMIndication_A_FlexRay_372befd6
          BswMConditionValue
            BswMBswMode: BswMBswRequestedMode=FRSM_BSWM_ONLINE
        CC_LE_A_FlexRay_372befd6_RX (BswMLogicalExpression): BswMLogicalOperator=BSWM_AND, BswMArgumentRef=CC_LE_FrSMIndication_A_FlexRay_372befd6_Online
        Rule_Darh_Run (BswMRule):
          BswMNestedExecutionOnly = false
          BswMRuleId = 8
          BswMRuleInitState = BSWM_FALSE
          BswMRuleExpressionRef = LogEx_Darh_IsInitialized
          BswMRuleTrueActionList = AL_Run_Darh
        SwcModeNotification_DcmEcuReset (BswMModeRequestPort): BswMArbitrateOnInit=false, BswMRequestProcessing=BSWM_DEFERRED
          BswMModeRequestSource
            BswMSwcModeNotification: BswMSwcModeNotificationModeDeclarationGroupPrototypeRef=DcmEcuReset
          BswMModeInitValue
            BswMSwcModeInitValue: BswMSwcModeInitValueRef=NONE
        BswMModeCondition_004 (BswMModeCondition): BswMConditionType=BSWM_EQUALS, BswMConditionMode=SwcModeNotification_DcmEcuReset
          BswMConditionValue
            BswMModeDeclaration: BswMModeValueRef=HARD
        LogEx_ECU_Hard_Reset (BswMLogicalExpression): BswMArgumentRef=BswMModeCondition_004
        Rule_Dcm_HardReset (BswMRule):
          BswMNestedExecutionOnly = false
          BswMRuleId = 10
          BswMRuleInitState = BSWM_FALSE
          BswMRuleExpressionRef = LogEx_IsDcmHardResetTimerExpired
          BswMRuleTrueActionList = AL_Dcm_ShutDown_HardReset
        BswMModeCondition_029 (BswMModeCondition): BswMConditionType=BSWM_EQUALS, BswMConditionMode=SwcModeNotification_SysTime_LifeCycle
          BswMConditionValue
            BswMModeDeclaration: BswMModeValueRef=SYSTIME_INITIALIZED
        BswM_ShutdownReason (BswMModeRequestPort): BswMArbitrateOnInit=false, BswMRequestProcessing=BSWM_FORCED_IMMEDIATE
          BswMModeRequestSource
            BswMGenericRequest: BswMModeRequesterId=1, BswMRequestedModeMax=4
              5 x BswMGenericRequestMode:
                Prog: BswMGenericRequestModeValue=0
                HardReset: BswMGenericRequestModeValue=1
                SoftReset: BswMGenericRequestModeValue=2
                Default: BswMGenericRequestModeValue=3
                SwtOff: BswMGenericRequestModeValue=4
          BswMModeInitValue
            BswMBswModeInitValue: BswMBswModeInitValueMode=Default
        BswMModeCondition_002 (BswMModeCondition): BswMConditionType=BSWM_EQUALS, BswMConditionMode=BswMSt
          BswMConditionValue
            BswMBswMode: BswMBswRequestedMode=PrepShtdwn
        BswMModeCondition: BswMConditionType=BSWM_EQUALS, BswMConditionMode=BswMSt
          BswMConditionValue
            BswMBswMode: BswMBswRequestedMode=GoOffOne
        SwcModeNotification_DcmCommunicationControl_ComMConf_ComMChannel_A_FlexRay_372befd6 (BswMModeRequestPort): BswMArbitrateOnInit=false, BswMRequestProcessing=BSWM_DEFERRED
          BswMModeRequestSource
            BswMSwcModeNotification: BswMSwcModeNotificationModeDeclarationGroupPrototypeRef=DcmCommunicationControl_ComMConf_ComMChannel_A_FlexRay_372befd6
          BswMModeInitValue
            BswMSwcModeInitValue: BswMSwcModeInitValueRef=DCM_ENABLE_RX_TX_NORM_NM
        4 x BswMModeCondition, all with BswMConditionType=BSWM_EQUALS, BswMConditionMode=SwcModeNotification_DcmCommunicationControl_ComMConf_ComMChannel_A_FlexRay_372befd6:
          BswMModeCondition_001
            BswMConditionValue
              BswMModeDeclaration: BswMModeValueRef=DCM_ENABLE_RX_TX_NORM_NM
          BswMModeCondition_003
            BswMConditionValue
              BswMModeDeclaration: BswMModeValueRef=DCM_ENABLE_RX_TX_NORM
          BswMModeCondition_005
            BswMConditionValue
              BswMModeDeclaration: BswMModeValueRef=DCM_ENABLE_RX_DISABLE_TX_NORM_NM
          BswMModeCondition_008
            BswMConditionValue
              BswMModeDeclaration: BswMModeValueRef=DCM_ENABLE_RX_DISABLE_TX_NORM
        LogEx_NDC_Dcm_Rx_Enabled (BswMLogicalExpression):
          BswMLogicalOperator = BSWM_OR
          BswMArgumentRef = BswMModeCondition_008
          BswMArgumentRef = BswMModeCondition_005
          BswMArgumentRef = BswMModeCondition_003
          BswMArgumentRef = BswMModeCondition_001
        BswMModeCondition_010 (BswMModeCondition): BswMConditionType=BSWM_EQUALS, BswMConditionMode=SwcModeNotification_DcmCommunicationControl_ComMConf_ComMChannel_A_FlexRay_372befd6
          BswMConditionValue
            BswMModeDeclaration: BswMModeValueRef=DCM_DISABLE_RX_ENABLE_TX_NORM_NM
        BswMModeCondition_030 (BswMModeCondition): BswMConditionType=BSWM_EQUALS, BswMConditionMode=SwcModeNotification_DcmCommunicationControl_ComMConf_ComMChannel_A_FlexRay_372befd6
          BswMConditionValue
            BswMModeDeclaration: BswMModeValueRef=DCM_DISABLE_RX_ENABLE_TX_NORM
        11 x BswMLogicalExpression:
          LogEx_NDC_Dcm_Tx_Enabled: BswMLogicalOperator=BSWM_OR, BswMArgumentRef=BswMModeCondition_030, BswMArgumentRef=BswMModeCondition_010, BswMArgumentRef=BswMModeCondition_003, BswMArgumentRef=BswMModeCondition_001
          LogEx_NDC_StdDiag_Rx_Enabled: BswMLogicalOperator=BSWM_OR, BswMArgumentRef=BswMModeCondition_025, BswMArgumentRef=BswMModeCondition_026
          LogEx_NDC_StdDiag_Tx_Enabled: BswMLogicalOperator=BSWM_OR, BswMArgumentRef=BswMModeCondition_027, BswMArgumentRef=BswMModeCondition_025
          LogEx_NDC_Rx_Disabled: BswMLogicalOperator=BSWM_NAND, BswMArgumentRef=LogEx_NDC_Dcm_Rx_Enabled, BswMArgumentRef=LogEx_NDC_StdDiag_Rx_Enabled
          LogEx_NDC_Tx_Disabled: BswMLogicalOperator=BSWM_NAND, BswMArgumentRef=LogEx_NDC_Dcm_Tx_Enabled, BswMArgumentRef=LogEx_NDC_StdDiag_Tx_Enabled
          LogEx_NDC_Tx_Enabled: BswMLogicalOperator=BSWM_AND, BswMArgumentRef=LogEx_NDC_Dcm_Tx_Enabled, BswMArgumentRef=LogEx_NDC_StdDiag_Tx_Enabled
          LogEx_NDC_Rx_Disabled_Tx_Disabled: BswMLogicalOperator=BSWM_AND, BswMArgumentRef=LogEx_NDC_Rx_Disabled, BswMArgumentRef=LogEx_NDC_Tx_Disabled
          LogEx_NDC_Rx_Disabled_Tx_Enabled: BswMLogicalOperator=BSWM_AND, BswMArgumentRef=LogEx_NDC_Rx_Disabled, BswMArgumentRef=LogEx_NDC_Tx_Enabled
          LogEx_NDC_Rx_Enabled: BswMLogicalOperator=BSWM_AND, BswMArgumentRef=LogEx_NDC_Dcm_Rx_Enabled, BswMArgumentRef=LogEx_NDC_StdDiag_Rx_Enabled
          LogEx_NDC_Rx_Enabled_Tx_Disabled: BswMLogicalOperator=BSWM_AND, BswMArgumentRef=LogEx_NDC_Rx_Enabled, BswMArgumentRef=LogEx_NDC_Tx_Disabled
          LogEx_NDC_Rx_Enabled_Tx_Enabled: BswMLogicalOperator=BSWM_AND, BswMArgumentRef=LogEx_NDC_Rx_Enabled, BswMArgumentRef=LogEx_NDC_Tx_Enabled
        3 x BswMModeCondition, all with BswMConditionType=BSWM_EQUALS:
          BswMModeCondition_017: BswMConditionMode=SwcModeNotification_StdDiag_LifeCycle
            BswMConditionValue
              BswMModeDeclaration: BswMModeValueRef=STDDIAG_STOPPED
          BswMModeCondition_018: BswMConditionMode=SwcModeNotification_Dlog_LifeCycle
            BswMConditionValue
              BswMModeDeclaration: BswMModeValueRef=DLOG_RUNNING
          BswMModeCondition_019: BswMConditionMode=SwcModeNotification_Omc_LifeCycle
            BswMConditionValue
              BswMModeDeclaration: BswMModeValueRef=OMC_RUNNING
        LogEx_Start_StdDiag_Init_when_Omc_Run_and_Dlog_Run (BswMLogicalExpression): BswMLogicalOperator=BSWM_AND, BswMArgumentRef=BswMModeCondition_019, BswMArgumentRef=BswMModeCondition_018, BswMArgumentRef=BswMModeCondition_017
        Rule_Start_StdDiag_Init_when_Omc_Run (BswMRule):
          BswMNestedExecutionOnly = false
          BswMRuleId = 24
          BswMRuleInitState = BSWM_FALSE
          BswMRuleExpressionRef = LogEx_Start_StdDiag_Init_when_Omc_Run_and_Dlog_Run
          BswMRuleTrueActionList = AL_Initialize_StdDiag
        BswMModeCondition_020 (BswMModeCondition): BswMConditionType=BSWM_EQUALS, BswMConditionMode=SwcModeNotification_DcmEcuReset
          BswMConditionValue
            BswMModeDeclaration: BswMModeValueRef=EXECUTE
        LogEx_DcmEcuReset (BswMLogicalExpression): BswMLogicalOperator=BSWM_AND, BswMArgumentRef=BswMModeCondition_020, BswMArgumentRef=BswMModeCondition_038
        Rule_Dcm_EcuResetForReprogramming (BswMRule):
          BswMNestedExecutionOnly = false
          BswMRuleId = 9
          BswMRuleInitState = BSWM_FALSE
          BswMRuleExpressionRef = LogEx_DcmEcuReset
          BswMRuleTrueActionList = AL_Dcm_ShutDown_EcuReset
        BswMModeCondition_021 (BswMModeCondition): BswMConditionType=BSWM_EQUALS, BswMConditionMode=SwcModeNotification_SysTime_LifeCycle
          BswMConditionValue
            BswMModeDeclaration: BswMModeValueRef=SYSTIME_STOPPED
        LogEx_Set_Systime_Init (BswMLogicalExpression): BswMArgumentRef=BswMModeCondition_021
        Rule_Systime_Init (BswMRule):
          BswMNestedExecutionOnly = false
          BswMRuleId = 28
          BswMRuleInitState = BSWM_FALSE
          BswMRuleExpressionRef = LogEx_Set_Systime_Init
          BswMRuleTrueActionList = AL_Rule_Systime_Init_True
        LogEx_Start_Systime_Run_when_Systime_Init (BswMLogicalExpression): BswMLogicalOperator=BSWM_AND, BswMArgumentRef=LogEx_SysTime_IsInitialized, BswMArgumentRef=CC_LE_FrSMIndication_A_FlexRay_372befd6_Online
        SwcModeNotification_Coding_LifeCycle (BswMModeRequestPort): BswMArbitrateOnInit=false, BswMRequestProcessing=BSWM_DEFERRED
          BswMModeRequestSource
            BswMSwcModeNotification: BswMSwcModeNotificationModeDeclarationGroupPrototypeRef=Mode
          BswMModeInitValue
            BswMSwcModeInitValue: BswMSwcModeInitValueRef=CODING_STOPPED
        BswMModeCondition_022 (BswMModeCondition): BswMConditionType=BSWM_EQUALS, BswMConditionMode=SwcModeNotification_Coding_LifeCycle
          BswMConditionValue
            BswMModeDeclaration: BswMModeValueRef=CODING_STOPPED
        LogEx_Coding_IsReadyToInit (BswMLogicalExpression):
          BswMLogicalOperator = BSWM_AND
          BswMArgumentRef = BswMModeCondition_022
          BswMArgumentRef = BswMModeCondition_018
          BswMArgumentRef = LogEx_IsNvmReadAllCompleted
        NvMBlock_Rte_NvmBlock_Coding_CodingData (BswMModeRequestPort): BswMArbitrateOnInit=false, BswMRequestProcessing=BSWM_DEFERRED
          BswMModeRequestSource
            BswMNvMRequest: BswMNvMBlockRef=Rte_NvmBlock_Coding_CodingData
          BswMModeInitValue
            BswMBswModeInitValue: BswMBswModeInitValueMode=NVM_REQ_OK
        BswMModeCondition_023 (BswMModeCondition): BswMConditionType=BSWM_EQUALS, BswMConditionMode=NvMBlock_Rte_NvmBlock_Coding_CodingData
          BswMConditionValue
            BswMBswMode: BswMBswRequestedMode=NVM_REQ_OK
        BswMModeCondition_024 (BswMModeCondition): BswMConditionType=BSWM_EQUALS, BswMConditionMode=NvMBlock_Rte_NvmBlock_Coding_CodingData
          BswMConditionValue
            BswMBswMode: BswMBswRequestedMode=NVM_REQ_RESTORED_FROM_ROM
        LogEx_CodingNvmBlockRead (BswMLogicalExpression): BswMLogicalOperator=BSWM_OR, BswMArgumentRef=BswMModeCondition_023, BswMArgumentRef=BswMModeCondition_024
        Rule_Coding_Init (BswMRule):
          BswMNestedExecutionOnly = false
          BswMRuleId = 3
          BswMRuleInitState = BSWM_FALSE
          BswMRuleExpressionRef = LogEx_Coding_IsReadyToInit
          BswMRuleTrueActionList = AL_Initialize_Coding
        BswMModeCondition_028 (BswMModeCondition): BswMConditionType=BSWM_EQUALS, BswMConditionMode=SwcModeNotification_DcmDiagnosticSessionControl
          BswMConditionValue
            BswMModeDeclaration: BswMModeValueRef=DEFAULT_SESSION
        NvmJobModeIndication_NvmReadAllCompleted (BswMModeRequestPort): BswMArbitrateOnInit=false, BswMRequestProcessing=BSWM_DEFERRED
          BswMModeRequestSource
            BswMNvMJobModeIndication: BswMNvmService=NvmReadAll
          BswMModeInitValue
            BswMBswModeInitValue: BswMBswModeInitValueMode=NVM_REQ_OK
        LogEx_IsNvmReadAllCompleted (BswMLogicalExpression): BswMArgumentRef=BswMModeCondition_039
        BswMModeCondition_031 (BswMModeCondition): BswMConditionType=BSWM_EQUALS, BswMConditionMode=SwcModeNotification_Dlog_LifeCycle
          BswMConditionValue
            BswMModeDeclaration: BswMModeValueRef=DLOG_STOPPED
        LogEx_IsDlogReadyToBeInitialized (BswMLogicalExpression): BswMLogicalOperator=BSWM_AND, BswMArgumentRef=BswMModeCondition_031
        Rule_Dlog_Init (BswMRule):
          BswMNestedExecutionOnly = false
          BswMRuleId = 12
          BswMRuleInitState = BSWM_FALSE
          BswMRuleExpressionRef = LogEx_IsDlogReadyToBeInitialized
          BswMRuleTrueActionList = AL_Initialize_Dlog
        LogEx_Set_DarhReportError_due_ComM_and_CEL_mode (BswMLogicalExpression): BswMLogicalOperator=BSWM_AND, BswMArgumentRef=BswMModeCondition_034, BswMArgumentRef=LogEx_IsFullComEnabled
        LogEx_IsFullComEnabled (BswMLogicalExpression): BswMLogicalOperator=BSWM_OR, BswMArgumentRef=BswMModeCondition_033, BswMArgumentRef=BswMModeCondition_032
        BswMModeCondition_032 (BswMModeCondition): BswMConditionType=BSWM_EQUALS, BswMConditionMode=CC_FrSMIndication_A_FlexRay_372befd6
          BswMConditionValue
            BswMBswMode: BswMBswRequestedMode=FRSM_BSWM_ONLINE_PASSIVE
        BswMModeCondition_033 (BswMModeCondition): BswMConditionType=BSWM_EQUALS, BswMConditionMode=CC_FrSMIndication_A_FlexRay_372befd6
          BswMConditionValue
            BswMBswMode: BswMBswRequestedMode=FRSM_BSWM_ONLINE
        SWCModeSwitch_currentCentralErrorLockMode (BswMModeRequestPort): BswMArbitrateOnInit=false, BswMRequestProcessing=BSWM_DEFERRED
          BswMModeRequestSource
            BswMSwcModeNotification: BswMSwcModeNotificationModeDeclarationGroupPrototypeRef=currentCentralErrorLockMode
          BswMModeInitValue
            BswMSwcModeInitValue: BswMSwcModeInitValueRef=STM_CEL_INVALID
        BswMModeCondition_034 (BswMModeCondition): BswMConditionType=BSWM_EQUALS_NOT, BswMConditionMode=SWCModeSwitch_currentCentralErrorLockMode
          BswMConditionValue
            BswMModeDeclaration: BswMModeValueRef=STM_CEL_INVALID
        Rule_Set_DarhReportError_due_ComM_and_CEL_mode (BswMRule):
          BswMNestedExecutionOnly = false
          BswMRuleId = 23
          BswMRuleInitState = BSWM_UNDEFINED
          BswMRuleExpressionRef = LogEx_Set_DarhReportError_due_ComM_and_CEL_mode
          BswMRuleTrueActionList = AL_Set_DarhReportError_due_ComM_and_CEL_mode_BswMActionList_True
          BswMRuleFalseActionList = AL_Set_DarhReportError_due_ComM_and_CEL_mode_BswMActionList_False
        BswMModeCondition_035 (BswMModeCondition): BswMConditionType=BSWM_EQUALS, BswMConditionMode=SwcModeNotification_Darh_LifeCycle
          BswMConditionValue
            BswMModeDeclaration: BswMModeValueRef=DARH_STOPPED
        LogEx_IsDarhReadyToBeInitialized (BswMLogicalExpression): BswMLogicalOperator=BSWM_AND, BswMArgumentRef=BswMModeCondition_035
        Rule_Darh_Init (BswMRule):
          BswMNestedExecutionOnly = false
          BswMRuleId = 7
          BswMRuleInitState = BSWM_FALSE
          BswMRuleExpressionRef = LogEx_IsDarhReadyToBeInitialized
          BswMRuleTrueActionList = AL_Initialize_Darh
        BswMModeCondition_036 (BswMModeCondition): BswMConditionType=BSWM_EQUALS, BswMConditionMode=SwcModeNotification_DcmDiagnosticSessionControl
          BswMConditionValue
            BswMModeDeclaration: BswMModeValueRef=CODING_SESSION
        LogEx_IsCodingSession (BswMLogicalExpression): BswMArgumentRef=BswMModeCondition_036
        Dcm_HardResetTimer (BswMModeRequestPort): BswMArbitrateOnInit=false, BswMRequestProcessing=BSWM_DEFERRED
          BswMModeRequestSource
            BswMTimer
          BswMModeInitValue
            BswMBswModeInitValue: BswMBswModeInitValueMode=BSWM_TIMER_STOPPED
        BswMModeCondition_037 (BswMModeCondition): BswMConditionType=BSWM_EQUALS, BswMConditionMode=Dcm_HardResetTimer
          BswMConditionValue
            BswMBswMode: BswMBswRequestedMode=BSWM_TIMER_EXPIRED
        LogEx_IsDcmHardResetTimerExpired (BswMLogicalExpression): BswMArgumentRef=BswMModeCondition_037
        Rule_Dcm_HardResetStartTimer (BswMRule):
          BswMNestedExecutionOnly = false
          BswMRuleId = 11
          BswMRuleInitState = BSWM_FALSE
          BswMRuleExpressionRef = LogEx_ECU_Hard_Reset
          BswMRuleTrueActionList = AL_Dcm_HardResetStartTimer
        3 x BswMModeCondition:
          BswMModeCondition_038: BswMConditionType=BSWM_EQUALS, BswMConditionMode=SwcModeNotification_DcmDiagnosticSessionControl
            BswMConditionValue
              BswMModeDeclaration: BswMModeValueRef=PROGRAMMING_SESSION
          BswMModeCondition_039: BswMConditionType=BSWM_EQUALS_NOT, BswMConditionMode=NvmJobModeIndication_NvmReadAllCompleted
            BswMConditionValue
              BswMBswMode: BswMBswRequestedMode=NVM_REQ_PENDING
          BswMModeCondition_016: BswMConditionType=BSWM_EQUALS, BswMConditionMode=SwcModeNotification_Coding_LifeCycle
            BswMConditionValue
              BswMModeDeclaration: BswMModeValueRef=CODING_INITIALIZED
        LogEx_Coding_IsReadyToRun (BswMLogicalExpression): BswMArgumentRef=BswMModeCondition_016
        Rule_Coding_Run (BswMRule):
          BswMNestedExecutionOnly = false
          BswMRuleId = 4
          BswMRuleInitState = BSWM_FALSE
          BswMRuleExpressionRef = LogEx_Coding_IsReadyToRun
          BswMRuleTrueActionList = AL_Run_Coding
        BswMModeCondition_040 (BswMModeCondition): BswMConditionType=BSWM_EQUALS, BswMConditionMode=SwcModeNotification_Coding_LifeCycle
          BswMConditionValue
            BswMModeDeclaration: BswMModeValueRef=CODING_RUNNING
        LogEx_CodingStopRequired (BswMLogicalExpression): BswMLogicalOperator=BSWM_OR, BswMArgumentRef=BswMModeCondition_016, BswMArgumentRef=BswMModeCondition_040
        Rule_Coding_BusComSwitch (BswMRule):
          BswMNestedExecutionOnly = false
          BswMRuleId = 0
          BswMRuleInitState = BSWM_FALSE
          BswMRuleExpressionRef = LogEx_IsFullComEnabled
          BswMRuleTrueActionList = AL_Coding_BusComOn
          BswMRuleFalseActionList = AL_Coding_BusComOff
      BswMModeControl: BswMInitActionListRef=INIT_AL_Initialize
        4 x BswMActionList:
          AL_Run: BswMActionListExecution=BSWM_TRIGGER
          AL_GoOffOne: BswMActionListExecution=BSWM_CONDITION
            A_NvMWriteAll (BswMActionListItem): BswMAbortOnFail=false, BswMActionListItemIndex=0, BswMActionListItemRef=BswMModeControl/A_NvMWriteAll
            A_BswM_FinalizeShtdwn (BswMActionListItem): BswMAbortOnFail=false, BswMActionListItemIndex=1, BswMActionListItemRef=BswMModeControl/A_BswM_FinalizeShtdwn
          AL_PrepShtdwn: BswMActionListExecution=BSWM_CONDITION
            11 x BswMActionListItem, all with BswMAbortOnFail=false:
              A_ShtdwnHndlg_PrepShtdwn: BswMActionListItemIndex=8, BswMActionListItemRef=BswMModeControl/A_ShtdwnHndlg_PrepShtdwn
              A_DiagcMgrPwrDwn: BswMActionListItemIndex=9, BswMActionListItemRef=BswMModeControl/A_DiagcMgrPwrDwn
              A_GetResource_ShutdownOngoing: BswMActionListItemIndex=7, BswMActionListItemRef=BswMModeControl/A_GetResource_ShutdownOngoing
              ChgMod_GoOffOne: BswMActionListItemIndex=10, BswMActionListItemRef=BswMModeControl/ChgMod_GoOffOne
              AL_Stop_Darh: BswMActionListItemIndex=0, BswMActionListItemRef=BswMModeControl/AL_Stop_Darh
              AL_Stop_Omc: BswMActionListItemIndex=2, BswMActionListItemRef=BswMModeControl/AL_Stop_Omc
              AL_Stop_StdDiag: BswMActionListItemIndex=3, BswMActionListItemRef=BswMModeControl/AL_Stop_StdDiag
              AL_Stop_Dlog: BswMActionListItemIndex=1, BswMActionListItemRef=BswMModeControl/AL_Stop_Dlog
              AL_Stop_Vin: BswMActionListItemIndex=5, BswMActionListItemRef=BswMModeControl/AL_Stop_Vin
              AL_Stop_SysTime: BswMActionListItemIndex=4, BswMActionListItemRef=BswMModeControl/AL_Stop_SysTime
              AL_Stop_Coding: BswMActionListItemIndex=6, BswMActionListItemRef=BswMModeControl/AL_Stop_Coding
          AL_Rstrt: BswMActionListExecution=BSWM_TRIGGER
            3 x BswMActionListItem, all with BswMAbortOnFail=false:
              ChgMod_Run: BswMActionListItemIndex=1, BswMActionListItemRef=BswMModeControl/ChgMod_Run
              A_Init_Dem: BswMActionListItemIndex=0, BswMActionListItemRef=BswMModeControl/A_Init_Dem
              A_BswMRstrt: BswMActionListItemIndex=2, BswMActionListItemRef=BswMModeControl/A_BswMRstrt
        24 x BswMAction:
          ChgMod_GoOffOne
            BswMAvailableActions
              BswMGenericModeSwitch: BswMGenericRequestRef=BswMSt, BswMGenericRequestModeRef=GoOffOne
          ChgMod_PrepShtdwn
            BswMAvailableActions
              BswMGenericModeSwitch: BswMGenericRequestRef=BswMSt, BswMGenericRequestModeRef=PrepShtdwn
          ChgMod_Run
            BswMAvailableActions
              BswMGenericModeSwitch: BswMGenericRequestRef=BswMSt, BswMGenericRequestModeRef=Run
          A_NvMWriteAll
            BswMAvailableActions
              BswMUserCallout: BswMUserCalloutFunction=BswM_SHUTDOWN_NvMWriteAll(), BswMCreateCallout=true
          A_BswM_FinalizeShtdwn
            BswMAvailableActions
              BswMUserCallout: BswMUserCalloutFunction=BswM_FinalizeShtdwn(), BswMCreateCallout=true, BswMUserIncludeFile=Os.h
          A_Init_Fee
            BswMAvailableActions
              BswMUserCallout: BswMUserCalloutFunction=Fee_30_SmallSector_Init(), BswMCreateCallout=false, BswMUserIncludeFile=Fee_30_SmallSector.h
          A_Init_NvMReadAll
            BswMAvailableActions
              BswMUserCallout: BswMUserCalloutFunction=BswM_INIT_NvMReadAll(), BswMCreateCallout=true, BswMUserIncludeFile=Fls.h
          A_Init_NvM
            BswMAvailableActions
              BswMUserCallout: BswMUserCalloutFunction=NvM_Init(), BswMCreateCallout=false, BswMUserIncludeFile=NvM.h
          A_RteStrt
            BswMAvailableActions
              BswMUserCallout: BswMUserCalloutFunction=Rte_Start(), BswMCreateCallout=false, BswMUserIncludeFile=Rte_Main.h
          A_ShtdwnHndlg_PrepShtdwn
            BswMAvailableActions
              BswMUserCallout: BswMUserCalloutFunction=BswM_ShtdwnHndlg_PrepShutdown(), BswMCreateCallout=true
          A_Init_Dem
            BswMAvailableActions
              BswMUserCallout: BswMUserCalloutFunction=Dem_Init(NULL_PTR), BswMCreateCallout=false, BswMUserIncludeFile=Dem.h
          A_BswMRstrt
            BswMAvailableActions
              BswMUserCallout: BswMUserCalloutFunction=BswM_Restart(), BswMCreateCallout=true
          A_DemShtdwn
            BswMAvailableActions
              BswMUserCallout: BswMUserCalloutFunction=Dem_Shutdown(), BswMCreateCallout=false, BswMUserIncludeFile=Dem.h
          A_DiagcMgrPwrDwn
            BswMAvailableActions
              BswMUserCallout: BswMUserCalloutFunction=BswM_DiagcMgrPwrDwn(), BswMCreateCallout=true, BswMUserIncludeFile=DiagcMgr.h
          A_GetResource_ShutdownOngoing
            BswMAvailableActions
              BswMUserCallout: BswMUserCalloutFunction=BwmM_GetShutdownOngoing(), BswMCreateCallout=true
          A_EnableMotCtrlIsr
            BswMAvailableActions
              BswMUserCallout:
                BswMUserCalloutFunction = Os_ModifyPeripheral32(InterruptController, (uint32 *)0xFFFEEAF0U, 0xFFFEFFFFU, 0x0U)
                BswMCreateCallout = false
                BswMUserIncludeFile = Os.h
                BswMUserCode = 
          A_EnaOsTmr
            BswMAvailableActions
              BswMUserCallout: BswMUserCalloutFunction=OSTM0TS = 1U, BswMCreateCallout=false, BswMUserIncludeFile=ostm_regs.h
          A_GuardCfgAndDiagcInit1
            BswMAvailableActions
              BswMUserCallout: BswMUserCalloutFunction=GuardCfgAndDiagcInit1(), BswMCreateCallout=false, BswMCalloutParameterList=, BswMUserIncludeFile=CDD_GuardCfgAndDiagc.h
          A_Init_SyncCrc
            BswMAvailableActions
              BswMUserCallout: BswMUserCalloutFunction=SyncCrcInit0(), BswMCreateCallout=false, BswMUserIncludeFile=CDD_SyncCrc.h
          A_Init_FlsMem
            BswMAvailableActions
              BswMUserCallout: BswMUserCalloutFunction=FlsMemInit2(), BswMCreateCallout=false, BswMUserIncludeFile=CDD_FlsMem.h
          A_Init_WdgM
            BswMAvailableActions
              BswMUserCallout: BswMUserCalloutFunction=Os_Call_NxtrWdgM_Init(), BswMCreateCallout=false, BswMUserIncludeFile=Os.h
          A_RTE_SWITCH_StdDiagSessionChangeIndicationPort_STDDIAG_OTHER_SESSION
            BswMAvailableActions
              BswMRteSwitch: BswMSwitchedMode=STDDIAG_OTHER_SESSION, BswMRteSwitchPortRef=StdDiagSessionChangeIndicationPort
          INIT_Action_FrXcp_Init
            BswMAvailableActions
              BswMUserCallout: BswMUserCalloutFunction=FrXcp_Init(NULL_PTR), BswMCreateCallout=false, BswMUserIncludeFile=FrXcp.h
          A_RTE_REQUEST_SysTime_LifeCycle_RequestPort_SYSTIME_STOPPED
            BswMAvailableActions
              BswMRteModeRequest: BswMRequestedMode=SYSTIME_STOPPED, BswMRteModeRequestPortRef=MSRP_SysTime
        MSRP_Omc (BswMRteModeRequestPort): BswMRteModeRequestPortInterfaceRef=Omc.LifeCycleRequest.requestMode
        CC_AL_A_FlexRay_372befd6_RX_EnableNoinit (BswMActionList): BswMActionListExecution=BSWM_TRIGGER
          10 x BswMActionListItem, all with BswMAbortOnFail=false:
            CC_EnablePDUGroup_EPS_IN_PduGroup: BswMActionListItemIndex=0, BswMActionListItemRef=BswMModeControl/CC_EnablePDUGroup_EPS_IN_PduGroup
            CC_EnablePDUGroup_EPS_IN_PduGroup2: BswMActionListItemIndex=1, BswMActionListItemRef=BswMModeControl/CC_EnablePDUGroup_EPS_IN_PduGroup2
            CC_EnablePDUGroup_EPS_IN_PduGroup3: BswMActionListItemIndex=2, BswMActionListItemRef=BswMModeControl/CC_EnablePDUGroup_EPS_IN_PduGroup3
            CC_EnablePDUGroup_EPS_IN_PduGroup4: BswMActionListItemIndex=3, BswMActionListItemRef=BswMModeControl/CC_EnablePDUGroup_EPS_IN_PduGroup4
            CC_EnablePDUGroup_EPS_IN_PduGroup5: BswMActionListItemIndex=4, BswMActionListItemRef=BswMModeControl/CC_EnablePDUGroup_EPS_IN_PduGroup5
            CC_EnablePDUGroup_EPS_IN_PduGroup6: BswMActionListItemIndex=5, BswMActionListItemRef=BswMModeControl/CC_EnablePDUGroup_EPS_IN_PduGroup6
            CC_EnablePDUGroup_EPS_IN_PduGroup7: BswMActionListItemIndex=6, BswMActionListItemRef=BswMModeControl/CC_EnablePDUGroup_EPS_IN_PduGroup7
            CC_EnablePDUGroup_EPS_IN_PduGroup8: BswMActionListItemIndex=7, BswMActionListItemRef=BswMModeControl/CC_EnablePDUGroup_EPS_IN_PduGroup8
            CC_EnablePDUGroup_EPS_IN_PduGroup9: BswMActionListItemIndex=8, BswMActionListItemRef=BswMModeControl/CC_EnablePDUGroup_EPS_IN_PduGroup9
            CC_EnablePDUGroup_EPS_IN_PduGroup10: BswMActionListItemIndex=9, BswMActionListItemRef=BswMModeControl/CC_EnablePDUGroup_EPS_IN_PduGroup10
        3 x BswMAction:
          A_RTE_REQUEST_Darh_LifeCycle_RequestPort_DARH_INITIALIZED
            BswMAvailableActions
              BswMRteModeRequest: BswMRequestedMode=DARH_INITIALIZED, BswMRteModeRequestPortRef=MSRP_Darh
          INIT_Action_Fr_Init
            BswMAvailableActions
              BswMUserCallout: BswMUserCalloutFunction=Fr_Init(&Fr_Config), BswMCreateCallout=false, BswMUserIncludeFile=Fr.h
          CC_DisablePDUGroup_EPS_IN_PduGroup4  # Annotation PLAIN_TEXT BAC Stm needs to get notified if this group is disabled. Make sure that when this action gets executed, also to execute action "RTE_SWITCH_ErrorMemoryLockSignalReceptionSwitchPort_EM_LOCK_NOT_RECEIVABLE".
            BswMAvailableActions
              BswMPduGroupSwitch: BswMPduGroupSwitchReinit=false, BswMDisabledPduGroupRef=EPS_IN_PduGroup4
        AL_Stop_SysTime (BswMActionList): BswMActionListExecution=BSWM_TRIGGER
          A_RTE_REQUEST_SysTime_LifeCycle_RequestPort_SYSTIME_STOPPED (BswMActionListItem):
            BswMAbortOnFail = false
            BswMActionListItemIndex = 0
            BswMActionListItemRef = BswMModeControl/A_RTE_REQUEST_SysTime_LifeCycle_RequestPort_SYSTIME_STOPPED
        4 x BswMAction:
          INIT_Action_EnableInterrupts
            BswMAvailableActions
              BswMUserCallout: BswMUserCalloutFunction=BswM_AL_SetProgrammableInterrupts(), BswMCreateCallout=true
          A_RTE_SWITCH_ErrorMemoryLockSignalReceptionSwitchPort_EM_LOCK_NOT_RECEIVABLE
            BswMAvailableActions
              BswMRteSwitch: BswMSwitchedMode=EM_LOCK_NOT_RECEIVABLE, BswMRteSwitchPortRef=ErrorMemoryLockSignalReceptionSwitchPort
          A_RTE_REQUEST_Darh_LifeCycle_RequestPort_DARH_RUNNING
            BswMAvailableActions
              BswMRteModeRequest: BswMRequestedMode=DARH_RUNNING, BswMRteModeRequestPortRef=MSRP_Darh
          INIT_Action_IpduM_Init
            BswMAvailableActions
              BswMUserCallout: BswMUserCalloutFunction=IpduM_Init(IpduM_Config_Ptr), BswMCreateCallout=false, BswMUserIncludeFile=IpduM.h
        AL_Run_Vin (BswMActionList): BswMActionListExecution=BSWM_TRIGGER
          A_RTE_REQUEST_Vin_LifeCycle_RequestPort_VIN_RUNNING (BswMActionListItem): BswMAbortOnFail=false, BswMActionListItemIndex=0, BswMActionListItemRef=BswMModeControl/A_RTE_REQUEST_Vin_LifeCycle_RequestPort_VIN_RUNNING
        CC_DisablePDUGroup_EPS_IN_PduGroup2 (BswMAction)
          BswMAvailableActions
            BswMPduGroupSwitch: BswMPduGroupSwitchReinit=false, BswMDisabledPduGroupRef=EPS_IN_PduGroup2
        AL_Initialize_Darh (BswMActionList): BswMActionListExecution=BSWM_TRIGGER
          A_RTE_REQUEST_Darh_LifeCycle_RequestPort_DARH_INITIALIZED (BswMActionListItem):
            BswMAbortOnFail = false
            BswMActionListItemIndex = 0
            BswMActionListItemRef = BswMModeControl/A_RTE_REQUEST_Darh_LifeCycle_RequestPort_DARH_INITIALIZED
        CC_EnablePDUGroup_EPS_IN_PduGroup3 (BswMAction)  # Annotation PLAIN_TEXT BAC Vin needs to get notified if this group is enabled. Make sure that when this action gets executed, also to execute action "RTE_SWITCH_VinComSwitchPort_VIN_VINCOMON".
          BswMAvailableActions
            BswMPduGroupSwitch: BswMPduGroupSwitchReinit=false, BswMEnabledPduGroupRef=EPS_IN_PduGroup3
        3 x BswMActionList, all with BswMActionListExecution=BSWM_TRIGGER:
          AL_StdDiag_SessionChangeToDefaultSession
            A_RTE_SWITCH_StdDiagSessionChangeIndicationPort_STDDIAG_DEFAULT_SESSION (BswMActionListItem):
              BswMAbortOnFail = false
              BswMActionListItemIndex = 0
              BswMActionListItemRef = BswMModeControl/A_RTE_SWITCH_StdDiagSessionChangeIndicationPort_STDDIAG_DEFAULT_SESSION
          AL_Run_Dlog
            A_RTE_REQUEST_Dlog_LifeCycle_RequestPort_DLOG_RUNNING (BswMActionListItem): BswMAbortOnFail=false, BswMActionListItemIndex=0, BswMActionListItemRef=BswMModeControl/A_RTE_REQUEST_Dlog_LifeCycle_RequestPort_DLOG_RUNNING
          AL_Stop_Darh
            A_RTE_REQUEST_Darh_LifeCycle_RequestPort_DARH_STOPPED (BswMActionListItem): BswMAbortOnFail=false, BswMActionListItemIndex=0, BswMActionListItemRef=BswMModeControl/A_RTE_REQUEST_Darh_LifeCycle_RequestPort_DARH_STOPPED
        A_RTE_REQUEST_Vin_LifeCycle_RequestPort_VIN_STOPPED (BswMAction)
          BswMAvailableActions
            BswMRteModeRequest: BswMRequestedMode=VIN_STOPPED, BswMRteModeRequestPortRef=MSRP_Vin
        INIT_Action_Xcp_Init (BswMAction)
          BswMAvailableActions
            BswMUserCallout: BswMUserCalloutFunction=Xcp_Init(), BswMCreateCallout=false, BswMUserIncludeFile=Xcp.h
        ErrorMemoryLockSignalReceptionSwitchPort (BswMSwitchPort): BswMModeSwitchInterfaceRef=EMLockSignalReceptionModeInterface
        INIT_Action_ComM_Init (BswMAction)
          BswMAvailableActions
            BswMUserCallout: BswMUserCalloutFunction=ComM_Init(), BswMCreateCallout=false, BswMUserIncludeFile=ComM.h
        CC_AL_A_FlexRay_372befd6_TX_EnableNoinit (BswMActionList): BswMActionListExecution=BSWM_TRIGGER
          3 x BswMActionListItem, all with BswMAbortOnFail=false:
            CC_EnablePDUGroup_EPS_OUT_PduGroup: BswMActionListItemIndex=0, BswMActionListItemRef=BswMModeControl/CC_EnablePDUGroup_EPS_OUT_PduGroup
            CC_EnablePDUGroup_EPS_OUT_PduGroup2: BswMActionListItemIndex=1, BswMActionListItemRef=BswMModeControl/CC_EnablePDUGroup_EPS_OUT_PduGroup2
            CC_EnablePDUGroup_EPS_OUT_PduGroup3: BswMActionListItemIndex=2, BswMActionListItemRef=BswMModeControl/CC_EnablePDUGroup_EPS_OUT_PduGroup3
        AL_NDC_Disable_Rx_And_Tx_Normal (BswMActionList): BswMActionListExecution=BSWM_TRIGGER
          A_RTE_SWITCH_StdDiagComControlNormalNotificationPort_DISABLE_RX_AND_TX_NORMAL (BswMActionListItem):
            BswMAbortOnFail = false
            BswMActionListItemIndex = 0
            BswMActionListItemRef = BswMModeControl/A_RTE_SWITCH_StdDiagComControlNormalNotificationPort_DISABLE_RX_AND_TX_NORMAL
        CC_DisablePDUGroup_EPS_IN_PduGroup5 (BswMAction)
          BswMAvailableActions
            BswMPduGroupSwitch: BswMPduGroupSwitchReinit=false, BswMDisabledPduGroupRef=EPS_IN_PduGroup5
        StdDiagSessionChangeIndicationPort (BswMSwitchPort): BswMModeSwitchInterfaceRef=SessionChangeIndicationInterface
        CC_DisablePDUGroup_EPS_IN_PduGroup6 (BswMAction)
          BswMAvailableActions
            BswMPduGroupSwitch: BswMPduGroupSwitchReinit=false, BswMDisabledPduGroupRef=EPS_IN_PduGroup6
        AL_Initialize_Vin (BswMActionList): BswMActionListExecution=BSWM_TRIGGER
          A_RTE_REQUEST_Vin_LifeCycle_RequestPort_VIN_INITIALIZED (BswMActionListItem): BswMAbortOnFail=false, BswMActionListItemIndex=0, BswMActionListItemRef=BswMModeControl/A_RTE_REQUEST_Vin_LifeCycle_RequestPort_VIN_INITIALIZED
        INIT_Action_FrTp_Init (BswMAction)
          BswMAvailableActions
            BswMUserCallout: BswMUserCalloutFunction=FrTp_Init(&FrTp_Config), BswMCreateCallout=false, BswMUserIncludeFile=FrTp.h
        MSRP_Dlog (BswMRteModeRequestPort): BswMRteModeRequestPortInterfaceRef=Dlog.LifeCycleRequest.requestMode
        10 x BswMAction:
          A_RTE_REQUEST_Omc_LifeCycle_RequestPort_OMC_RUNNING
            BswMAvailableActions
              BswMRteModeRequest: BswMRequestedMode=OMC_RUNNING, BswMRteModeRequestPortRef=MSRP_Omc
          A_RTE_SWITCH_VinComSwitchPort_VIN_VINCOMON
            BswMAvailableActions
              BswMRteSwitch: BswMSwitchedMode=VIN_VINCOMON, BswMRteSwitchPortRef=VinComSwitchPort
          INIT_Action_Com_Init
            BswMAvailableActions
              BswMUserCallout: BswMUserCalloutFunction=Com_Init(Com_Config_Ptr), BswMCreateCallout=false, BswMUserIncludeFile=Com.h
          A_RTE_REQUEST_Dlog_LifeCycle_RequestPort_DLOG_INITIALIZED
            BswMAvailableActions
              BswMRteModeRequest: BswMRequestedMode=DLOG_INITIALIZED, BswMRteModeRequestPortRef=MSRP_Dlog
          ALLOW_COM_A_FlexRay_5b5a9ac2
            BswMAvailableActions
              BswMComMAllowCom: BswMComAllowed=true, BswMComMAllowChannelRef=A_FlexRay_372befd6
          A_BswM_ShtdwnHndlg_PrepShutdown
            BswMAvailableActions
              BswMUserCallout: BswMUserCalloutFunction=BswM_ShtdwnHndlg_PrepShutdown(), BswMCreateCallout=true
          INIT_Action_Dcm_Init
            BswMAvailableActions
              BswMUserCallout: BswMUserCalloutFunction=Dcm_Init(NULL_PTR), BswMCreateCallout=false, BswMUserIncludeFile=Dcm.h
          CC_DisablePDUGroup_EPS_IN_PduGroup10
            BswMAvailableActions
              BswMPduGroupSwitch: BswMPduGroupSwitchReinit=false, BswMDisabledPduGroupRef=EPS_IN_PduGroup10
          CC_DisablePDUGroup_EPS_IN_PduGroup8
            BswMAvailableActions
              BswMPduGroupSwitch: BswMPduGroupSwitchReinit=false, BswMDisabledPduGroupRef=EPS_IN_PduGroup8
          INIT_Action_FrIf_Init
            BswMAvailableActions
              BswMUserCallout: BswMUserCalloutFunction=FrIf_Init(&FrIf_Config), BswMCreateCallout=false, BswMUserIncludeFile=FrIf.h
        MSRP_StdDiag (BswMRteModeRequestPort): BswMRteModeInitValue=STDDIAG_STOPPED, BswMRteModeRequestPortInterfaceRef=StdDiag.LifeCycleRequest.requestMode
        AL_Stop_Omc (BswMActionList): BswMActionListExecution=BSWM_TRIGGER
          A_RTE_REQUEST_Omc_LifeCycle_RequestPort_OMC_STOPPED (BswMActionListItem): BswMAbortOnFail=false, BswMActionListItemIndex=0, BswMActionListItemRef=BswMModeControl/A_RTE_REQUEST_Omc_LifeCycle_RequestPort_OMC_STOPPED
        CC_AL_A_FlexRay_372befd6_TX_Disable (BswMActionList): BswMActionListExecution=BSWM_TRIGGER
          3 x BswMActionListItem, all with BswMAbortOnFail=false:
            CC_DisablePDUGroup_EPS_OUT_PduGroup: BswMActionListItemIndex=0, BswMActionListItemRef=BswMModeControl/CC_DisablePDUGroup_EPS_OUT_PduGroup
            CC_DisablePDUGroup_EPS_OUT_PduGroup2: BswMActionListItemIndex=1, BswMActionListItemRef=BswMModeControl/CC_DisablePDUGroup_EPS_OUT_PduGroup2
            CC_DisablePDUGroup_EPS_OUT_PduGroup3: BswMActionListItemIndex=2, BswMActionListItemRef=BswMModeControl/CC_DisablePDUGroup_EPS_OUT_PduGroup3
        A_RTE_REQUEST_StdDiag_LifeCycle_RequestPort_STDDIAG_INITIALIZED (BswMAction)
          BswMAvailableActions
            BswMRteModeRequest: BswMRequestedMode=STDDIAG_INITIALIZED, BswMRteModeRequestPortRef=MSRP_StdDiag
        AL_Stop_StdDiag (BswMActionList): BswMActionListExecution=BSWM_TRIGGER
          A_RTE_REQUEST_StdDiag_LifeCycle_RequestPort_STDDIAG_STOPPED (BswMActionListItem):
            BswMAbortOnFail = false
            BswMActionListItemIndex = 0
            BswMActionListItemRef = BswMModeControl/A_RTE_REQUEST_StdDiag_LifeCycle_RequestPort_STDDIAG_STOPPED
        INIT_Action_FrSM_Init (BswMAction)
          BswMAvailableActions
            BswMUserCallout: BswMUserCalloutFunction=FrSM_Init(FrSM_Config_Ptr), BswMCreateCallout=false, BswMUserIncludeFile=FrSM.h
        A_RTE_REQUEST_StdDiag_LifeCycle_RequestPort_STDDIAG_STOPPED (BswMAction)
          BswMAvailableActions
            BswMRteModeRequest: BswMRequestedMode=STDDIAG_STOPPED, BswMRteModeRequestPortRef=MSRP_StdDiag
        AL_Run_StdDiag (BswMActionList): BswMActionListExecution=BSWM_TRIGGER
          A_RTE_REQUEST_StdDiag_LifeCycle_RequestPort_STDDIAG_RUNNING (BswMActionListItem):
            BswMAbortOnFail = false
            BswMActionListItemIndex = 0
            BswMActionListItemRef = BswMModeControl/A_RTE_REQUEST_StdDiag_LifeCycle_RequestPort_STDDIAG_RUNNING
        3 x BswMAction:
          CC_EnablePDUGroup_EPS_IN_PduGroup7
            BswMAvailableActions
              BswMPduGroupSwitch: BswMPduGroupSwitchReinit=false, BswMEnabledPduGroupRef=EPS_IN_PduGroup7
          CC_DisablePDUGroup_EPS_OUT_PduGroup2
            BswMAvailableActions
              BswMPduGroupSwitch: BswMPduGroupSwitchReinit=false, BswMDisabledPduGroupRef=EPS_OUT_PduGroup2
          A_RTE_REQUEST_SysTime_LifeCycle_RequestPort_SYSTIME_INITIALIZED
            BswMAvailableActions
              BswMRteModeRequest: BswMRequestedMode=SYSTIME_INITIALIZED, BswMRteModeRequestPortRef=MSRP_SysTime
        3 x BswMActionList, all with BswMActionListExecution=BSWM_TRIGGER:
          AL_Rule_Systime_Init_True
            A_RTE_REQUEST_SysTime_LifeCycle_RequestPort_SYSTIME_INITIALIZED (BswMActionListItem):
              BswMAbortOnFail = false
              BswMActionListItemIndex = 0
              BswMActionListItemRef = BswMModeControl/A_RTE_REQUEST_SysTime_LifeCycle_RequestPort_SYSTIME_INITIALIZED
          AL_NDC_Enable_RX_Disable_TX_NORMAL
            A_RTE_SWITCH_StdDiagComControlNormalNotificationPort_ENABLE_RX_DISABLE_TX_NORMAL (BswMActionListItem):
              BswMAbortOnFail = false
              BswMActionListItemIndex = 0
              BswMActionListItemRef = BswMModeControl/A_RTE_SWITCH_StdDiagComControlNormalNotificationPort_ENABLE_RX_DISABLE_TX_NORMAL
          AL_NDC_Disable_RX_Enable_TX_NORMAL
            A_RTE_SWITCH_StdDiagComControlNormalNotificationPort_DISABLE_RX_ENABLE_TX_NORMAL (BswMActionListItem):
              BswMAbortOnFail = false
              BswMActionListItemIndex = 0
              BswMActionListItemRef = BswMModeControl/A_RTE_SWITCH_StdDiagComControlNormalNotificationPort_DISABLE_RX_ENABLE_TX_NORMAL
        StdDiagComControlNormalNotificationPort (BswMSwitchPort): BswMModeSwitchInterfaceRef=ComControlNormalNotificationInterface
        CC_EnablePDUGroup_EPS_OUT_PduGroup3 (BswMAction)
          BswMAvailableActions
            BswMPduGroupSwitch: BswMPduGroupSwitchReinit=false, BswMEnabledPduGroupRef=EPS_OUT_PduGroup3
        A_RTE_REQUEST_Dlog_LifeCycle_RequestPort_DLOG_RUNNING (BswMAction)
          BswMAvailableActions
            BswMRteModeRequest: BswMRequestedMode=DLOG_RUNNING, BswMRteModeRequestPortRef=MSRP_Dlog
        AL_Initialize_Omc (BswMActionList): BswMActionListExecution=BSWM_TRIGGER
          A_RTE_REQUEST_Omc_LifeCycle_RequestPort_OMC_INITIALIZED (BswMActionListItem): BswMAbortOnFail=false, BswMActionListItemIndex=0, BswMActionListItemRef=BswMModeControl/A_RTE_REQUEST_Omc_LifeCycle_RequestPort_OMC_INITIALIZED
        AL_Stop_Dlog (BswMActionList): BswMActionListExecution=BSWM_TRIGGER
          A_RTE_REQUEST_Dlog_LifeCycle_RequestPort_DLOG_STOPPED (BswMActionListItem): BswMAbortOnFail=false, BswMActionListItemIndex=0, BswMActionListItemRef=BswMModeControl/A_RTE_REQUEST_Dlog_LifeCycle_RequestPort_DLOG_STOPPED
        CC_DisablePDUGroup_EPS_IN_PduGroup7 (BswMAction)
          BswMAvailableActions
            BswMPduGroupSwitch: BswMPduGroupSwitchReinit=false, BswMDisabledPduGroupRef=EPS_IN_PduGroup7
        CC_EnablePDUGroup_EPS_IN_PduGroup10 (BswMAction)
          BswMAvailableActions
            BswMPduGroupSwitch: BswMPduGroupSwitchReinit=false, BswMEnabledPduGroupRef=EPS_IN_PduGroup10
        AL_Run_Darh (BswMActionList): BswMActionListExecution=BSWM_TRIGGER
          A_RTE_REQUEST_Darh_LifeCycle_RequestPort_DARH_RUNNING (BswMActionListItem): BswMAbortOnFail=false, BswMActionListItemIndex=0, BswMActionListItemRef=BswMModeControl/A_RTE_REQUEST_Darh_LifeCycle_RequestPort_DARH_RUNNING
        A_RTE_SWITCH_StdDiagComControlNormalNotificationPort_DISABLE_RX_AND_TX_NORMAL (BswMAction)
          BswMAvailableActions
            BswMRteSwitch: BswMSwitchedMode=DISABLE_RX_AND_TX_NORMAL, BswMRteSwitchPortRef=StdDiagComControlNormalNotificationPort
        AL_COM_PDU_GROUP_3_ENABLED (BswMActionList): BswMActionListExecution=BSWM_TRIGGER
          A_RTE_SWITCH_VinComSwitchPort_VIN_VINCOMON (BswMActionListItem): BswMAbortOnFail=false, BswMActionListItemIndex=0, BswMActionListItemRef=BswMModeControl/A_RTE_SWITCH_VinComSwitchPort_VIN_VINCOMON
        CC_EnablePDUGroup_EPS_IN_PduGroup9 (BswMAction)
          BswMAvailableActions
            BswMPduGroupSwitch: BswMPduGroupSwitchReinit=false, BswMEnabledPduGroupRef=EPS_IN_PduGroup9
        MSRP_SysTime (BswMRteModeRequestPort): BswMRteModeRequestPortInterfaceRef=SysTime.LifeCycleRequest.requestMode
        AL_NDC_Enable_RX_AND_TX_NORMAL (BswMActionList): BswMActionListExecution=BSWM_TRIGGER
          A_RTE_SWITCH_StdDiagComControlNormalNotificationPort_ENABLE_RX_AND_TX_NORMAL (BswMActionListItem):
            BswMAbortOnFail = false
            BswMActionListItemIndex = 0
            BswMActionListItemRef = BswMModeControl/A_RTE_SWITCH_StdDiagComControlNormalNotificationPort_ENABLE_RX_AND_TX_NORMAL
        5 x BswMAction:
          CC_DisablePDUGroup_EPS_IN_PduGroup9
            BswMAvailableActions
              BswMPduGroupSwitch: BswMPduGroupSwitchReinit=false, BswMDisabledPduGroupRef=EPS_IN_PduGroup9
          A_RTE_REQUEST_Omc_LifeCycle_RequestPort_OMC_INITIALIZED
            BswMAvailableActions
              BswMRteModeRequest: BswMRequestedMode=OMC_INITIALIZED, BswMRteModeRequestPortRef=MSRP_Omc
          A_RTE_SWITCH_StdDiagComControlNormalNotificationPort_ENABLE_RX_DISABLE_TX_NORMAL
            BswMAvailableActions
              BswMRteSwitch: BswMSwitchedMode=ENABLE_RX_DISABLE_TX_NORMAL, BswMRteSwitchPortRef=StdDiagComControlNormalNotificationPort
          INIT_Action_FrTrcv_30_Tja1082_Init
            BswMAvailableActions
              BswMUserCallout: BswMUserCalloutFunction=FrTrcv_30_Tja1082_Init(), BswMCreateCallout=false, BswMUserIncludeFile=FrTrcv_30_Tja1082.h
          INIT_Action_PduR_Init
            BswMAvailableActions
              BswMUserCallout: BswMUserCalloutFunction=PduR_Init(PduR_Config_Ptr), BswMCreateCallout=false, BswMUserIncludeFile=PduR.h
        AL_COM_PDU_GROUP_4_DISABLED (BswMActionList): BswMActionListExecution=BSWM_TRIGGER
          A_RTE_SWITCH_ErrorMemoryLockSignalReceptionSwitchPort_EM_LOCK_NOT_RECEIVABLE (BswMActionListItem):
            BswMAbortOnFail = false
            BswMActionListItemIndex = 0
            BswMActionListItemRef = BswMModeControl/A_RTE_SWITCH_ErrorMemoryLockSignalReceptionSwitchPort_EM_LOCK_NOT_RECEIVABLE
        3 x BswMAction:
          CC_EnablePDUGroup_EPS_IN_PduGroup8
            BswMAvailableActions
              BswMPduGroupSwitch: BswMPduGroupSwitchReinit=false, BswMEnabledPduGroupRef=EPS_IN_PduGroup8
          A_RTE_REQUEST_Dlog_LifeCycle_RequestPort_DLOG_STOPPED
            BswMAvailableActions
              BswMRteModeRequest: BswMRequestedMode=DLOG_STOPPED, BswMRteModeRequestPortRef=MSRP_Dlog
          CC_EnablePDUGroup_EPS_OUT_PduGroup2
            BswMAvailableActions
              BswMPduGroupSwitch: BswMPduGroupSwitchReinit=false, BswMEnabledPduGroupRef=EPS_OUT_PduGroup2
        VinComSwitchPort (BswMSwitchPort): BswMModeSwitchInterfaceRef=VinCom
        AL_Initialize_StdDiag (BswMActionList): BswMActionListExecution=BSWM_TRIGGER
          A_RTE_REQUEST_StdDiag_LifeCycle_RequestPort_STDDIAG_INITIALIZED (BswMActionListItem):
            BswMAbortOnFail = false
            BswMActionListItemIndex = 0
            BswMActionListItemRef = BswMModeControl/A_RTE_REQUEST_StdDiag_LifeCycle_RequestPort_STDDIAG_INITIALIZED
        A_RTE_REQUEST_StdDiag_LifeCycle_RequestPort_STDDIAG_RUNNING (BswMAction)
          BswMAvailableActions
            BswMRteModeRequest: BswMRequestedMode=STDDIAG_RUNNING, BswMRteModeRequestPortRef=MSRP_StdDiag
        MSRP_Darh (BswMRteModeRequestPort): BswMRteModeRequestPortInterfaceRef=Darh.LifeCycleRequest.requestMode
        CC_DisablePDUGroup_EPS_IN_PduGroup3 (BswMAction)  # Annotation PLAIN_TEXT BAC Vin needs to get notified if this group is disabled. Make sure that when this action gets executed, also to execute action "RTE_SWITCH_VinComSwitchPort_VIN_VINCOMOFF".
          BswMAvailableActions
            BswMPduGroupSwitch: BswMPduGroupSwitchReinit=false, BswMDisabledPduGroupRef=EPS_IN_PduGroup3
        AL_COM_PDU_GROUP_4_ENABLED (BswMActionList): BswMActionListExecution=BSWM_TRIGGER
          A_RTE_SWITCH_ErrorMemoryLockSignalReceptionSwitchPort_EM_LOCK_RECEIVABLE (BswMActionListItem):
            BswMAbortOnFail = false
            BswMActionListItemIndex = 0
            BswMActionListItemRef = BswMModeControl/A_RTE_SWITCH_ErrorMemoryLockSignalReceptionSwitchPort_EM_LOCK_RECEIVABLE
        A_RTE_SWITCH_StdDiagSessionChangeIndicationPort_STDDIAG_DEFAULT_SESSION (BswMAction)
          BswMAvailableActions
            BswMRteSwitch: BswMSwitchedMode=STDDIAG_DEFAULT_SESSION, BswMRteSwitchPortRef=StdDiagSessionChangeIndicationPort
        AL_StdDiag_SessionChangeToOtherSession (BswMActionList): BswMActionListExecution=BSWM_TRIGGER
          A_RTE_SWITCH_StdDiagSessionChangeIndicationPort_STDDIAG_OTHER_SESSION (BswMActionListItem):
            BswMAbortOnFail = false
            BswMActionListItemIndex = 0
            BswMActionListItemRef = BswMModeControl/A_RTE_SWITCH_StdDiagSessionChangeIndicationPort_STDDIAG_OTHER_SESSION
        A_RTE_REQUEST_Darh_LifeCycle_RequestPort_DARH_STOPPED (BswMAction)
          BswMAvailableActions
            BswMRteModeRequest: BswMRequestedMode=DARH_STOPPED, BswMRteModeRequestPortRef=MSRP_Darh
        AL_COM_PDU_GROUP_3_DISABLED (BswMActionList): BswMActionListExecution=BSWM_TRIGGER
          A_RTE_SWITCH_VinComSwitchPort_VIN_VINCOMOFF (BswMActionListItem): BswMAbortOnFail=false, BswMActionListItemIndex=0, BswMActionListItemRef=BswMModeControl/A_RTE_SWITCH_VinComSwitchPort_VIN_VINCOMOFF
        CC_EnablePDUGroup_EPS_OUT_PduGroup (BswMAction)
          BswMAvailableActions
            BswMPduGroupSwitch: BswMPduGroupSwitchReinit=false, BswMEnabledPduGroupRef=EPS_OUT_PduGroup
        A_RTE_REQUEST_SysTime_LifeCycle_RequestPort_SYSTIME_RUNNING (BswMAction)
          BswMAvailableActions
            BswMRteModeRequest: BswMRequestedMode=SYSTIME_RUNNING, BswMRteModeRequestPortRef=MSRP_SysTime
        AL_Run_Omc (BswMActionList): BswMActionListExecution=BSWM_TRIGGER
          A_RTE_REQUEST_Omc_LifeCycle_RequestPort_OMC_RUNNING (BswMActionListItem): BswMAbortOnFail=false, BswMActionListItemIndex=0, BswMActionListItemRef=BswMModeControl/A_RTE_REQUEST_Omc_LifeCycle_RequestPort_OMC_RUNNING
        A_RTE_SWITCH_StdDiagComControlNormalNotificationPort_ENABLE_RX_AND_TX_NORMAL (BswMAction)
          BswMAvailableActions
            BswMRteSwitch: BswMSwitchedMode=ENABLE_RX_AND_TX_NORMAL, BswMRteSwitchPortRef=StdDiagComControlNormalNotificationPort
        AL_Initialize_Dlog (BswMActionList): BswMActionListExecution=BSWM_TRIGGER
          A_RTE_REQUEST_Dlog_LifeCycle_RequestPort_DLOG_INITIALIZED (BswMActionListItem):
            BswMAbortOnFail = false
            BswMActionListItemIndex = 0
            BswMActionListItemRef = BswMModeControl/A_RTE_REQUEST_Dlog_LifeCycle_RequestPort_DLOG_INITIALIZED
        A_RTE_SWITCH_ErrorMemoryLockSignalReceptionSwitchPort_EM_LOCK_RECEIVABLE (BswMAction)
          BswMAvailableActions
            BswMRteSwitch: BswMSwitchedMode=EM_LOCK_RECEIVABLE, BswMRteSwitchPortRef=ErrorMemoryLockSignalReceptionSwitchPort
        AL_Rule_Start_Systime_Run_when_Systime_Init_True (BswMActionList): BswMActionListExecution=BSWM_TRIGGER
          A_RTE_REQUEST_SysTime_LifeCycle_RequestPort_SYSTIME_RUNNING (BswMActionListItem):
            BswMAbortOnFail = false
            BswMActionListItemIndex = 0
            BswMActionListItemRef = BswMModeControl/A_RTE_REQUEST_SysTime_LifeCycle_RequestPort_SYSTIME_RUNNING
        6 x BswMAction:
          A_RTE_SWITCH_VinComSwitchPort_VIN_VINCOMOFF
            BswMAvailableActions
              BswMRteSwitch: BswMSwitchedMode=VIN_VINCOMOFF, BswMRteSwitchPortRef=VinComSwitchPort
          A_RTE_SWITCH_StdDiagComControlNormalNotificationPort_DISABLE_RX_ENABLE_TX_NORMAL
            BswMAvailableActions
              BswMRteSwitch: BswMSwitchedMode=DISABLE_RX_ENABLE_TX_NORMAL, BswMRteSwitchPortRef=StdDiagComControlNormalNotificationPort
          CC_EnablePDUGroup_EPS_IN_PduGroup
            BswMAvailableActions
              BswMPduGroupSwitch: BswMPduGroupSwitchReinit=false, BswMEnabledPduGroupRef=EPS_IN_PduGroup
          CC_EnablePDUGroup_EPS_IN_PduGroup6
            BswMAvailableActions
              BswMPduGroupSwitch: BswMPduGroupSwitchReinit=false, BswMEnabledPduGroupRef=EPS_IN_PduGroup6
          CC_DisablePDUGroup_EPS_OUT_PduGroup
            BswMAvailableActions
              BswMPduGroupSwitch: BswMPduGroupSwitchReinit=false, BswMDisabledPduGroupRef=EPS_OUT_PduGroup
          CC_DisablePDUGroup_EPS_IN_PduGroup
            BswMAvailableActions
              BswMPduGroupSwitch: BswMPduGroupSwitchReinit=false, BswMDisabledPduGroupRef=EPS_IN_PduGroup
        AL_Stop_Vin (BswMActionList): BswMActionListExecution=BSWM_TRIGGER
          A_RTE_REQUEST_Vin_LifeCycle_RequestPort_VIN_STOPPED (BswMActionListItem): BswMAbortOnFail=false, BswMActionListItemIndex=0, BswMActionListItemRef=BswMModeControl/A_RTE_REQUEST_Vin_LifeCycle_RequestPort_VIN_STOPPED
        CC_AL_A_FlexRay_372befd6_RX_Disable (BswMActionList): BswMActionListExecution=BSWM_TRIGGER
          10 x BswMActionListItem, all with BswMAbortOnFail=false:
            CC_DisablePDUGroup_EPS_IN_PduGroup: BswMActionListItemIndex=0, BswMActionListItemRef=BswMModeControl/CC_DisablePDUGroup_EPS_IN_PduGroup
            CC_DisablePDUGroup_EPS_IN_PduGroup2: BswMActionListItemIndex=1, BswMActionListItemRef=BswMModeControl/CC_DisablePDUGroup_EPS_IN_PduGroup2
            CC_DisablePDUGroup_EPS_IN_PduGroup3: BswMActionListItemIndex=2, BswMActionListItemRef=BswMModeControl/CC_DisablePDUGroup_EPS_IN_PduGroup3
            CC_DisablePDUGroup_EPS_IN_PduGroup4: BswMActionListItemIndex=3, BswMActionListItemRef=BswMModeControl/CC_DisablePDUGroup_EPS_IN_PduGroup4
            CC_DisablePDUGroup_EPS_IN_PduGroup5: BswMActionListItemIndex=4, BswMActionListItemRef=BswMModeControl/CC_DisablePDUGroup_EPS_IN_PduGroup5
            CC_DisablePDUGroup_EPS_IN_PduGroup6: BswMActionListItemIndex=5, BswMActionListItemRef=BswMModeControl/CC_DisablePDUGroup_EPS_IN_PduGroup6
            CC_DisablePDUGroup_EPS_IN_PduGroup7: BswMActionListItemIndex=6, BswMActionListItemRef=BswMModeControl/CC_DisablePDUGroup_EPS_IN_PduGroup7
            CC_DisablePDUGroup_EPS_IN_PduGroup8: BswMActionListItemIndex=7, BswMActionListItemRef=BswMModeControl/CC_DisablePDUGroup_EPS_IN_PduGroup8
            CC_DisablePDUGroup_EPS_IN_PduGroup9: BswMActionListItemIndex=8, BswMActionListItemRef=BswMModeControl/CC_DisablePDUGroup_EPS_IN_PduGroup9
            CC_DisablePDUGroup_EPS_IN_PduGroup10: BswMActionListItemIndex=9, BswMActionListItemRef=BswMModeControl/CC_DisablePDUGroup_EPS_IN_PduGroup10
        CC_DisablePDUGroup_EPS_OUT_PduGroup3 (BswMAction)
          BswMAvailableActions
            BswMPduGroupSwitch: BswMPduGroupSwitchReinit=false, BswMDisabledPduGroupRef=EPS_OUT_PduGroup3
        MSRP_Vin (BswMRteModeRequestPort): BswMRteModeInitValue=VIN_STOPPED, BswMRteModeRequestPortInterfaceRef=Vin.LifeCycleRequest.requestMode
        6 x BswMAction:
          A_RTE_REQUEST_Vin_LifeCycle_RequestPort_VIN_RUNNING
            BswMAvailableActions
              BswMRteModeRequest: BswMRequestedMode=VIN_RUNNING, BswMRteModeRequestPortRef=MSRP_Vin
          CC_EnablePDUGroup_EPS_IN_PduGroup2
            BswMAvailableActions
              BswMPduGroupSwitch: BswMPduGroupSwitchReinit=false, BswMEnabledPduGroupRef=EPS_IN_PduGroup2
          CC_EnablePDUGroup_EPS_IN_PduGroup5
            BswMAvailableActions
              BswMPduGroupSwitch: BswMPduGroupSwitchReinit=false, BswMEnabledPduGroupRef=EPS_IN_PduGroup5
          A_RTE_REQUEST_Omc_LifeCycle_RequestPort_OMC_STOPPED
            BswMAvailableActions
              BswMRteModeRequest: BswMRequestedMode=OMC_STOPPED, BswMRteModeRequestPortRef=MSRP_Omc
          A_RTE_REQUEST_Vin_LifeCycle_RequestPort_VIN_INITIALIZED
            BswMAvailableActions
              BswMRteModeRequest: BswMRequestedMode=VIN_INITIALIZED, BswMRteModeRequestPortRef=MSRP_Vin
          CC_EnablePDUGroup_EPS_IN_PduGroup4  # Annotation PLAIN_TEXT BAC Stm needs to get notified if this group is enabled. Make sure that when this action gets executed, also to execute action "RTE_SWITCH_ErrorMemoryLockSignalReceptionSwitchPort_EM_LOCK_RECEIVABLE".
            BswMAvailableActions
              BswMPduGroupSwitch: BswMPduGroupSwitchReinit=false, BswMEnabledPduGroupRef=EPS_IN_PduGroup4
        INIT_AL_Initialize (BswMActionList): BswMActionListExecution=BSWM_CONDITION
          31 x BswMActionListItem, all with BswMAbortOnFail=false:
            INIT_Action_FrTrcv_30_Tja1082_Init: BswMActionListItemIndex=10, BswMActionListItemRef=BswMModeControl/INIT_Action_FrTrcv_30_Tja1082_Init
            INIT_Action_Fr_Init: BswMActionListItemIndex=11, BswMActionListItemRef=BswMModeControl/INIT_Action_Fr_Init
            INIT_Action_FrIf_Init: BswMActionListItemIndex=12, BswMActionListItemRef=BswMModeControl/INIT_Action_FrIf_Init
            INIT_Action_Com_Init: BswMActionListItemIndex=13, BswMActionListItemRef=BswMModeControl/INIT_Action_Com_Init
            INIT_Action_IpduM_Init: BswMActionListItemIndex=14, BswMActionListItemRef=BswMModeControl/INIT_Action_IpduM_Init
            INIT_Action_PduR_Init: BswMActionListItemIndex=15, BswMActionListItemRef=BswMModeControl/INIT_Action_PduR_Init
            INIT_Action_FrSM_Init: BswMActionListItemIndex=16, BswMActionListItemRef=BswMModeControl/INIT_Action_FrSM_Init
            INIT_Action_FrTp_Init: BswMActionListItemIndex=17, BswMActionListItemRef=BswMModeControl/INIT_Action_FrTp_Init
            INIT_Action_FrXcp_Init: BswMActionListItemIndex=18, BswMActionListItemRef=BswMModeControl/INIT_Action_FrXcp_Init
            INIT_Action_Xcp_Init: BswMActionListItemIndex=19, BswMActionListItemRef=BswMModeControl/INIT_Action_Xcp_Init
            INIT_Action_EnableInterrupts: BswMActionListItemIndex=20, BswMActionListItemRef=BswMModeControl/INIT_Action_EnableInterrupts
            INIT_Action_ComM_Init: BswMActionListItemIndex=21, BswMActionListItemRef=BswMModeControl/INIT_Action_ComM_Init
            INIT_Action_Dcm_Init: BswMActionListItemIndex=23, BswMActionListItemRef=BswMModeControl/INIT_Action_Dcm_Init
            AL_Initialize_Vin: BswMActionListItemIndex=26, BswMActionListItemRef=BswMModeControl/AL_Initialize_Vin
            AL_Initialize_Omc: BswMActionListItemIndex=25, BswMActionListItemRef=BswMModeControl/AL_Initialize_Omc
            ALLOW_COM_A_FlexRay_5b5a9ac2: BswMActionListItemIndex=22, BswMActionListItemRef=BswMModeControl/ALLOW_COM_A_FlexRay_5b5a9ac2
            BSWM_FULL_COM_USR_A_FlexRay_372befd6: BswMActionListItemIndex=24, BswMActionListItemRef=BswMModeControl/BSWM_FULL_COM_USR_A_FlexRay_372befd6
            INIT_Action_Fee_30_SmallSector_Init: BswMActionListItemIndex=0, BswMActionListItemRef=BswMModeControl/INIT_Action_Fee_30_SmallSector_Init
            INIT_Action_Dem_Init: BswMActionListItemIndex=3, BswMActionListItemRef=BswMModeControl/INIT_Action_Dem_Init
            INIT_Action_Os_Call_NxtrWdgM_Init: BswMActionListItemIndex=5, BswMActionListItemRef=BswMModeControl/INIT_Action_Os_Call_NxtrWdgM_Init
            INIT_Action_Os_ModifyPeripheral32: BswMActionListItemIndex=28, BswMActionListItemRef=BswMModeControl/INIT_Action_Os_ModifyPeripheral32
            INIT_Action_SyncCrcInit0: BswMActionListItemIndex=7, BswMActionListItemRef=BswMModeControl/INIT_Action_SyncCrcInit0
            INIT_Action_NvM_Init: BswMActionListItemIndex=1, BswMActionListItemRef=BswMModeControl/INIT_Action_NvM_Init
            INIT_Action_E2EProtectionWrapperInit: BswMActionListItemIndex=9, BswMActionListItemRef=BswMModeControl/INIT_Action_E2EProtectionWrapperInit
            INIT_Action_FlsMemInit2: BswMActionListItemIndex=8, BswMActionListItemRef=BswMModeControl/INIT_Action_FlsMemInit2
            INIT_Action_RteStart: BswMActionListItemIndex=27, BswMActionListItemRef=BswMModeControl/INIT_Action_RteStart
            A_Init_NvMReadAll: BswMActionListItemIndex=2, BswMActionListItemRef=BswMModeControl/A_Init_NvMReadAll
            A_Dem_SetOperationCycleState: BswMActionListItemIndex=4, BswMActionListItemRef=BswMModeControl/A_Dem_SetOperationCycleState
            A_GuardCfgAndDiagcInit1: BswMActionListItemIndex=6, BswMActionListItemRef=BswMModeControl/A_GuardCfgAndDiagcInit1
            A_EnaOsTmr: BswMActionListItemIndex=29, BswMActionListItemRef=BswMModeControl/A_EnaOsTmr
            ChgMod_Run: BswMActionListItemIndex=30, BswMActionListItemRef=BswMModeControl/ChgMod_Run
        BSWM_FULL_COM_USR_A_FlexRay_372befd6 (BswMAction)
          BswMAvailableActions
            BswMComMModeSwitch: BswMComMRequestedMode=BSWM_FULL_COM, BswMComMUserRef=USR_A_FlexRay_372befd6
        ChgMod_ShutdownReason (BswMAction)
          BswMAvailableActions
            BswMGenericModeSwitch: BswMGenericRequestRef=BswM_ShutdownReason, BswMGenericRequestModeRef=HardReset
        AL_Dcm_ShutDown_HardReset (BswMActionList): BswMActionListExecution=BSWM_TRIGGER
          A_Mcu_PerformReset (BswMActionListItem): BswMAbortOnFail=false, BswMActionListItemIndex=0, BswMActionListItemRef=BswMModeControl/A_Mcu_PerformReset
        3 x BswMAction:
          A_E2EProtectionWrapperInit
            BswMAvailableActions
              BswMUserCallout: BswMUserCalloutFunction=E2EProtectionWrapperInit(), BswMCreateCallout=false, BswMUserIncludeFile=E2EPW_Init.h
          A_BswMUserCallout
            BswMAvailableActions
              BswMUserCallout: BswMUserCalloutFunction=Dem_SetOperationCycleState, BswMCreateCallout=false
          A_Dem_SetOperationCycleState
            BswMAvailableActions
              BswMUserCallout: BswMUserCalloutFunction=Dem_SetOperationCycleState(0,0), BswMCreateCallout=false
        AL_Dcm_ShutDown_EcuReset (BswMActionList): BswMActionListExecution=BSWM_TRIGGER
          A_ShtdwnHndlg_PrepShtdwn (BswMActionListItem): BswMAbortOnFail=false, BswMActionListItemIndex=1, BswMActionListItemRef=BswMModeControl/A_ShtdwnHndlg_PrepShtdwn
          ChdMod_ShutdownReason_Programming (BswMActionListItem): BswMAbortOnFail=false, BswMActionListItemIndex=0, BswMActionListItemRef=BswMModeControl/ChdMod_ShutdownReason_Programming
        MSRP_Coding (BswMRteModeRequestPort): BswMRteModeRequestPortInterfaceRef=Coding.LifeCycleRequest.requestMode
        AL_Initialize_Coding (BswMActionList): BswMActionListExecution=BSWM_TRIGGER
          A_RTE_REQUEST_MSRP_Coding_CODING_INITIALIZED (BswMActionListItem): BswMAbortOnFail=false, BswMActionListItemIndex=0, BswMActionListItemRef=BswMModeControl/A_RTE_REQUEST_MSRP_Coding_CODING_INITIALIZED
        A_RTE_REQUEST_MSRP_Coding_CODING_INITIALIZED (BswMAction)
          BswMAvailableActions
            BswMRteModeRequest: BswMRequestedMode=CODING_INITIALIZED, BswMRteModeRequestPortRef=MSRP_Coding
        SwitchPort_Darh_ReportErrorMode (BswMSwitchPort): BswMModeSwitchInterfaceRef=DarhReportErrorModeInterface
        A_Set_Darh_ERROR_ACTIVE (BswMAction)
          BswMAvailableActions
            BswMRteSwitch: BswMSwitchedMode=DARH_REPORT_ERROR_ACTIVE, BswMRteSwitchPortRef=SwitchPort_Darh_ReportErrorMode
        A_Set_Darh_ERROR_INACTIVE (BswMAction)
          BswMAvailableActions
            BswMRteSwitch: BswMSwitchedMode=DARH_REPORT_ERROR_INACTIVE, BswMRteSwitchPortRef=SwitchPort_Darh_ReportErrorMode
        AL_Set_DarhReportError_due_ComM_and_CEL_mode_BswMActionList_False (BswMActionList): BswMActionListExecution=BSWM_TRIGGER
          A_Set_Darh_ERROR_INACTIVE (BswMActionListItem): BswMAbortOnFail=false, BswMActionListItemIndex=0, BswMActionListItemRef=BswMModeControl/A_Set_Darh_ERROR_INACTIVE
        AL_Set_DarhReportError_due_ComM_and_CEL_mode_BswMActionList_True (BswMActionList): BswMActionListExecution=BSWM_TRIGGER
          A_Set_Darh_ERROR_ACTIVE (BswMActionListItem): BswMAbortOnFail=false, BswMActionListItemIndex=0, BswMActionListItemRef=BswMModeControl/A_Set_Darh_ERROR_ACTIVE
        Coding_SwitchCodingMode (BswMSwitchPort): BswMModeSwitchInterfaceRef=Coding_ConditionModeInterface
        A_CodingAllowed (BswMAction)
          BswMAvailableActions
            BswMRteSwitch: BswMSwitchedMode=CODING_ALLOWED, BswMRteSwitchPortRef=Coding_SwitchCodingMode
        AL_CodingAllowed (BswMActionList): BswMActionListExecution=BSWM_TRIGGER
          A_CodingAllowed (BswMActionListItem): BswMAbortOnFail=false, BswMActionListItemIndex=0, BswMActionListItemRef=BswMModeControl/A_CodingAllowed
        A_CodingNotAllowed (BswMAction)
          BswMAvailableActions
            BswMRteSwitch: BswMSwitchedMode=CODING_NOT_ALLOWED, BswMRteSwitchPortRef=Coding_SwitchCodingMode
        AL_CodingNotAllowed (BswMActionList): BswMActionListExecution=BSWM_TRIGGER
          A_CodingNotAllowed (BswMActionListItem): BswMAbortOnFail=false, BswMActionListItemIndex=0, BswMActionListItemRef=BswMModeControl/A_CodingNotAllowed
        ChdMod_ShutdownReason_Programming (BswMAction)
          BswMAvailableActions
            BswMGenericModeSwitch: BswMGenericRequestRef=BswM_ShutdownReason, BswMGenericRequestModeRef=Prog
        A_Dcm_StartHardResetTimer (BswMAction)
          BswMAvailableActions
            BswMTimerControl: BswMTimerAction=BSWM_TIMER_START, BswMTimerValue=3, BswMTimerRef=Dcm_HardResetTimer
        AL_Dcm_HardResetStartTimer (BswMActionList): BswMActionListExecution=BSWM_TRIGGER
          A_Dcm_StartHardResetTimer (BswMActionListItem): BswMAbortOnFail=false, BswMActionListItemIndex=0, BswMActionListItemRef=BswMModeControl/A_Dcm_StartHardResetTimer
        A_Mcu_PerformReset (BswMAction)
          BswMAvailableActions
            BswMUserCallout: BswMUserCalloutFunction=NxtrSwRst(MCUDIAGC_PWRONRST,0u), BswMCreateCallout=false, BswMUserIncludeFile=NxtrMcuSuprtLib.h
        A_RTE_REQUEST_MSRP_Coding_CODING_RUNNING (BswMAction)
          BswMAvailableActions
            BswMRteModeRequest: BswMRequestedMode=CODING_RUNNING, BswMRteModeRequestPortRef=MSRP_Coding
        AL_Run_Coding (BswMActionList): BswMActionListExecution=BSWM_TRIGGER
          A_RTE_REQUEST_MSRP_Coding_CODING_RUNNING (BswMActionListItem): BswMAbortOnFail=false, BswMActionListItemIndex=0, BswMActionListItemRef=BswMModeControl/A_RTE_REQUEST_MSRP_Coding_CODING_RUNNING
        A_RTE_REQUEST_MSRP_Coding_CODING_STOPPED (BswMAction)
          BswMAvailableActions
            BswMRteModeRequest: BswMRequestedMode=CODING_STOPPED, BswMRteModeRequestPortRef=MSRP_Coding
        AL_Stop_Coding (BswMActionList): BswMActionListExecution=BSWM_TRIGGER
          A_RTE_REQUEST_MSRP_Coding_CODING_STOPPED (BswMActionListItem): BswMAbortOnFail=false, BswMActionListItemIndex=0, BswMActionListItemRef=BswMModeControl/A_RTE_REQUEST_MSRP_Coding_CODING_STOPPED
        Coding_BusComModeSwitch (BswMSwitchPort): BswMModeSwitchInterfaceRef=Coding_BusCom
        A_RTE_SWITCH_Coding_BusComModeSwitch_CODING_BUSCOMOFF (BswMAction)
          BswMAvailableActions
            BswMRteSwitch: BswMSwitchedMode=CODING_BUSCOMOFF, BswMRteSwitchPortRef=Coding_BusComModeSwitch
        A_RTE_SWITCH_Coding_BusComModeSwitch_CODING_BUSCOMON (BswMAction)
          BswMAvailableActions
            BswMRteSwitch: BswMSwitchedMode=CODING_BUSCOMON, BswMRteSwitchPortRef=Coding_BusComModeSwitch
        AL_Coding_BusComOff (BswMActionList): BswMActionListExecution=BSWM_TRIGGER
          A_RTE_SWITCH_Coding_BusComModeSwitch_CODING_BUSCOMOFF (BswMActionListItem): BswMAbortOnFail=false, BswMActionListItemIndex=0, BswMActionListItemRef=BswMModeControl/A_RTE_SWITCH_Coding_BusComModeSwitch_CODING_BUSCOMOFF
        AL_Coding_BusComOn (BswMActionList): BswMActionListExecution=BSWM_TRIGGER
          A_RTE_SWITCH_Coding_BusComModeSwitch_CODING_BUSCOMON (BswMActionListItem): BswMAbortOnFail=false, BswMActionListItemIndex=0, BswMActionListItemRef=BswMModeControl/A_RTE_SWITCH_Coding_BusComModeSwitch_CODING_BUSCOMON
        10 x BswMAction:
          INIT_Action_Fee_30_SmallSector_Init
            BswMAvailableActions
              BswMUserCallout: BswMUserCalloutFunction=Fee_30_SmallSector_Init(), BswMCreateCallout=false, BswMUserIncludeFile=Fee_30_SmallSector.h
          INIT_Action_Dem_Init
            BswMAvailableActions
              BswMUserCallout: BswMUserCalloutFunction=Dem_Init(NULL_PTR), BswMCreateCallout=false, BswMUserIncludeFile=Dem.h
          INIT_Action_Os_Call_NxtrWdgM_Init
            BswMAvailableActions
              BswMUserCallout: BswMUserCalloutFunction=Os_Call_NxtrWdgM_Init(), BswMCreateCallout=false, BswMUserIncludeFile=
          INIT_Action_Os_ModifyPeripheral32
            BswMAvailableActions
              BswMUserCallout:
                BswMUserCalloutFunction = Os_ModifyPeripheral32(InterruptController, (uint32 *)0xFFFEEAF0U, 0xFFFEFFFFU, 0x0U);
                BswMCreateCallout = false
                BswMUserIncludeFile = Os.h
          INIT_Action_SyncCrcInit0
            BswMAvailableActions
              BswMUserCallout: BswMUserCalloutFunction=SyncCrcInit0(), BswMCreateCallout=false, BswMUserIncludeFile=
          INIT_Action_NvM_Init
            BswMAvailableActions
              BswMUserCallout: BswMUserCalloutFunction=NvM_Init(), BswMCreateCallout=false, BswMUserIncludeFile=NvM.h
          INIT_Action_E2EProtectionWrapperInit
            BswMAvailableActions
              BswMUserCallout: BswMUserCalloutFunction=E2EProtectionWrapperInit(), BswMCreateCallout=false, BswMUserIncludeFile=E2EPW_Init.h
          INIT_Action_FlsMemInit2
            BswMAvailableActions
              BswMUserCallout: BswMUserCalloutFunction=FlsMemInit2(), BswMCreateCallout=false, BswMUserIncludeFile=
          INIT_Action_IoHwAb_Init
            BswMAvailableActions
              BswMUserCallout: BswMUserCalloutFunction=IoHwAb_Init(), BswMCreateCallout=false, BswMUserIncludeFile=
          INIT_Action_RteStart
            BswMAvailableActions
              BswMUserCallout: BswMUserCalloutFunction=(void)Rte_Start(), BswMCreateCallout=false, BswMUserIncludeFile=Rte_Main.h
      BswMDataTypeMappingSets: BswMDataTypeMappingSetRef=BswMMappingSet
