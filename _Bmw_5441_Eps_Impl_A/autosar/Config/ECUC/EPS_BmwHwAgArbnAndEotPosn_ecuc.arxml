AUTOSAR XML (schema 4-3-0)
package /ActiveEcuC
  module config BmwHwAgArbnAndEotPosn: implementation-config-variant=VARIANT-PRE-COMPILE
    BmwHwAgArbnAndEotPosnGeneral: NTCHWAGSNSRNOTTRIM=NTCNR_0X1E4, NTCLOSSOFPINIOINAGZEROSPD=NTCNR_0X0E0, NTCLOSSOFPINIONAG=NTCNR_0X0E1
