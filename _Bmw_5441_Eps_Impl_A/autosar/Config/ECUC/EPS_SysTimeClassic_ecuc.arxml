AUTOSAR XML (schema 4-3-0)
package /ActiveEcuC
  module config SysTimeClassic: implementation-config-variant=VARIANT-PRE-COMPILE
    SysTimeGeneral: SysTimeEnableServiceInterface=false
    CommonPublishedInformation: SwMajorVersion=5, SwMinorVersion=0, SwPatchVersion=3
