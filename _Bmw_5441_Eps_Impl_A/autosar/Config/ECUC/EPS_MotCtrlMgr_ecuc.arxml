AUTOSAR XML (schema 4-3-0)
package /ActiveEcuC
  module config MotCtrlMgr: implementation-config-variant=VARIANT-PRE-COMPILE
    MotCtrlMgrConfigSet
      RunnableManagement:
        IncludeHeaders = CDD_Adc0CfgAndUse.h
        IncludeHeaders = CDD_Bmw5441McuCfg_Stub.h
        IncludeHeaders = CDD_CurrMeas.h
        IncludeHeaders = CDD_MotAg0Meas.h
        IncludeHeaders = CDD_MotAg1Meas.h
        IncludeHeaders = CDD_TSG31CfgAndUse.h
        IncludeHeaders = CDD_HwTq4Meas.h
        IncludeHeaders = CDD_HwTq5Meas.h
        IncludeHeaders = CDD_MotAgCmp.h
        IncludeHeaders = CDD_SinVltgGenn.h
        IncludeHeaders = CDD_MotVel.h
        IncludeHeaders = CDD_MotCurrRegVltgLimr.h
        16 x Runnable:
          MotAg1MeasPer1: RunnableRate=MotorControl, SequenceOrder=2
          MotAgCmpPer1: RunnableRate=MotorControl, SequenceOrder=4
          Adc0CfgAndUsePer1: RunnableRate=MotorControlx2, SequenceOrder=11
          Bmw5441McuCfgPer1: RunnableRate=MotorControl, SequenceOrder=5
          MotAg0MeasPer1: RunnableRate=MotorControl, SequenceOrder=1
          SinVltgGennPer2: RunnableRate=MotorControl, SequenceOrder=14
          SinVltgGennPer1: RunnableRate=MotorControl, SequenceOrder=12
          HwTq4MeasPer1: RunnableRate=MotorControl, SequenceOrder=16
          HwTq5MeasPer1: RunnableRate=MotorControl, SequenceOrder=17
          CurrMeasPer2: RunnableRate=MotorControlx2, SequenceOrder=6
          TSG31CfgAndUsePer1: RunnableRate=MotorControl, SequenceOrder=13
          MotCurrRegVltgLimrPer1: RunnableRate=MotorControlx2, SequenceOrder=8
          MotVelPer1: RunnableRate=MotorControl, SequenceOrder=15
          CurrMeasArbnPer1: RunnableRate=MotorControlx2, SequenceOrder=7
          McuDiagcPer1: RunnableRate=MotorControlx2, SequenceOrder=9
          BattRtnCurrPer1: RunnableRate=MotorControlx2, SequenceOrder=10
      SignalManagement
        PhaOnTiSumB (Signal):
          WrittenInMotCtrlRunnable = true
          ReadInMotCtrlRunnable = false
          WrittenIn2msRunnable = false
          ReadIn2msRunnable = true
          ImplementationDataType = uint32
          Size = 1
          InitialValue = 0U
          Min = 0
          Max = 4294967295
          Units = NanoSec
        PhaOnTiSumC (Signal):
          WrittenInMotCtrlRunnable = true
          ReadInMotCtrlRunnable = false
          WrittenIn2msRunnable = false
          ReadIn2msRunnable = true
          ImplementationDataType = uint32
          Size = 1
          InitialValue = 0U
          Min = 0
          Max = 4294967295
          Units = NanoSec
        MotAg0MeclRollgCntrMap (SignalMapping): OutputSignalName=MotAg0MeclRollgCntr, InputSignalName=MotAgAMeclRollgCntr
        3 x Signal, all with ReadInMotCtrlRunnable=true, Size=1:
          MotAgElec: WrittenInMotCtrlRunnable=true, WrittenIn2msRunnable=false, ReadIn2msRunnable=false, ImplementationDataType=uint16, InitialValue=0U, Min=0, Max=0.9999847412, Units=MotRevElec
          MotVelMrf: WrittenInMotCtrlRunnable=false, WrittenIn2msRunnable=true, ReadIn2msRunnable=true, ImplementationDataType=float32, InitialValue=0.0F, Min=-1350, Max=1350, Units=MotRadPerSec
          IvtrFetFltTyp: WrittenInMotCtrlRunnable=false, WrittenIn2msRunnable=true, ReadIn2msRunnable=true, ImplementationDataType=uint8, InitialValue=IVTRFETFLTTYP_NOFETFLT, Min=0, Max=4, Units=Cnt, EnumerationNameReference=IvtrFetFltTyp1
        BattVltgAdcMap (SignalMapping): OutputSignalName=BattVltgAdc, InputSignalName=BattVltg
        SysSt1 (NonRteEnum): EnumImplementationDataType=uint8
          4 x EnumElement:
            SYSST_DI: Value=0
            SYSST_ENA: Value=2
            SYSST_OFF: Value=1
            SYSST_WRMININ: Value=3
        13 x Signal, all with Size=1:
          CurrMeasMotAgCorrd: WrittenInMotCtrlRunnable=true, ReadInMotCtrlRunnable=true, WrittenIn2msRunnable=false, ReadIn2msRunnable=false, ImplementationDataType=float32, InitialValue=0.0F, Min=-6.2832, Max=6.2832, Units=MotRad
          MotAg1Mecl: WrittenInMotCtrlRunnable=true, ReadInMotCtrlRunnable=false, WrittenIn2msRunnable=false, ReadIn2msRunnable=false, ImplementationDataType=uint16, InitialValue=0U, Min=0, Max=0.9999847412, Units=MotRev
          HwTq4RawAdc: WrittenInMotCtrlRunnable=true, ReadInMotCtrlRunnable=false, WrittenIn2msRunnable=false, ReadIn2msRunnable=true, ImplementationDataType=float32, InitialValue=0.0F, Min=0, Max=5, Units=Volt
          MotCurrAdcPeakC: WrittenInMotCtrlRunnable=true, ReadInMotCtrlRunnable=false, WrittenIn2msRunnable=false, ReadIn2msRunnable=false, ImplementationDataType=float32, InitialValue=0.0F, Min=0, Max=5, Units=Volt
          CurrMeasWrmIninTestCmpl: WrittenInMotCtrlRunnable=false, ReadInMotCtrlRunnable=true, WrittenIn2msRunnable=true, ReadIn2msRunnable=true, ImplementationDataType=boolean, InitialValue=FALSE, Min=0, Max=1, Units=Cnt
          MotCurrAdcPeakA: WrittenInMotCtrlRunnable=true, ReadInMotCtrlRunnable=false, WrittenIn2msRunnable=false, ReadIn2msRunnable=false, ImplementationDataType=float32, InitialValue=0.0F, Min=0, Max=5, Units=Volt
          MotCurrAdcPeakB: WrittenInMotCtrlRunnable=true, ReadInMotCtrlRunnable=false, WrittenIn2msRunnable=false, ReadIn2msRunnable=false, ImplementationDataType=float32, InitialValue=0.0F, Min=0, Max=5, Units=Volt
          SysSt: WrittenInMotCtrlRunnable=false, ReadInMotCtrlRunnable=true, WrittenIn2msRunnable=true, ReadIn2msRunnable=true, ImplementationDataType=uint8, InitialValue=SYSST_WRMININ, Min=0, Max=3, Units=Cnt, EnumerationNameReference=SysSt1
          MotCurrEolCalSt: WrittenInMotCtrlRunnable=false, ReadInMotCtrlRunnable=true, WrittenIn2msRunnable=true, ReadIn2msRunnable=true, ImplementationDataType=uint8, InitialValue=MCECS_OFFSCMDSTRT, Min=0, Max=8, Units=Cnt, EnumerationNameReference=MotCurrEolCalSt2
          MotAg0ErrReg: WrittenInMotCtrlRunnable=true, ReadInMotCtrlRunnable=false, WrittenIn2msRunnable=false, ReadIn2msRunnable=true, ImplementationDataType=uint32, InitialValue=0U, Min=0, Max=67108863, Units=Cnt
          MotAg0VltgFltCnt: WrittenInMotCtrlRunnable=true, ReadInMotCtrlRunnable=false, WrittenIn2msRunnable=false, ReadIn2msRunnable=true, ImplementationDataType=uint16, InitialValue=0U, Min=0, Max=65535, Units=Cnt
          DiagcStsIvtr1Inactv: WrittenInMotCtrlRunnable=false, ReadInMotCtrlRunnable=true, WrittenIn2msRunnable=true, ReadIn2msRunnable=true, ImplementationDataType=boolean, InitialValue=FALSE, Min=0, Max=1, Units=Cnt
          MotCurrAdcVlyAAdcFaild: WrittenInMotCtrlRunnable=false, ReadInMotCtrlRunnable=true, WrittenIn2msRunnable=true, ReadIn2msRunnable=false, ImplementationDataType=boolean, InitialValue=FALSE, Min=0, Max=1, Units=Cnt
        CurrMeasLoaMtgtnEnaMap (SignalMapping): OutputSignalName=CurrMeasLoaMtgtnEna, InputSignalName=MotCurrLoaMtgtnEna
        SigQlfr1 (NonRteEnum): EnumImplementationDataType=uint8
          3 x EnumElement:
            SIGQLFR_FAILD: Value=2
            SIGQLFR_NORES: Value=0
            SIGQLFR_PASSD: Value=1
        20 x Signal, all with WrittenIn2msRunnable=false:
          MotCurrSnsrOffs1: WrittenInMotCtrlRunnable=true, ReadInMotCtrlRunnable=false, ReadIn2msRunnable=false, ImplementationDataType=float32, Size=1, InitialValue=0.0F, Min=0, Max=5, Units=Volt
          PwmPerd: WrittenInMotCtrlRunnable=true, ReadInMotCtrlRunnable=true, ReadIn2msRunnable=false, ImplementationDataType=uint32, Size=1, InitialValue=62500U, Min=55555, Max=71429, Units=NanoSec
          MotAg0RawRes: WrittenInMotCtrlRunnable=false, ReadInMotCtrlRunnable=true, ReadIn2msRunnable=false, ImplementationDataType=uint32, Size=5, InitialValue=0U, 0U, 0U, 0U, 0U, Min=0, Max=67108863, Units=Cnt
          CmuOffs: WrittenInMotCtrlRunnable=true, ReadInMotCtrlRunnable=false, ReadIn2msRunnable=false, ImplementationDataType=uint32, Size=1, InitialValue=0U, Min=0, Max=71429, Units=NanoSec
          Adc0SelfDiag4: WrittenInMotCtrlRunnable=true, ReadInMotCtrlRunnable=false, ReadIn2msRunnable=true, ImplementationDataType=float32, Size=1, InitialValue=0.0F, Min=0, Max=5, Units=Volt
          MotAg1MeclRollgCntr: WrittenInMotCtrlRunnable=true, ReadInMotCtrlRunnable=false, ReadIn2msRunnable=false, ImplementationDataType=uint8, Size=1, InitialValue=0U, Min=0, Max=255, Units=Cnt
          SwCalEna: WrittenInMotCtrlRunnable=false, ReadInMotCtrlRunnable=true, ReadIn2msRunnable=false, ImplementationDataType=boolean, Size=1, InitialValue=FALSE, Min=0, Max=1, Units=Cnt
          HwTq4RawFastAdcBuf: WrittenInMotCtrlRunnable=true, ReadInMotCtrlRunnable=false, ReadIn2msRunnable=true, ImplementationDataType=float32, Size=8, InitialValue=0.0F, 0.0F, 0.0F, 0.0F, 0.0F, 0.0F, 0.0F, 0.0F, Min=0, Max=5, Units=Volt
          MotCurrCorrdC: WrittenInMotCtrlRunnable=true, ReadInMotCtrlRunnable=true, ReadIn2msRunnable=true, ImplementationDataType=float32, Size=1, InitialValue=0.0F, Min=-200, Max=200, Units=Ampr
          MotCurrCorrdB: WrittenInMotCtrlRunnable=true, ReadInMotCtrlRunnable=true, ReadIn2msRunnable=true, ImplementationDataType=float32, Size=1, InitialValue=0.0F, Min=-200, Max=200, Units=Ampr
          Adc0SelfDiag2: WrittenInMotCtrlRunnable=true, ReadInMotCtrlRunnable=false, ReadIn2msRunnable=true, ImplementationDataType=float32, Size=1, InitialValue=0.0F, Min=0, Max=5, Units=Volt
          MotCurrCorrdA: WrittenInMotCtrlRunnable=true, ReadInMotCtrlRunnable=true, ReadIn2msRunnable=true, ImplementationDataType=float32, Size=1, InitialValue=0.0F, Min=-200, Max=200, Units=Ampr
          MotAg0TurnCntrReg: WrittenInMotCtrlRunnable=true, ReadInMotCtrlRunnable=false, ReadIn2msRunnable=true, ImplementationDataType=uint32, Size=1, InitialValue=0U, Min=0, Max=67108863, Units=Cnt
          Adc0SelfDiag0: WrittenInMotCtrlRunnable=true, ReadInMotCtrlRunnable=false, ReadIn2msRunnable=true, ImplementationDataType=float32, Size=1, InitialValue=0.0F, Min=0, Max=5, Units=Volt
          MotPhaAdv: WrittenInMotCtrlRunnable=true, ReadInMotCtrlRunnable=true, ReadIn2msRunnable=false, ImplementationDataType=uint16, Size=1, InitialValue=0U, Min=0, Max=0.9999847412, Units=MotRev
          PhaOnTiSumA: WrittenInMotCtrlRunnable=true, ReadInMotCtrlRunnable=false, ReadIn2msRunnable=true, ImplementationDataType=uint32, Size=1, InitialValue=0U, Min=0, Max=4294967295, Units=NanoSec
          Adc0ScanGroup2Ref1: WrittenInMotCtrlRunnable=true, ReadInMotCtrlRunnable=false, ReadIn2msRunnable=true, ImplementationDataType=float32, Size=1, InitialValue=0.0F, Min=0, Max=5, Units=Volt
          MotAg1TurnCntrReg: WrittenInMotCtrlRunnable=true, ReadInMotCtrlRunnable=false, ReadIn2msRunnable=true, ImplementationDataType=uint32, Size=1, InitialValue=0U, Min=0, Max=67108863, Units=Cnt
          Adc0ScanGroup2Ref0: WrittenInMotCtrlRunnable=true, ReadInMotCtrlRunnable=false, ReadIn2msRunnable=true, ImplementationDataType=float32, Size=1, InitialValue=0.0F, Min=0, Max=5, Units=Volt
          MotModlnIdx: WrittenInMotCtrlRunnable=true, ReadInMotCtrlRunnable=true, ReadIn2msRunnable=false, ImplementationDataType=float32, Size=1, InitialValue=0.0F, Min=0, Max=1, Units=Uls
        MotAg1MeclMap (SignalMapping): OutputSignalName=MotAg1Mecl, InputSignalName=MotAgBMecl
        MotCurrEolCalSt2 (NonRteEnum): EnumImplementationDataType=uint8
          9 x EnumElement:
            MCECS_CMDSAFEST: Value=8
            MCECS_GAINCMDAD: Value=5
            MCECS_GAINCMDBE: Value=6
            MCECS_GAINCMDCF: Value=7
            MCECS_OFFSCMDEND: Value=4
            MCECS_OFFSCMDHI: Value=1
            MCECS_OFFSCMDLO: Value=2
            MCECS_OFFSCMDSTRT: Value=0
            MCECS_OFFSCMDZERO: Value=3
        HwTq5RawFastAdc (Signal):
          WrittenInMotCtrlRunnable = false
          ReadInMotCtrlRunnable = true
          WrittenIn2msRunnable = false
          ReadIn2msRunnable = false
          ImplementationDataType = float32
          Size = 1
          InitialValue = 0.0F
          Min = 0
          Max = 5
          Units = Volt
        MotAg0MeclMap (SignalMapping): OutputSignalName=MotAg0Mecl, InputSignalName=MotAgMecl, InputSignalName=MotAgAMecl
        14 x Signal:
          MotCurrAdcVlyBAdcFaild: WrittenInMotCtrlRunnable=false, ReadInMotCtrlRunnable=true, WrittenIn2msRunnable=true, ReadIn2msRunnable=false, ImplementationDataType=boolean, Size=1, InitialValue=FALSE, Min=0, Max=1, Units=Cnt
          VehSpd: WrittenInMotCtrlRunnable=false, ReadInMotCtrlRunnable=true, WrittenIn2msRunnable=true, ReadIn2msRunnable=true, ImplementationDataType=float32, Size=1, InitialValue=0.0F, Min=0, Max=511, Units=Kph
          MotAgMecl: WrittenInMotCtrlRunnable=false, ReadInMotCtrlRunnable=true, WrittenIn2msRunnable=false, ReadIn2msRunnable=false, ImplementationDataType=uint16, Size=1, InitialValue=0U, Min=0, Max=0.9999847412, Units=MotRev
          MotAgBMeclRollgCntr: WrittenInMotCtrlRunnable=false, ReadInMotCtrlRunnable=false, WrittenIn2msRunnable=false, ReadIn2msRunnable=true, ImplementationDataType=uint8, Size=1, InitialValue=0U, Min=0, Max=255, Units=Cnt
          MotAg1RawRes: WrittenInMotCtrlRunnable=false, ReadInMotCtrlRunnable=true, WrittenIn2msRunnable=false, ReadIn2msRunnable=false, ImplementationDataType=uint32, Size=5, InitialValue=0U, 0U, 0U, 0U, 0U, Min=0, Max=67108863, Units=Cnt
          BattVltg: WrittenInMotCtrlRunnable=false, ReadInMotCtrlRunnable=false, WrittenIn2msRunnable=false, ReadIn2msRunnable=true, ImplementationDataType=float32, Size=1, InitialValue=5.0F, Min=0, Max=40, Units=Volt
          MotAg0ParFltCnt: WrittenInMotCtrlRunnable=true, ReadInMotCtrlRunnable=false, WrittenIn2msRunnable=false, ReadIn2msRunnable=true, ImplementationDataType=uint16, Size=1, InitialValue=0U, Min=0, Max=65535, Units=Cnt
          MotAgMeasTi: WrittenInMotCtrlRunnable=true, ReadInMotCtrlRunnable=true, WrittenIn2msRunnable=false, ReadIn2msRunnable=false, ImplementationDataType=uint32, Size=1, InitialValue=0U, Min=0, Max=4294967295, Units=Cnt
          BattRtnCurrAdc: WrittenInMotCtrlRunnable=true, ReadInMotCtrlRunnable=true, WrittenIn2msRunnable=false, ReadIn2msRunnable=true, ImplementationDataType=float32, Size=1, InitialValue=0.0F, Min=0, Max=5, Units=Volt
          SwCalPosnIdx: WrittenInMotCtrlRunnable=false, ReadInMotCtrlRunnable=true, WrittenIn2msRunnable=false, ReadIn2msRunnable=false, ImplementationDataType=uint16, Size=1, InitialValue=0U, Min=0, Max=0.9999847412, Units=Cnt
          BattVltgAdc: WrittenInMotCtrlRunnable=true, ReadInMotCtrlRunnable=false, WrittenIn2msRunnable=false, ReadIn2msRunnable=false, ImplementationDataType=float32, Size=1, InitialValue=0.0F, Min=0, Max=40, Units=Volt
          MotAg1ParFltCnt: WrittenInMotCtrlRunnable=true, ReadInMotCtrlRunnable=false, WrittenIn2msRunnable=false, ReadIn2msRunnable=true, ImplementationDataType=uint16, Size=1, InitialValue=0U, Min=0, Max=65535, Units=Cnt
          EcuTFild: WrittenInMotCtrlRunnable=false, ReadInMotCtrlRunnable=true, WrittenIn2msRunnable=true, ReadIn2msRunnable=true, ImplementationDataType=float32, Size=1, InitialValue=25.0F, Min=-50, Max=150, Units=DegCgrd
          AdcDiagcStrtPtrOutp: WrittenInMotCtrlRunnable=false, ReadInMotCtrlRunnable=true, WrittenIn2msRunnable=true, ReadIn2msRunnable=true, ImplementationDataType=uint8, Size=1, InitialValue=21U, Min=21, Max=23, Units=Cnt
        MfgEnaSt1 (NonRteEnum): EnumImplementationDataType=uint8
          3 x EnumElement:
            MFGENAST_MFGMOD: Value=1
            MFGENAST_PRDNMOD: Value=0
            MFGENAST_TESTMOD: Value=2
        9 x Signal, all with Size=1, Min=0:
          MotCurrAdcVlyC: WrittenInMotCtrlRunnable=true, ReadInMotCtrlRunnable=true, WrittenIn2msRunnable=false, ReadIn2msRunnable=true, ImplementationDataType=float32, InitialValue=0.0F, Max=5, Units=Volt
          MotAgCumvInid: WrittenInMotCtrlRunnable=true, ReadInMotCtrlRunnable=false, WrittenIn2msRunnable=false, ReadIn2msRunnable=true, ImplementationDataType=boolean, InitialValue=FALSE, Max=1, Units=Cnt
          MotCurrRollgCntr1: WrittenInMotCtrlRunnable=true, ReadInMotCtrlRunnable=true, WrittenIn2msRunnable=false, ReadIn2msRunnable=true, ImplementationDataType=uint8, InitialValue=0U, Max=255, Units=Cnt
          MotAgBMecl: WrittenInMotCtrlRunnable=false, ReadInMotCtrlRunnable=false, WrittenIn2msRunnable=false, ReadIn2msRunnable=true, ImplementationDataType=uint16, InitialValue=0U, Max=0.9999847412, Units=MotRev
          PhaOnTiC: WrittenInMotCtrlRunnable=true, ReadInMotCtrlRunnable=true, WrittenIn2msRunnable=false, ReadIn2msRunnable=false, ImplementationDataType=uint32, InitialValue=0U, Max=71429, Units=NanoSec
          PhaOnTiA: WrittenInMotCtrlRunnable=true, ReadInMotCtrlRunnable=true, WrittenIn2msRunnable=false, ReadIn2msRunnable=false, ImplementationDataType=uint32, InitialValue=0U, Max=71429, Units=NanoSec
          PhaOnTiB: WrittenInMotCtrlRunnable=true, ReadInMotCtrlRunnable=true, WrittenIn2msRunnable=false, ReadIn2msRunnable=false, ImplementationDataType=uint32, InitialValue=0U, Max=71429, Units=NanoSec
          MotAgAMeclRollgCntr: WrittenInMotCtrlRunnable=false, ReadInMotCtrlRunnable=false, WrittenIn2msRunnable=false, ReadIn2msRunnable=true, ImplementationDataType=uint8, InitialValue=0U, Max=255, Units=Cnt
          MotCurrAdcVlyCAdcFaild: WrittenInMotCtrlRunnable=false, ReadInMotCtrlRunnable=true, WrittenIn2msRunnable=true, ReadIn2msRunnable=false, ImplementationDataType=boolean, InitialValue=FALSE, Max=1, Units=Cnt
        MotAg1MeclRollgCntrMap (SignalMapping): OutputSignalName=MotAg1MeclRollgCntr, InputSignalName=MotAgBMeclRollgCntr
        16 x Signal:
          MotAg0Mecl: WrittenInMotCtrlRunnable=true, ReadInMotCtrlRunnable=false, WrittenIn2msRunnable=false, ReadIn2msRunnable=false, ImplementationDataType=uint16, Size=1, InitialValue=0U, Min=0, Max=0.9999847412, Units=MotRev
          AdcDiagcEndPtrOutp: WrittenInMotCtrlRunnable=false, ReadInMotCtrlRunnable=true, WrittenIn2msRunnable=true, ReadIn2msRunnable=true, ImplementationDataType=uint8, Size=1, InitialValue=23U, Min=21, Max=23, Units=Cnt
          MotAg1ErrReg: WrittenInMotCtrlRunnable=true, ReadInMotCtrlRunnable=false, WrittenIn2msRunnable=false, ReadIn2msRunnable=true, ImplementationDataType=uint32, Size=1, InitialValue=0U, Min=0, Max=67108863, Units=Cnt
          RegInpADCD0SGSR1: WrittenInMotCtrlRunnable=false, ReadInMotCtrlRunnable=true, WrittenIn2msRunnable=false, ReadIn2msRunnable=false, ImplementationDataType=uint8, Size=1, InitialValue=0U, Min=0, Max=255, Units=Cnt
          MotElecMeclPolarity: WrittenInMotCtrlRunnable=false, ReadInMotCtrlRunnable=true, WrittenIn2msRunnable=true, ReadIn2msRunnable=false, ImplementationDataType=sint8, Size=1, InitialValue=1, Min=-1, Max=1, Units=Uls
          HwTq5RawAdc: WrittenInMotCtrlRunnable=true, ReadInMotCtrlRunnable=false, WrittenIn2msRunnable=false, ReadIn2msRunnable=true, ImplementationDataType=float32, Size=1, InitialValue=0.0F, Min=0, Max=5, Units=Volt
          MotAg1VltgFltCnt: WrittenInMotCtrlRunnable=true, ReadInMotCtrlRunnable=false, WrittenIn2msRunnable=false, ReadIn2msRunnable=true, ImplementationDataType=uint16, Size=1, InitialValue=0U, Min=0, Max=65535, Units=Cnt
          MotCurrAdcVlyB: WrittenInMotCtrlRunnable=true, ReadInMotCtrlRunnable=true, WrittenIn2msRunnable=false, ReadIn2msRunnable=true, ImplementationDataType=float32, Size=1, InitialValue=0.0F, Min=0, Max=5, Units=Volt
          MotCurrAdcVlyA: WrittenInMotCtrlRunnable=true, ReadInMotCtrlRunnable=true, WrittenIn2msRunnable=false, ReadIn2msRunnable=true, ImplementationDataType=float32, Size=1, InitialValue=0.0F, Min=0, Max=5, Units=Volt
          HwTq4RawFastAdc: WrittenInMotCtrlRunnable=false, ReadInMotCtrlRunnable=true, WrittenIn2msRunnable=false, ReadIn2msRunnable=false, ImplementationDataType=float32, Size=1, InitialValue=0.0F, Min=0, Max=5, Units=Volt
          MotAgCumvAlgndMrfRev: WrittenInMotCtrlRunnable=true, ReadInMotCtrlRunnable=false, WrittenIn2msRunnable=false, ReadIn2msRunnable=true, ImplementationDataType=sint32, Size=1, InitialValue=0, Min=-32768, Max=32767.99998, Units=MotRev
          MfgEnaSt: WrittenInMotCtrlRunnable=false, ReadInMotCtrlRunnable=true, WrittenIn2msRunnable=false, ReadIn2msRunnable=true, ImplementationDataType=uint8, Size=1, InitialValue=MFGENAST_PRDNMOD, Min=0, Max=2, Units=Cnt, EnumerationNameReference=MfgEnaSt1
          BrdgVltg: WrittenInMotCtrlRunnable=false, ReadInMotCtrlRunnable=true, WrittenIn2msRunnable=true, ReadIn2msRunnable=true, ImplementationDataType=float32, Size=1, InitialValue=6.0F, Min=6, Max=26.5, Units=Volt
          MotAg0MeclRollgCntr: WrittenInMotCtrlRunnable=true, ReadInMotCtrlRunnable=false, WrittenIn2msRunnable=false, ReadIn2msRunnable=false, ImplementationDataType=uint8, Size=1, InitialValue=0U, Min=0, Max=255, Units=Cnt
          SwCalModlnIdx: WrittenInMotCtrlRunnable=false, ReadInMotCtrlRunnable=true, WrittenIn2msRunnable=false, ReadIn2msRunnable=false, ImplementationDataType=float32, Size=1, InitialValue=0.0F, Min=0, Max=1, Units=Uls
          HwTq5RawFastAdcBuf: WrittenInMotCtrlRunnable=true, ReadInMotCtrlRunnable=false, WrittenIn2msRunnable=false, ReadIn2msRunnable=true, ImplementationDataType=float32, Size=8, InitialValue=0.0F, 0.0F, 0.0F, 0.0F, 0.0F, 0.0F, 0.0F, 0.0F, Min=0, Max=5, Units=Volt
        IvtrFetFltPha1 (NonRteEnum): EnumImplementationDataType=uint8
          4 x EnumElement:
            IVTRFETFLTPHA_NOPHASNGFETFLT: Value=0
            IVTRFETFLTPHA_PHAASNGFETFLT: Value=1
            IVTRFETFLTPHA_PHABSNGFETFLT: Value=2
            IVTRFETFLTPHA_PHACSNGFETFLT: Value=4
        3 x Signal, all with WrittenIn2msRunnable=false, Min=0:
          Adc0ScanGroup3Ref1: WrittenInMotCtrlRunnable=true, ReadInMotCtrlRunnable=false, ReadIn2msRunnable=true, ImplementationDataType=float32, Size=1, InitialValue=0.0F, Max=5, Units=Volt
          Adc0ScanGroup3Ref0: WrittenInMotCtrlRunnable=true, ReadInMotCtrlRunnable=false, ReadIn2msRunnable=true, ImplementationDataType=float32, Size=1, InitialValue=0.0F, Max=5, Units=Volt
          Adc0RawRes: WrittenInMotCtrlRunnable=false, ReadInMotCtrlRunnable=true, ReadIn2msRunnable=false, ImplementationDataType=uint16, Size=24, InitialValue=0U, 0U, 0U, 0U, 0U, 0U, 0U, 0U, 0U, 0U, 0U, 0U, 0U, 0U, 0U, 0U, 0U, 0U, 0U, 0U, 0U, 0U, 0U, 0U, Max=4095, Units=Cnt
        IvtrFetFltTyp1 (NonRteEnum): EnumImplementationDataType=uint8
          4 x EnumElement:
            IVTRFETFLTTYP_NOFETFLT: Value=0
            IVTRFETFLTTYP_LOWRFETFLT: Value=1
            IVTRFETFLTTYP_UPPRFETFLT: Value=2
            IVTRFETFLTTYP_MPLFETFLT: Value=4
        45 x Signal:
          Ntc5DErrCnt: WrittenInMotCtrlRunnable=true, ReadInMotCtrlRunnable=false, WrittenIn2msRunnable=false, ReadIn2msRunnable=true, ImplementationDataType=uint16, Size=1, InitialValue=0U, Min=0, Max=65535, Units=Cnt
          IvtrFetFltPha: WrittenInMotCtrlRunnable=false, ReadInMotCtrlRunnable=true, WrittenIn2msRunnable=true, ReadIn2msRunnable=true, ImplementationDataType=uint8, Size=1, InitialValue=IVTRFETFLTPHA_NOPHASNGFETFLT, Min=0, Max=4, Units=Cnt, EnumerationNameReference=IvtrFetFltPha1
          DualEcuMotCtrlMtgtnEna: WrittenInMotCtrlRunnable=false, ReadInMotCtrlRunnable=true, WrittenIn2msRunnable=false, ReadIn2msRunnable=true, ImplementationDataType=boolean, Size=1, InitialValue=FALSE, Min=0, Max=1, Units=Cnt
          MotAgBuf: WrittenInMotCtrlRunnable=true, ReadInMotCtrlRunnable=true, WrittenIn2msRunnable=false, ReadIn2msRunnable=true, ImplementationDataType=uint16, Size=8, InitialValue=0U, 0U, 0U, 0U, 0U, 0U, 0U, 0U, Min=0, Max=0.9999847412, Units=MotRev
          MotAgBufIdx: WrittenInMotCtrlRunnable=true, ReadInMotCtrlRunnable=false, WrittenIn2msRunnable=false, ReadIn2msRunnable=true, ImplementationDataType=uint8, Size=1, InitialValue=0U, Min=0, Max=7, Units=Cnt
          MotAgElecDly: WrittenInMotCtrlRunnable=false, ReadInMotCtrlRunnable=true, WrittenIn2msRunnable=true, ReadIn2msRunnable=false, ImplementationDataType=float32, Size=1, InitialValue=0.0F, Min=-1.5, Max=1.5, Units=MotRad
          MotAgTiBuf: WrittenInMotCtrlRunnable=true, ReadInMotCtrlRunnable=true, WrittenIn2msRunnable=false, ReadIn2msRunnable=true, ImplementationDataType=uint32, Size=8, InitialValue=0U, 62U, 125U, 187U, 250U, 312U, 375U, 437U, Min=0, Max=4294967295, Units=MicroSec
          MotBackEmfVltg: WrittenInMotCtrlRunnable=false, ReadInMotCtrlRunnable=true, WrittenIn2msRunnable=true, ReadIn2msRunnable=false, ImplementationDataType=float32, Size=1, InitialValue=0.0F, Min=-101.25, Max=101.25, Units=Volt
          MotCurrDax: WrittenInMotCtrlRunnable=true, ReadInMotCtrlRunnable=true, WrittenIn2msRunnable=false, ReadIn2msRunnable=true, ImplementationDataType=float32, Size=1, InitialValue=0.0F, Min=-200, Max=200, Units=Ampr
          MotCurrDaxCmd: WrittenInMotCtrlRunnable=false, ReadInMotCtrlRunnable=true, WrittenIn2msRunnable=true, ReadIn2msRunnable=true, ImplementationDataType=float32, Size=1, InitialValue=0.0F, Min=0, Max=220, Units=Ampr
          MotCurrDaxMax: WrittenInMotCtrlRunnable=false, ReadInMotCtrlRunnable=true, WrittenIn2msRunnable=true, ReadIn2msRunnable=false, ImplementationDataType=float32, Size=1, InitialValue=0.0F, Min=0, Max=220, Units=Ampr
          MotCurrQax: WrittenInMotCtrlRunnable=true, ReadInMotCtrlRunnable=true, WrittenIn2msRunnable=false, ReadIn2msRunnable=true, ImplementationDataType=float32, Size=1, InitialValue=0.0F, Min=-200, Max=200, Units=Ampr
          MotCurrQaxCmd: WrittenInMotCtrlRunnable=false, ReadInMotCtrlRunnable=true, WrittenIn2msRunnable=true, ReadIn2msRunnable=true, ImplementationDataType=float32, Size=1, InitialValue=0.0F, Min=-220, Max=220, Units=Ampr
          MotCurrQaxCmdFinal: WrittenInMotCtrlRunnable=true, ReadInMotCtrlRunnable=false, WrittenIn2msRunnable=false, ReadIn2msRunnable=false, ImplementationDataType=float32, Size=1, InitialValue=0.0F, Min=-200, Max=200, Units=Ampr
          MotCurrQaxCoggCmd: WrittenInMotCtrlRunnable=false, ReadInMotCtrlRunnable=true, WrittenIn2msRunnable=false, ReadIn2msRunnable=false, ImplementationDataType=float32, Size=1, InitialValue=0.0F, Min=-6, Max=6, Units=Ampr
          MotCurrQaxRplCmd: WrittenInMotCtrlRunnable=false, ReadInMotCtrlRunnable=true, WrittenIn2msRunnable=false, ReadIn2msRunnable=false, ImplementationDataType=float32, Size=1, InitialValue=0.0F, Min=-29, Max=29, Units=Ampr
          MotDampgDax: WrittenInMotCtrlRunnable=false, ReadInMotCtrlRunnable=true, WrittenIn2msRunnable=true, ReadIn2msRunnable=false, ImplementationDataType=float32, Size=1, InitialValue=0.0F, Min=-0.11, Max=5.5, Units=Ohm
          MotDampgQax: WrittenInMotCtrlRunnable=false, ReadInMotCtrlRunnable=true, WrittenIn2msRunnable=true, ReadIn2msRunnable=false, ImplementationDataType=float32, Size=1, InitialValue=0.0F, Min=-0.11, Max=5.5, Units=Ohm
          MotInduDaxEstimdIvs: WrittenInMotCtrlRunnable=false, ReadInMotCtrlRunnable=true, WrittenIn2msRunnable=true, ReadIn2msRunnable=false, ImplementationDataType=float32, Size=1, InitialValue=8412.0F, Min=2440, Max=33334, Units=IvsHenry
          MotInduQaxEstimdIvs: WrittenInMotCtrlRunnable=false, ReadInMotCtrlRunnable=true, WrittenIn2msRunnable=true, ReadIn2msRunnable=false, ImplementationDataType=float32, Size=1, InitialValue=8412.0F, Min=2440, Max=33334, Units=IvsHenry
          MotIntglGainDax: WrittenInMotCtrlRunnable=false, ReadInMotCtrlRunnable=true, WrittenIn2msRunnable=true, ReadIn2msRunnable=false, ImplementationDataType=float32, Size=1, InitialValue=0.0F, Min=0, Max=0.6, Units=Ohm
          MotIntglGainQax: WrittenInMotCtrlRunnable=false, ReadInMotCtrlRunnable=true, WrittenIn2msRunnable=true, ReadIn2msRunnable=false, ImplementationDataType=float32, Size=1, InitialValue=0.0F, Min=0, Max=0.6, Units=Ohm
          MotPropGainDax: WrittenInMotCtrlRunnable=false, ReadInMotCtrlRunnable=true, WrittenIn2msRunnable=true, ReadIn2msRunnable=false, ImplementationDataType=float32, Size=1, InitialValue=0.0F, Min=0, Max=2.25, Units=Ohm
          MotPropGainQax: WrittenInMotCtrlRunnable=false, ReadInMotCtrlRunnable=true, WrittenIn2msRunnable=true, ReadIn2msRunnable=false, ImplementationDataType=float32, Size=1, InitialValue=0.0F, Min=0, Max=2.25, Units=Ohm
          MotReacncDax: WrittenInMotCtrlRunnable=false, ReadInMotCtrlRunnable=true, WrittenIn2msRunnable=true, ReadIn2msRunnable=false, ImplementationDataType=float32, Size=1, InitialValue=0.0F, Min=-2.87607, Max=2.87607, Units=Ohm
          MotReacncQax: WrittenInMotCtrlRunnable=false, ReadInMotCtrlRunnable=true, WrittenIn2msRunnable=true, ReadIn2msRunnable=false, ImplementationDataType=float32, Size=1, InitialValue=0.0F, Min=-2.87607, Max=2.87607, Units=Ohm
          MotREstimd: WrittenInMotCtrlRunnable=false, ReadInMotCtrlRunnable=true, WrittenIn2msRunnable=true, ReadIn2msRunnable=true, ImplementationDataType=float32, Size=1, InitialValue=0.005F, Min=0.005, Max=0.12565, Units=Ohm
          MotVltgDax: WrittenInMotCtrlRunnable=true, ReadInMotCtrlRunnable=false, WrittenIn2msRunnable=false, ReadIn2msRunnable=true, ImplementationDataType=float32, Size=1, InitialValue=0.0F, Min=-26.5, Max=26.5, Units=Volt
          MotVltgDaxFf: WrittenInMotCtrlRunnable=false, ReadInMotCtrlRunnable=true, WrittenIn2msRunnable=true, ReadIn2msRunnable=false, ImplementationDataType=float32, Size=1, InitialValue=0.0F, Min=-26.5, Max=26.5, Units=Volt
          MotVltgQax: WrittenInMotCtrlRunnable=true, ReadInMotCtrlRunnable=false, WrittenIn2msRunnable=false, ReadIn2msRunnable=true, ImplementationDataType=float32, Size=1, InitialValue=0.0F, Min=-26.5, Max=26.5, Units=Volt
          MotVltgQaxFf: WrittenInMotCtrlRunnable=false, ReadInMotCtrlRunnable=true, WrittenIn2msRunnable=true, ReadIn2msRunnable=false, ImplementationDataType=float32, Size=1, InitialValue=0.0F, Min=-101.25, Max=101.25, Units=Volt
          CurrMeasCorrlnSts: WrittenInMotCtrlRunnable=false, ReadInMotCtrlRunnable=true, WrittenIn2msRunnable=true, ReadIn2msRunnable=false, ImplementationDataType=uint8, Size=1, InitialValue=63U, Min=0, Max=63, Units=Cnt
          MotCurrQlfr2: WrittenInMotCtrlRunnable=false, ReadInMotCtrlRunnable=true, WrittenIn2msRunnable=false, ReadIn2msRunnable=false, ImplementationDataType=uint8, Size=1, InitialValue=SIGQLFR_NORES, Min=0, Max=2, Units=Cnt, EnumerationNameReference=SigQlfr1
          MotCurrQlfr1: WrittenInMotCtrlRunnable=false, ReadInMotCtrlRunnable=true, WrittenIn2msRunnable=true, ReadIn2msRunnable=true, ImplementationDataType=uint8, Size=1, InitialValue=SIGQLFR_NORES, Min=0, Max=2, Units=Cnt, EnumerationNameReference=SigQlfr1
          MotCurrCorrdF: WrittenInMotCtrlRunnable=false, ReadInMotCtrlRunnable=true, WrittenIn2msRunnable=false, ReadIn2msRunnable=false, ImplementationDataType=float32, Size=1, InitialValue=0.0F, Min=-200, Max=200, Units=Ampr
          MotCurrCorrdE: WrittenInMotCtrlRunnable=false, ReadInMotCtrlRunnable=true, WrittenIn2msRunnable=false, ReadIn2msRunnable=false, ImplementationDataType=float32, Size=1, InitialValue=0.0F, Min=-200, Max=200, Units=Ampr
          MotCurrCorrdD: WrittenInMotCtrlRunnable=false, ReadInMotCtrlRunnable=true, WrittenIn2msRunnable=false, ReadIn2msRunnable=false, ImplementationDataType=float32, Size=1, InitialValue=0.0F, Min=-200, Max=200, Units=Ampr
          MotCurrRollgCntr2: WrittenInMotCtrlRunnable=false, ReadInMotCtrlRunnable=true, WrittenIn2msRunnable=false, ReadIn2msRunnable=false, ImplementationDataType=uint8, Size=1, InitialValue=0U, Min=0, Max=255, Units=Cnt
          SlowLoopCntr: WrittenInMotCtrlRunnable=true, ReadInMotCtrlRunnable=false, WrittenIn2msRunnable=false, ReadIn2msRunnable=true, ImplementationDataType=uint16, Size=1, InitialValue=0U, Min=0, Max=65535, Units=Cnt
          FastLoopCntr: WrittenInMotCtrlRunnable=true, ReadInMotCtrlRunnable=false, WrittenIn2msRunnable=false, ReadIn2msRunnable=true, ImplementationDataType=uint16, Size=1, InitialValue=0U, Min=0, Max=65535, Units=Cnt
          LoopCntr2MilliSec: WrittenInMotCtrlRunnable=false, ReadInMotCtrlRunnable=true, WrittenIn2msRunnable=true, ReadIn2msRunnable=false, ImplementationDataType=uint16, Size=1, InitialValue=0U, Min=0, Max=65535, Units=Cnt
          MotAg1WarnReg: WrittenInMotCtrlRunnable=true, ReadInMotCtrlRunnable=false, WrittenIn2msRunnable=false, ReadIn2msRunnable=true, ImplementationDataType=uint32, Size=1, InitialValue=0U, Min=0, Max=67108863, Units=Cnt
          MotAg0WarnReg: WrittenInMotCtrlRunnable=true, ReadInMotCtrlRunnable=false, WrittenIn2msRunnable=false, ReadIn2msRunnable=true, ImplementationDataType=uint32, Size=1, InitialValue=0U, Min=0, Max=67108863, Units=Cnt
          PhaDiscnctDiagcActv: WrittenInMotCtrlRunnable=false, ReadInMotCtrlRunnable=true, WrittenIn2msRunnable=true, ReadIn2msRunnable=true, ImplementationDataType=boolean, Size=1, InitialValue=FALSE, Min=0, Max=1, Units=Cnt
          PhaDiscnctDiagcPwmVect: WrittenInMotCtrlRunnable=false, ReadInMotCtrlRunnable=true, WrittenIn2msRunnable=true, ReadIn2msRunnable=false, ImplementationDataType=uint8, Size=1, InitialValue=PHADISCNCTPWMVECT_NOCMD, Min=0, Max=4, Units=Cnt, EnumerationNameReference=PhaDiscnctPwmVect1
        PhaDiscnctPwmVect1 (NonRteEnum): EnumImplementationDataType=uint8
          4 x EnumElement:
            PHADISCNCTPWMVECT_NOCMD: Value=0
            PHADISCNCTPWMVECT_PHAACMD: Value=1
            PHADISCNCTPWMVECT_PHABCMD: Value=2
            PHADISCNCTPWMVECT_PHACCMD: Value=4
        15 x Signal, all with Size=1:
          MotAndThermProtnLoaMod: WrittenInMotCtrlRunnable=false, ReadInMotCtrlRunnable=true, WrittenIn2msRunnable=true, ReadIn2msRunnable=true, ImplementationDataType=uint8, InitialValue=0U, Min=0, Max=7, Units=Cnt
          TSG31CMP0E: WrittenInMotCtrlRunnable=true, ReadInMotCtrlRunnable=false, WrittenIn2msRunnable=false, ReadIn2msRunnable=false, ImplementationDataType=uint32, InitialValue=4444U, Min=0, Max=65535, Units=Cnt
          TSG31CMP12E: WrittenInMotCtrlRunnable=true, ReadInMotCtrlRunnable=false, WrittenIn2msRunnable=false, ReadIn2msRunnable=false, ImplementationDataType=uint32, InitialValue=4364U, Min=0, Max=262143, Units=Cnt
          TSG31CMPUE: WrittenInMotCtrlRunnable=true, ReadInMotCtrlRunnable=false, WrittenIn2msRunnable=false, ReadIn2msRunnable=false, ImplementationDataType=uint32, InitialValue=4444U, Min=0, Max=262143, Units=Cnt
          TSG31CMPVE: WrittenInMotCtrlRunnable=true, ReadInMotCtrlRunnable=false, WrittenIn2msRunnable=false, ReadIn2msRunnable=false, ImplementationDataType=uint32, InitialValue=4444U, Min=0, Max=262143, Units=Cnt
          TSG31CMPWE: WrittenInMotCtrlRunnable=true, ReadInMotCtrlRunnable=false, WrittenIn2msRunnable=false, ReadIn2msRunnable=false, ImplementationDataType=uint32, InitialValue=4444U, Min=0, Max=262143, Units=Cnt
          TSG31DCMP0E: WrittenInMotCtrlRunnable=true, ReadInMotCtrlRunnable=false, WrittenIn2msRunnable=false, ReadIn2msRunnable=false, ImplementationDataType=uint32, InitialValue=3964U, Min=0, Max=262143, Units=Cnt
          BattRtnCurrAmprFastLoop: WrittenInMotCtrlRunnable=true, ReadInMotCtrlRunnable=false, WrittenIn2msRunnable=false, ReadIn2msRunnable=false, ImplementationDataType=float32, InitialValue=0.0F, Min=-300, Max=300, Units=Ampr
          MotAgAMecl: WrittenInMotCtrlRunnable=false, ReadInMotCtrlRunnable=false, WrittenIn2msRunnable=false, ReadIn2msRunnable=true, ImplementationDataType=uint16, InitialValue=0U, Min=0, Max=0.9999847412, Units=MotRev
          MotAg3Mecl: WrittenInMotCtrlRunnable=true, ReadInMotCtrlRunnable=false, WrittenIn2msRunnable=false, ReadIn2msRunnable=true, ImplementationDataType=uint16, InitialValue=0U, Min=0, Max=0.9999847412, Units=MotRev
          MotAg0QepFaild: WrittenInMotCtrlRunnable=false, ReadInMotCtrlRunnable=true, WrittenIn2msRunnable=true, ReadIn2msRunnable=false, ImplementationDataType=boolean, InitialValue=FALSE, Min=0, Max=1, Units=Cnt
          MotAg0SpiMecl: WrittenInMotCtrlRunnable=true, ReadInMotCtrlRunnable=false, WrittenIn2msRunnable=false, ReadIn2msRunnable=true, ImplementationDataType=uint16, InitialValue=0U, Min=0, Max=0.9999847412, Units=MotRev
          MotAg4Mecl: WrittenInMotCtrlRunnable=true, ReadInMotCtrlRunnable=false, WrittenIn2msRunnable=false, ReadIn2msRunnable=true, ImplementationDataType=uint16, InitialValue=0U, Min=0, Max=0.9999847412, Units=MotRev
          MotAg1SpiMecl: WrittenInMotCtrlRunnable=true, ReadInMotCtrlRunnable=false, WrittenIn2msRunnable=false, ReadIn2msRunnable=true, ImplementationDataType=uint16, InitialValue=0U, Min=0, Max=0.9999847412, Units=MotRev
          MotAg1QepFaild: WrittenInMotCtrlRunnable=false, ReadInMotCtrlRunnable=true, WrittenIn2msRunnable=true, ReadIn2msRunnable=false, ImplementationDataType=boolean, InitialValue=FALSE, Min=0, Max=1, Units=Cnt
