AUTOSAR XML (schema 4-3-0)
package /ActiveEcuC
  module config Darh: implementation-config-variant=VARIANT-PRE-COMPILE
    CommonPublishedInformation: SwMajorVersion=5, SwMinorVersion=1, SwPatchVersion=0
    DarhGeneral: DarhActiveReportListType=POSITIVE_LIST, DarhDevErrorDetect=false, DarhQueueHandlerCycleTime=1, DarhQueueSize=3, DarhRetryCount=3
