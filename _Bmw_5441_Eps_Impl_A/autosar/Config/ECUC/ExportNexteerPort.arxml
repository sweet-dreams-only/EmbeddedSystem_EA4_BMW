AUTOSAR XML (schema 4-0-2)
package /ActiveEcuC
  ecuc value collection ECUConfiguration: ecuc-values=Port
  module config Port: implementation-config-variant=VARIANT-POST-BUILD, module-description=Port_Impl
    PortConfigSet
      PortContainer: PortNumberOfPortPins=1
        PortPin:
          PortPinDirection = PORT_PIN_IN
          PortPinDirectionChangeable = 0
          PortPinId = 1
          PortPinInitialMode = PORT_PIN_MODE_ADC
          PortPinLevelValue = PORT_PIN_LEVEL_HIGH
          PortPinMode = PORT_PIN_MODE_ADC
          PortPinModeChangeable = 0
      PortFilterGroupConfig: PortDigitalFilterClockSelection=McuHighspeedPeriClk0
        SamplingClockSourceSelection:
          PortClockSource0 = CLK_HSB_DNFCKS100C
          PortClockSource1 = CLK_HSB_DNFCKS108C
          PortClockSource2 = CLK_HSB_DNFCKS109C
          PortClockSource3 = CLK_HSB_DNFCKS110C
          PortClockSource4 = CLK_HSB_DNFCKS112C
          PortClockSource5 = CLK_HSB_DNFCKS113C
          PortClockSource6 = CLK_HSB_DNFCKS114C
          PortClockSource7 = CLK_HSB_DNFCKS104C
          PortClockSource8 = CLK_HSB_DNFCKS105C
          PortClockSource9 = CLK_HSB_DNFCKS102C
          PortClockSource10 = CLK_HSB_DNFCKS101C
          PortClockSource11 = CLK_HSB_DNFCKS106C
          PortClockSource12 = CLK_HSB_DNFCKS107C
        PortDigitalFilterGroup20:
          PortDigitalFilterModeSelection = ALTERNATIVE_MODE
          PortSameLevelSamples = TWO_SAMPLES
          PortSamplingClockFrequency = DNFATCKI_DIV_BY_1
          PortDigitalFilterEnableInput0 = BYPASSED
        PortDigitalFilterGroup21:
          PortDigitalFilterModeSelection = ALTERNATIVE_MODE
          PortSameLevelSamples = TWO_SAMPLES
          PortSamplingClockFrequency = DNFATCKI_DIV_BY_1
          PortDigitalFilterEnableInput0 = BYPASSED
        PortDigitalFilterGroup23:
          PortDigitalFilterModeSelection = ALTERNATIVE_MODE
          PortSameLevelSamples = TWO_SAMPLES
          PortSamplingClockFrequency = DNFATCKI_DIV_BY_1
          PortDigitalFilterEnableInput0 = BYPASSED
      PortGroup0
        PortPin0_PhaFbB (PortPin0):
          PortPinDirectionChangeable = 0
          PortPinDioAltModeChangeable = 0
          PortPinModeChangeable = 0
          PortPinLevelValue = PORT_PIN_LEVEL_LOW
          PortPinInitialMode = TAUJ0I1_ALT1_IN
          PortPinDirection = PORT_PIN_IN
          PortInputBufferControl = 0
          PortBiDirectionControl = 0
          PortPullUpOption = 0
          PortPullDownOption = 0
          PortOpenDrainControl_Expansion = OpenDrain_N_Channel
          PortOutputLevelInversion = 0
          PortOutputDriveStrength = SLOW
        PortPin1:
          PortPinDirectionChangeable = 0
          PortPinDioAltModeChangeable = 0
          PortPinModeChangeable = 0
          PortPinLevelValue = PORT_PIN_LEVEL_LOW
          PortPinInitialMode = DIO
          PortPinDirection = PORT_PIN_IN
          PortInputBufferControl = 0
          PortBiDirectionControl = 0
          PortPullUpOption = 0
          PortPullDownOption = 0
          PortOpenDrainControl_Expansion = OpenDrain_N_Channel
          PortOutputLevelInversion = 0
          PortOutputDriveStrength = SLOW
        PortPin2:
          PortPinDirectionChangeable = 0
          PortPinDioAltModeChangeable = 0
          PortPinModeChangeable = 0
          PortPinLevelValue = PORT_PIN_LEVEL_LOW
          PortPinInitialMode = DIO
          PortPinDirection = PORT_PIN_IN
          PortInputBufferControl = 0
          PortBiDirectionControl = 0
          PortPullUpOption = 0
          PortPullDownOption = 0
          PortOpenDrainControl_Expansion = OpenDrain_N_Channel
          PortOutputLevelInversion = 0
          PortOutputDriveStrength = SLOW
        PortPin3_DebPin0 (PortPin3):
          PortPinDirectionChangeable = 0
          PortPinDioAltModeChangeable = 0
          PortPinModeChangeable = 0
          PortPinLevelValue = PORT_PIN_LEVEL_LOW
          PortPinInitialMode = DIO
          PortPinDirection = PORT_PIN_IN
          PortInputBufferControl = 0
          PortBiDirectionControl = 0
          PortPullUpOption = 0
          PortPullDownOption = 0
          PortOpenDrainControl_Expansion = OpenDrain_N_Channel
          PortOutputLevelInversion = 0
          PortOutputDriveStrength = SLOW
          PortInputSelection = TYPE_1_SUPP_PISA
        PortPin4_DebPin0 (PortPin4):
          PortPinDirectionChangeable = 0
          PortPinDioAltModeChangeable = 0
          PortPinModeChangeable = 0
          PortPinLevelValue = PORT_PIN_LEVEL_LOW
          PortPinInitialMode = DIO
          PortPinDirection = PORT_PIN_IN
          PortInputBufferControl = 0
          PortBiDirectionControl = 0
          PortPullUpOption = 0
          PortPullDownOption = 0
          PortOpenDrainControl_Expansion = OpenDrain_N_Channel
          PortOutputLevelInversion = 0
          PortOutputDriveStrength = SLOW
          PortInputSelection = TYPE_1_SUPP_PISA
        PortPin5:
          PortPinDirectionChangeable = 0
          PortPinDioAltModeChangeable = 0
          PortPinModeChangeable = 0
          PortPinLevelValue = PORT_PIN_LEVEL_LOW
          PortPinInitialMode = DIO
          PortPinDirection = PORT_PIN_IN
          PortInputBufferControl = 0
          PortBiDirectionControl = 0
          PortPullUpOption = 0
          PortPullDownOption = 0
          PortOpenDrainControl_Expansion = OpenDrain_N_Channel
          PortOutputLevelInversion = 0
          PortOutputDriveStrength = SLOW
          PortInputSelection = TYPE_1_SUPP_PISA
        PortPin6:
          PortPinDirectionChangeable = 0
          PortPinDioAltModeChangeable = 0
          PortPinModeChangeable = 0
          PortPinLevelValue = PORT_PIN_LEVEL_LOW
          PortPinInitialMode = DIO
          PortPinDirection = PORT_PIN_IN
          PortInputBufferControl = 0
          PortBiDirectionControl = 0
          PortPullUpOption = 0
          PortPullDownOption = 0
          PortOpenDrainControl_Expansion = OpenDrain_N_Channel
          PortOutputLevelInversion = 0
          PortOutputDriveStrength = SLOW
          PortInputSelection = TYPE_1_SUPP_PISA
        PortPin7:
          PortPinDirectionChangeable = 0
          PortPinDioAltModeChangeable = 0
          PortPinModeChangeable = 0
          PortPinLevelValue = PORT_PIN_LEVEL_LOW
          PortPinInitialMode = DIO
          PortPinDirection = PORT_PIN_IN
          PortInputBufferControl = 0
          PortBiDirectionControl = 0
          PortPullUpOption = 0
          PortPullDownOption = 0
          PortOpenDrainControl_Expansion = OpenDrain_N_Channel
          PortOutputLevelInversion = 0
          PortOutputDriveStrength = SLOW
          PortInputSelection = TYPE_1_SUPP_PISA
        PortPin8_PhaDiscnctC (PortPin8):
          PortPinDirectionChangeable = 0
          PortPinDioAltModeChangeable = 0
          PortPinModeChangeable = 0
          PortPinLevelValue = PORT_PIN_LEVEL_HIGH
          PortPinInitialMode = DIO
          PortPinDirection = PORT_PIN_OUT
          PortInputBufferControl = 0
          PortBiDirectionControl = 0
          PortPullUpOption = 0
          PortPullDownOption = 0
          PortOpenDrainControl_Expansion = OpenDrain_PushPull
          PortOutputLevelInversion = 0
          PortOutputDriveStrength = SLOW
          PortInputSelection = TYPE_1_SUPP_PISA
        PortPin9:
          PortPinDirectionChangeable = 0
          PortPinDioAltModeChangeable = 0
          PortPinModeChangeable = 0
          PortPinLevelValue = PORT_PIN_LEVEL_LOW
          PortPinInitialMode = DIO_SUPP_PFC_PFCE_PMCSR
          PortPinDirection = PORT_PIN_IN
          PortInputBufferControl = 0
          PortBiDirectionControl = 0
          PortPullUpOption = 0
          PortPullDownOption = 0
          PortOpenDrainControl_Expansion = OpenDrain_N_Channel
          PortOutputLevelInversion = 0
          PortOutputDriveStrength = SLOW
          PortInputSelection = TYPE_1_SUPP_PISA
        PortPin10:
          PortPinDirectionChangeable = 0
          PortPinDioAltModeChangeable = 0
          PortPinModeChangeable = 0
          PortPinLevelValue = PORT_PIN_LEVEL_LOW
          PortPinInitialMode = DIO_SUPP_PFC_PMCSR
          PortPinDirection = PORT_PIN_OUT
          PortInputBufferControl = 0
          PortBiDirectionControl = 0
          PortPullUpOption = 0
          PortPullDownOption = 0
          PortOpenDrainControl_Expansion = OpenDrain_N_Channel
          PortOutputLevelInversion = 0
          PortOutputDriveStrength = FAST
        PortPin11:
          PortPinDirectionChangeable = 0
          PortPinDioAltModeChangeable = 0
          PortPinModeChangeable = 0
          PortPinLevelValue = PORT_PIN_LEVEL_LOW
          PortPinInitialMode = DIO_SUPP_PFC_PMCSR
          PortPinDirection = PORT_PIN_IN
          PortInputBufferControl = 0
          PortBiDirectionControl = 0
          PortPullUpOption = 0
          PortPullDownOption = 0
          PortOpenDrainControl_Expansion = OpenDrain_N_Channel
          PortOutputLevelInversion = 0
          PortOutputDriveStrength = SLOW
        PortPin12:
          PortPinDirectionChangeable = 0
          PortPinDioAltModeChangeable = 0
          PortPinModeChangeable = 0
          PortPinLevelValue = PORT_PIN_LEVEL_LOW
          PortPinInitialMode = DIO_SUPP_PFC_PMCSR
          PortPinDirection = PORT_PIN_IN
          PortInputBufferControl = 0
          PortBiDirectionControl = 0
          PortPullUpOption = 0
          PortPullDownOption = 0
          PortOpenDrainControl_Expansion = OpenDrain_N_Channel
          PortOutputLevelInversion = 0
          PortOutputDriveStrength = SLOW
        PortPin13_McuTOD (PortPin13):
          PortPinDirectionChangeable = 0
          PortPinDioAltModeChangeable = 0
          PortPinModeChangeable = 0
          PortPinLevelValue = PORT_PIN_LEVEL_LOW
          PortPinInitialMode = DIO_SUPP_PFC_PFCE_PMCSR
          PortPinDirection = PORT_PIN_OUT
          PortInputBufferControl = 0
          PortBiDirectionControl = 0
          PortPullUpOption = 0
          PortPullDownOption = 0
          PortOpenDrainControl_Expansion = OpenDrain_PushPull
          PortOutputLevelInversion = 0
          PortOutputDriveStrength = SLOW
          PortInputSelection = TYPE_1_SUPP_PISA
        PortPin14:
          PortPinDirectionChangeable = 0
          PortPinDioAltModeChangeable = 0
          PortPinModeChangeable = 0
          PortPinLevelValue = PORT_PIN_LEVEL_LOW
          PortPinInitialMode = DIO_SUPP_PFC_PMCSR
          PortPinDirection = PORT_PIN_IN
          PortInputBufferControl = 0
          PortBiDirectionControl = 0
          PortPullUpOption = 0
          PortPullDownOption = 0
          PortOpenDrainControl_Expansion = OpenDrain_N_Channel
          PortOutputLevelInversion = 0
          PortOutputDriveStrength = SLOW
      PortGroup1
        PortPin0:
          PortPinDirectionChangeable = 0
          PortPinDioAltModeChangeable = 0
          PortPinModeChangeable = 0
          PortPinLevelValue = PORT_PIN_LEVEL_LOW
          PortPinInitialMode = DIO
          PortPinDirection = PORT_PIN_IN
          PortInputBufferControl = 0
          PortBiDirectionControl = 0
          PortPullUpOption = 0
          PortPullDownOption = 0
          PortOpenDrainControl_Expansion = OpenDrain_N_Channel
          PortOutputLevelInversion = 0
          PortOutputDriveStrength = SLOW
        PortPin1_GateDrv0Cs (PortPin1):
          PortPinDirectionChangeable = 0
          PortPinDioAltModeChangeable = 0
          PortPinModeChangeable = 0
          PortPinLevelValue = PORT_PIN_LEVEL_LOW
          PortPinInitialMode = CSIH2CSS0_ALT4_OUT
          PortPinDirection = PORT_PIN_OUT
          PortInputBufferControl = 0
          PortBiDirectionControl = 0
          PortPullUpOption = 0
          PortPullDownOption = 0
          PortOpenDrainControl_Expansion = OpenDrain_PushPull
          PortOutputLevelInversion = 0
          PortOutputDriveStrength = SLOW
          PortInputSelection = TYPE_1_SUPP_PISA
        PortPin2_GateDrv0Miso (PortPin2):
          PortPinDirectionChangeable = 0
          PortPinDioAltModeChangeable = 0
          PortPinModeChangeable = 0
          PortPinLevelValue = PORT_PIN_LEVEL_LOW
          PortPinInitialMode = CSIH2SI_ALT4_IN
          PortPinDirection = PORT_PIN_IN
          PortInputBufferControl = 0
          PortBiDirectionControl = 0
          PortPullUpOption = 0
          PortPullDownOption = 0
          PortOpenDrainControl_Expansion = OpenDrain_N_Channel
          PortOutputLevelInversion = 0
          PortOutputDriveStrength = SLOW
          PortInputSelection = TYPE_1_SUPP_PISA
        PortPin3_GateDrv0Mosi (PortPin3):
          PortPinDirectionChangeable = 0
          PortPinDioAltModeChangeable = 0
          PortPinModeChangeable = 0
          PortPinLevelValue = PORT_PIN_LEVEL_LOW
          PortPinInitialMode = CSIH2SO_ALT4_OUT
          PortPinDirection = PORT_PIN_OUT
          PortInputBufferControl = 0
          PortBiDirectionControl = 0
          PortIpControl = 1
          PortPullUpOption = 0
          PortPullDownOption = 0
          PortOpenDrainControl_Expansion = OpenDrain_PushPull
          PortOutputLevelInversion = 0
          PortOutputDriveStrength = SLOW
          PortInputSelection = TYPE_1_SUPP_PISA
        PortPin4_GateDrv0Clk (PortPin4):
          PortPinDirectionChangeable = 0
          PortPinDioAltModeChangeable = 0
          PortPinModeChangeable = 0
          PortPinLevelValue = PORT_PIN_LEVEL_LOW
          PortPinInitialMode = CSIH2SCO_ALT4_OUT
          PortPinDirection = PORT_PIN_OUT
          PortInputBufferControl = 0
          PortBiDirectionControl = 0
          PortIpControl = 1
          PortPullUpOption = 0
          PortPullDownOption = 0
          PortOpenDrainControl_Expansion = OpenDrain_PushPull
          PortOutputLevelInversion = 0
          PortOutputDriveStrength = SLOW
          PortInputSelection = TYPE_1_SUPP_PISA
      PortGroup2
        PortPin0:
          PortPinDirectionChangeable = 0
          PortPinDioAltModeChangeable = 0
          PortPinModeChangeable = 0
          PortPinLevelValue = PORT_PIN_LEVEL_LOW
          PortPinInitialMode = DIO_SUPP_PFC_PFCE_PMCSR
          PortPinDirection = PORT_PIN_IN
          PortInputBufferControl = 0
          PortBiDirectionControl = 0
          PortPullUpOption = 0
          PortPullDownOption = 0
          PortOpenDrainControl_Expansion = OpenDrain_N_Channel
          PortOutputLevelInversion = 0
          PortOutputDriveStrength = SLOW
          PortInputSelection = TYPE_1_SUPP_PISA
        PortPin1:
          PortPinDirectionChangeable = 0
          PortPinDioAltModeChangeable = 0
          PortPinModeChangeable = 0
          PortPinLevelValue = PORT_PIN_LEVEL_LOW
          PortPinInitialMode = DIO
          PortPinDirection = PORT_PIN_IN
          PortInputBufferControl = 0
          PortBiDirectionControl = 0
          PortIpControl = 0
          PortPullUpOption = 0
          PortPullDownOption = 0
          PortOpenDrainControl_Expansion = OpenDrain_N_Channel
          PortOutputLevelInversion = 0
          PortOutputDriveStrength = SLOW
          PortInputSelection = TYPE_1_SUPP_PISA
        PortPin2_GateDrv0Diagc (PortPin2):
          PortPinDirectionChangeable = 0
          PortPinDioAltModeChangeable = 0
          PortPinModeChangeable = 0
          PortPinLevelValue = PORT_PIN_LEVEL_LOW
          PortPinInitialMode = DIO
          PortPinDirection = PORT_PIN_IN
          PortInputBufferControl = 1
          PortBiDirectionControl = 0
          PortIpControl = 0
          PortPullUpOption = 0
          PortPullDownOption = 0
          PortOpenDrainControl_Expansion = OpenDrain_N_Channel
          PortOutputLevelInversion = 0
          PortOutputDriveStrength = SLOW
          PortInputSelection = TYPE_1_SUPP_PISA
        PortPin3_FrErr (PortPin3):
          PortPinDirectionChangeable = 0
          PortPinDioAltModeChangeable = 0
          PortPinModeChangeable = 0
          PortPinLevelValue = PORT_PIN_LEVEL_LOW
          PortPinInitialMode = DIO
          PortPinDirection = PORT_PIN_IN
          PortInputBufferControl = 0
          PortBiDirectionControl = 0
          PortIpControl = 0
          PortPullUpOption = 0
          PortPullDownOption = 0
          PortOpenDrainControl_Expansion = OpenDrain_N_Channel
          PortOutputLevelInversion = 0
          PortOutputDriveStrength = SLOW
        PortPin4_SysFlt2A (PortPin4):
          PortPinDirectionChangeable = 0
          PortPinDioAltModeChangeable = 0
          PortPinModeChangeable = 0
          PortPinLevelValue = PORT_PIN_LEVEL_HIGH
          PortPinInitialMode = DIO
          PortPinDirection = PORT_PIN_OUT
          PortInputBufferControl = 0
          PortBiDirectionControl = 0
          PortPullUpOption = 0
          PortPullDownOption = 0
          PortOpenDrainControl_Expansion = OpenDrain_PushPull
          PortOutputLevelInversion = 0
          PortOutputDriveStrength = SLOW
        PortPin5_MotAg2Mosi (PortPin5):
          PortPinDirectionChangeable = 0
          PortPinDioAltModeChangeable = 0
          PortPinModeChangeable = 0
          PortPinLevelValue = PORT_PIN_LEVEL_LOW
          PortPinInitialMode = CSIH3SO_ALT4_OUT
          PortPinDirection = PORT_PIN_OUT
          PortInputBufferControl = 0
          PortBiDirectionControl = 0
          PortIpControl = 1
          PortPullUpOption = 0
          PortPullDownOption = 0
          PortOpenDrainControl_Expansion = OpenDrain_PushPull
          PortOutputLevelInversion = 0
          PortOutputDriveStrength = SLOW
          PortInputSelection = TYPE_1_SUPP_PISA
        PortPin6_MotAg2Miso (PortPin6):
          PortPinDirectionChangeable = 0
          PortPinDioAltModeChangeable = 0
          PortPinModeChangeable = 0
          PortPinLevelValue = PORT_PIN_LEVEL_LOW
          PortPinInitialMode = CSIH3SI_ALT4_IN
          PortPinDirection = PORT_PIN_IN
          PortInputBufferControl = 0
          PortBiDirectionControl = 0
          PortIpControl = 0
          PortPullUpOption = 0
          PortPullDownOption = 0
          PortOpenDrainControl_Expansion = OpenDrain_N_Channel
          PortOutputLevelInversion = 0
          PortOutputDriveStrength = SLOW
        PortPin7_MotAg2Clk (PortPin7):
          PortPinDirectionChangeable = 0
          PortPinDioAltModeChangeable = 0
          PortPinModeChangeable = 0
          PortPinLevelValue = PORT_PIN_LEVEL_LOW
          PortPinInitialMode = CSIH3SCO_ALT4_OUT
          PortPinDirection = PORT_PIN_OUT
          PortInputBufferControl = 0
          PortBiDirectionControl = 0
          PortIpControl = 1
          PortPullUpOption = 0
          PortPullDownOption = 0
          PortOpenDrainControl_Expansion = OpenDrain_PushPull
          PortOutputLevelInversion = 0
          PortOutputDriveStrength = SLOW
          PortInputSelection = TYPE_1_SUPP_PISA
        PortPin8_MotAg0Mosi (PortPin8):
          PortPinDirectionChangeable = 0
          PortPinDioAltModeChangeable = 0
          PortPinModeChangeable = 0
          PortPinLevelValue = PORT_PIN_LEVEL_LOW
          PortPinInitialMode = CSIH1SO_ALT3_OUT
          PortPinDirection = PORT_PIN_OUT
          PortInputBufferControl = 0
          PortBiDirectionControl = 0
          PortIpControl = 1
          PortPullUpOption = 0
          PortPullDownOption = 0
          PortOpenDrainControl_Expansion = OpenDrain_PushPull
          PortOutputLevelInversion = 0
          PortOutputDriveStrength = SLOW
        PortPin9_MotAg0Clk (PortPin9):
          PortPinDirectionChangeable = 0
          PortPinDioAltModeChangeable = 0
          PortPinModeChangeable = 0
          PortPinLevelValue = PORT_PIN_LEVEL_LOW
          PortPinInitialMode = CSIH1SCO_ALT3_OUT
          PortPinDirection = PORT_PIN_OUT
          PortInputBufferControl = 0
          PortBiDirectionControl = 0
          PortIpControl = 1
          PortPullUpOption = 0
          PortPullDownOption = 0
          PortOpenDrainControl_Expansion = OpenDrain_PushPull
          PortOutputLevelInversion = 0
          PortOutputDriveStrength = SLOW
        PortPin10:
          PortPinDirectionChangeable = 0
          PortPinDioAltModeChangeable = 0
          PortPinModeChangeable = 0
          PortPinLevelValue = PORT_PIN_LEVEL_LOW
          PortPinInitialMode = DIO
          PortPinDirection = PORT_PIN_IN
          PortInputBufferControl = 0
          PortBiDirectionControl = 0
          PortPullUpOption = 0
          PortPullDownOption = 0
          PortOpenDrainControl_Expansion = OpenDrain_N_Channel
          PortOutputLevelInversion = 0
          PortOutputDriveStrength = SLOW
        PortPin11_DebPin2 (PortPin11):
          PortPinDirectionChangeable = 0
          PortPinDioAltModeChangeable = 0
          PortPinModeChangeable = 0
          PortPinLevelValue = PORT_PIN_LEVEL_LOW
          PortPinInitialMode = DIO
          PortPinDirection = PORT_PIN_IN
          PortInputBufferControl = 0
          PortBiDirectionControl = 0
          PortPullUpOption = 0
          PortPullDownOption = 0
          PortOpenDrainControl_Expansion = OpenDrain_N_Channel
          PortOutputLevelInversion = 0
          PortOutputDriveStrength = SLOW
        PortPin12_DebPin3 (PortPin12):
          PortPinDirectionChangeable = 0
          PortPinDioAltModeChangeable = 0
          PortPinModeChangeable = 0
          PortPinLevelValue = PORT_PIN_LEVEL_LOW
          PortPinInitialMode = DIO
          PortPinDirection = PORT_PIN_IN
          PortInputBufferControl = 0
          PortBiDirectionControl = 0
          PortIpControl = 0
          PortPullUpOption = 0
          PortPullDownOption = 0
          PortOpenDrainControl_Expansion = OpenDrain_N_Channel
          PortOutputLevelInversion = 0
          PortOutputDriveStrength = SLOW
          PortInputSelection = TYPE_1_SUPP_PISA
        PortPin13:
          PortPinDirectionChangeable = 0
          PortPinDioAltModeChangeable = 0
          PortPinModeChangeable = 0
          PortPinLevelValue = PORT_PIN_LEVEL_LOW
          PortPinInitialMode = DIO
          PortPinDirection = PORT_PIN_IN
          PortInputBufferControl = 0
          PortBiDirectionControl = 0
          PortPullUpOption = 0
          PortPullDownOption = 0
          PortOpenDrainControl_Expansion = OpenDrain_N_Channel
          PortOutputLevelInversion = 0
          PortOutputDriveStrength = SLOW
        PortPin14_FrCs (PortPin14):
          PortPinDirectionChangeable = 0
          PortPinDioAltModeChangeable = 0
          PortPinModeChangeable = 0
          PortPinLevelValue = PORT_PIN_LEVEL_LOW
          PortPinInitialMode = CSIH0CSS2_ALT5_OUT
          PortPinDirection = PORT_PIN_OUT
          PortInputBufferControl = 0
          PortBiDirectionControl = 0
          PortPullUpOption = 0
          PortPullDownOption = 0
          PortOpenDrainControl_Expansion = OpenDrain_PushPull
          PortOutputLevelInversion = 0
          PortOutputDriveStrength = SLOW
        PortPin15:
          PortPinDirectionChangeable = 0
          PortPinDioAltModeChangeable = 0
          PortPinModeChangeable = 0
          PortPinLevelValue = PORT_PIN_LEVEL_LOW
          PortPinInitialMode = DIO
          PortPinDirection = PORT_PIN_IN
          PortInputBufferControl = 0
          PortBiDirectionControl = 0
          PortPullUpOption = 0
          PortPullDownOption = 0
          PortOpenDrainControl_Expansion = OpenDrain_N_Channel
          PortOutputLevelInversion = 0
          PortOutputDriveStrength = SLOW
      PortGroup3
        PortPin0:
          PortPinDirectionChangeable = 0
          PortPinDioAltModeChangeable = 0
          PortPinModeChangeable = 0
          PortPinLevelValue = PORT_PIN_LEVEL_LOW
          PortPinInitialMode = DIO
          PortPinDirection = PORT_PIN_IN
          PortInputBufferControl = 0
          PortBiDirectionControl = 0
          PortIpControl = 0
          PortPullUpOption = 0
          PortPullDownOption = 0
          PortOpenDrainControl_Expansion = OpenDrain_N_Channel
          PortOutputLevelInversion = 0
          PortOutputDriveStrength = SLOW
          PortInputSelection = TYPE_1_SUPP_PISA
        PortPin1_FrClk (PortPin1):
          PortPinDirectionChangeable = 0
          PortPinDioAltModeChangeable = 0
          PortPinModeChangeable = 0
          PortPinLevelValue = PORT_PIN_LEVEL_LOW
          PortPinInitialMode = CSIH0SCO_ALT5_OUT
          PortPinDirection = PORT_PIN_OUT
          PortInputBufferControl = 0
          PortBiDirectionControl = 0
          PortIpControl = 0
          PortPullUpOption = 0
          PortPullDownOption = 0
          PortOpenDrainControl_Expansion = OpenDrain_PushPull
          PortOutputLevelInversion = 0
          PortOutputDriveStrength = SLOW
          PortInputSelection = TYPE_1_SUPP_PISA
        PortPin2_FrMosi (PortPin2):
          PortPinDirectionChangeable = 0
          PortPinDioAltModeChangeable = 0
          PortPinModeChangeable = 0
          PortPinLevelValue = PORT_PIN_LEVEL_LOW
          PortPinInitialMode = CSIH0SI_ALT5_IN
          PortPinDirection = PORT_PIN_IN
          PortInputBufferControl = 0
          PortBiDirectionControl = 0
          PortIpControl = 0
          PortPullUpOption = 0
          PortPullDownOption = 0
          PortOpenDrainControl_Expansion = OpenDrain_N_Channel
          PortOutputLevelInversion = 0
          PortOutputDriveStrength = SLOW
        PortPin3_MotAg2Cs (PortPin3):
          PortPinDirectionChangeable = 0
          PortPinDioAltModeChangeable = 0
          PortPinModeChangeable = 0
          PortPinLevelValue = PORT_PIN_LEVEL_LOW
          PortPinInitialMode = CSIH3CSS4_ALT4_OUT
          PortPinDirection = PORT_PIN_OUT
          PortInputBufferControl = 0
          PortBiDirectionControl = 0
          PortPullUpOption = 0
          PortPullDownOption = 0
          PortOpenDrainControl_Expansion = OpenDrain_PushPull
          PortOutputLevelInversion = 0
          PortOutputDriveStrength = SLOW
        PortPin4:
          PortPinDirectionChangeable = 0
          PortPinDioAltModeChangeable = 0
          PortPinModeChangeable = 0
          PortPinLevelValue = PORT_PIN_LEVEL_LOW
          PortPinInitialMode = DIO
          PortPinDirection = PORT_PIN_IN
          PortInputBufferControl = 0
          PortBiDirectionControl = 0
          PortPullUpOption = 0
          PortPullDownOption = 0
          PortOpenDrainControl_Expansion = OpenDrain_N_Channel
          PortOutputLevelInversion = 0
          PortOutputDriveStrength = SLOW
        PortPin5_GateDrv0Rst (PortPin5):
          PortPinDirectionChangeable = 0
          PortPinDioAltModeChangeable = 0
          PortPinModeChangeable = 0
          PortPinLevelValue = PORT_PIN_LEVEL_LOW
          PortPinInitialMode = DIO
          PortPinDirection = PORT_PIN_OUT
          PortInputBufferControl = 0
          PortBiDirectionControl = 0
          PortPullUpOption = 0
          PortPullDownOption = 0
          PortOpenDrainControl_Expansion = OpenDrain_PushPull
          PortOutputLevelInversion = 0
          PortOutputDriveStrength = SLOW
        PortPin6_PwrOutEnaFb (PortPin6):
          PortPinDirectionChangeable = 0
          PortPinDioAltModeChangeable = 0
          PortPinModeChangeable = 0
          PortPinLevelValue = PORT_PIN_LEVEL_LOW
          PortPinInitialMode = DIO
          PortPinDirection = PORT_PIN_IN
          PortInputBufferControl = 1
          PortBiDirectionControl = 0
          PortPullUpOption = 0
          PortPullDownOption = 0
          PortOpenDrainControl_Expansion = OpenDrain_N_Channel
          PortOutputLevelInversion = 0
          PortOutputDriveStrength = SLOW
        PortPin7_PhaAUpprCmd (PortPin7):
          PortPinDirectionChangeable = 0
          PortPinDioAltModeChangeable = 1
          PortPinModeChangeable = 0
          PortPinLevelValue = PORT_PIN_LEVEL_LOW
          PortPinInitialMode = TSG31O1_ALT2_OUT
          PortPinDirection = PORT_PIN_OUT
          PortInputBufferControl = 0
          PortBiDirectionControl = 0
          PortIpControl = 0
          PortPullUpOption = 0
          PortPullDownOption = 0
          PortOpenDrainControl_Expansion = OpenDrain_PushPull
          PortOutputLevelInversion = 0
          PortOutputDriveStrength = SLOW
        PortPin8_PhaALowrCmd (PortPin8):
          PortPinDirectionChangeable = 0
          PortPinDioAltModeChangeable = 1
          PortPinModeChangeable = 0
          PortPinLevelValue = PORT_PIN_LEVEL_LOW
          PortPinInitialMode = TSG31O2_ALT2_OUT
          PortPinDirection = PORT_PIN_OUT
          PortInputBufferControl = 0
          PortBiDirectionControl = 0
          PortIpControl = 0
          PortPullUpOption = 0
          PortPullDownOption = 0
          PortOpenDrainControl_Expansion = OpenDrain_PushPull
          PortOutputLevelInversion = 0
          PortOutputDriveStrength = SLOW
        PortPin9_PhaBUpprCmd (PortPin9):
          PortPinDirectionChangeable = 0
          PortPinDioAltModeChangeable = 1
          PortPinModeChangeable = 0
          PortPinLevelValue = PORT_PIN_LEVEL_LOW
          PortPinInitialMode = TSG31O3_ALT2_OUT
          PortPinDirection = PORT_PIN_OUT
          PortInputBufferControl = 0
          PortBiDirectionControl = 0
          PortIpControl = 0
          PortPullUpOption = 0
          PortPullDownOption = 0
          PortOpenDrainControl_Expansion = OpenDrain_PushPull
          PortOutputLevelInversion = 0
          PortOutputDriveStrength = SLOW
        PortPin10_PhaBLowrCmd (PortPin10):
          PortPinDirectionChangeable = 0
          PortPinDioAltModeChangeable = 1
          PortPinModeChangeable = 0
          PortPinLevelValue = PORT_PIN_LEVEL_LOW
          PortPinInitialMode = TSG31O4_ALT2_OUT_SUPP_PFC_PFCAE_PMCSR
          PortPinDirection = PORT_PIN_OUT
          PortInputBufferControl = 0
          PortBiDirectionControl = 0
          PortIpControl = 0
          PortPullUpOption = 0
          PortPullDownOption = 0
          PortOpenDrainControl_Expansion = OpenDrain_PushPull
          PortOutputLevelInversion = 0
          PortOutputDriveStrength = SLOW
        PortPin11_PhaFbC (PortPin11):
          PortPinDirectionChangeable = 0
          PortPinDioAltModeChangeable = 0
          PortPinModeChangeable = 0
          PortPinLevelValue = PORT_PIN_LEVEL_LOW
          PortPinInitialMode = TAUJ0I3_ALT1_IN
          PortPinDirection = PORT_PIN_IN
          PortInputBufferControl = 0
          PortBiDirectionControl = 0
          PortPullUpOption = 0
          PortPullDownOption = 0
          PortOpenDrainControl_Expansion = OpenDrain_N_Channel
          PortOutputLevelInversion = 0
          PortOutputDriveStrength = SLOW
        PortPin12_PhaCUpprCmd (PortPin12):
          PortPinDirectionChangeable = 0
          PortPinDioAltModeChangeable = 1
          PortPinModeChangeable = 0
          PortPinLevelValue = PORT_PIN_LEVEL_LOW
          PortPinInitialMode = TSG31O5_ALT2_OUT
          PortPinDirection = PORT_PIN_OUT
          PortInputBufferControl = 0
          PortBiDirectionControl = 0
          PortIpControl = 0
          PortPullUpOption = 0
          PortPullDownOption = 0
          PortOpenDrainControl_Expansion = OpenDrain_PushPull
          PortOutputLevelInversion = 0
          PortOutputDriveStrength = SLOW
        PortPin13_PhaCLowrCmd (PortPin13):
          PortPinDirectionChangeable = 0
          PortPinDioAltModeChangeable = 1
          PortPinModeChangeable = 0
          PortPinLevelValue = PORT_PIN_LEVEL_LOW
          PortPinInitialMode = TSG31O6_ALT2_OUT
          PortPinDirection = PORT_PIN_OUT
          PortInputBufferControl = 0
          PortBiDirectionControl = 0
          PortIpControl = 0
          PortPullUpOption = 0
          PortPullDownOption = 0
          PortOpenDrainControl_Expansion = OpenDrain_PushPull
          PortOutputLevelInversion = 0
          PortOutputDriveStrength = SLOW
        PortPin14_MotAg0Miso (PortPin14):
          PortPinDirectionChangeable = 0
          PortPinDioAltModeChangeable = 0
          PortPinModeChangeable = 0
          PortPinLevelValue = PORT_PIN_LEVEL_LOW
          PortPinInitialMode = CSIH1SI_ALT1_IN
          PortPinDirection = PORT_PIN_IN
          PortInputBufferControl = 0
          PortBiDirectionControl = 0
          PortPullUpOption = 0
          PortPullDownOption = 0
          PortOpenDrainControl_Expansion = OpenDrain_N_Channel
          PortOutputLevelInversion = 0
          PortOutputDriveStrength = SLOW
          PortInputSelection = TYPE_1_SUPP_PISA
      PortGroup4
        PortPin0:
          PortPinDirectionChangeable = 0
          PortPinDioAltModeChangeable = 0
          PortPinModeChangeable = 0
          PortPinLevelValue = PORT_PIN_LEVEL_LOW
          PortPinInitialMode = ENCA0E0_ALT4_IN
          PortPinDirection = PORT_PIN_IN
          PortInputBufferControl = 0
          PortBiDirectionControl = 0
          PortIpControl = 0
          PortPullUpOption = 0
          PortPullDownOption = 0
          PortOpenDrainControl_Expansion = OpenDrain_N_Channel
          PortOutputLevelInversion = 0
          PortOutputDriveStrength = SLOW
          PortInputSelection = TYPE_1_SUPP_PISA
        PortPin1:
          PortPinDirectionChangeable = 0
          PortPinDioAltModeChangeable = 0
          PortPinModeChangeable = 0
          PortPinLevelValue = PORT_PIN_LEVEL_LOW
          PortPinInitialMode = ENCA0E1_ALT4_IN
          PortPinDirection = PORT_PIN_IN
          PortInputBufferControl = 0
          PortBiDirectionControl = 0
          PortIpControl = 0
          PortPullUpOption = 0
          PortPullDownOption = 0
          PortOpenDrainControl_Expansion = OpenDrain_N_Channel
          PortOutputLevelInversion = 0
          PortOutputDriveStrength = SLOW
          PortInputSelection = TYPE_1_SUPP_PISA
        PortPin2:
          PortPinDirectionChangeable = 0
          PortPinDioAltModeChangeable = 0
          PortPinModeChangeable = 0
          PortPinLevelValue = PORT_PIN_LEVEL_LOW
          PortPinInitialMode = ENCA0EC_ALT4_IN
          PortPinDirection = PORT_PIN_IN
          PortInputBufferControl = 0
          PortBiDirectionControl = 0
          PortPullUpOption = 0
          PortPullDownOption = 0
          PortOpenDrainControl_Expansion = OpenDrain_N_Channel
          PortOutputLevelInversion = 0
          PortOutputDriveStrength = SLOW
          PortInputSelection = TYPE_1_SUPP_PISA
        PortPin3_MotAg0Cs (PortPin3):
          PortPinDirectionChangeable = 0
          PortPinDioAltModeChangeable = 0
          PortPinModeChangeable = 0
          PortPinLevelValue = PORT_PIN_LEVEL_LOW
          PortPinInitialMode = CSIH1CSS0_ALT4_OUT
          PortPinDirection = PORT_PIN_OUT
          PortInputBufferControl = 0
          PortBiDirectionControl = 0
          PortPullUpOption = 0
          PortPullDownOption = 0
          PortOpenDrainControl_Expansion = OpenDrain_PushPull
          PortOutputLevelInversion = 0
          PortOutputDriveStrength = SLOW
          PortInputSelection = TYPE_1_SUPP_PISA
        PortPin4:
          PortPinDirectionChangeable = 0
          PortPinDioAltModeChangeable = 0
          PortPinModeChangeable = 0
          PortPinLevelValue = PORT_PIN_LEVEL_LOW
          PortPinInitialMode = ENCA1E0_ALT4_IN
          PortPinDirection = PORT_PIN_IN
          PortInputBufferControl = 0
          PortBiDirectionControl = 0
          PortPullUpOption = 0
          PortPullDownOption = 0
          PortOpenDrainControl_Expansion = OpenDrain_N_Channel
          PortOutputLevelInversion = 0
          PortOutputDriveStrength = SLOW
          PortInputSelection = TYPE_1_SUPP_PISA
        PortPin5_FrStb (PortPin5):
          PortPinDirectionChangeable = 0
          PortPinDioAltModeChangeable = 0
          PortPinModeChangeable = 0
          PortPinLevelValue = PORT_PIN_LEVEL_LOW
          PortPinInitialMode = ENCA1E1_ALT4_IN
          PortPinDirection = PORT_PIN_IN
          PortInputBufferControl = 0
          PortBiDirectionControl = 0
          PortIpControl = 0
          PortPullUpOption = 0
          PortPullDownOption = 0
          PortOpenDrainControl_Expansion = OpenDrain_N_Channel
          PortOutputLevelInversion = 0
          PortOutputDriveStrength = SLOW
          PortInputSelection = TYPE_1_SUPP_PISA
        PortPin6:
          PortPinDirectionChangeable = 0
          PortPinDioAltModeChangeable = 0
          PortPinModeChangeable = 0
          PortPinLevelValue = PORT_PIN_LEVEL_LOW
          PortPinInitialMode = ENCA1EC_ALT4_IN
          PortPinDirection = PORT_PIN_IN
          PortInputBufferControl = 0
          PortBiDirectionControl = 0
          PortIpControl = 0
          PortPullUpOption = 0
          PortPullDownOption = 0
          PortOpenDrainControl_Expansion = OpenDrain_N_Channel
          PortOutputLevelInversion = 0
          PortOutputDriveStrength = SLOW
          PortInputSelection = TYPE_1_SUPP_PISA
        PortPin7:
          PortPinDirectionChangeable = 0
          PortPinDioAltModeChangeable = 0
          PortPinModeChangeable = 0
          PortPinLevelValue = PORT_PIN_LEVEL_LOW
          PortPinInitialMode = DIO
          PortPinDirection = PORT_PIN_IN
          PortInputBufferControl = 0
          PortBiDirectionControl = 0
          PortPullUpOption = 0
          PortPullDownOption = 0
          PortOpenDrainControl_Expansion = OpenDrain_N_Channel
          PortOutputLevelInversion = 0
          PortOutputDriveStrength = SLOW
        PortPin8_FrTxData (PortPin8):
          PortPinDirectionChangeable = 0
          PortPinDioAltModeChangeable = 0
          PortPinModeChangeable = 0
          PortPinLevelValue = PORT_PIN_LEVEL_LOW
          PortPinInitialMode = FLX0RXDA_ALT1_IN
          PortPinDirection = PORT_PIN_IN
          PortInputBufferControl = 0
          PortBiDirectionControl = 0
          PortPullUpOption = 0
          PortPullDownOption = 0
          PortOpenDrainControl_Expansion = OpenDrain_N_Channel
          PortOutputLevelInversion = 0
          PortOutputDriveStrength = SLOW
        PortPin9_FrTxData (PortPin9):
          PortPinDirectionChangeable = 0
          PortPinDioAltModeChangeable = 0
          PortPinModeChangeable = 0
          PortPinLevelValue = PORT_PIN_LEVEL_HIGH
          PortPinInitialMode = FLX0TXDA_ALT1_OUT
          PortPinDirection = PORT_PIN_OUT
          PortInputBufferControl = 0
          PortBiDirectionControl = 0
          PortPullUpOption = 0
          PortPullDownOption = 0
          PortOpenDrainControl_Expansion = OpenDrain_PushPull
          PortOutputLevelInversion = 0
          PortOutputDriveStrength = SLOW
          PortInputSelection = TYPE_1_SUPP_PISA
        PortPin10_FrTxEna (PortPin10):
          PortPinDirectionChangeable = 0
          PortPinDioAltModeChangeable = 0
          PortPinModeChangeable = 0
          PortPinLevelValue = PORT_PIN_LEVEL_HIGH
          PortPinInitialMode = FLX0TXENA_ALT1_OUT
          PortPinDirection = PORT_PIN_OUT
          PortInputBufferControl = 0
          PortBiDirectionControl = 0
          PortPullUpOption = 0
          PortPullDownOption = 0
          PortOpenDrainControl_Expansion = OpenDrain_PushPull
          PortOutputLevelInversion = 0
          PortOutputDriveStrength = SLOW
          PortInputSelection = TYPE_1_SUPP_PISA
        PortPin11:
          PortPinDirectionChangeable = 0
          PortPinDioAltModeChangeable = 0
          PortPinModeChangeable = 0
          PortPinLevelValue = PORT_PIN_LEVEL_LOW
          PortPinInitialMode = DIO
          PortPinDirection = PORT_PIN_IN
          PortInputBufferControl = 0
          PortBiDirectionControl = 0
          PortPullUpOption = 0
          PortPullDownOption = 0
          PortOpenDrainControl_Expansion = OpenDrain_N_Channel
          PortOutputLevelInversion = 0
          PortOutputDriveStrength = SLOW
        PortPin12:
          PortPinDirectionChangeable = 0
          PortPinDioAltModeChangeable = 0
          PortPinModeChangeable = 0
          PortPinLevelValue = PORT_PIN_LEVEL_LOW
          PortPinInitialMode = DIO
          PortPinDirection = PORT_PIN_IN
          PortInputBufferControl = 0
          PortBiDirectionControl = 0
          PortPullUpOption = 0
          PortPullDownOption = 0
          PortOpenDrainControl_Expansion = OpenDrain_N_Channel
          PortOutputLevelInversion = 0
          PortOutputDriveStrength = SLOW
          PortInputSelection = TYPE_1_SUPP_PISA
        PortPin13:
          PortPinDirectionChangeable = 0
          PortPinDioAltModeChangeable = 0
          PortPinModeChangeable = 0
          PortPinLevelValue = PORT_PIN_LEVEL_LOW
          PortPinInitialMode = DIO
          PortPinDirection = PORT_PIN_IN
          PortInputBufferControl = 0
          PortBiDirectionControl = 0
          PortPullUpOption = 0
          PortPullDownOption = 0
          PortOpenDrainControl_Expansion = OpenDrain_N_Channel
          PortOutputLevelInversion = 0
          PortOutputDriveStrength = SLOW
          PortInputSelection = TYPE_1_SUPP_PISA
        PortPin14:
          PortPinDirectionChangeable = 0
          PortPinDioAltModeChangeable = 0
          PortPinModeChangeable = 0
          PortPinLevelValue = PORT_PIN_LEVEL_LOW
          PortPinInitialMode = DIO
          PortPinDirection = PORT_PIN_IN
          PortInputBufferControl = 0
          PortBiDirectionControl = 0
          PortPullUpOption = 0
          PortPullDownOption = 0
          PortOpenDrainControl_Expansion = OpenDrain_N_Channel
          PortOutputLevelInversion = 0
          PortOutputDriveStrength = SLOW
      PortGroup5
        PortPin0_PwrSplyMiso (PortPin0):
          PortPinDirectionChangeable = 0
          PortPinDioAltModeChangeable = 0
          PortPinModeChangeable = 0
          PortPinLevelValue = PORT_PIN_LEVEL_LOW
          PortPinInitialMode = CSIG0SI_ALT1_IN
          PortPinDirection = PORT_PIN_IN
          PortInputBufferControl = 0
          PortBiDirectionControl = 0
          PortPullUpOption = 0
          PortPullDownOption = 0
          PortOpenDrainControl_Expansion = OpenDrain_N_Channel
          PortOutputLevelInversion = 0
          PortOutputDriveStrength = SLOW
        PortPin1_PwrSplyMosi (PortPin1):
          PortPinDirectionChangeable = 0
          PortPinDioAltModeChangeable = 0
          PortPinModeChangeable = 0
          PortPinLevelValue = PORT_PIN_LEVEL_LOW
          PortPinInitialMode = CSIG0SO_ALT1_OUT
          PortPinDirection = PORT_PIN_OUT
          PortInputBufferControl = 0
          PortBiDirectionControl = 0
          PortIpControl = 1
          PortPullUpOption = 0
          PortPullDownOption = 0
          PortOpenDrainControl_Expansion = OpenDrain_PushPull
          PortOutputLevelInversion = 0
          PortOutputDriveStrength = SLOW
        PortPin2:
          PortPinDirectionChangeable = 0
          PortPinDioAltModeChangeable = 0
          PortPinModeChangeable = 0
          PortPinLevelValue = PORT_PIN_LEVEL_LOW
          PortPinInitialMode = DIO
          PortPinDirection = PORT_PIN_IN
          PortInputBufferControl = 0
          PortBiDirectionControl = 0
          PortIpControl = 0
          PortPullUpOption = 0
          PortPullDownOption = 0
          PortOpenDrainControl_Expansion = OpenDrain_N_Channel
          PortOutputLevelInversion = 0
          PortOutputDriveStrength = SLOW
        PortPin3:
          PortPinDirectionChangeable = 0
          PortPinDioAltModeChangeable = 0
          PortPinModeChangeable = 0
          PortPinLevelValue = PORT_PIN_LEVEL_LOW
          PortPinInitialMode = DIO_SUPP_PFCE_PFCAE_PMCSR
          PortPinDirection = PORT_PIN_IN
          PortInputBufferControl = 0
          PortBiDirectionControl = 0
          PortPullUpOption = 0
          PortPullDownOption = 0
          PortOpenDrainControl_Expansion = OpenDrain_N_Channel
          PortOutputLevelInversion = 0
          PortOutputDriveStrength = SLOW
        PortPin4_PwrSplyClk (PortPin4):
          PortPinDirectionChangeable = 0
          PortPinDioAltModeChangeable = 0
          PortPinModeChangeable = 0
          PortPinLevelValue = PORT_PIN_LEVEL_LOW
          PortPinInitialMode = CSIG0SCO_ALT1_OUT
          PortPinDirection = PORT_PIN_OUT
          PortInputBufferControl = 0
          PortBiDirectionControl = 0
          PortIpControl = 0
          PortPullUpOption = 0
          PortPullDownOption = 0
          PortOpenDrainControl_Expansion = OpenDrain_PushPull
          PortOutputLevelInversion = 0
          PortOutputDriveStrength = SLOW
        PortPin5:
          PortPinDirectionChangeable = 0
          PortPinDioAltModeChangeable = 0
          PortPinModeChangeable = 0
          PortPinLevelValue = PORT_PIN_LEVEL_LOW
          PortPinInitialMode = DIO
          PortPinDirection = PORT_PIN_IN
          PortInputBufferControl = 0
          PortBiDirectionControl = 0
          PortPullUpOption = 0
          PortPullDownOption = 0
          PortOpenDrainControl_Expansion = OpenDrain_N_Channel
          PortOutputLevelInversion = 0
          PortOutputDriveStrength = SLOW
        PortPin6_PwrSplyNonFlt (PortPin6):
          PortPinDirectionChangeable = 0
          PortPinDioAltModeChangeable = 0
          PortPinModeChangeable = 0
          PortPinLevelValue = PORT_PIN_LEVEL_LOW
          PortPinInitialMode = DIO
          PortPinDirection = PORT_PIN_IN
          PortInputBufferControl = 1
          PortBiDirectionControl = 0
          PortPullUpOption = 0
          PortPullDownOption = 0
          PortOpenDrainControl_Expansion = OpenDrain_N_Channel
          PortOutputLevelInversion = 0
          PortOutputDriveStrength = SLOW
        PortPin7_McuEna (PortPin7):
          PortPinDirectionChangeable = 0
          PortPinDioAltModeChangeable = 0
          PortPinModeChangeable = 0
          PortPinLevelValue = PORT_PIN_LEVEL_LOW
          PortPinInitialMode = DIO
          PortPinDirection = PORT_PIN_IN
          PortInputBufferControl = 1
          PortBiDirectionControl = 0
          PortPullUpOption = 0
          PortPullDownOption = 0
          PortOpenDrainControl_Expansion = OpenDrain_N_Channel
          PortOutputLevelInversion = 0
          PortOutputDriveStrength = SLOW
        PortPin8:
          PortPinDirectionChangeable = 0
          PortPinDioAltModeChangeable = 0
          PortPinModeChangeable = 0
          PortPinLevelValue = PORT_PIN_LEVEL_LOW
          PortPinInitialMode = DIO
          PortPinDirection = PORT_PIN_IN
          PortInputBufferControl = 0
          PortBiDirectionControl = 0
          PortPullUpOption = 0
          PortPullDownOption = 0
          PortOpenDrainControl_Expansion = OpenDrain_N_Channel
          PortOutputLevelInversion = 0
          PortOutputDriveStrength = SLOW
        PortPin9_PwrSplyCs (PortPin9):
          PortPinDirectionChangeable = 0
          PortPinDioAltModeChangeable = 0
          PortPinModeChangeable = 0
          PortPinLevelValue = PORT_PIN_LEVEL_HIGH
          PortPinInitialMode = DIO
          PortPinDirection = PORT_PIN_OUT
          PortInputBufferControl = 0
          PortBiDirectionControl = 0
          PortPullUpOption = 0
          PortPullDownOption = 0
          PortOpenDrainControl_Expansion = OpenDrain_PushPull
          PortOutputLevelInversion = 0
          PortOutputDriveStrength = SLOW
        PortPin10_TmplMonrWdg (PortPin10):
          PortPinDirectionChangeable = 0
          PortPinDioAltModeChangeable = 0
          PortPinModeChangeable = 0
          PortPinLevelValue = PORT_PIN_LEVEL_LOW
          PortPinInitialMode = DIO
          PortPinDirection = PORT_PIN_OUT
          PortInputBufferControl = 0
          PortBiDirectionControl = 0
          PortPullUpOption = 0
          PortPullDownOption = 0
          PortOpenDrainControl_Expansion = OpenDrain_PushPull
          PortOutputLevelInversion = 0
          PortOutputDriveStrength = SLOW
        PortPin11:
          PortPinDirectionChangeable = 0
          PortPinDioAltModeChangeable = 0
          PortPinModeChangeable = 0
          PortPinLevelValue = PORT_PIN_LEVEL_LOW
          PortPinInitialMode = DIO_SUPP_PFC_PFCE_PMCSR
          PortPinDirection = PORT_PIN_IN
          PortInputBufferControl = 0
          PortBiDirectionControl = 0
          PortPullUpOption = 0
          PortPullDownOption = 0
          PortOpenDrainControl_Expansion = OpenDrain_N_Channel
          PortOutputLevelInversion = 0
          PortOutputDriveStrength = SLOW
        PortPin12:
          PortPinDirectionChangeable = 0
          PortPinDioAltModeChangeable = 0
          PortPinModeChangeable = 0
          PortPinLevelValue = PORT_PIN_LEVEL_LOW
          PortPinInitialMode = DIO_SUPP_PFC_PFCE_PMCSR
          PortPinDirection = PORT_PIN_IN
          PortInputBufferControl = 0
          PortBiDirectionControl = 0
          PortPullUpOption = 0
          PortPullDownOption = 0
          PortOpenDrainControl_Expansion = OpenDrain_N_Channel
          PortOutputLevelInversion = 0
          PortOutputDriveStrength = SLOW
        PortPin13_PhaDiscnctA (PortPin13):
          PortPinDirectionChangeable = 0
          PortPinDioAltModeChangeable = 0
          PortPinModeChangeable = 0
          PortPinLevelValue = PORT_PIN_LEVEL_HIGH
          PortPinInitialMode = DIO
          PortPinDirection = PORT_PIN_OUT
          PortInputBufferControl = 0
          PortBiDirectionControl = 0
          PortPullUpOption = 0
          PortPullDownOption = 0
          PortOpenDrainControl_Expansion = OpenDrain_PushPull
          PortOutputLevelInversion = 0
          PortOutputDriveStrength = SLOW
        PortPin14_PhaFbA (PortPin14):
          PortPinDirectionChangeable = 0
          PortPinDioAltModeChangeable = 0
          PortPinModeChangeable = 0
          PortPinLevelValue = PORT_PIN_LEVEL_LOW
          PortPinInitialMode = TAUJ0I0_ALT1_IN
          PortPinDirection = PORT_PIN_IN
          PortInputBufferControl = 0
          PortBiDirectionControl = 0
          PortPullUpOption = 0
          PortPullDownOption = 0
          PortOpenDrainControl_Expansion = OpenDrain_N_Channel
          PortOutputLevelInversion = 0
          PortOutputDriveStrength = SLOW
        PortPin15_PhaDiscnctB (PortPin15):
          PortPinDirectionChangeable = 0
          PortPinDioAltModeChangeable = 0
          PortPinModeChangeable = 0
          PortPinLevelValue = PORT_PIN_LEVEL_HIGH
          PortPinInitialMode = DIO_SUPP_PFC_PFCAE_PMCSR
          PortPinDirection = PORT_PIN_OUT
          PortInputBufferControl = 0
          PortBiDirectionControl = 0
          PortPullUpOption = 0
          PortPullDownOption = 0
          PortOpenDrainControl_Expansion = OpenDrain_PushPull
          PortOutputLevelInversion = 0
          PortOutputDriveStrength = SLOW
      PortGroupJtag0
        PortPin0_nRDY (PortPin0):
          PortPinDirectionChangeable = 0
          PortPinDioAltModeChangeable = 0
          PortPinModeChangeable = 0
          PortPinLevelValue = PORT_PIN_LEVEL_LOW
          PortPinInitialMode = DIO_SUPP_PFCE_PMCSR
          PortPinDirection = PORT_PIN_IN
          PortInputBufferControl = 0
          PortBiDirectionControl = 0
          PortPullUpOption = 0
          PortPullDownOption = 0
          PortOpenDrainControl_Expansion = OpenDrain_PushPull_SUPP_PODC
          PortOutputDriveStrength = SLOW
          PortInputSelection = TYPE_1_SUPP_PISA
        PortPin1_TMS (PortPin1):
          PortPinDirectionChangeable = 0
          PortPinDioAltModeChangeable = 0
          PortPinModeChangeable = 0
          PortPinLevelValue = PORT_PIN_LEVEL_LOW
          PortPinInitialMode = DIO_SUPP_PFCE_PMCSR
          PortPinDirection = PORT_PIN_IN
          PortInputBufferControl = 0
          PortBiDirectionControl = 0
          PortPullUpOption = 0
          PortPullDownOption = 0
          PortOpenDrainControl_Expansion = OpenDrain_PushPull_SUPP_PODC
          PortOutputDriveStrength = SLOW
          PortInputSelection = TYPE_1_SUPP_PISA
        PortPin2_TCK (PortPin2):
          PortPinDioAltModeChangeable = 0
          PortPinModeChangeable = 0
          PortPinInitialMode = DIO_SUPP_PFCE_PMCSR
          PortPinDirection = PORT_PIN_IN
          PortInputBufferControl = 0
          PortPullUpOption = 0
          PortPullDownOption = 0
          PortInputSelection = TYPE_1_SUPP_PISA
        PortPin3_TDO (PortPin3):
          PortPinDirectionChangeable = 0
          PortPinDioAltModeChangeable = 0
          PortPinModeChangeable = 0
          PortPinLevelValue = PORT_PIN_LEVEL_LOW
          PortPinInitialMode = ALT_NOT_SUPPORTED
          PortPinDirection = PORT_PIN_IN
          PortInputBufferControl = 0
          PortBiDirectionControl = 0
          PortPullUpOption = 0
          PortPullDownOption = 0
          PortOpenDrainControl_Expansion = OpenDrain_PushPull_SUPP_PODC
          PortOutputDriveStrength = SLOW
          PortInputSelection = TYPE_1_SUPP_PISA
        PortPin4_TDI (PortPin4): PortPinDioAltModeChangeable=0, PortPinModeChangeable=0, PortPinInitialMode=ALT_NOT_SUPPORTED, PortPinDirection=PORT_PIN_IN
        PortPin5_nTRST (PortPin5):
          PortPinDirectionChangeable = 0
          PortPinDioAltModeChangeable = 0
          PortPinModeChangeable = 0
          PortPinLevelValue = PORT_PIN_LEVEL_LOW
          PortPinInitialMode = ALT_NOT_SUPPORTED
          PortPinDirection = PORT_PIN_IN
          PortInputBufferControl = 0
          PortBiDirectionControl = 0
          PortPullUpOption = 0
          PortPullDownOption = 0
          PortOpenDrainControl_Expansion = OpenDrain_PushPull_SUPP_PODC
          PortOutputDriveStrength = SLOW
          PortInputSelection = TYPE_1_SUPP_PISA
    PortGeneral:
      PortDevErrorDetect = 1
      PortSetPinDirectionApi = 1
      PortSetPinDefaultDirectionApi = 1
      PortSetPinModeApi = 1
      PortSetPinDefaultModeApi = 1
      PortVersionInfoApi = 1
      PortVersionCheckExternalModules = 0
      PortDeviceName = R7F701319
      PortCriticalSectionProtection = 1
      PortMaxMode = 6
      PortSetToDioAltModeApi = 1
      PortLoopTimeout = 5
      PortWriteVerify = WV_INIT_ONLY
      PortUseWriteVerifyErrorInterface = 1
      PortWriteVerifyErrorInterface = HndlMcalWrVrfyErr
    PortDemEventParameterRefs: PORT_E_WRITE_TIMEOUT_FAILURE=PORT_E_WRITE_TIMEOUT_FAILURE, PORT_E_REG_WRITE_VERIFY=PORT_E_REG_WRITE_VERIFY
