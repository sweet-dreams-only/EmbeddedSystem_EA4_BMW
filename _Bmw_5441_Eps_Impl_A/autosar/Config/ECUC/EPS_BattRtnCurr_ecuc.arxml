AUTOSAR XML (schema 4-3-0)
package /ActiveEcuC
  module config BattRtnCurr: implementation-config-variant=VARIANT-PRE-COMPILE
    BattRtnCurrGeneral: CURRESTIMDIFTHD=10, FAILSTEP=3276, PASSSTEP=1638, FASTLOOPPROC=true, FILCUTFREQ=10, GAIN=100, LOWRTHD=-200, OFFSET=2.5, OUTPMAX=200, OUTPMIN=-200, UPPRTHD=200
