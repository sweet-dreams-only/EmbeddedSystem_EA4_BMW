AUTOSAR XML (schema 4-3-0)
package /ActiveEcuC
  module config NvM: implementation-config-variant=VARIANT-PRE-COMPILE, module-description=NvM_Impl
    NvMCommon:
      NvMSafeBswChecks = true
      NvMBswMMultiBlockJobStatusInformation = true
      NvMCompiledConfigId = 1
      NvMCrcNumOfBytes = 64
      NvMDatasetSelectionBits = 1
      NvMDevErrorDetect = true
      NvMDrvModeSwitch = true
      NvMDynamicConfiguration = true
      NvMJobPrioritization = false
      NvMPollingMode = true
      NvMSetRamBlockStatusApi = true
      NvMSizeStandardJobQueue = 8
      NvMVersionInfoApi = false
      NvMMaxNoOfWriteRetries = 3
      NvMMainFunctionPeriod = 0.01
      NvMUseBlockIdCheck = false
      NvMRepairRedundantBlocksApi = false
      NvMMultiBlockCallback = BswM_NvM_CurrentJobMode
      NvMApiConfigClass = NVM_API_CONFIG_CLASS_3
    NvMConfigBlock (NvMBlockDescriptor):
      NvMBlockCrcType = NVM_CRC16
      NvMNvramBlockIdentifier = 1
      NvMBlockManagementType = NVM_BLOCK_REDUNDANT
      NvMNvBlockNum = 2
      NvMBlockUseCrc = true
      NvMNvBlockLength = 2
      NvMSelectBlockForReadAll = true
      NvMResistantToChangedSw = true
      NvMUseInitCallback = false
      NvMSelectBlockForWriteAll = true
      NvMCalcRamBlockCrc = false
      NvMRomBlockDataAddress = NULL_PTR
      NvMBlockJobPriority = 127
      NvMBlockUseSyncMechanism = false
      NvMBlockWriteProt = false
      NvMBswMBlockStatusInformation = false
      NvMWriteBlockOnce = false
      NvMUseServicePorts = false
      NvMUseJobendCallback = false
      NvMAutomaticBlockLength = false
      NvMBlockLengthCheckType = false
      NvMBlockLengthCheck = false
      NvMRamBlockDataAddress = NULL_PTR
      NvMSingleBlockCallback = NULL_PTR
      NvMBlockUseCRCCompMechanism = false
      NvMTargetBlockReference
        NvMFeeRef: NvMNameOfFeeBlock=FeeBlockConfiguration
    NvMCommonVendorParams:
      NvMCrcIntBuffer = true
      NvMKillWriteAllApi = true
      NvMMultiblockId = MultiBlockRequest
      NvMCfgCbkIncludeList = Dem_Cbk.h
      NvMCfgCbkIncludeList = CDD_NvMProxyDftDataGroup.h
      NvMCfgCbkIncludeList = Vin_NvM.h
      NvMCfgCbkIncludeList = Omc_NvM.h
      NvMCfgCbkIncludeList = Darh_NvM.h
      NvMCfgCbkIncludeList = Dlog_NvM.h
      NvMCfgCbkIncludeList = Coding_Data.h
    90 x NvMBlockDescriptor, all with NvMBlockUseSyncMechanism=false, NvMResistantToChangedSw=true, NvMWriteBlockOnce=false, NvMBlockUseCRCCompMechanism=false:
      DemAdminDataBlock: NvMBlockJobPriority=127, NvMBlockManagementType=NVM_BLOCK_NATIVE, NvMBlockUseCrc=false, NvMBlockWriteProt=false, NvMBswMBlockStatusInformation=false, NvMNvBlockLength=1, NvMNvBlockNum=1, NvMNvramBlockIdentifier=2, NvMUseServicePorts=false, NvMUseJobendCallback=true, NvMUseInitCallback=true, NvMRamBlockDataAddress=Dem_Cfg_AdminData, NvMRomBlockDataAddress=NULL_PTR, NvMInitBlockCallback=Dem_NvM_InitAdminData, NvMSelectBlockForReadAll=true, NvMSelectBlockForWriteAll=true, NvMSingleBlockCallback=Dem_NvM_JobFinished
        NvMTargetBlockReference
          NvMFeeRef: NvMNameOfFeeBlock=FeeDemAdminDataBlock
      DemStatusDataBlock: NvMBlockJobPriority=127, NvMBlockManagementType=NVM_BLOCK_NATIVE, NvMBlockUseCrc=false, NvMBlockWriteProt=false, NvMBswMBlockStatusInformation=false, NvMNvBlockLength=1, NvMNvBlockNum=1, NvMNvramBlockIdentifier=59, NvMUseServicePorts=false, NvMUseJobendCallback=true, NvMUseInitCallback=true, NvMRamBlockDataAddress=Dem_Cfg_StatusData, NvMRomBlockDataAddress=NULL_PTR, NvMInitBlockCallback=Dem_NvM_InitStatusData, NvMSelectBlockForReadAll=true, NvMSelectBlockForWriteAll=true, NvMSingleBlockCallback=Dem_NvM_JobFinished
        NvMTargetBlockReference
          NvMFeeRef: NvMNameOfFeeBlock=FeeDemStatusDataBlock
      DemPrimaryDataBlock0: NvMBlockJobPriority=127, NvMBlockManagementType=NVM_BLOCK_NATIVE, NvMBlockUseCrc=false, NvMBlockWriteProt=false, NvMBswMBlockStatusInformation=false, NvMNvBlockLength=1, NvMNvBlockNum=1, NvMNvramBlockIdentifier=60, NvMUseServicePorts=false, NvMUseJobendCallback=true, NvMUseInitCallback=false, NvMRamBlockDataAddress=Dem_Cfg_PrimaryEntry_0, NvMRomBlockDataAddress=Dem_Cfg_MemoryEntryInit, NvMInitBlockCallback=NULL_PTR, NvMSelectBlockForReadAll=true, NvMSelectBlockForWriteAll=true, NvMSingleBlockCallback=Dem_NvM_JobFinished
        NvMTargetBlockReference
          NvMFeeRef: NvMNameOfFeeBlock=FeeDemPrimaryDataBlock0
      DemPrimaryDataBlock1: NvMBlockJobPriority=127, NvMBlockManagementType=NVM_BLOCK_NATIVE, NvMBlockUseCrc=false, NvMBlockWriteProt=false, NvMBswMBlockStatusInformation=false, NvMNvBlockLength=1, NvMNvBlockNum=1, NvMNvramBlockIdentifier=61, NvMUseServicePorts=false, NvMUseJobendCallback=true, NvMUseInitCallback=false, NvMRamBlockDataAddress=Dem_Cfg_PrimaryEntry_1, NvMRomBlockDataAddress=Dem_Cfg_MemoryEntryInit, NvMInitBlockCallback=NULL_PTR, NvMSelectBlockForReadAll=true, NvMSelectBlockForWriteAll=true, NvMSingleBlockCallback=Dem_NvM_JobFinished
        NvMTargetBlockReference
          NvMFeeRef: NvMNameOfFeeBlock=FeeDemPrimaryDataBlock1
      DemPrimaryDataBlock2: NvMBlockJobPriority=127, NvMBlockManagementType=NVM_BLOCK_NATIVE, NvMBlockUseCrc=false, NvMBlockWriteProt=false, NvMBswMBlockStatusInformation=false, NvMNvBlockLength=1, NvMNvBlockNum=1, NvMNvramBlockIdentifier=62, NvMUseServicePorts=false, NvMUseJobendCallback=true, NvMUseInitCallback=false, NvMRamBlockDataAddress=Dem_Cfg_PrimaryEntry_2, NvMRomBlockDataAddress=Dem_Cfg_MemoryEntryInit, NvMInitBlockCallback=NULL_PTR, NvMSelectBlockForReadAll=true, NvMSelectBlockForWriteAll=true, NvMSingleBlockCallback=Dem_NvM_JobFinished
        NvMTargetBlockReference
          NvMFeeRef: NvMNameOfFeeBlock=FeeDemPrimaryDataBlock2
      DemPrimaryDataBlock3: NvMBlockJobPriority=127, NvMBlockManagementType=NVM_BLOCK_NATIVE, NvMBlockUseCrc=false, NvMBlockWriteProt=false, NvMBswMBlockStatusInformation=false, NvMNvBlockLength=1, NvMNvBlockNum=1, NvMNvramBlockIdentifier=63, NvMUseServicePorts=false, NvMUseJobendCallback=true, NvMUseInitCallback=false, NvMRamBlockDataAddress=Dem_Cfg_PrimaryEntry_3, NvMRomBlockDataAddress=Dem_Cfg_MemoryEntryInit, NvMInitBlockCallback=NULL_PTR, NvMSelectBlockForReadAll=true, NvMSelectBlockForWriteAll=true, NvMSingleBlockCallback=Dem_NvM_JobFinished
        NvMTargetBlockReference
          NvMFeeRef: NvMNameOfFeeBlock=FeeDemPrimaryDataBlock3
      DemPrimaryDataBlock4: NvMBlockJobPriority=127, NvMBlockManagementType=NVM_BLOCK_NATIVE, NvMBlockUseCrc=false, NvMBlockWriteProt=false, NvMBswMBlockStatusInformation=false, NvMNvBlockLength=1, NvMNvBlockNum=1, NvMNvramBlockIdentifier=64, NvMUseServicePorts=false, NvMUseJobendCallback=true, NvMUseInitCallback=false, NvMRamBlockDataAddress=Dem_Cfg_PrimaryEntry_4, NvMRomBlockDataAddress=Dem_Cfg_MemoryEntryInit, NvMInitBlockCallback=NULL_PTR, NvMSelectBlockForReadAll=true, NvMSelectBlockForWriteAll=true, NvMSingleBlockCallback=Dem_NvM_JobFinished
        NvMTargetBlockReference
          NvMFeeRef: NvMNameOfFeeBlock=FeeDemPrimaryDataBlock4
      DemPrimaryDataBlock5: NvMBlockJobPriority=127, NvMBlockManagementType=NVM_BLOCK_NATIVE, NvMBlockUseCrc=false, NvMBlockWriteProt=false, NvMBswMBlockStatusInformation=false, NvMNvBlockLength=1, NvMNvBlockNum=1, NvMNvramBlockIdentifier=65, NvMUseServicePorts=false, NvMUseJobendCallback=true, NvMUseInitCallback=false, NvMRamBlockDataAddress=Dem_Cfg_PrimaryEntry_5, NvMRomBlockDataAddress=Dem_Cfg_MemoryEntryInit, NvMInitBlockCallback=NULL_PTR, NvMSelectBlockForReadAll=true, NvMSelectBlockForWriteAll=true, NvMSingleBlockCallback=Dem_NvM_JobFinished
        NvMTargetBlockReference
          NvMFeeRef: NvMNameOfFeeBlock=FeeDemPrimaryDataBlock5
      DemPrimaryDataBlock6: NvMBlockJobPriority=127, NvMBlockManagementType=NVM_BLOCK_NATIVE, NvMBlockUseCrc=false, NvMBlockWriteProt=false, NvMBswMBlockStatusInformation=false, NvMNvBlockLength=1, NvMNvBlockNum=1, NvMNvramBlockIdentifier=66, NvMUseServicePorts=false, NvMUseJobendCallback=true, NvMUseInitCallback=false, NvMRamBlockDataAddress=Dem_Cfg_PrimaryEntry_6, NvMRomBlockDataAddress=Dem_Cfg_MemoryEntryInit, NvMInitBlockCallback=NULL_PTR, NvMSelectBlockForReadAll=true, NvMSelectBlockForWriteAll=true, NvMSingleBlockCallback=Dem_NvM_JobFinished
        NvMTargetBlockReference
          NvMFeeRef: NvMNameOfFeeBlock=FeeDemPrimaryDataBlock6
      DemPrimaryDataBlock7: NvMBlockJobPriority=127, NvMBlockManagementType=NVM_BLOCK_NATIVE, NvMBlockUseCrc=false, NvMBlockWriteProt=false, NvMBswMBlockStatusInformation=false, NvMNvBlockLength=1, NvMNvBlockNum=1, NvMNvramBlockIdentifier=67, NvMUseServicePorts=false, NvMUseJobendCallback=true, NvMUseInitCallback=false, NvMRamBlockDataAddress=Dem_Cfg_PrimaryEntry_7, NvMRomBlockDataAddress=Dem_Cfg_MemoryEntryInit, NvMInitBlockCallback=NULL_PTR, NvMSelectBlockForReadAll=true, NvMSelectBlockForWriteAll=true, NvMSingleBlockCallback=Dem_NvM_JobFinished
        NvMTargetBlockReference
          NvMFeeRef: NvMNameOfFeeBlock=FeeDemPrimaryDataBlock7
      DemSecondaryDataBlock0: NvMBlockJobPriority=127, NvMBlockManagementType=NVM_BLOCK_NATIVE, NvMBlockUseCrc=false, NvMBlockWriteProt=false, NvMBswMBlockStatusInformation=false, NvMNvBlockLength=1, NvMNvBlockNum=1, NvMNvramBlockIdentifier=68, NvMUseServicePorts=false, NvMUseJobendCallback=true, NvMUseInitCallback=false, NvMRamBlockDataAddress=Dem_Cfg_SecondaryEntry_0, NvMRomBlockDataAddress=Dem_Cfg_MemoryEntryInit, NvMInitBlockCallback=NULL_PTR, NvMSelectBlockForReadAll=true, NvMSelectBlockForWriteAll=true, NvMSingleBlockCallback=Dem_NvM_JobFinished
        NvMTargetBlockReference
          NvMFeeRef: NvMNameOfFeeBlock=FeeDemSecondaryDataBlock0
      DemSecondaryDataBlock1: NvMBlockJobPriority=127, NvMBlockManagementType=NVM_BLOCK_NATIVE, NvMBlockUseCrc=false, NvMBlockWriteProt=false, NvMBswMBlockStatusInformation=false, NvMNvBlockLength=1, NvMNvBlockNum=1, NvMNvramBlockIdentifier=69, NvMUseServicePorts=false, NvMUseJobendCallback=true, NvMUseInitCallback=false, NvMRamBlockDataAddress=Dem_Cfg_SecondaryEntry_1, NvMRomBlockDataAddress=Dem_Cfg_MemoryEntryInit, NvMInitBlockCallback=NULL_PTR, NvMSelectBlockForReadAll=true, NvMSelectBlockForWriteAll=true, NvMSingleBlockCallback=Dem_NvM_JobFinished
        NvMTargetBlockReference
          NvMFeeRef: NvMNameOfFeeBlock=FeeDemSecondaryDataBlock1
      DemSecondaryDataBlock2: NvMBlockJobPriority=127, NvMBlockManagementType=NVM_BLOCK_NATIVE, NvMBlockUseCrc=false, NvMBlockWriteProt=false, NvMBswMBlockStatusInformation=false, NvMNvBlockLength=1, NvMNvBlockNum=1, NvMNvramBlockIdentifier=70, NvMUseServicePorts=false, NvMUseJobendCallback=true, NvMUseInitCallback=false, NvMRamBlockDataAddress=Dem_Cfg_SecondaryEntry_2, NvMRomBlockDataAddress=Dem_Cfg_MemoryEntryInit, NvMInitBlockCallback=NULL_PTR, NvMSelectBlockForReadAll=true, NvMSelectBlockForWriteAll=true, NvMSingleBlockCallback=Dem_NvM_JobFinished
        NvMTargetBlockReference
          NvMFeeRef: NvMNameOfFeeBlock=FeeDemSecondaryDataBlock2
      DemSecondaryDataBlock3: NvMBlockJobPriority=127, NvMBlockManagementType=NVM_BLOCK_NATIVE, NvMBlockUseCrc=false, NvMBlockWriteProt=false, NvMBswMBlockStatusInformation=false, NvMNvBlockLength=1, NvMNvBlockNum=1, NvMNvramBlockIdentifier=71, NvMUseServicePorts=false, NvMUseJobendCallback=true, NvMUseInitCallback=false, NvMRamBlockDataAddress=Dem_Cfg_SecondaryEntry_3, NvMRomBlockDataAddress=Dem_Cfg_MemoryEntryInit, NvMInitBlockCallback=NULL_PTR, NvMSelectBlockForReadAll=true, NvMSelectBlockForWriteAll=true, NvMSingleBlockCallback=Dem_NvM_JobFinished
        NvMTargetBlockReference
          NvMFeeRef: NvMNameOfFeeBlock=FeeDemSecondaryDataBlock3
      DemSecondaryDataBlock4: NvMBlockJobPriority=127, NvMBlockManagementType=NVM_BLOCK_NATIVE, NvMBlockUseCrc=false, NvMBlockWriteProt=false, NvMBswMBlockStatusInformation=false, NvMNvBlockLength=1, NvMNvBlockNum=1, NvMNvramBlockIdentifier=72, NvMUseServicePorts=false, NvMUseJobendCallback=true, NvMUseInitCallback=false, NvMRamBlockDataAddress=Dem_Cfg_SecondaryEntry_4, NvMRomBlockDataAddress=Dem_Cfg_MemoryEntryInit, NvMInitBlockCallback=NULL_PTR, NvMSelectBlockForReadAll=true, NvMSelectBlockForWriteAll=true, NvMSingleBlockCallback=Dem_NvM_JobFinished
        NvMTargetBlockReference
          NvMFeeRef: NvMNameOfFeeBlock=FeeDemSecondaryDataBlock4
      DemSecondaryDataBlock5: NvMBlockJobPriority=127, NvMBlockManagementType=NVM_BLOCK_NATIVE, NvMBlockUseCrc=false, NvMBlockWriteProt=false, NvMBswMBlockStatusInformation=false, NvMNvBlockLength=1, NvMNvBlockNum=1, NvMNvramBlockIdentifier=73, NvMUseServicePorts=false, NvMUseJobendCallback=true, NvMUseInitCallback=false, NvMRamBlockDataAddress=Dem_Cfg_SecondaryEntry_5, NvMRomBlockDataAddress=Dem_Cfg_MemoryEntryInit, NvMInitBlockCallback=NULL_PTR, NvMSelectBlockForReadAll=true, NvMSelectBlockForWriteAll=true, NvMSingleBlockCallback=Dem_NvM_JobFinished
        NvMTargetBlockReference
          NvMFeeRef: NvMNameOfFeeBlock=FeeDemSecondaryDataBlock5
      DemSecondaryDataBlock6: NvMBlockJobPriority=127, NvMBlockManagementType=NVM_BLOCK_NATIVE, NvMBlockUseCrc=false, NvMBlockWriteProt=false, NvMBswMBlockStatusInformation=false, NvMNvBlockLength=1, NvMNvBlockNum=1, NvMNvramBlockIdentifier=74, NvMUseServicePorts=false, NvMUseJobendCallback=true, NvMUseInitCallback=false, NvMRamBlockDataAddress=Dem_Cfg_SecondaryEntry_6, NvMRomBlockDataAddress=Dem_Cfg_MemoryEntryInit, NvMInitBlockCallback=NULL_PTR, NvMSelectBlockForReadAll=true, NvMSelectBlockForWriteAll=true, NvMSingleBlockCallback=Dem_NvM_JobFinished
        NvMTargetBlockReference
          NvMFeeRef: NvMNameOfFeeBlock=FeeDemSecondaryDataBlock6
      DemSecondaryDataBlock7: NvMBlockJobPriority=127, NvMBlockManagementType=NVM_BLOCK_NATIVE, NvMBlockUseCrc=false, NvMBlockWriteProt=false, NvMBswMBlockStatusInformation=false, NvMNvBlockLength=1, NvMNvBlockNum=1, NvMNvramBlockIdentifier=75, NvMUseServicePorts=false, NvMUseJobendCallback=true, NvMUseInitCallback=false, NvMRamBlockDataAddress=Dem_Cfg_SecondaryEntry_7, NvMRomBlockDataAddress=Dem_Cfg_MemoryEntryInit, NvMInitBlockCallback=NULL_PTR, NvMSelectBlockForReadAll=true, NvMSelectBlockForWriteAll=true, NvMSingleBlockCallback=Dem_NvM_JobFinished
        NvMTargetBlockReference
          NvMFeeRef: NvMNameOfFeeBlock=FeeDemSecondaryDataBlock7
      DemSecondaryDataBlock8: NvMBlockJobPriority=127, NvMBlockManagementType=NVM_BLOCK_NATIVE, NvMBlockUseCrc=false, NvMBlockWriteProt=false, NvMBswMBlockStatusInformation=false, NvMNvBlockLength=1, NvMNvBlockNum=1, NvMNvramBlockIdentifier=76, NvMUseServicePorts=false, NvMUseJobendCallback=true, NvMUseInitCallback=false, NvMRamBlockDataAddress=Dem_Cfg_SecondaryEntry_8, NvMRomBlockDataAddress=Dem_Cfg_MemoryEntryInit, NvMInitBlockCallback=NULL_PTR, NvMSelectBlockForReadAll=true, NvMSelectBlockForWriteAll=true, NvMSingleBlockCallback=Dem_NvM_JobFinished
        NvMTargetBlockReference
          NvMFeeRef: NvMNameOfFeeBlock=FeeDemSecondaryDataBlock8
      DemSecondaryDataBlock9: NvMBlockJobPriority=127, NvMBlockManagementType=NVM_BLOCK_NATIVE, NvMBlockUseCrc=false, NvMBlockWriteProt=false, NvMBswMBlockStatusInformation=false, NvMNvBlockLength=1, NvMNvBlockNum=1, NvMNvramBlockIdentifier=77, NvMUseServicePorts=false, NvMUseJobendCallback=true, NvMUseInitCallback=false, NvMRamBlockDataAddress=Dem_Cfg_SecondaryEntry_9, NvMRomBlockDataAddress=Dem_Cfg_MemoryEntryInit, NvMInitBlockCallback=NULL_PTR, NvMSelectBlockForReadAll=true, NvMSelectBlockForWriteAll=true, NvMSingleBlockCallback=Dem_NvM_JobFinished
        NvMTargetBlockReference
          NvMFeeRef: NvMNameOfFeeBlock=FeeDemSecondaryDataBlock9
      DemSecondaryDataBlock10: NvMBlockJobPriority=127, NvMBlockManagementType=NVM_BLOCK_NATIVE, NvMBlockUseCrc=false, NvMBlockWriteProt=false, NvMBswMBlockStatusInformation=false, NvMNvBlockLength=1, NvMNvBlockNum=1, NvMNvramBlockIdentifier=78, NvMUseServicePorts=false, NvMUseJobendCallback=true, NvMUseInitCallback=false, NvMRamBlockDataAddress=Dem_Cfg_SecondaryEntry_10, NvMRomBlockDataAddress=Dem_Cfg_MemoryEntryInit, NvMInitBlockCallback=NULL_PTR, NvMSelectBlockForReadAll=true, NvMSelectBlockForWriteAll=true, NvMSingleBlockCallback=Dem_NvM_JobFinished
        NvMTargetBlockReference
          NvMFeeRef: NvMNameOfFeeBlock=FeeDemSecondaryDataBlock10
      DemSecondaryDataBlock11: NvMBlockJobPriority=127, NvMBlockManagementType=NVM_BLOCK_NATIVE, NvMBlockUseCrc=false, NvMBlockWriteProt=false, NvMBswMBlockStatusInformation=false, NvMNvBlockLength=1, NvMNvBlockNum=1, NvMNvramBlockIdentifier=79, NvMUseServicePorts=false, NvMUseJobendCallback=true, NvMUseInitCallback=false, NvMRamBlockDataAddress=Dem_Cfg_SecondaryEntry_11, NvMRomBlockDataAddress=Dem_Cfg_MemoryEntryInit, NvMInitBlockCallback=NULL_PTR, NvMSelectBlockForReadAll=true, NvMSelectBlockForWriteAll=true, NvMSingleBlockCallback=Dem_NvM_JobFinished
        NvMTargetBlockReference
          NvMFeeRef: NvMNameOfFeeBlock=FeeDemSecondaryDataBlock11
      DemSecondaryDataBlock12: NvMBlockJobPriority=127, NvMBlockManagementType=NVM_BLOCK_NATIVE, NvMBlockUseCrc=false, NvMBlockWriteProt=false, NvMBswMBlockStatusInformation=false, NvMNvBlockLength=1, NvMNvBlockNum=1, NvMNvramBlockIdentifier=80, NvMUseServicePorts=false, NvMUseJobendCallback=true, NvMUseInitCallback=false, NvMRamBlockDataAddress=Dem_Cfg_SecondaryEntry_12, NvMRomBlockDataAddress=Dem_Cfg_MemoryEntryInit, NvMInitBlockCallback=NULL_PTR, NvMSelectBlockForReadAll=true, NvMSelectBlockForWriteAll=true, NvMSingleBlockCallback=Dem_NvM_JobFinished
        NvMTargetBlockReference
          NvMFeeRef: NvMNameOfFeeBlock=FeeDemSecondaryDataBlock12
      DemSecondaryDataBlock13: NvMBlockJobPriority=127, NvMBlockManagementType=NVM_BLOCK_NATIVE, NvMBlockUseCrc=false, NvMBlockWriteProt=false, NvMBswMBlockStatusInformation=false, NvMNvBlockLength=1, NvMNvBlockNum=1, NvMNvramBlockIdentifier=81, NvMUseServicePorts=false, NvMUseJobendCallback=true, NvMUseInitCallback=false, NvMRamBlockDataAddress=Dem_Cfg_SecondaryEntry_13, NvMRomBlockDataAddress=Dem_Cfg_MemoryEntryInit, NvMInitBlockCallback=NULL_PTR, NvMSelectBlockForReadAll=true, NvMSelectBlockForWriteAll=true, NvMSingleBlockCallback=Dem_NvM_JobFinished
        NvMTargetBlockReference
          NvMFeeRef: NvMNameOfFeeBlock=FeeDemSecondaryDataBlock13
      DemSecondaryDataBlock14: NvMBlockJobPriority=127, NvMBlockManagementType=NVM_BLOCK_NATIVE, NvMBlockUseCrc=false, NvMBlockWriteProt=false, NvMBswMBlockStatusInformation=false, NvMNvBlockLength=1, NvMNvBlockNum=1, NvMNvramBlockIdentifier=82, NvMUseServicePorts=false, NvMUseJobendCallback=true, NvMUseInitCallback=false, NvMRamBlockDataAddress=Dem_Cfg_SecondaryEntry_14, NvMRomBlockDataAddress=Dem_Cfg_MemoryEntryInit, NvMInitBlockCallback=NULL_PTR, NvMSelectBlockForReadAll=true, NvMSelectBlockForWriteAll=true, NvMSingleBlockCallback=Dem_NvM_JobFinished
        NvMTargetBlockReference
          NvMFeeRef: NvMNameOfFeeBlock=FeeDemSecondaryDataBlock14
      DemSecondaryDataBlock15: NvMBlockJobPriority=127, NvMBlockManagementType=NVM_BLOCK_NATIVE, NvMBlockUseCrc=false, NvMBlockWriteProt=false, NvMBswMBlockStatusInformation=false, NvMNvBlockLength=1, NvMNvBlockNum=1, NvMNvramBlockIdentifier=83, NvMUseServicePorts=false, NvMUseJobendCallback=true, NvMUseInitCallback=false, NvMRamBlockDataAddress=Dem_Cfg_SecondaryEntry_15, NvMRomBlockDataAddress=Dem_Cfg_MemoryEntryInit, NvMInitBlockCallback=NULL_PTR, NvMSelectBlockForReadAll=true, NvMSelectBlockForWriteAll=true, NvMSingleBlockCallback=Dem_NvM_JobFinished
        NvMTargetBlockReference
          NvMFeeRef: NvMNameOfFeeBlock=FeeDemSecondaryDataBlock15
      DemSecondaryDataBlock16: NvMBlockJobPriority=127, NvMBlockManagementType=NVM_BLOCK_NATIVE, NvMBlockUseCrc=false, NvMBlockWriteProt=false, NvMBswMBlockStatusInformation=false, NvMNvBlockLength=1, NvMNvBlockNum=1, NvMNvramBlockIdentifier=84, NvMUseServicePorts=false, NvMUseJobendCallback=true, NvMUseInitCallback=false, NvMRamBlockDataAddress=Dem_Cfg_SecondaryEntry_16, NvMRomBlockDataAddress=Dem_Cfg_MemoryEntryInit, NvMInitBlockCallback=NULL_PTR, NvMSelectBlockForReadAll=true, NvMSelectBlockForWriteAll=true, NvMSingleBlockCallback=Dem_NvM_JobFinished
        NvMTargetBlockReference
          NvMFeeRef: NvMNameOfFeeBlock=FeeDemSecondaryDataBlock16
      DemSecondaryDataBlock17: NvMBlockJobPriority=127, NvMBlockManagementType=NVM_BLOCK_NATIVE, NvMBlockUseCrc=false, NvMBlockWriteProt=false, NvMBswMBlockStatusInformation=false, NvMNvBlockLength=1, NvMNvBlockNum=1, NvMNvramBlockIdentifier=85, NvMUseServicePorts=false, NvMUseJobendCallback=true, NvMUseInitCallback=false, NvMRamBlockDataAddress=Dem_Cfg_SecondaryEntry_17, NvMRomBlockDataAddress=Dem_Cfg_MemoryEntryInit, NvMInitBlockCallback=NULL_PTR, NvMSelectBlockForReadAll=true, NvMSelectBlockForWriteAll=true, NvMSingleBlockCallback=Dem_NvM_JobFinished
        NvMTargetBlockReference
          NvMFeeRef: NvMNameOfFeeBlock=FeeDemSecondaryDataBlock17
      DemSecondaryDataBlock18: NvMBlockJobPriority=127, NvMBlockManagementType=NVM_BLOCK_NATIVE, NvMBlockUseCrc=false, NvMBlockWriteProt=false, NvMBswMBlockStatusInformation=false, NvMNvBlockLength=1, NvMNvBlockNum=1, NvMNvramBlockIdentifier=86, NvMUseServicePorts=false, NvMUseJobendCallback=true, NvMUseInitCallback=false, NvMRamBlockDataAddress=Dem_Cfg_SecondaryEntry_18, NvMRomBlockDataAddress=Dem_Cfg_MemoryEntryInit, NvMInitBlockCallback=NULL_PTR, NvMSelectBlockForReadAll=true, NvMSelectBlockForWriteAll=true, NvMSingleBlockCallback=Dem_NvM_JobFinished
        NvMTargetBlockReference
          NvMFeeRef: NvMNameOfFeeBlock=FeeDemSecondaryDataBlock18
      DemSecondaryDataBlock19: NvMBlockJobPriority=127, NvMBlockManagementType=NVM_BLOCK_NATIVE, NvMBlockUseCrc=false, NvMBlockWriteProt=false, NvMBswMBlockStatusInformation=false, NvMNvBlockLength=1, NvMNvBlockNum=1, NvMNvramBlockIdentifier=87, NvMUseServicePorts=false, NvMUseJobendCallback=true, NvMUseInitCallback=false, NvMRamBlockDataAddress=Dem_Cfg_SecondaryEntry_19, NvMRomBlockDataAddress=Dem_Cfg_MemoryEntryInit, NvMInitBlockCallback=NULL_PTR, NvMSelectBlockForReadAll=true, NvMSelectBlockForWriteAll=true, NvMSingleBlockCallback=Dem_NvM_JobFinished
        NvMTargetBlockReference
          NvMFeeRef: NvMNameOfFeeBlock=FeeDemSecondaryDataBlock19
      DemSecondaryDataBlock20: NvMBlockJobPriority=127, NvMBlockManagementType=NVM_BLOCK_NATIVE, NvMBlockUseCrc=false, NvMBlockWriteProt=false, NvMBswMBlockStatusInformation=false, NvMNvBlockLength=1, NvMNvBlockNum=1, NvMNvramBlockIdentifier=88, NvMUseServicePorts=false, NvMUseJobendCallback=true, NvMUseInitCallback=false, NvMRamBlockDataAddress=Dem_Cfg_SecondaryEntry_20, NvMRomBlockDataAddress=Dem_Cfg_MemoryEntryInit, NvMInitBlockCallback=NULL_PTR, NvMSelectBlockForReadAll=true, NvMSelectBlockForWriteAll=true, NvMSingleBlockCallback=Dem_NvM_JobFinished
        NvMTargetBlockReference
          NvMFeeRef: NvMNameOfFeeBlock=FeeDemSecondaryDataBlock20
      DemSecondaryDataBlock21: NvMBlockJobPriority=127, NvMBlockManagementType=NVM_BLOCK_NATIVE, NvMBlockUseCrc=false, NvMBlockWriteProt=false, NvMBswMBlockStatusInformation=false, NvMNvBlockLength=1, NvMNvBlockNum=1, NvMNvramBlockIdentifier=89, NvMUseServicePorts=false, NvMUseJobendCallback=true, NvMUseInitCallback=false, NvMRamBlockDataAddress=Dem_Cfg_SecondaryEntry_21, NvMRomBlockDataAddress=Dem_Cfg_MemoryEntryInit, NvMInitBlockCallback=NULL_PTR, NvMSelectBlockForReadAll=true, NvMSelectBlockForWriteAll=true, NvMSingleBlockCallback=Dem_NvM_JobFinished
        NvMTargetBlockReference
          NvMFeeRef: NvMNameOfFeeBlock=FeeDemSecondaryDataBlock21
      DemSecondaryDataBlock22: NvMBlockJobPriority=127, NvMBlockManagementType=NVM_BLOCK_NATIVE, NvMBlockUseCrc=false, NvMBlockWriteProt=false, NvMBswMBlockStatusInformation=false, NvMNvBlockLength=1, NvMNvBlockNum=1, NvMNvramBlockIdentifier=90, NvMUseServicePorts=false, NvMUseJobendCallback=true, NvMUseInitCallback=false, NvMRamBlockDataAddress=Dem_Cfg_SecondaryEntry_22, NvMRomBlockDataAddress=Dem_Cfg_MemoryEntryInit, NvMInitBlockCallback=NULL_PTR, NvMSelectBlockForReadAll=true, NvMSelectBlockForWriteAll=true, NvMSingleBlockCallback=Dem_NvM_JobFinished
        NvMTargetBlockReference
          NvMFeeRef: NvMNameOfFeeBlock=FeeDemSecondaryDataBlock22
      DemSecondaryDataBlock23: NvMBlockJobPriority=127, NvMBlockManagementType=NVM_BLOCK_NATIVE, NvMBlockUseCrc=false, NvMBlockWriteProt=false, NvMBswMBlockStatusInformation=false, NvMNvBlockLength=1, NvMNvBlockNum=1, NvMNvramBlockIdentifier=91, NvMUseServicePorts=false, NvMUseJobendCallback=true, NvMUseInitCallback=false, NvMRamBlockDataAddress=Dem_Cfg_SecondaryEntry_23, NvMRomBlockDataAddress=Dem_Cfg_MemoryEntryInit, NvMInitBlockCallback=NULL_PTR, NvMSelectBlockForReadAll=true, NvMSelectBlockForWriteAll=true, NvMSingleBlockCallback=Dem_NvM_JobFinished
        NvMTargetBlockReference
          NvMFeeRef: NvMNameOfFeeBlock=FeeDemSecondaryDataBlock23
      Rte_NvmBlock_CDD_NvMProxy_ShtdwnClsChk: NvMBlockJobPriority=127, NvMBlockManagementType=NVM_BLOCK_NATIVE, NvMBlockUseCrc=true, NvMBlockWriteProt=false, NvMBswMBlockStatusInformation=false, NvMNvBlockLength=4, NvMNvBlockNum=1, NvMNvramBlockIdentifier=58, NvMUseServicePorts=true, NvMUseJobendCallback=false, NvMUseInitCallback=false, NvMSelectBlockForReadAll=true, NvMSelectBlockForWriteAll=false, NvMBlockCrcType=NVM_CRC16, NvMRamBlockDataAddress=Rte_CDD_NvMProxy_ShtdwnClsChk, NvMRomBlockDataAddress=NULL_PTR
        NvMTargetBlockReference
          NvMFeeRef: NvMNameOfFeeBlock=FeeRte_NvmBlock_CDD_NvMProxy_ShtdwnClsChk
      Rte_NvmBlock_DiagcMgr_DiagcMgrApplCrc: NvMBlockJobPriority=127, NvMBlockManagementType=NVM_BLOCK_NATIVE, NvMBlockUseCrc=true, NvMBlockWriteProt=false, NvMBswMBlockStatusInformation=false, NvMNvBlockLength=4, NvMNvBlockNum=1, NvMNvramBlockIdentifier=55, NvMUseServicePorts=true, NvMUseJobendCallback=false, NvMUseInitCallback=false, NvMBlockCrcType=NVM_CRC16, NvMSelectBlockForReadAll=true, NvMSelectBlockForWriteAll=true, NvMRamBlockDataAddress=Rte_DiagcMgr_DiagcMgrApplCrc, NvMRomBlockDataAddress=Rte_CalprmRom_DiagcMgr_DEFAULT_RTE_CDATA_GROUP.DiagcMgrApplCrcDft
        NvMTargetBlockReference
          NvMFeeRef: NvMNameOfFeeBlock=FeeRte_NvmBlock_DiagcMgr_DiagcMgrApplCrc
      Rte_NvmBlock_DiagcMgr_DiagcMgrNtcFltAry: NvMBlockJobPriority=127, NvMBlockManagementType=NVM_BLOCK_NATIVE, NvMBlockUseCrc=true, NvMBlockWriteProt=false, NvMBswMBlockStatusInformation=false, NvMNvBlockLength=80, NvMNvBlockNum=1, NvMNvramBlockIdentifier=56, NvMUseServicePorts=true, NvMUseJobendCallback=false, NvMUseInitCallback=false, NvMBlockCrcType=NVM_CRC16, NvMSelectBlockForWriteAll=true, NvMSelectBlockForReadAll=true, NvMRamBlockDataAddress=Rte_DiagcMgr_DiagcMgrNtcFltAry, NvMRomBlockDataAddress=NULL_PTR
        NvMTargetBlockReference
          NvMFeeRef: NvMNameOfFeeBlock=FeeRte_NvmBlock_DiagcMgr_DiagcMgrNtcFltAry
      Rte_NvmBlock_DiagcMgr_DiagcMgrLtchCntrAry: NvMBlockJobPriority=127, NvMBlockManagementType=NVM_BLOCK_NATIVE, NvMBlockUseCrc=true, NvMBlockWriteProt=false, NvMBswMBlockStatusInformation=false, NvMNvBlockLength=20, NvMNvBlockNum=1, NvMNvramBlockIdentifier=57, NvMUseServicePorts=true, NvMUseJobendCallback=false, NvMUseInitCallback=false, NvMSelectBlockForReadAll=true, NvMSelectBlockForWriteAll=true, NvMBlockCrcType=NVM_CRC16, NvMRamBlockDataAddress=Rte_DiagcMgr_DiagcMgrLtchCntrAry, NvMRomBlockDataAddress=NULL_PTR
        NvMTargetBlockReference
          NvMFeeRef: NvMNameOfFeeBlock=FeeRte_NvmBlock_DiagcMgr_DiagcMgrLtchCntrAry
      Rte_NvmBlock_CDD_MotAg0Meas_MotAg0CoeffTbl: NvMBlockJobPriority=127, NvMBlockManagementType=NVM_BLOCK_REDUNDANT, NvMBlockUseCrc=true, NvMBlockWriteProt=false, NvMBswMBlockStatusInformation=false, NvMNvBlockLength=104, NvMNvBlockNum=2, NvMNvramBlockIdentifier=54, NvMUseServicePorts=true, NvMUseJobendCallback=false, NvMUseInitCallback=false, NvMSelectBlockForReadAll=true, NvMSelectBlockForWriteAll=true, NvMBlockCrcType=NVM_CRC16, NvMRamBlockDataAddress=Rte_CDD_MotAg0Meas_MotAg0CoeffTbl, NvMRomBlockDataAddress=NULL_PTR
        NvMTargetBlockReference
          NvMFeeRef: NvMNameOfFeeBlock=FeeRte_NvmBlock_CDD_MotAg0Meas_MotAg0CoeffTbl
      Rte_NvmBlock_CDD_MotAg1Meas_MotAg1CoeffTbl: NvMBlockJobPriority=127, NvMBlockManagementType=NVM_BLOCK_REDUNDANT, NvMBlockUseCrc=true, NvMBlockWriteProt=false, NvMBswMBlockStatusInformation=false, NvMNvBlockLength=104, NvMNvBlockNum=2, NvMNvramBlockIdentifier=53, NvMUseServicePorts=true, NvMUseJobendCallback=false, NvMUseInitCallback=false, NvMSelectBlockForReadAll=true, NvMSelectBlockForWriteAll=true, NvMBlockCrcType=NVM_CRC16, NvMRamBlockDataAddress=Rte_CDD_MotAg1Meas_MotAg1CoeffTbl, NvMRomBlockDataAddress=NULL_PTR
        NvMTargetBlockReference
          NvMFeeRef: NvMNameOfFeeBlock=FeeRte_NvmBlock_CDD_MotAg1Meas_MotAg1CoeffTbl
      Rte_NvmBlock_CDD_CurrMeas_CurrMeasEolGainCalSetABC: NvMBlockJobPriority=127, NvMBlockManagementType=NVM_BLOCK_REDUNDANT, NvMBlockUseCrc=true, NvMBlockWriteProt=false, NvMBswMBlockStatusInformation=false, NvMNvBlockLength=12, NvMNvBlockNum=2, NvMNvramBlockIdentifier=52, NvMUseServicePorts=true, NvMUseJobendCallback=false, NvMUseInitCallback=false, NvMBlockCrcType=NVM_CRC16, NvMSelectBlockForReadAll=true, NvMSelectBlockForWriteAll=true, NvMRamBlockDataAddress=Rte_CDD_CurrMeas_CurrMeasEolGainCalSetABC, NvMRomBlockDataAddress=Rte_CalprmRom_CDD_CurrMeas_DEFAULT_RTE_CDATA_GROUP.CurrMeasEolGainCalSetABCDft
        NvMTargetBlockReference
          NvMFeeRef: NvMNameOfFeeBlock=FeeRte_NvmBlock_CDD_CurrMeas_CurrMeasEolGainCalSetABC
      Rte_NvmBlock_CDD_CurrMeas_CurrMeasEolOffsCalSetABC: NvMBlockJobPriority=127, NvMBlockManagementType=NVM_BLOCK_REDUNDANT, NvMBlockUseCrc=true, NvMBlockWriteProt=false, NvMBswMBlockStatusInformation=false, NvMNvBlockLength=28, NvMNvBlockNum=2, NvMNvramBlockIdentifier=51, NvMUseServicePorts=true, NvMUseJobendCallback=false, NvMUseInitCallback=false, NvMBlockCrcType=NVM_CRC16, NvMSelectBlockForReadAll=true, NvMSelectBlockForWriteAll=true, NvMRamBlockDataAddress=Rte_CDD_CurrMeas_CurrMeasEolOffsCalSetABC, NvMRomBlockDataAddress=Rte_CalprmRom_CDD_CurrMeas_DEFAULT_RTE_CDATA_GROUP.CurrMeasEolOffsCalSetABCDft
        NvMTargetBlockReference
          NvMFeeRef: NvMNameOfFeeBlock=FeeRte_NvmBlock_CDD_CurrMeas_CurrMeasEolOffsCalSetABC
      NVM_BLOCK_DCM_ROE: NvMBlockJobPriority=127, NvMBlockManagementType=NVM_BLOCK_NATIVE, NvMBlockUseCrc=true, NvMBlockWriteProt=false, NvMBswMBlockStatusInformation=false, NvMNvBlockLength=2, NvMNvBlockNum=1, NvMNvramBlockIdentifier=50, NvMUseServicePorts=false, NvMUseJobendCallback=false, NvMUseInitCallback=false, NvMBlockCrcType=NVM_CRC16, NvMSelectBlockForReadAll=false, NvMSelectBlockForWriteAll=false, NvMSingleBlockCallback=NULL_PTR
        NvMTargetBlockReference
          NvMFeeRef: NvMNameOfFeeBlock=Fee_NVM_BLOCK_DCM_ROE
      Rte_NvmBlock_CmnMfgSrv_CcaHwPartNr: NvMBlockJobPriority=127, NvMBlockManagementType=NVM_BLOCK_NATIVE, NvMBlockUseCrc=true, NvMBlockWriteProt=false, NvMBswMBlockStatusInformation=false, NvMNvBlockLength=20, NvMNvBlockNum=1, NvMNvramBlockIdentifier=49, NvMUseServicePorts=true, NvMUseJobendCallback=false, NvMUseInitCallback=false, NvMSelectBlockForReadAll=true, NvMSelectBlockForWriteAll=true, NvMBlockCrcType=NVM_CRC16, NvMRamBlockDataAddress=Rte_CmnMfgSrv_CcaHwPartNr, NvMRomBlockDataAddress=NULL_PTR, NvMCalcRamBlockCrc=false
        NvMTargetBlockReference
          NvMFeeRef: NvMNameOfFeeBlock=FeeRte_NvmBlock_CmnMfgSrv_CcaHwPartNr
      Rte_NvmBlock_CmnMfgSrv_CcaSerlNr: NvMBlockJobPriority=127, NvMBlockManagementType=NVM_BLOCK_NATIVE, NvMBlockUseCrc=true, NvMBlockWriteProt=false, NvMBswMBlockStatusInformation=false, NvMNvBlockLength=20, NvMNvBlockNum=1, NvMNvramBlockIdentifier=48, NvMUseServicePorts=true, NvMUseJobendCallback=false, NvMUseInitCallback=false, NvMBlockCrcType=NVM_CRC16, NvMRamBlockDataAddress=Rte_CmnMfgSrv_CcaSerlNr, NvMRomBlockDataAddress=NULL_PTR, NvMSelectBlockForReadAll=true, NvMSelectBlockForWriteAll=true
        NvMTargetBlockReference
          NvMFeeRef: NvMNameOfFeeBlock=FeeRte_NvmBlock_CmnMfgSrv_CcaSerlNr
      Rte_NvmBlock_CmnMfgSrv_DiRestore: NvMBlockJobPriority=127, NvMBlockManagementType=NVM_BLOCK_NATIVE, NvMBlockUseCrc=true, NvMBlockWriteProt=false, NvMBswMBlockStatusInformation=false, NvMNvBlockLength=8, NvMNvBlockNum=1, NvMNvramBlockIdentifier=47, NvMUseServicePorts=true, NvMUseJobendCallback=false, NvMUseInitCallback=false, NvMBlockCrcType=NVM_CRC16, NvMSelectBlockForReadAll=true, NvMSelectBlockForWriteAll=true, NvMRamBlockDataAddress=Rte_CmnMfgSrv_DiRestore, NvMCalcRamBlockCrc=false, NvMRomBlockDataAddress=NULL_PTR
        NvMTargetBlockReference
          NvMFeeRef: NvMNameOfFeeBlock=FeeRte_NvmBlock_CmnMfgSrv_DiRestore
      Rte_NvmBlock_CmnMfgSrv_EpsSysSerlNr: NvMBlockJobPriority=127, NvMBlockManagementType=NVM_BLOCK_NATIVE, NvMBlockUseCrc=true, NvMBlockWriteProt=false, NvMBswMBlockStatusInformation=false, NvMNvBlockLength=20, NvMNvBlockNum=1, NvMNvramBlockIdentifier=46, NvMUseServicePorts=true, NvMUseJobendCallback=false, NvMUseInitCallback=false, NvMBlockCrcType=NVM_CRC16, NvMSelectBlockForReadAll=true, NvMSelectBlockForWriteAll=false, NvMRomBlockDataAddress=NULL_PTR, NvMRamBlockDataAddress=Rte_CmnMfgSrv_EpsSysSerlNr
        NvMTargetBlockReference
          NvMFeeRef: NvMNameOfFeeBlock=FeeRte_NvmBlock_CmnMfgSrv_EpsSysSerlNr
      Rte_NvmBlock_CmnMfgSrv_IgnCntr: NvMBlockJobPriority=127, NvMBlockManagementType=NVM_BLOCK_NATIVE, NvMBlockUseCrc=true, NvMBlockWriteProt=false, NvMBswMBlockStatusInformation=false, NvMNvBlockLength=4, NvMNvBlockNum=1, NvMNvramBlockIdentifier=45, NvMUseServicePorts=true, NvMUseJobendCallback=false, NvMUseInitCallback=false, NvMBlockCrcType=NVM_CRC16, NvMSelectBlockForReadAll=true, NvMSelectBlockForWriteAll=true, NvMRamBlockDataAddress=Rte_CmnMfgSrv_IgnCntr, NvMRomBlockDataAddress=Rte_CalprmRom_CmnMfgSrv_DEFAULT_RTE_CDATA_GROUP.NvmIgnCntr_DefaultValue, NvMCalcRamBlockCrc=false
        NvMTargetBlockReference
          NvMFeeRef: NvMNameOfFeeBlock=FeeRte_NvmBlock_CmnMfgSrv_IgnCntr
      Rte_NvmBlock_CmnMfgSrv_NxtrMfgEnaCntr: NvMBlockJobPriority=127, NvMBlockManagementType=NVM_BLOCK_NATIVE, NvMBlockUseCrc=true, NvMBlockWriteProt=false, NvMBswMBlockStatusInformation=false, NvMNvBlockLength=1, NvMNvBlockNum=1, NvMNvramBlockIdentifier=44, NvMUseServicePorts=true, NvMUseJobendCallback=false, NvMUseInitCallback=false, NvMBlockCrcType=NVM_CRC16, NvMSelectBlockForReadAll=true, NvMSelectBlockForWriteAll=true, NvMRamBlockDataAddress=Rte_CmnMfgSrv_NxtrMfgEnaCntr, NvMRomBlockDataAddress=Rte_CalprmRom_CmnMfgSrv_DEFAULT_RTE_CDATA_GROUP.NvmMfgEnaCntr_DefaultValue
        NvMTargetBlockReference
          NvMFeeRef: NvMNameOfFeeBlock=FeeRte_NvmBlock_CmnMfgSrv_NxtrMfgEnaCntr
      Rte_NvmBlock_CmnMfgSrv_MfgTmpBuf0: NvMBlockJobPriority=127, NvMBlockManagementType=NVM_BLOCK_NATIVE, NvMBlockUseCrc=true, NvMBlockWriteProt=false, NvMBswMBlockStatusInformation=false, NvMNvBlockLength=16, NvMNvBlockNum=1, NvMNvramBlockIdentifier=43, NvMUseServicePorts=true, NvMUseJobendCallback=false, NvMUseInitCallback=false, NvMBlockCrcType=NVM_CRC16, NvMSelectBlockForReadAll=true, NvMSelectBlockForWriteAll=true, NvMRamBlockDataAddress=Rte_CmnMfgSrv_MfgTmpBuf0, NvMRomBlockDataAddress=NULL_PTR
        NvMTargetBlockReference
          NvMFeeRef: NvMNameOfFeeBlock=FeeRte_NvmBlock_CmnMfgSrv_MfgTmpBuf0
      Rte_NvmBlock_CmnMfgSrv_MfgTmpBuf1: NvMBlockJobPriority=127, NvMBlockManagementType=NVM_BLOCK_NATIVE, NvMBlockUseCrc=true, NvMBlockWriteProt=false, NvMBswMBlockStatusInformation=false, NvMNvBlockLength=16, NvMNvBlockNum=1, NvMNvramBlockIdentifier=42, NvMUseServicePorts=true, NvMUseJobendCallback=false, NvMUseInitCallback=false, NvMBlockCrcType=NVM_CRC16, NvMSelectBlockForReadAll=true, NvMSelectBlockForWriteAll=true, NvMRamBlockDataAddress=Rte_CmnMfgSrv_MfgTmpBuf1, NvMRomBlockDataAddress=NULL_PTR
        NvMTargetBlockReference
          NvMFeeRef: NvMNameOfFeeBlock=FeeRte_NvmBlock_CmnMfgSrv_MfgTmpBuf1
      Rte_NvmBlock_CmnMfgSrv_MfgTmpBuf2: NvMBlockJobPriority=127, NvMBlockManagementType=NVM_BLOCK_NATIVE, NvMBlockUseCrc=true, NvMBlockWriteProt=false, NvMBswMBlockStatusInformation=false, NvMNvBlockLength=16, NvMNvBlockNum=1, NvMNvramBlockIdentifier=41, NvMUseServicePorts=true, NvMUseJobendCallback=false, NvMUseInitCallback=false, NvMBlockCrcType=NVM_CRC16, NvMSelectBlockForReadAll=true, NvMSelectBlockForWriteAll=true, NvMRamBlockDataAddress=Rte_CmnMfgSrv_MfgTmpBuf2, NvMRomBlockDataAddress=NULL_PTR
        NvMTargetBlockReference
          NvMFeeRef: NvMNameOfFeeBlock=FeeRte_NvmBlock_CmnMfgSrv_MfgTmpBuf2
      Rte_NvmBlock_CmnMfgSrv_MfgTmpBuf3: NvMBlockJobPriority=127, NvMBlockManagementType=NVM_BLOCK_NATIVE, NvMBlockUseCrc=true, NvMBlockWriteProt=false, NvMBswMBlockStatusInformation=false, NvMNvBlockLength=16, NvMNvBlockNum=1, NvMNvramBlockIdentifier=40, NvMUseServicePorts=true, NvMUseJobendCallback=false, NvMUseInitCallback=false, NvMBlockCrcType=NVM_CRC16, NvMRamBlockDataAddress=Rte_CmnMfgSrv_MfgTmpBuf3, NvMSelectBlockForReadAll=true, NvMSelectBlockForWriteAll=true, NvMRomBlockDataAddress=NULL_PTR
        NvMTargetBlockReference
          NvMFeeRef: NvMNameOfFeeBlock=FeeRte_NvmBlock_CmnMfgSrv_MfgTmpBuf3
      Rte_NvmBlock_CmnMfgSrv_MfgTmpBuf4: NvMBlockJobPriority=127, NvMBlockManagementType=NVM_BLOCK_NATIVE, NvMBlockUseCrc=true, NvMBlockWriteProt=false, NvMBswMBlockStatusInformation=false, NvMNvBlockLength=16, NvMNvBlockNum=1, NvMNvramBlockIdentifier=39, NvMUseServicePorts=true, NvMUseJobendCallback=false, NvMUseInitCallback=false, NvMBlockCrcType=NVM_CRC16, NvMSelectBlockForReadAll=true, NvMSelectBlockForWriteAll=true, NvMRamBlockDataAddress=Rte_CmnMfgSrv_MfgTmpBuf4, NvMRomBlockDataAddress=NULL_PTR
        NvMTargetBlockReference
          NvMFeeRef: NvMNameOfFeeBlock=FeeRte_NvmBlock_CmnMfgSrv_MfgTmpBuf4
      Rte_NvmBlock_CmnMfgSrv_SeedKey: NvMBlockJobPriority=127, NvMBlockManagementType=NVM_BLOCK_NATIVE, NvMBlockUseCrc=true, NvMBlockWriteProt=false, NvMBswMBlockStatusInformation=false, NvMNvBlockLength=8, NvMNvBlockNum=1, NvMNvramBlockIdentifier=38, NvMUseServicePorts=true, NvMUseJobendCallback=false, NvMUseInitCallback=false, NvMBlockCrcType=NVM_CRC16, NvMSelectBlockForReadAll=true, NvMSelectBlockForWriteAll=true, NvMRamBlockDataAddress=Rte_CmnMfgSrv_SeedKey, NvMRomBlockDataAddress=Rte_CalprmRom_CmnMfgSrv_DEFAULT_RTE_CDATA_GROUP.SeedKeyDft
        NvMTargetBlockReference
          NvMFeeRef: NvMNameOfFeeBlock=FeeRte_NvmBlock_CmnMfgSrv_SeedKey
      Rte_NvmBlock_PolarityCfg_PolarityCfgSaved: NvMBlockJobPriority=127, NvMBlockManagementType=NVM_BLOCK_REDUNDANT, NvMBlockUseCrc=true, NvMBlockWriteProt=false, NvMBswMBlockStatusInformation=false, NvMNvBlockLength=4, NvMNvBlockNum=2, NvMNvramBlockIdentifier=37, NvMUseServicePorts=true, NvMUseJobendCallback=false, NvMUseInitCallback=false, NvMBlockCrcType=NVM_CRC16, NvMSelectBlockForReadAll=true, NvMSelectBlockForWriteAll=true, NvMRamBlockDataAddress=Rte_PolarityCfg_PolarityCfgSaved, NvMRomBlockDataAddress=Rte_CalprmRom_PolarityCfg_DEFAULT_RTE_CDATA_GROUP.PolarityCfgSavedDft
        NvMTargetBlockReference
          NvMFeeRef: NvMNameOfFeeBlock=FeeRte_NvmBlock_PolarityCfg_PolarityCfgSaved
      Rte_NvmBlock_CDD_MotAgCmp_MotAgCmpMotAgBackEmf: NvMBlockJobPriority=127, NvMBlockManagementType=NVM_BLOCK_REDUNDANT, NvMBlockUseCrc=true, NvMBlockWriteProt=false, NvMBswMBlockStatusInformation=false, NvMNvBlockLength=2, NvMNvBlockNum=2, NvMNvramBlockIdentifier=36, NvMUseServicePorts=true, NvMUseJobendCallback=false, NvMUseInitCallback=false, NvMBlockCrcType=NVM_CRC16, NvMSelectBlockForReadAll=true, NvMSelectBlockForWriteAll=true, NvMRamBlockDataAddress=Rte_CDD_MotAgCmp_MotAgCmpMotAgBackEmf, NvMRomBlockDataAddress=Rte_CalprmRom_CDD_MotAgCmp_DEFAULT_RTE_CDATA_GROUP.MotAgCmpMotAgBackEmfDft
        NvMTargetBlockReference
          NvMFeeRef: NvMNameOfFeeBlock=FeeRte_NvmBlock_CDD_MotAgCmp_MotAgCmpMotAgBackEmf
      Rte_NvmBlock_CDD_HwTq4Meas_HwTq4Offs_MirrorBlock: NvMBlockJobPriority=127, NvMBlockManagementType=NVM_BLOCK_REDUNDANT, NvMBlockUseCrc=true, NvMBlockWriteProt=false, NvMBswMBlockStatusInformation=false, NvMNvBlockLength=8, NvMNvBlockNum=2, NvMNvramBlockIdentifier=35, NvMUseServicePorts=true, NvMUseJobendCallback=false, NvMUseInitCallback=false, NvMBlockCrcType=NVM_CRC16, NvMSelectBlockForReadAll=true, NvMSelectBlockForWriteAll=true, NvMReadRamBlockFromNvCallback=NULL_PTR, NvMWriteRamBlockToNvCallback=NULL_PTR, NvMSingleBlockCallback=NULL_PTR, NvMRamBlockDataAddress=Rte_CDD_HwTq4Meas_HwTq4Offs, NvMRomBlockDataAddress=NULL_PTR
        NvMTargetBlockReference
          NvMFeeRef: NvMNameOfFeeBlock=FeeRte_NvmBlock_CDD_HwTq4Meas_HwTq4Offs_MirrorBlock
      Rte_NvmBlock_CDD_HwTq5Meas_HwTq5Offs_MirrorBlock: NvMBlockJobPriority=127, NvMBlockManagementType=NVM_BLOCK_REDUNDANT, NvMBlockUseCrc=true, NvMBlockWriteProt=false, NvMBswMBlockStatusInformation=false, NvMNvBlockLength=8, NvMNvBlockNum=2, NvMNvramBlockIdentifier=34, NvMUseServicePorts=true, NvMUseJobendCallback=false, NvMUseInitCallback=false, NvMBlockCrcType=NVM_CRC16, NvMSelectBlockForReadAll=true, NvMSelectBlockForWriteAll=true, NvMReadRamBlockFromNvCallback=NULL_PTR, NvMWriteRamBlockToNvCallback=NULL_PTR, NvMSingleBlockCallback=NULL_PTR, NvMRamBlockDataAddress=Rte_CDD_HwTq5Meas_HwTq5Offs, NvMRomBlockDataAddress=NULL_PTR
        NvMTargetBlockReference
          NvMFeeRef: NvMNameOfFeeBlock=FeeRte_NvmBlock_CDD_HwTq5Meas_HwTq5Offs_MirrorBlock
      Rte_NvmBlock_CDD_HwTq4Meas_HwTq4Sca_MirrorBlock: NvMBlockJobPriority=127, NvMBlockManagementType=NVM_BLOCK_REDUNDANT, NvMBlockUseCrc=true, NvMBlockWriteProt=false, NvMBswMBlockStatusInformation=false, NvMNvBlockLength=8, NvMNvBlockNum=2, NvMNvramBlockIdentifier=33, NvMUseServicePorts=true, NvMUseJobendCallback=false, NvMUseInitCallback=false, NvMBlockCrcType=NVM_CRC16, NvMSelectBlockForReadAll=true, NvMSelectBlockForWriteAll=true, NvMReadRamBlockFromNvCallback=NULL_PTR, NvMWriteRamBlockToNvCallback=NULL_PTR, NvMSingleBlockCallback=NULL_PTR, NvMRamBlockDataAddress=Rte_CDD_HwTq4Meas_HwTq4Sca, NvMRomBlockDataAddress=NULL_PTR
        NvMTargetBlockReference
          NvMFeeRef: NvMNameOfFeeBlock=FeeRte_NvmBlock_CDD_HwTq4Meas_HwTq4Sca_MirrorBlock
      Rte_NvmBlock_CDD_HwTq5Meas_HwTq5Sca_MirrorBlock: NvMBlockJobPriority=127, NvMBlockManagementType=NVM_BLOCK_REDUNDANT, NvMBlockUseCrc=true, NvMBlockWriteProt=false, NvMBswMBlockStatusInformation=false, NvMNvBlockLength=8, NvMNvBlockNum=2, NvMNvramBlockIdentifier=32, NvMUseServicePorts=true, NvMUseJobendCallback=false, NvMUseInitCallback=false, NvMBlockCrcType=NVM_CRC16, NvMSelectBlockForReadAll=true, NvMSelectBlockForWriteAll=true, NvMReadRamBlockFromNvCallback=NULL_PTR, NvMWriteRamBlockToNvCallback=NULL_PTR, NvMSingleBlockCallback=NULL_PTR, NvMRamBlockDataAddress=Rte_CDD_HwTq5Meas_HwTq5Sca, NvMRomBlockDataAddress=NULL_PTR
        NvMTargetBlockReference
          NvMFeeRef: NvMNameOfFeeBlock=FeeRte_NvmBlock_CDD_HwTq5Meas_HwTq5Sca_MirrorBlock
      Rte_NvmBlock_HwTqCorrln_HwTqChACmnModCmpLpFilSt: NvMBlockJobPriority=127, NvMBlockManagementType=NVM_BLOCK_NATIVE, NvMBlockUseCrc=true, NvMBlockWriteProt=false, NvMBswMBlockStatusInformation=false, NvMNvBlockLength=4, NvMNvBlockNum=1, NvMNvramBlockIdentifier=31, NvMUseServicePorts=true, NvMUseJobendCallback=false, NvMUseInitCallback=false, NvMBlockCrcType=NVM_CRC16, NvMSelectBlockForReadAll=true, NvMSelectBlockForWriteAll=true, NvMReadRamBlockFromNvCallback=NULL_PTR, NvMWriteRamBlockToNvCallback=NULL_PTR, NvMSingleBlockCallback=NULL_PTR, NvMRamBlockDataAddress=Rte_HwTqCorrln_HwTqChACmnModCmpLpFilSt, NvMRomBlockDataAddress=Rte_CalprmRom_HwTqCorrln_DEFAULT_RTE_CDATA_GROUP.HwTqChACmnModCmpLpFilStDft
        NvMTargetBlockReference
          NvMFeeRef: NvMNameOfFeeBlock=FeeRte_NvmBlock_HwTqCorrln_HwTqChACmnModCmpLpFilSt
      Rte_NvmBlock_DutyCycThermProtn_FilStVal: NvMBlockJobPriority=127, NvMBlockManagementType=NVM_BLOCK_NATIVE, NvMBlockUseCrc=true, NvMBlockWriteProt=false, NvMBswMBlockStatusInformation=false, NvMNvBlockLength=4, NvMNvBlockNum=1, NvMNvramBlockIdentifier=30, NvMUseServicePorts=true, NvMUseJobendCallback=false, NvMUseInitCallback=false, NvMBlockCrcType=NVM_CRC16, NvMSelectBlockForReadAll=true, NvMSelectBlockForWriteAll=true, NvMRamBlockDataAddress=Rte_DutyCycThermProtn_FilStVal, NvMRomBlockDataAddress=NULL_PTR
        NvMTargetBlockReference
          NvMFeeRef: NvMNameOfFeeBlock=FeeRte_NvmBlock_DutyCycThermProtn_FilStVal
      Rte_NvmBlock_MotTqCmdSca_MotTqScaFac: NvMBlockJobPriority=127, NvMBlockManagementType=NVM_BLOCK_REDUNDANT, NvMBlockUseCrc=true, NvMBlockWriteProt=false, NvMBswMBlockStatusInformation=false, NvMNvBlockLength=4, NvMNvBlockNum=2, NvMNvramBlockIdentifier=29, NvMUseServicePorts=true, NvMUseJobendCallback=false, NvMUseInitCallback=false, NvMBlockCrcType=NVM_CRC16, NvMSelectBlockForReadAll=true, NvMSelectBlockForWriteAll=true, NvMRamBlockDataAddress=Rte_MotTqCmdSca_MotTqScaFac, NvMRomBlockDataAddress=NULL_PTR
        NvMTargetBlockReference
          NvMFeeRef: NvMNameOfFeeBlock=FeeRte_NvmBlock_MotTqCmdSca_MotTqScaFac
      Rte_NvmBlock_MotCtrlPrmEstimn_MotPrmNom: NvMBlockJobPriority=127, NvMBlockManagementType=NVM_BLOCK_REDUNDANT, NvMBlockUseCrc=true, NvMBlockWriteProt=false, NvMBswMBlockStatusInformation=false, NvMNvBlockLength=8, NvMNvBlockNum=2, NvMNvramBlockIdentifier=28, NvMUseServicePorts=true, NvMUseJobendCallback=false, NvMUseInitCallback=false, NvMSelectBlockForReadAll=true, NvMSelectBlockForWriteAll=true, NvMBlockCrcType=NVM_CRC16, NvMRamBlockDataAddress=Rte_MotCtrlPrmEstimn_MotPrmNom
        NvMTargetBlockReference
          NvMFeeRef: NvMNameOfFeeBlock=FeeRte_NvmBlock_MotCtrlPrmEstimn_MotPrmNom
      Rte_NvmBlock_Vin: NvMBlockJobPriority=127, NvMBlockManagementType=NVM_BLOCK_NATIVE, NvMBlockUseCrc=true, NvMBlockWriteProt=false, NvMBswMBlockStatusInformation=false, NvMNvBlockLength=8, NvMNvBlockNum=1, NvMNvramBlockIdentifier=27, NvMUseServicePorts=true, NvMUseJobendCallback=true, NvMUseInitCallback=false, NvMBlockCrcType=NVM_CRC16, NvMRomBlockDataAddress=&Vin_NVStateDefault
        NvMTargetBlockReference
          NvMFeeRef: NvMNameOfFeeBlock=FeeRte_NvmBlock_Vin
      Rte_NvmBlock_Omc: NvMBlockJobPriority=127, NvMBlockManagementType=NVM_BLOCK_NATIVE, NvMBlockUseCrc=false, NvMBlockWriteProt=false, NvMBswMBlockStatusInformation=false, NvMNvBlockLength=2, NvMNvBlockNum=1, NvMNvramBlockIdentifier=26, NvMUseServicePorts=true, NvMUseJobendCallback=true, NvMUseInitCallback=false, NvMRamBlockDataAddress=&Omc_NvData, NvMRomBlockDataAddress=&Omc_DefaultNvData, NvMSelectBlockForReadAll=true
        NvMTargetBlockReference
          NvMFeeRef: NvMNameOfFeeBlock=FeeRte_NvmBlock_Omc
      NVM_BLOCK_BOOT_PROG_COUNTER: NvMBlockJobPriority=0, NvMBlockManagementType=NVM_BLOCK_NATIVE, NvMBlockUseCrc=false, NvMBlockWriteProt=true, NvMBswMBlockStatusInformation=false, NvMNvBlockLength=8, NvMNvBlockNum=1, NvMNvramBlockIdentifier=25, NvMUseServicePorts=true, NvMUseJobendCallback=true, NvMUseInitCallback=true, NvMSelectBlockForWriteAll=false, NvMSelectBlockForReadAll=false, NvMRamBlockDataAddress=
        NvMTargetBlockReference
          NvMFeeRef: NvMNameOfFeeBlock=Fee_NVM_BLOCK_BOOT_PROG_COUNTER
      NVM_BLOCK_BOOT_PROG_DATA: NvMBlockJobPriority=0, NvMBlockManagementType=NVM_BLOCK_NATIVE, NvMBlockUseCrc=false, NvMBlockWriteProt=true, NvMBswMBlockStatusInformation=false, NvMNvBlockLength=48, NvMNvBlockNum=1, NvMNvramBlockIdentifier=24, NvMUseServicePorts=true, NvMUseJobendCallback=true, NvMUseInitCallback=true, NvMSelectBlockForWriteAll=false, NvMSelectBlockForReadAll=true, NvMRamBlockDataAddress=&Dlog_ProgData
        NvMTargetBlockReference
          NvMFeeRef: NvMNameOfFeeBlock=Fee_NVM_BLOCK_BOOT_PROG_DATA
      NVM_BLOCK_BOOT_SVK_HISTORY: NvMBlockJobPriority=0, NvMBlockManagementType=NVM_BLOCK_NATIVE, NvMBlockUseCrc=false, NvMBlockWriteProt=true, NvMBswMBlockStatusInformation=false, NvMNvBlockLength=12, NvMNvBlockNum=1, NvMNvramBlockIdentifier=23, NvMUseServicePorts=true, NvMUseJobendCallback=true, NvMUseInitCallback=true, NvMSelectBlockForWriteAll=false, NvMSelectBlockForReadAll=false, NvMRamBlockDataAddress=Dlog_SvkHistory
        NvMTargetBlockReference
          NvMFeeRef: NvMNameOfFeeBlock=Fee_NVM_BLOCK_BOOT_SVK_HISTORY
      NVM_BLOCK_DLOG_SVK_SYS_SUPP: NvMBlockJobPriority=0, NvMBlockManagementType=NVM_BLOCK_NATIVE, NvMBlockUseCrc=false, NvMBlockWriteProt=true, NvMBswMBlockStatusInformation=false, NvMNvBlockLength=57, NvMNvBlockNum=1, NvMNvramBlockIdentifier=22, NvMUseServicePorts=true, NvMUseJobendCallback=false, NvMUseInitCallback=false, NvMSelectBlockForReadAll=false, NvMSelectBlockForWriteAll=false
        NvMTargetBlockReference
          NvMFeeRef: NvMNameOfFeeBlock=Fee_NVM_BLOCK_DLOG_SVK_SYS_SUPP
      NVM_BLOCK_DLOG_SVK_PLANT: NvMBlockJobPriority=0, NvMBlockManagementType=NVM_BLOCK_NATIVE, NvMBlockUseCrc=false, NvMBlockWriteProt=true, NvMBswMBlockStatusInformation=false, NvMNvBlockLength=57, NvMNvBlockNum=1, NvMNvramBlockIdentifier=21, NvMUseServicePorts=true, NvMUseJobendCallback=false, NvMUseInitCallback=false, NvMSelectBlockForReadAll=false, NvMSelectBlockForWriteAll=false
        NvMTargetBlockReference
          NvMFeeRef: NvMNameOfFeeBlock=Fee_NVM_BLOCK_DLOG_SVK_PLANT
      Rte_NvmBlock_Darh_ErrorQueue: NvMBlockJobPriority=127, NvMBlockManagementType=NVM_BLOCK_NATIVE, NvMBlockUseCrc=true, NvMBlockWriteProt=false, NvMBswMBlockStatusInformation=false, NvMNvBlockLength=28, NvMNvBlockNum=1, NvMNvramBlockIdentifier=20, NvMUseServicePorts=true, NvMUseJobendCallback=false, NvMUseInitCallback=false, NvMSelectBlockForReadAll=true, NvMSelectBlockForWriteAll=true, NvMRamBlockDataAddress=&Darh_ErrorQueue, NvMRomBlockDataAddress=, NvMBlockCrcType=NVM_CRC16
        NvMTargetBlockReference
          NvMFeeRef: NvMNameOfFeeBlock=FeeRte_NvmBlock_Darh_ErrorQueue
      Rte_NvmBlock_SysFricLrng_FricNonLrngData: NvMBlockJobPriority=127, NvMBlockManagementType=NVM_BLOCK_NATIVE, NvMBlockUseCrc=true, NvMBlockWriteProt=false, NvMBswMBlockStatusInformation=false, NvMNvBlockLength=8, NvMNvBlockNum=1, NvMNvramBlockIdentifier=18, NvMUseServicePorts=false, NvMUseJobendCallback=false, NvMUseInitCallback=false, NvMBlockCrcType=NVM_CRC16, NvMSelectBlockForReadAll=true, NvMSelectBlockForWriteAll=true, NvMReadRamBlockFromNvCallback=NULL_PTR, NvMWriteRamBlockToNvCallback=NULL_PTR, NvMSingleBlockCallback=NULL_PTR, NvMRamBlockDataAddress=Rte_SysFricLrng_FricNonLrngData, NvMRomBlockDataAddress=Rte_CalprmRom_SysFricLrng_DEFAULT_RTE_CDATA_GROUP.FricNonLrngDataDft
        NvMTargetBlockReference
          NvMFeeRef: NvMNameOfFeeBlock=FeeRte_NvmBlock_SysFricLrng_FricNonLrngData
      Rte_NvmBlock_SysFricLrng_FricLrngData: NvMBlockJobPriority=127, NvMBlockManagementType=NVM_BLOCK_NATIVE, NvMBlockUseCrc=true, NvMBlockWriteProt=false, NvMBswMBlockStatusInformation=false, NvMNvBlockLength=216, NvMNvBlockNum=1, NvMNvramBlockIdentifier=19, NvMUseServicePorts=false, NvMUseJobendCallback=false, NvMUseInitCallback=false, NvMBlockCrcType=NVM_CRC16, NvMSelectBlockForReadAll=true, NvMSelectBlockForWriteAll=true, NvMReadRamBlockFromNvCallback=NULL_PTR, NvMWriteRamBlockToNvCallback=NULL_PTR, NvMSingleBlockCallback=NULL_PTR, NvMRamBlockDataAddress=Rte_SysFricLrng_FricLrngData, NvMRomBlockDataAddress=Rte_CalprmRom_SysFricLrng_DEFAULT_RTE_CDATA_GROUP.FricLrngDataDft
        NvMTargetBlockReference
          NvMFeeRef: NvMNameOfFeeBlock=FeeRte_NvmBlock_SysFricLrng_FricLrngData
      Rte_NvmBlock_CDD_VrfyCritReg_MCalReadVrfyCritRegFltInfo: NvMBlockJobPriority=127, NvMBlockManagementType=NVM_BLOCK_NATIVE, NvMBlockUseCrc=true, NvMBlockWriteProt=false, NvMBswMBlockStatusInformation=false, NvMNvBlockLength=4, NvMNvBlockNum=1, NvMNvramBlockIdentifier=17, NvMUseServicePorts=true, NvMUseJobendCallback=false, NvMUseInitCallback=false, NvMBlockCrcType=NVM_CRC16, NvMSelectBlockForReadAll=true, NvMSelectBlockForWriteAll=true, NvMRamBlockDataAddress=Rte_CDD_VrfyCritReg_MCalReadVrfyCritRegFltNvmInfo, NvMBlockLengthCheck=true, NvMBlockLengthCheckType=true, NvMAutomaticBlockLength=false, NvMRomBlockDataAddress=NULL_PTR
        NvMTargetBlockReference
          NvMFeeRef: NvMNameOfFeeBlock=FeeRte_NvmBlock_CDD_VrfyCritReg_MCalReadVrfyCritRegFltInfo
      Rte_NvmBlock_BmwHwAgArbnAndEotPosn_BmwVehCentrOffs: NvMBlockJobPriority=127, NvMBlockManagementType=NVM_BLOCK_REDUNDANT, NvMBlockUseCrc=true, NvMBlockWriteProt=false, NvMBswMBlockStatusInformation=false, NvMNvBlockLength=20, NvMNvBlockNum=2, NvMNvramBlockIdentifier=16, NvMUseServicePorts=true, NvMUseJobendCallback=false, NvMUseInitCallback=false, NvMBlockCrcType=NVM_CRC16, NvMSelectBlockForReadAll=true, NvMSelectBlockForWriteAll=true, NvMRamBlockDataAddress=Rte_BmwHwAgArbnAndEotPosn_BmwVehCentrOffs, NvMRomBlockDataAddress=NULL_PTR
        NvMTargetBlockReference
          NvMFeeRef: NvMNameOfFeeBlock=FeeRte_NvmBlock_BmwHwAgArbnAndEotPosn_BmwVehCentrOffs
      Rte_NvmBlock_LrndRackCentr_LrndRackCentr: NvMBlockJobPriority=127, NvMBlockManagementType=NVM_BLOCK_REDUNDANT, NvMBlockUseCrc=true, NvMBlockWriteProt=false, NvMBswMBlockStatusInformation=false, NvMNvBlockLength=12, NvMNvBlockNum=2, NvMNvramBlockIdentifier=15, NvMUseServicePorts=true, NvMUseJobendCallback=false, NvMUseInitCallback=false, NvMBlockCrcType=NVM_CRC16, NvMRamBlockDataAddress=Rte_LrndRackCentr_LrndRackCentr, NvMSelectBlockForReadAll=true, NvMSelectBlockForWriteAll=true, NvMRomBlockDataAddress=NULL_PTR
        NvMTargetBlockReference
          NvMFeeRef: NvMNameOfFeeBlock=FeeRte_NvmBlock_LrndRackCentr_LrndRackCentr
      Rte_NvmBlock_ExcpnHndlg_McuDiagcData: NvMBlockJobPriority=127, NvMBlockManagementType=NVM_BLOCK_NATIVE, NvMBlockUseCrc=true, NvMBlockWriteProt=false, NvMBswMBlockStatusInformation=false, NvMNvBlockLength=16, NvMNvBlockNum=1, NvMNvramBlockIdentifier=14, NvMUseServicePorts=true, NvMUseJobendCallback=false, NvMUseInitCallback=false, NvMBlockCrcType=NVM_CRC16, NvMSelectBlockForReadAll=true, NvMSelectBlockForWriteAll=true, NvMRamBlockDataAddress=Rte_CDD_ExcpnHndlg_McuDiagcData, NvMRomBlockDataAddress=Rte_CalprmRom_CDD_ExcpnHndlg_DEFAULT_RTE_CDATA_GROUP.McuDiagcDataDft
        NvMTargetBlockReference
          NvMFeeRef: NvMNameOfFeeBlock=FeeRte_NvmBlock_ExcpnHndlg_McuDiagcData
      Rte_NvmBlock_TEstimn_TFilStVal: NvMBlockJobPriority=127, NvMBlockManagementType=NVM_BLOCK_NATIVE, NvMBlockUseCrc=true, NvMBlockWriteProt=false, NvMBswMBlockStatusInformation=false, NvMNvBlockLength=32, NvMNvBlockNum=1, NvMNvramBlockIdentifier=13, NvMUseServicePorts=true, NvMUseJobendCallback=false, NvMUseInitCallback=false, NvMBlockCrcType=NVM_CRC16, NvMSelectBlockForReadAll=true, NvMSelectBlockForWriteAll=true, NvMRamBlockDataAddress=Rte_TEstimn_TFilStVal, NvMRomBlockDataAddress=NULL_PTR
        NvMTargetBlockReference
          NvMFeeRef: NvMNameOfFeeBlock=FeeRte_NvmBlock_TEstimn_TFilStVal
      NVM_BLOCK_DLOG_SVK_ENTRY: NvMBlockJobPriority=127, NvMBlockManagementType=NVM_BLOCK_DATASET, NvMBlockUseCrc=false, NvMBlockWriteProt=false, NvMBswMBlockStatusInformation=false, NvMNvBlockLength=56, NvMNvBlockNum=2, NvMNvramBlockIdentifier=12, NvMUseServicePorts=true, NvMUseJobendCallback=true, NvMUseInitCallback=false, NvMBlockCrcType=NVM_CRC16, NvMSelectBlockForReadAll=false, NvMSelectBlockForWriteAll=false
        NvMTargetBlockReference
          NvMFeeRef: NvMNameOfFeeBlock=Fee_NVM_BLOCK_DLOG_SVK_ENTRY
      Rte_NvmBlock_Darh_DiagnoseMasterEnable: NvMBlockJobPriority=127, NvMBlockManagementType=NVM_BLOCK_NATIVE, NvMBlockUseCrc=false, NvMBlockWriteProt=false, NvMBswMBlockStatusInformation=false, NvMNvBlockLength=1, NvMNvBlockNum=1, NvMNvramBlockIdentifier=11, NvMUseServicePorts=true, NvMUseJobendCallback=true, NvMUseInitCallback=false, NvMSelectBlockForReadAll=true, NvMSelectBlockForWriteAll=false, NvMRamBlockDataAddress=Darh_DiagnoseMasterEnable
        NvMTargetBlockReference
          NvMFeeRef: NvMNameOfFeeBlock=FeeRte_NvmBlock_Darh_DiagnoseMasterEnable
      Rte_NvmBlock_Coding_CodingData: NvMBlockJobPriority=127, NvMBlockManagementType=NVM_BLOCK_NATIVE, NvMBlockUseCrc=true, NvMBlockWriteProt=false, NvMBswMBlockStatusInformation=true, NvMNvBlockLength=160, NvMNvBlockNum=1, NvMNvramBlockIdentifier=10, NvMUseServicePorts=true, NvMUseJobendCallback=true, NvMUseInitCallback=false, NvMBlockCrcType=NVM_CRC16, NvMSelectBlockForReadAll=true, NvMSelectBlockForWriteAll=false, NvMRamBlockDataAddress=Coding_CodingData, NvMRomBlockDataAddress=Coding_CodingDataDefault, NvMCalcRamBlockCrc=false, NvMSingleBlockCallback=Coding_NvMNotifyJobFinishedCodingData
        NvMTargetBlockReference
          NvMFeeRef: NvMNameOfFeeBlock=FeeRte_NvmBlock_Coding_CodingData
      Rte_NvmBlock_BmwTunSetHndlr_BmwDesIninIdx: NvMBlockJobPriority=127, NvMBlockManagementType=NVM_BLOCK_NATIVE, NvMBlockUseCrc=true, NvMBlockWriteProt=false, NvMBswMBlockStatusInformation=false, NvMNvBlockLength=2, NvMNvBlockNum=1, NvMNvramBlockIdentifier=9, NvMUseServicePorts=true, NvMUseJobendCallback=false, NvMUseInitCallback=false, NvMBlockCrcType=NVM_CRC16, NvMSelectBlockForReadAll=true, NvMSelectBlockForWriteAll=true, NvMRamBlockDataAddress=Rte_BmwTunSetHndlr_BmwDesIninIdx, NvMRomBlockDataAddress=Rte_CalprmRom_BmwTunSetHndlr_DEFAULT_RTE_CDATA_GROUP.BmwDesIninIdxDft
        NvMTargetBlockReference
          NvMFeeRef: NvMNameOfFeeBlock=FeeRte_NvmBlock_BmwTunSetHndlr_BmwDesIninIdx
      Rte_NvmBlock_BmwTunSetHndlr_NvmBmwDesIninOptSetAIdx: NvMBlockJobPriority=127, NvMBlockManagementType=NVM_BLOCK_NATIVE, NvMBlockUseCrc=true, NvMBlockWriteProt=false, NvMBswMBlockStatusInformation=false, NvMNvBlockLength=2, NvMNvBlockNum=1, NvMNvramBlockIdentifier=8, NvMUseServicePorts=true, NvMUseJobendCallback=false, NvMUseInitCallback=false, NvMSelectBlockForReadAll=true, NvMSelectBlockForWriteAll=true, NvMRamBlockDataAddress=Rte_BmwTunSetHndlr_BmwDesIninOptSetAIdx, NvMRomBlockDataAddress=Rte_CalprmRom_BmwTunSetHndlr_DEFAULT_RTE_CDATA_GROUP.BmwDesIninOptSetAIdxDft, NvMBlockCrcType=NVM_CRC16
        NvMTargetBlockReference
          NvMFeeRef: NvMNameOfFeeBlock=FeeRte_NvmBlock_BmwTunSetHndlr_NvmBmwDesIninOptSetAIdx
      Rte_NvmBlock_BmwDiagcSrvHndlg_MilesKmEeprom: NvMBlockJobPriority=127, NvMBlockManagementType=NVM_BLOCK_NATIVE, NvMBlockUseCrc=true, NvMBlockWriteProt=false, NvMBswMBlockStatusInformation=false, NvMNvBlockLength=4, NvMNvBlockNum=1, NvMNvramBlockIdentifier=7, NvMUseServicePorts=true, NvMUseJobendCallback=false, NvMUseInitCallback=false, NvMSelectBlockForReadAll=true, NvMSelectBlockForWriteAll=true, NvMRamBlockDataAddress=Rte_BmwDiagcSrvHndlg_MilesKmEeprom, NvMRomBlockDataAddress=NULL_PTR, NvMBlockCrcType=NVM_CRC16
        NvMTargetBlockReference
          NvMFeeRef: NvMNameOfFeeBlock=FeeRte_NvmBlock_BmwDiagcSrvHndlg_MilesKmEeprom
      Rte_NvmBlock_BmwDiagcSrvHndlg_ProgCntr: NvMBlockJobPriority=127, NvMBlockManagementType=NVM_BLOCK_NATIVE, NvMBlockUseCrc=true, NvMBlockWriteProt=false, NvMBswMBlockStatusInformation=false, NvMNvBlockLength=2, NvMNvBlockNum=1, NvMNvramBlockIdentifier=6, NvMUseServicePorts=true, NvMUseJobendCallback=false, NvMUseInitCallback=false, NvMSelectBlockForReadAll=true, NvMSelectBlockForWriteAll=false, NvMRamBlockDataAddress=Rte_BmwDiagcSrvHndlg_ProgCntr, NvMRomBlockDataAddress=NULL_PTR, NvMBlockCrcType=NVM_CRC16
        NvMTargetBlockReference
          NvMFeeRef: NvMNameOfFeeBlock=FeeRte_NvmBlock_BmwDiagcSrvHndlg_ProgCntr
      Rte_NvmBlock_BmwDiagcSrvHndlg_ProgCntrMaxVal: NvMBlockJobPriority=127, NvMBlockManagementType=NVM_BLOCK_NATIVE, NvMBlockUseCrc=true, NvMBlockWriteProt=false, NvMBswMBlockStatusInformation=false, NvMNvBlockLength=2, NvMNvBlockNum=1, NvMNvramBlockIdentifier=5, NvMUseServicePorts=true, NvMUseJobendCallback=false, NvMUseInitCallback=false, NvMSelectBlockForReadAll=true, NvMSelectBlockForWriteAll=true, NvMRamBlockDataAddress=Rte_BmwDiagcSrvHndlg_ProgCntrMaxVal, NvMRomBlockDataAddress=Rte_CalprmRom_BmwDiagcSrvHndlg_DEFAULT_RTE_CDATA_GROUP.ProgCntrMaxValDft, NvMBlockCrcType=NVM_CRC16
        NvMTargetBlockReference
          NvMFeeRef: NvMNameOfFeeBlock=FeeRte_NvmBlock_BmwDiagcSrvHndlg_ProgCntrMaxVal
      Rte_NvmBlock_BmwDiagcSrvHndlg_TestStamp: NvMBlockJobPriority=127, NvMBlockManagementType=NVM_BLOCK_NATIVE, NvMBlockUseCrc=true, NvMBlockWriteProt=false, NvMBswMBlockStatusInformation=false, NvMNvBlockLength=3, NvMNvBlockNum=1, NvMNvramBlockIdentifier=4, NvMUseServicePorts=true, NvMUseJobendCallback=false, NvMUseInitCallback=false, NvMSelectBlockForReadAll=true, NvMSelectBlockForWriteAll=true, NvMRamBlockDataAddress=Rte_BmwDiagcSrvHndlg_TestStamp, NvMRomBlockDataAddress=NULL_PTR, NvMBlockCrcType=NVM_CRC16
        NvMTargetBlockReference
          NvMFeeRef: NvMNameOfFeeBlock=FeeRte_NvmBlock_BmwDiagcSrvHndlg_TestStamp
      Rte_NvmBlock_PullCmpActv_PullCmpLongTerm: NvMBlockJobPriority=127, NvMBlockManagementType=NVM_BLOCK_NATIVE, NvMBlockUseCrc=true, NvMBlockWriteProt=false, NvMBswMBlockStatusInformation=false, NvMNvBlockLength=4, NvMNvBlockNum=1, NvMNvramBlockIdentifier=3, NvMUseServicePorts=true, NvMUseJobendCallback=false, NvMUseInitCallback=false, NvMBlockCrcType=NVM_CRC16, NvMSelectBlockForReadAll=true, NvMSelectBlockForWriteAll=true, NvMRamBlockDataAddress=Rte_PullCmpActv_PullCmpLongTerm, NvMCalcRamBlockCrc=false, NvMAutomaticBlockLength=true, NvMBlockLengthCheck=true, NvMBlockLengthCheckType=true, NvMBlockUseSetRamBlockStatus=true, NvMRomBlockDataAddress=Rte_CalprmRom_PullCmpActv_DEFAULT_RTE_CDATA_GROUP.PullCmpLongTermDft
        NvMTargetBlockReference
          NvMFeeRef: NvMNameOfFeeBlock=FeeBlockDescriptor
