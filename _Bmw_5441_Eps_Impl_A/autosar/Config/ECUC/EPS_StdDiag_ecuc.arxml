AUTOSAR XML (schema 4-3-0)
package /BMW_CONF
  module config StdDiag: implementation-config-variant=VARIANT-PRE-COMPILE
    StdDiagGeneral: StdDiagUserActiveSessionState=true, StdDiagDevErrorDetect=false, StdDiagUserEstablishIntrinsicSafety=false
    CommonPublishedInformation: SwMajorVersion=5, SwMinorVersion=3, SwPatchVersion=0
