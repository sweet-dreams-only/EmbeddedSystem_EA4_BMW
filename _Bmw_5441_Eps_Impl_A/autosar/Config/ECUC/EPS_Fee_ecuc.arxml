AUTOSAR XML (schema 4-3-0)
package /ActiveEcuC
  module config Fee: implementation-config-variant=VARIANT-PRE-COMPILE, module-description=Fee_Impl
    FeeGeneral:
      FeeSafeBswChecks = true
      FeeDevErrorDetect = true
      FeeIndex = 0
      FeeNvmJobEndNotification = NULL_PTR
      FeeNvmJobErrorNotification = NULL_PTR
      FeePollingMode = true
      FeeSetModeSupported = true
      FeeVersionInfoApi = false
      FeeVirtualPageSize = 8
      FeeMainFunctionPeriod = 0.01
      FeeMainFunctionTriggering = FixedCycleTime
      FeeCorrectSingleBitFlips = false
      FeeFlsApi:
        FeeFlsIncludeFile = Fls.h
        FeeFlsSetMode = Fls_SetMode
        FeeFlsRead = Fls_Read
        FeeFlsWrite = Fls_Write
        FeeFlsCancel = Fls_Cancel
        FeeFlsGetStatus = Fls_GetStatus
        FeeFlsGetJobResult = Fls_GetJobResult
        FeeFlsErase = Fls_Erase
        FeeFlsCompare = Fls_Compare
        FeeFlsBlankCheck = Fls_BlankCheck
        FeeFlsDeviceIndex = FlsGeneral
    FeePublishedInformation: FeeBlockOverhead=2, FeeMaximumBlockingTime=1, FeePageOverhead=0
    FEE0 (FeePartitionConfiguration):
      FeePartitionStartAddress = 0
      FeePartitionSize = 32768
      FeePartitionAddressAlignment = 64
      FeePartitionWriteAlignment = 4
      FeePartitionReadAlignment = 1
      FeeFlsBlankCheckApi = true
      FeePartitionDevice = FlsConfigSet
    FEE1 (FeePartitionConfiguration):
      FeePartitionStartAddress = 32768
      FeePartitionSize = 32768
      FeePartitionAddressAlignment = 64
      FeePartitionWriteAlignment = 4
      FeePartitionReadAlignment = 1
      FeeFlsBlankCheckApi = true
      FeePartitionDevice = FlsConfigSet
    107 x FeeBlockConfiguration, all with FeeNumberOfWriteCycles=10000, FeeNumberOfInstances=1, FeeVerifyWrittenData=false, FeeDeviceIndex=FlsGeneral, FeePartition=FEE0:
      FeeBlockConfiguration: FeeBlockNumber=2, FeeBlockSize=4, FeeImmediateData=false, FeeNumberOfDatasets=2, FeeBlockId=0
      FeeDemAdminDataBlock: FeeBlockNumber=4, FeeBlockSize=1, FeeImmediateData=false, FeeNumberOfDatasets=1, FeeBlockId=2
      FeeDemStatusDataBlock: FeeBlockNumber=6, FeeBlockSize=1, FeeImmediateData=false, FeeNumberOfDatasets=1, FeeBlockId=1
      FeeDemPrimaryDataBlock0: FeeBlockNumber=8, FeeBlockSize=1, FeeImmediateData=false, FeeNumberOfDatasets=1, FeeBlockId=3
      FeeDemPrimaryDataBlock1: FeeBlockNumber=10, FeeBlockSize=1, FeeImmediateData=false, FeeNumberOfDatasets=1, FeeBlockId=5
      FeeDemPrimaryDataBlock2: FeeBlockNumber=12, FeeBlockSize=1, FeeImmediateData=false, FeeNumberOfDatasets=1, FeeBlockId=7
      FeeDemPrimaryDataBlock3: FeeBlockNumber=14, FeeBlockSize=1, FeeImmediateData=false, FeeNumberOfDatasets=1, FeeBlockId=9
      FeeDemPrimaryDataBlock4: FeeBlockNumber=16, FeeBlockSize=1, FeeImmediateData=false, FeeNumberOfDatasets=1, FeeBlockId=11
      FeeDemPrimaryDataBlock5: FeeBlockNumber=18, FeeBlockSize=1, FeeImmediateData=false, FeeNumberOfDatasets=1, FeeBlockId=13
      FeeDemPrimaryDataBlock6: FeeBlockNumber=20, FeeBlockSize=1, FeeImmediateData=false, FeeNumberOfDatasets=1, FeeBlockId=15
      FeeDemPrimaryDataBlock7: FeeBlockNumber=22, FeeBlockSize=1, FeeImmediateData=false, FeeNumberOfDatasets=1, FeeBlockId=17
      FeeDemSecondaryDataBlock0: FeeBlockNumber=24, FeeBlockSize=1, FeeImmediateData=false, FeeNumberOfDatasets=1, FeeBlockId=19
      FeeDemSecondaryDataBlock1: FeeBlockNumber=26, FeeBlockSize=1, FeeImmediateData=false, FeeNumberOfDatasets=1, FeeBlockId=21
      FeeDemSecondaryDataBlock2: FeeBlockNumber=28, FeeBlockSize=1, FeeImmediateData=false, FeeNumberOfDatasets=1, FeeBlockId=23
      FeeDemSecondaryDataBlock3: FeeBlockNumber=30, FeeBlockSize=1, FeeImmediateData=false, FeeNumberOfDatasets=1, FeeBlockId=25
      FeeDemSecondaryDataBlock5: FeeBlockNumber=32, FeeBlockSize=1, FeeImmediateData=false, FeeNumberOfDatasets=1, FeeBlockId=27
      FeeDemSecondaryDataBlock6: FeeBlockNumber=34, FeeBlockSize=1, FeeImmediateData=false, FeeNumberOfDatasets=1, FeeBlockId=29
      FeeDemSecondaryDataBlock7: FeeBlockNumber=36, FeeBlockSize=1, FeeImmediateData=false, FeeNumberOfDatasets=1, FeeBlockId=31
      FeeDemSecondaryDataBlock8: FeeBlockNumber=38, FeeBlockSize=1, FeeImmediateData=false, FeeNumberOfDatasets=1, FeeBlockId=33
      FeeDemSecondaryDataBlock9: FeeBlockNumber=40, FeeBlockSize=1, FeeImmediateData=false, FeeNumberOfDatasets=1, FeeBlockId=35
      FeeDemSecondaryDataBlock10: FeeBlockNumber=42, FeeBlockSize=1, FeeImmediateData=false, FeeNumberOfDatasets=1, FeeBlockId=37
      FeeDemSecondaryDataBlock11: FeeBlockNumber=44, FeeBlockSize=1, FeeImmediateData=false, FeeNumberOfDatasets=1, FeeBlockId=39
      FeeDemSecondaryDataBlock12: FeeBlockNumber=46, FeeBlockSize=1, FeeImmediateData=false, FeeNumberOfDatasets=1, FeeBlockId=41
      FeeDemSecondaryDataBlock13: FeeBlockNumber=48, FeeBlockSize=1, FeeImmediateData=false, FeeNumberOfDatasets=1, FeeBlockId=43
      FeeDemSecondaryDataBlock14: FeeBlockNumber=50, FeeBlockSize=1, FeeImmediateData=false, FeeNumberOfDatasets=1, FeeBlockId=45
      FeeDemSecondaryDataBlock15: FeeBlockNumber=52, FeeBlockSize=1, FeeImmediateData=false, FeeNumberOfDatasets=1, FeeBlockId=47
      FeeDemSecondaryDataBlock16: FeeBlockNumber=54, FeeBlockSize=1, FeeImmediateData=false, FeeNumberOfDatasets=1, FeeBlockId=49
      FeeDemSecondaryDataBlock17: FeeBlockNumber=56, FeeBlockSize=1, FeeImmediateData=false, FeeNumberOfDatasets=1, FeeBlockId=51
      FeeDemSecondaryDataBlock18: FeeBlockNumber=58, FeeBlockSize=1, FeeImmediateData=false, FeeNumberOfDatasets=1, FeeBlockId=53
      FeeDemSecondaryDataBlock19: FeeBlockNumber=60, FeeBlockSize=1, FeeImmediateData=false, FeeNumberOfDatasets=1, FeeBlockId=55
      FeeDemSecondaryDataBlock20: FeeBlockNumber=62, FeeBlockSize=1, FeeImmediateData=false, FeeNumberOfDatasets=1, FeeBlockId=57
      FeeDemSecondaryDataBlock21: FeeBlockNumber=64, FeeBlockSize=1, FeeImmediateData=false, FeeNumberOfDatasets=1, FeeBlockId=58
      FeeDemSecondaryDataBlock22: FeeBlockNumber=66, FeeBlockSize=1, FeeImmediateData=false, FeeNumberOfDatasets=1, FeeBlockId=60
      FeeDemSecondaryDataBlock23: FeeBlockNumber=68, FeeBlockSize=1, FeeImmediateData=false, FeeNumberOfDatasets=1, FeeBlockId=62
      FeeDemSecondaryDataBlock24: FeeBlockNumber=70, FeeBlockSize=1, FeeImmediateData=false, FeeNumberOfDatasets=1, FeeBlockId=64
      FeeDemSecondaryDataBlock25: FeeBlockNumber=72, FeeBlockSize=1, FeeImmediateData=false, FeeNumberOfDatasets=1, FeeBlockId=66
      FeeDemSecondaryDataBlock26: FeeBlockNumber=74, FeeBlockSize=1, FeeImmediateData=false, FeeNumberOfDatasets=1, FeeBlockId=68
      FeeDemSecondaryDataBlock27: FeeBlockNumber=76, FeeBlockSize=1, FeeImmediateData=false, FeeNumberOfDatasets=1, FeeBlockId=69
      FeeDemSecondaryDataBlock28: FeeBlockNumber=78, FeeBlockSize=1, FeeImmediateData=false, FeeNumberOfDatasets=1, FeeBlockId=70
      FeeDemSecondaryDataBlock29: FeeBlockNumber=80, FeeBlockSize=1, FeeImmediateData=false, FeeNumberOfDatasets=1, FeeBlockId=71
      FeeDemSecondaryDataBlock30: FeeBlockNumber=82, FeeBlockSize=1, FeeImmediateData=false, FeeNumberOfDatasets=1, FeeBlockId=73
      FeeDemSecondaryDataBlock31: FeeBlockNumber=84, FeeBlockSize=1, FeeImmediateData=false, FeeNumberOfDatasets=1, FeeBlockId=75
      FeeDemSecondaryDataBlock32: FeeBlockNumber=86, FeeBlockSize=1, FeeImmediateData=false, FeeNumberOfDatasets=1, FeeBlockId=77
      FeeDemSecondaryDataBlock33: FeeBlockNumber=88, FeeBlockSize=1, FeeImmediateData=false, FeeNumberOfDatasets=1, FeeBlockId=79
      FeeDemSecondaryDataBlock34: FeeBlockNumber=90, FeeBlockSize=1, FeeImmediateData=false, FeeNumberOfDatasets=1, FeeBlockId=81
      FeeDemSecondaryDataBlock35: FeeBlockNumber=92, FeeBlockSize=1, FeeImmediateData=false, FeeNumberOfDatasets=1, FeeBlockId=82
      FeeDemSecondaryDataBlock36: FeeBlockNumber=94, FeeBlockSize=1, FeeImmediateData=false, FeeNumberOfDatasets=1, FeeBlockId=83
      FeeDemSecondaryDataBlock37: FeeBlockNumber=96, FeeBlockSize=1, FeeImmediateData=false, FeeNumberOfDatasets=1, FeeBlockId=84
      FeeDemSecondaryDataBlock38: FeeBlockNumber=98, FeeBlockSize=1, FeeImmediateData=false, FeeNumberOfDatasets=1, FeeBlockId=85
      FeeDemSecondaryDataBlock39: FeeBlockNumber=100, FeeBlockSize=1, FeeImmediateData=false, FeeNumberOfDatasets=1, FeeBlockId=86
      FeeDemSecondaryDataBlock4: FeeBlockNumber=102, FeeBlockSize=1, FeeImmediateData=false, FeeNumberOfDatasets=1, FeeBlockId=87
      FeeRte_NvmBlock_CDD_NvMProxy_ShtdwnClsChk: FeeBlockNumber=104, FeeBlockSize=6, FeeImmediateData=false, FeeNumberOfDatasets=1, FeeBlockId=88
      FeeRte_NvmBlock_DiagcMgr_DiagcMgrNtcFltAry: FeeBlockNumber=106, FeeBlockSize=82, FeeImmediateData=false, FeeNumberOfDatasets=1, FeeBlockId=89
      FeeRte_NvmBlock_DiagcMgr_DiagcMgrLtchCntrAry: FeeBlockNumber=108, FeeBlockSize=22, FeeImmediateData=false, FeeNumberOfDatasets=1, FeeBlockId=90
      FeeRte_NvmBlock_DiagcMgr_DiagcMgrApplCrc: FeeBlockNumber=110, FeeBlockSize=6, FeeImmediateData=false, FeeNumberOfDatasets=1, FeeBlockId=91
      FeeRte_NvmBlock_CDD_MotAg0Meas_MotAg0CoeffTbl: FeeBlockNumber=112, FeeBlockSize=106, FeeImmediateData=false, FeeNumberOfDatasets=2, FeeBlockId=4
      FeeRte_NvmBlock_CDD_MotAg1Meas_MotAg1CoeffTbl: FeeBlockNumber=114, FeeBlockSize=106, FeeImmediateData=false, FeeNumberOfDatasets=2, FeeBlockId=6
      FeeRte_NvmBlock_CDD_CurrMeas_CurrMeasEolGainCalSetABC: FeeBlockNumber=116, FeeBlockSize=14, FeeImmediateData=false, FeeNumberOfDatasets=2, FeeBlockId=8
      FeeRte_NvmBlock_CDD_CurrMeas_CurrMeasEolOffsCalSetABC: FeeBlockNumber=118, FeeBlockSize=30, FeeImmediateData=false, FeeNumberOfDatasets=2, FeeBlockId=10
      Fee_NVM_BLOCK_DCM_ROE: FeeBlockNumber=120, FeeBlockSize=4, FeeImmediateData=false, FeeNumberOfDatasets=1, FeeBlockId=12
      FeeRte_NvmBlock_CmnMfgSrv_CcaHwPartNr: FeeBlockNumber=122, FeeBlockSize=22, FeeImmediateData=false, FeeNumberOfDatasets=1, FeeBlockId=14
      FeeRte_NvmBlock_CmnMfgSrv_CcaSerlNr: FeeBlockNumber=124, FeeBlockSize=22, FeeImmediateData=false, FeeNumberOfDatasets=1, FeeBlockId=16
      FeeRte_NvmBlock_CmnMfgSrv_DiRestore: FeeBlockNumber=126, FeeBlockSize=10, FeeImmediateData=false, FeeNumberOfDatasets=1, FeeBlockId=18
      FeeRte_NvmBlock_CmnMfgSrv_EpsSysSerlNr: FeeBlockNumber=128, FeeBlockSize=22, FeeImmediateData=false, FeeNumberOfDatasets=1, FeeBlockId=20
      FeeRte_NvmBlock_CmnMfgSrv_IgnCntr: FeeBlockNumber=130, FeeBlockSize=6, FeeImmediateData=false, FeeNumberOfDatasets=1, FeeBlockId=92
      FeeRte_NvmBlock_CmnMfgSrv_NxtrMfgEnaCntr: FeeBlockNumber=132, FeeBlockSize=3, FeeImmediateData=false, FeeNumberOfDatasets=1, FeeBlockId=22
      FeeRte_NvmBlock_CmnMfgSrv_MfgTmpBuf0: FeeBlockNumber=134, FeeBlockSize=18, FeeImmediateData=false, FeeNumberOfDatasets=1, FeeBlockId=24
      FeeRte_NvmBlock_CmnMfgSrv_MfgTmpBuf1: FeeBlockNumber=136, FeeBlockSize=18, FeeImmediateData=false, FeeNumberOfDatasets=1, FeeBlockId=26
      FeeRte_NvmBlock_CmnMfgSrv_MfgTmpBuf2: FeeBlockNumber=138, FeeBlockSize=18, FeeImmediateData=false, FeeNumberOfDatasets=1, FeeBlockId=28
      FeeRte_NvmBlock_CmnMfgSrv_MfgTmpBuf3: FeeBlockNumber=140, FeeBlockSize=18, FeeImmediateData=false, FeeNumberOfDatasets=1, FeeBlockId=30
      FeeRte_NvmBlock_CmnMfgSrv_MfgTmpBuf4: FeeBlockNumber=142, FeeBlockSize=18, FeeImmediateData=false, FeeNumberOfDatasets=1, FeeBlockId=32
      FeeRte_NvmBlock_CmnMfgSrv_SeedKey: FeeBlockNumber=144, FeeBlockSize=10, FeeImmediateData=false, FeeNumberOfDatasets=1, FeeBlockId=34
      FeeRte_NvmBlock_PolarityCfg_PolarityCfgSaved: FeeBlockNumber=146, FeeBlockSize=6, FeeImmediateData=false, FeeNumberOfDatasets=2, FeeBlockId=36
      FeeRte_NvmBlock_CDD_MotAgCmp_MotAgCmpMotAgBackEmf: FeeBlockNumber=148, FeeBlockSize=4, FeeImmediateData=false, FeeNumberOfDatasets=2, FeeBlockId=38
      FeeRte_NvmBlock_CDD_HwTq4Meas_HwTq4Offs_MirrorBlock: FeeBlockNumber=150, FeeBlockSize=10, FeeImmediateData=false, FeeNumberOfDatasets=2, FeeBlockId=40
      FeeRte_NvmBlock_CDD_HwTq5Meas_HwTq5Offs_MirrorBlock: FeeBlockNumber=152, FeeBlockSize=10, FeeImmediateData=false, FeeNumberOfDatasets=2, FeeBlockId=42
      FeeRte_NvmBlock_CDD_HwTq4Meas_HwTq4Sca_MirrorBlock: FeeBlockNumber=154, FeeBlockSize=10, FeeImmediateData=false, FeeNumberOfDatasets=2, FeeBlockId=44
      FeeRte_NvmBlock_CDD_HwTq5Meas_HwTq5Sca_MirrorBlock: FeeBlockNumber=156, FeeBlockSize=10, FeeImmediateData=false, FeeNumberOfDatasets=2, FeeBlockId=46
      FeeRte_NvmBlock_HwTqCorrln_HwTqChACmnModCmpLpFilSt: FeeBlockNumber=158, FeeBlockSize=6, FeeImmediateData=false, FeeNumberOfDatasets=1, FeeBlockId=48
      FeeRte_NvmBlock_DutyCycThermProtn_FilStVal: FeeBlockNumber=160, FeeBlockSize=6, FeeImmediateData=false, FeeNumberOfDatasets=1, FeeBlockId=93
      FeeRte_NvmBlock_MotTqCmdSca_MotTqScaFac: FeeBlockNumber=162, FeeBlockSize=6, FeeImmediateData=false, FeeNumberOfDatasets=2, FeeBlockId=50
      FeeRte_NvmBlock_MotCtrlPrmEstimn_MotPrmNom: FeeBlockNumber=164, FeeBlockSize=10, FeeImmediateData=false, FeeNumberOfDatasets=2, FeeBlockId=52
      FeeRte_NvmBlock_Vin: FeeBlockNumber=166, FeeBlockSize=10, FeeImmediateData=false, FeeNumberOfDatasets=1, FeeBlockId=54
      FeeRte_NvmBlock_Omc: FeeBlockNumber=168, FeeBlockSize=2, FeeImmediateData=false, FeeNumberOfDatasets=1, FeeBlockId=56
      Fee_NVM_BLOCK_BOOT_PROG_COUNTER: FeeBlockNumber=170, FeeBlockSize=8, FeeImmediateData=true, FeeNumberOfDatasets=1, FeeBlockId=59
      Fee_NVM_BLOCK_BOOT_PROG_DATA: FeeBlockNumber=172, FeeBlockSize=48, FeeImmediateData=true, FeeNumberOfDatasets=1, FeeBlockId=61
      Fee_NVM_BLOCK_BOOT_SVK_HISTORY: FeeBlockNumber=174, FeeBlockSize=12, FeeImmediateData=true, FeeNumberOfDatasets=1, FeeBlockId=63
      Fee_NVM_BLOCK_DLOG_SVK_SYS_SUPP: FeeBlockNumber=176, FeeBlockSize=57, FeeImmediateData=true, FeeNumberOfDatasets=1, FeeBlockId=65
      Fee_NVM_BLOCK_DLOG_SVK_PLANT: FeeBlockNumber=178, FeeBlockSize=57, FeeImmediateData=true, FeeNumberOfDatasets=1, FeeBlockId=67
      FeeRte_NvmBlock_Darh_ErrorQueue: FeeBlockNumber=180, FeeBlockSize=30, FeeImmediateData=false, FeeNumberOfDatasets=1, FeeBlockId=72
      FeeRte_NvmBlock_SysFricLrng_FricNonLrngData: FeeBlockNumber=182, FeeBlockSize=10, FeeImmediateData=false, FeeNumberOfDatasets=1, FeeBlockId=74
      FeeRte_NvmBlock_SysFricLrng_FricLrngData: FeeBlockNumber=184, FeeBlockSize=218, FeeImmediateData=false, FeeNumberOfDatasets=1, FeeBlockId=76
      FeeRte_NvmBlock_CDD_VrfyCritReg_MCalReadVrfyCritRegFltInfo: FeeBlockNumber=186, FeeBlockSize=6, FeeImmediateData=false, FeeNumberOfDatasets=1, FeeBlockId=94
      FeeRte_NvmBlock_BmwHwAgArbnAndEotPosn_BmwVehCentrOffs: FeeBlockNumber=188, FeeBlockSize=22, FeeImmediateData=false, FeeNumberOfDatasets=2, FeeBlockId=78
      FeeRte_NvmBlock_LrndRackCentr_LrndRackCentr: FeeBlockNumber=190, FeeBlockSize=14, FeeImmediateData=false, FeeNumberOfDatasets=2, FeeBlockId=80
      FeeRte_NvmBlock_ExcpnHndlg_McuDiagcData: FeeBlockNumber=192, FeeBlockSize=18, FeeImmediateData=false, FeeNumberOfDatasets=1, FeeBlockId=95
      FeeRte_NvmBlock_TEstimn_TFilStVal: FeeBlockNumber=194, FeeBlockSize=34, FeeImmediateData=false, FeeNumberOfDatasets=1, FeeBlockId=96
      Fee_NVM_BLOCK_DLOG_SVK_ENTRY: FeeBlockNumber=196, FeeBlockSize=56, FeeImmediateData=false, FeeNumberOfDatasets=2, FeeBlockId=97
      FeeRte_NvmBlock_Darh_DiagnoseMasterEnable: FeeBlockNumber=198, FeeBlockSize=1, FeeImmediateData=false, FeeNumberOfDatasets=1, FeeBlockId=98
      FeeRte_NvmBlock_Coding_CodingData: FeeBlockNumber=200, FeeBlockSize=162, FeeImmediateData=false, FeeNumberOfDatasets=1, FeeBlockId=99
      FeeRte_NvmBlock_BmwTunSetHndlr_BmwDesIninIdx: FeeBlockNumber=202, FeeBlockSize=4, FeeImmediateData=false, FeeNumberOfDatasets=1, FeeBlockId=100
      FeeRte_NvmBlock_BmwTunSetHndlr_NvmBmwDesIninOptSetAIdx: FeeBlockNumber=204, FeeBlockSize=4, FeeImmediateData=false, FeeNumberOfDatasets=1, FeeBlockId=101
      FeeRte_NvmBlock_BmwDiagcSrvHndlg_MilesKmEeprom: FeeBlockNumber=206, FeeBlockSize=6, FeeImmediateData=false, FeeNumberOfDatasets=1, FeeBlockId=102
      FeeRte_NvmBlock_BmwDiagcSrvHndlg_ProgCntr: FeeBlockNumber=208, FeeBlockSize=4, FeeImmediateData=false, FeeNumberOfDatasets=1, FeeBlockId=103
      FeeRte_NvmBlock_BmwDiagcSrvHndlg_ProgCntrMaxVal: FeeBlockNumber=210, FeeBlockSize=4, FeeImmediateData=false, FeeNumberOfDatasets=1, FeeBlockId=104
      FeeRte_NvmBlock_BmwDiagcSrvHndlg_TestStamp: FeeBlockNumber=212, FeeBlockSize=5, FeeImmediateData=false, FeeNumberOfDatasets=1, FeeBlockId=105
      FeeBlockDescriptor: FeeBlockNumber=214, FeeBlockSize=6, FeeImmediateData=false, FeeNumberOfDatasets=1, FeeBlockId=106
