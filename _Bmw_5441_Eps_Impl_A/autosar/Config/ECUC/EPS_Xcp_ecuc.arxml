AUTOSAR XML (schema 4-3-0)
package /ActiveEcuC
  module config Xcp: implementation-config-variant=VARIANT-PRE-COMPILE, module-description=Xcp_Impl
    XcpGeneral:
      XcpOnFlexRayEnabled = true
      XcpDevErrorDetect = true
      XcpMainFunctionPeriod = 0.005
      XcpMaxEventChannel = 255
      XcpOnCanEnabled = false
      XcpOnCddEnabled = false
      XcpOnEthernetEnabled = false
      XcpPrescalerSupported = true
      XcpVersionInfoApi = false
      XcpBootloaderDownload = false
      XcpControl = true
      XcpMultiClientSupport = false
      XcpRuntimeMeasurementSupport = false
      XcpSafeBswChecks = true
      XcpSessionStatusAPI = false
      XcpTypeSafeCopy = false
      XcpDAQMemAccessByApplication = false
      XcpTimestampType = TWO_BYTE
      XcpTimestampUnit = TIMESTAMP_UNIT_1US
      XcpUserConfigFile = ./Config/Xcp/NxtrXcp.cfg
      XcpTimestampTicks = 1
      XcpIdentificationFieldType = ABSOLUTE
      XcpA2L: XcpTimeoutT1=2000, XcpTimeoutT2=10000, XcpTimeoutT3=2000, XcpTimeoutT4=2000, XcpTimeoutT5=2000, XcpTimeoutT6=2000, XcpTimeoutT7=0
    XcpConfig
      XcpTransportLayer
        XcpOnFr:
          XcpOnFrMaxCto = 28
          XcpOnFrMaxDto = 12
          XcpOnFrConfirmationTimeout = 8
          XcpOnFrReadCCConfig = false
          XcpOnFrReadCCConfigExtAddr = 253
          XcpOnFrNodeAddress = 48
          XcpOnFrFrameAlignment = Align32Bit
          XcpOnFrSequenceCounter = true
          XcpOnFrFrameConcatenation = true
          XcpOnFrMaxPDU = 254
          XcpOnFrTransmissionMode = Decoupled
          XcpOnFrOptimizedCopy = false
      11 x XcpPdu:
        xcpdynamic254_8_19255f18
          xcpdynamic254_8_19255f18 (XcpTxPdu):
            XcpTxPduId = 0
            XcpOnFrTxPduType = Variable
            XcpOnFrPduIsRuntimeConfigurable = true
            XcpTxPduRef = pduTrig_xcpdynamic254_8_pduPort_EPS_A_FlexRay_OUT_55c86d41_4f391dd1
        xcpdynamic254_5_19255f18
          xcpdynamic254_5_19255f18 (XcpTxPdu):
            XcpTxPduId = 1
            XcpOnFrTxPduType = Variable
            XcpOnFrPduIsRuntimeConfigurable = true
            XcpTxPduRef = pduTrig_xcpdynamic254_5_pduPort_EPS_A_FlexRay_OUT_55c86d41_4f391dd1
        xcpdynamic254_2_19255f18
          xcpdynamic254_2_19255f18 (XcpTxPdu):
            XcpTxPduId = 2
            XcpOnFrTxPduType = Variable
            XcpOnFrPduIsRuntimeConfigurable = true
            XcpTxPduRef = pduTrig_xcpdynamic254_2_pduPort_EPS_A_FlexRay_OUT_55c86d41_4f391dd1
        xcpdynamic254_3_19255f18
          xcpdynamic254_3_19255f18 (XcpTxPdu):
            XcpTxPduId = 3
            XcpOnFrTxPduType = Variable
            XcpOnFrPduIsRuntimeConfigurable = true
            XcpTxPduRef = pduTrig_xcpdynamic254_3_pduPort_EPS_A_FlexRay_OUT_55c86d41_4f391dd1
        dummy32bmaster_19255f18
          dummy32bmaster_19255f18 (XcpRxPdu):
            XcpRxPduId = 0
            XcpOnFrRxPduType = Cmd
            XcpOnFrPduIsRuntimeConfigurable = false
            XcpRxPduRef = pduTrig_dummy32bmaster_pduPort_EPS_A_FlexRay_IN_55c86d41_4f391dd1
        xcpdynamic254_1_19255f18
          xcpdynamic254_1_19255f18 (XcpTxPdu):
            XcpTxPduId = 4
            XcpOnFrTxPduType = Variable
            XcpOnFrPduIsRuntimeConfigurable = true
            XcpTxPduRef = pduTrig_xcpdynamic254_1_pduPort_EPS_A_FlexRay_OUT_55c86d41_4f391dd1
        xcpdynamic254_4_19255f18
          xcpdynamic254_4_19255f18 (XcpTxPdu):
            XcpTxPduId = 5
            XcpOnFrTxPduType = Variable
            XcpOnFrPduIsRuntimeConfigurable = true
            XcpTxPduRef = pduTrig_xcpdynamic254_4_pduPort_EPS_A_FlexRay_OUT_55c86d41_4f391dd1
        xcpdynamic254_7_19255f18
          xcpdynamic254_7_19255f18 (XcpTxPdu):
            XcpTxPduId = 6
            XcpOnFrTxPduType = Variable
            XcpOnFrPduIsRuntimeConfigurable = true
            XcpTxPduRef = pduTrig_xcpdynamic254_7_pduPort_EPS_A_FlexRay_OUT_55c86d41_4f391dd1
        dummy16bstatic_19255f18
          dummy16bstatic_19255f18 (XcpTxPdu):
            XcpTxPduId = 7
            XcpOnFrTxPduType = Variable
            XcpOnFrPduIsRuntimeConfigurable = true
            XcpTxPduRef = pduTrig_dummy16bstatic_pduPort_EPS_A_FlexRay_OUT_55c86d41_4f391dd1
        dummy32bslave_19255f18
          dummy32bslave_19255f18 (XcpTxPdu):
            XcpTxPduId = 8
            XcpOnFrTxPduType = ResErr
            XcpOnFrPduIsRuntimeConfigurable = false
            XcpTxPduRef = pduTrig_dummy32bslave_pduPort_EPS_A_FlexRay_OUT_55c86d41_4f391dd1
        xcpdynamic254_6_19255f18
          xcpdynamic254_6_19255f18 (XcpTxPdu):
            XcpTxPduId = 9
            XcpOnFrTxPduType = Variable
            XcpOnFrPduIsRuntimeConfigurable = true
            XcpTxPduRef = pduTrig_xcpdynamic254_6_pduPort_EPS_A_FlexRay_OUT_55c86d41_4f391dd1
      XcpEve2MilliSecDataAcqn (XcpEventChannel):
        XcpEventChannelMaxDaqList = 1
        XcpEventChannelNumber = 0
        XcpEventChannelTimeCycle = 2
        XcpEventChannelTimeUnit = TIMESTAMP_UNIT_1MS
        XcpEventChannelType = DAQ
        XcpEventChannelCoreRef = XcpCore0Definition
      XcpCore0Definition (XcpCoreDefinition): XcpSendQueueSize=256
    XcpCmdConfig: XcpOpenCommandInterface=false
      XcpStandard:
        XcpBlockUpload = false
        XcpCommunicationModeInfo = false
        XcpGetIdGeneric = false
        XcpMemoryReadProtection = false
        XcpSeedKey = false
        XcpUserDefinedCommand = true
      XcpAsynchMessage: XcpEventCodes=false, XcpServiceRequestMessage=false
      XcpPageSwitching: XcpCopyPage=true, XcpFreezeMode=false, XcpGeneralPagingInfo=true
      XcpDaqAndStim:
        XcpDAQODTMessageHeader = false
        XcpFixedTimestamp = true
        XcpGetDAQEventInfo = true
        XcpMaxNumberOfOdtDaq = 5
        XcpMaxNumberOfOdtEntries = 20
        XcpMaxNumberOfOdtStim = 3
        XcpOverrunIndication = true
        XcpResolutionInfo = true
        XcpResumeMode = false
        XcpSynchronousDataStimulation = true
        XcpWriteDAQMultiple = true
      XcpCalibration: XcpBlockDownload=false, XcpMIN_STForBlockDownload=0, XcpModifyBits=false, XcpShortDownload=false
