AUTOSAR XML (schema 4-3-0)
package /ActiveEcuC
  module config ComM: implementation-config-variant=VARIANT-PRE-COMPILE, module-description=ComM_Impl
    ComMGeneral:
      ComMPncIdCounting = COMM_PNC_ID_COUNT_FROM_NM_MESSAGE
      ComMPncSupport = false
      ComMDevErrorDetect = true
      ComMEcuGroupClassification = 3
      ComMModeLimitationEnabled = false
      ComMSynchronousWakeUp = true
      ComMTMinFullComModeDuration = 5
      ComMVersionInfoApi = false
      ComMWakeupInhibitionEnabled = false
      ComMSafeBswChecks = true
      ComMGeneration: ComMOutOfBoundsWriteSanitizer=false, ComMOutOfBoundsReadSanitizer=false
    ComMConfigSet: ComMPncEnabled=false
      USR_A_FlexRay_372befd6 (ComMUser): ComMUserIdentifier=0, ComMUserModeNotification=false  # con_EPS_FibexID_0b7e5e09c061465d913e8968ece3cded
      A_FlexRay_372befd6 (ComMChannel):  # con_EPS_FibexID_0b7e5e09c061465d913e8968ece3cded
        ComMBusType = COMM_BUS_TYPE_FR
        ComMChannelId = 0
        ComMFullCommRequestNotificationEnabled = false
        ComMMainFunctionPeriod = 0.005
        ComMNoCom = false
        ComMNoWakeup = false
        ComMNetworkManagement: ComMNmVariant=NONE, ComMPncNmRequest=false
        A_FlexRay_372befd6 (ComMUserPerChannel): ComMUserChannel=USR_A_FlexRay_372befd6  # con_EPS_FibexID_0b7e5e09c061465d913e8968ece3cded
