AUTOSAR XML (schema 4-3-0)
package /ActiveEcuC
  module config Mcu: implementation-config-variant=VARIANT-POST-BUILD, module-description=Mcu_Impl
    McuModuleConfiguration:
      McuClockSrcFailureNotification = DISABLED
      McuLviDetectionLevel = DETECTION_LEVEL_0
      McuLviResetMask = false
      McuNumberOfMcuModes = 1
      McuRamSectors = 1
      McuCvmOutMaskFbist = false
      McuCvmOutMaskDiag = false
      McuCvmOutputFilter = true
      McuCvmDiagLockBit = true
      McuCvmResetEnable = true
      McuEcmErrorSourcesCfg
        McuEcmErrorSource0_WinWdgTmr (McuEcmErrorSource0):
          McuMiNotification = NULL_PTR
          McuNmiNotification = FeNmiWdg
          McuEcmErrorMaskableInterrupt = false
          McuEcmErrorNonMaskableInterrupt = true
          McuEcmErrorInternalReset = false
          McuEcmErrorNMIDelayTimer = false
          McuEcmErrorMIDelayTimer = false
          McuEcmErrorOutputMask = false
        McuEcmErrorSource1_LockStepCompErr (McuEcmErrorSource1):
          McuMiNotification = NULL_PTR
          McuNmiNotification = NULL_PTR
          McuEcmErrorMaskableInterrupt = false
          McuEcmErrorNonMaskableInterrupt = false
          McuEcmErrorInternalReset = true
          McuEcmErrorNMIDelayTimer = false
          McuEcmErrorMIDelayTimer = false
          McuEcmErrorOutputMask = false
        McuEcmErrorSource4_ClkMonr0RtUpprLimFlt (McuEcmErrorSource4):
          McuNmiNotification = FeNmiClkMonr0RtUpprLimFlt
          McuMiNotification = NULL_PTR
          McuEcmErrorMaskableInterrupt = false
          McuEcmErrorNonMaskableInterrupt = true
          McuEcmErrorInternalReset = false
          McuEcmErrorNMIDelayTimer = false
          McuEcmErrorMIDelayTimer = false
          McuEcmErrorOutputMask = false
        McuEcmErrorSource10_ClkMonr3RtUpprLimFlt (McuEcmErrorSource10):
          McuNmiNotification = FeNmiClkMonr3RtUpprLimFlt
          McuMiNotification = NULL_PTR
          McuEcmErrorMaskableInterrupt = false
          McuEcmErrorNonMaskableInterrupt = true
          McuEcmErrorInternalReset = false
          McuEcmErrorNMIDelayTimer = false
          McuEcmErrorMIDelayTimer = false
          McuEcmErrorOutputMask = false
        McuEcmErrorSource11_ClkMonr3RtLowrLimFlt (McuEcmErrorSource11):
          McuNmiNotification = FeNmiClkMonr3RtLowrLimFlt
          McuMiNotification = NULL_PTR
          McuEcmErrorMaskableInterrupt = false
          McuEcmErrorNonMaskableInterrupt = true
          McuEcmErrorInternalReset = false
          McuEcmErrorNMIDelayTimer = false
          McuEcmErrorMIDelayTimer = false
          McuEcmErrorOutputMask = false
        McuEcmErrorSource12_RamEccDblBitErrOrAdrParFlt (McuEcmErrorSource12):
          McuNmiNotification = NULL_PTR
          McuMiNotification = NULL_PTR
          McuEcmErrorMaskableInterrupt = false
          McuEcmErrorNonMaskableInterrupt = false
          McuEcmErrorInternalReset = false
          McuEcmErrorNMIDelayTimer = false
          McuEcmErrorMIDelayTimer = false
          McuEcmErrorOutputMask = false
        McuEcmErrorSource14_ICache1BitOr2BitEccErr (McuEcmErrorSource14):
          McuNmiNotification = NULL_PTR
          McuMiNotification = NULL_PTR
          McuEcmErrorMaskableInterrupt = false
          McuEcmErrorNonMaskableInterrupt = false
          McuEcmErrorInternalReset = false
          McuEcmErrorNMIDelayTimer = false
          McuEcmErrorMIDelayTimer = false
          McuEcmErrorOutputMask = true
        McuEcmErrorSource15_CodeFlsEccDblBitErrOrAdrParFlt (McuEcmErrorSource15):
          McuNmiNotification = NULL_PTR
          McuMiNotification = NULL_PTR
          McuEcmErrorMaskableInterrupt = false
          McuEcmErrorNonMaskableInterrupt = false
          McuEcmErrorInternalReset = false
          McuEcmErrorNMIDelayTimer = false
          McuEcmErrorMIDelayTimer = false
          McuEcmErrorOutputMask = false
        McuEcmErrorSource16_DataFlsEccDblBitFlt (McuEcmErrorSource16):
          McuNmiNotification = NULL_PTR
          McuMiNotification = NULL_PTR
          McuEcmErrorMaskableInterrupt = false
          McuEcmErrorNonMaskableInterrupt = false
          McuEcmErrorInternalReset = false
          McuEcmErrorNMIDelayTimer = false
          McuEcmErrorMIDelayTimer = false
          McuEcmErrorOutputMask = true
        McuEcmErrorSource17_DTSRamEccDblBitFlt (McuEcmErrorSource17):
          McuNmiNotification = NULL_PTR
          McuMiNotification = NULL_PTR
          McuEcmErrorMaskableInterrupt = false
          McuEcmErrorNonMaskableInterrupt = false
          McuEcmErrorInternalReset = false
          McuEcmErrorNMIDelayTimer = false
          McuEcmErrorMIDelayTimer = false
          McuEcmErrorOutputMask = false
        McuEcmErrorSource18_CSIHRamEccDblBitFlt (McuEcmErrorSource18):
          McuNmiNotification = NULL_PTR
          McuMiNotification = NULL_PTR
          McuEcmErrorMaskableInterrupt = false
          McuEcmErrorNonMaskableInterrupt = false
          McuEcmErrorInternalReset = false
          McuEcmErrorNMIDelayTimer = false
          McuEcmErrorMIDelayTimer = false
          McuEcmErrorOutputMask = true
        McuEcmErrorSource19_CANRamEccDblBitFlt (McuEcmErrorSource19):
          McuNmiNotification = NULL_PTR
          McuMiNotification = NULL_PTR
          McuEcmErrorMaskableInterrupt = false
          McuEcmErrorNonMaskableInterrupt = false
          McuEcmErrorInternalReset = false
          McuEcmErrorNMIDelayTimer = false
          McuEcmErrorMIDelayTimer = false
          McuEcmErrorOutputMask = true
        McuEcmErrorSource20_FrMsgRamEccDblBitFlt (McuEcmErrorSource20):
          McuNmiNotification = NULL_PTR
          McuMiNotification = NULL_PTR
          McuEcmErrorMaskableInterrupt = false
          McuEcmErrorNonMaskableInterrupt = false
          McuEcmErrorInternalReset = false
          McuEcmErrorNMIDelayTimer = false
          McuEcmErrorMIDelayTimer = false
          McuEcmErrorOutputMask = true
        McuEcmErrorSource21_OperModErrFlsProgmModStrtd (McuEcmErrorSource21):
          McuNmiNotification = FeNmiOperModErrFlsProgmModStrtd
          McuMiNotification = NULL_PTR
          McuEcmErrorMaskableInterrupt = false
          McuEcmErrorNonMaskableInterrupt = true
          McuEcmErrorInternalReset = false
          McuEcmErrorNMIDelayTimer = false
          McuEcmErrorMIDelayTimer = false
          McuEcmErrorOutputMask = false
        McuEcmErrorSource22_OperModErrTestModStrtd (McuEcmErrorSource22):
          McuNmiNotification = FeNmiOperModErrTestModStrtd
          McuMiNotification = NULL_PTR
          McuEcmErrorMaskableInterrupt = false
          McuEcmErrorNonMaskableInterrupt = true
          McuEcmErrorInternalReset = false
          McuEcmErrorNMIDelayTimer = false
          McuEcmErrorMIDelayTimer = false
          McuEcmErrorOutputMask = false
        McuEcmErrorSource23_OperModErrSngChipInactv (McuEcmErrorSource23):
          McuNmiNotification = FeNmiOperModErrSngChipInactv
          McuMiNotification = NULL_PTR
          McuEcmErrorMaskableInterrupt = false
          McuEcmErrorNonMaskableInterrupt = true
          McuEcmErrorInternalReset = false
          McuEcmErrorNMIDelayTimer = false
          McuEcmErrorMIDelayTimer = false
          McuEcmErrorOutputMask = false
        McuEcmErrorSource24_PegRtFlt (McuEcmErrorSource24):
          McuNmiNotification = FeNmiPeg
          McuMiNotification = NULL_PTR
          McuEcmErrorMaskableInterrupt = false
          McuEcmErrorNonMaskableInterrupt = true
          McuEcmErrorInternalReset = false
          McuEcmErrorNMIDelayTimer = false
          McuEcmErrorMIDelayTimer = false
          McuEcmErrorOutputMask = false
        McuEcmErrorSource26_PBGRtFlt (McuEcmErrorSource26):
          McuNmiNotification = NULL_PTR
          McuMiNotification = NULL_PTR
          McuEcmErrorMaskableInterrupt = false
          McuEcmErrorNonMaskableInterrupt = false
          McuEcmErrorInternalReset = false
          McuEcmErrorNMIDelayTimer = false
          McuEcmErrorMIDelayTimer = false
          McuEcmErrorOutputMask = false
        McuEcmErrorSource27_ADCResParErr (McuEcmErrorSource27):
          McuNmiNotification = NULL_PTR
          McuMiNotification = NULL_PTR
          McuEcmErrorMaskableInterrupt = false
          McuEcmErrorNonMaskableInterrupt = false
          McuEcmErrorInternalReset = false
          McuEcmErrorNMIDelayTimer = false
          McuEcmErrorMIDelayTimer = false
          McuEcmErrorOutputMask = true
        McuEcmErrorSource28_PBusDataParFlt (McuEcmErrorSource28):
          McuNmiNotification = NULL_PTR
          McuMiNotification = NULL_PTR
          McuEcmErrorMaskableInterrupt = false
          McuEcmErrorNonMaskableInterrupt = false
          McuEcmErrorInternalReset = false
          McuEcmErrorNMIDelayTimer = false
          McuEcmErrorMIDelayTimer = false
          McuEcmErrorOutputMask = false
        McuEcmErrorSource29_EcmMstChkrCmp (McuEcmErrorSource29):
          McuNmiNotification = FeNmiEcmMstChkrCmp
          McuMiNotification = NULL_PTR
          McuEcmErrorMaskableInterrupt = false
          McuEcmErrorNonMaskableInterrupt = true
          McuEcmErrorInternalReset = false
          McuEcmErrorNMIDelayTimer = false
          McuEcmErrorMIDelayTimer = false
          McuEcmErrorOutputMask = false
        McuEcmErrorSource30_LowVccStrtTest (McuEcmErrorSource30):
          McuNmiNotification = NULL_PTR
          McuMiNotification = NULL_PTR
          McuEcmErrorMaskableInterrupt = false
          McuEcmErrorNonMaskableInterrupt = false
          McuEcmErrorInternalReset = false
          McuEcmErrorNMIDelayTimer = false
          McuEcmErrorMIDelayTimer = false
          McuEcmErrorOutputMask = true
        McuEcmErrorSource31_IntTSnsrRtFlt (McuEcmErrorSource31):
          McuNmiNotification = NULL_PTR
          McuMiNotification = NULL_PTR
          McuEcmErrorMaskableInterrupt = false
          McuEcmErrorNonMaskableInterrupt = false
          McuEcmErrorInternalReset = false
          McuEcmErrorNMIDelayTimer = false
          McuEcmErrorMIDelayTimer = false
          McuEcmErrorOutputMask = true
        McuEcmErrorSource32_DmaTrf (McuEcmErrorSource32):
          McuNmiNotification = FeNmiDmaTrf
          McuMiNotification = NULL_PTR
          McuEcmErrorMaskableInterrupt = false
          McuEcmErrorNonMaskableInterrupt = true
          McuEcmErrorInternalReset = false
          McuEcmErrorNMIDelayTimer = false
          McuEcmErrorMIDelayTimer = false
          McuEcmErrorOutputMask = false
        McuEcmErrorSource33_DmaRegAcsProtnErr (McuEcmErrorSource33):
          McuNmiNotification = FeNmiDmaRegAcsProtnErr
          McuMiNotification = NULL_PTR
          McuEcmErrorMaskableInterrupt = false
          McuEcmErrorNonMaskableInterrupt = true
          McuEcmErrorInternalReset = false
          McuEcmErrorNMIDelayTimer = false
          McuEcmErrorMIDelayTimer = false
          McuEcmErrorOutputMask = false
        McuEcmErrorSource34_RamMemLclRamSngBitEcc (McuEcmErrorSource34):
          McuNmiNotification = NULL_PTR
          McuMiNotification = RamMemLclRamSngBitEcc
          McuEcmErrorMaskableInterrupt = true
          McuEcmErrorNonMaskableInterrupt = false
          McuEcmErrorInternalReset = false
          McuEcmErrorNMIDelayTimer = false
          McuEcmErrorMIDelayTimer = false
          McuEcmErrorOutputMask = true
        McuEcmErrorSource36_CodFlsSngBitEcc (McuEcmErrorSource36):
          McuNmiNotification = NULL_PTR
          McuMiNotification = CodFlsSngBitEcc
          McuEcmErrorMaskableInterrupt = true
          McuEcmErrorNonMaskableInterrupt = false
          McuEcmErrorInternalReset = false
          McuEcmErrorNMIDelayTimer = false
          McuEcmErrorMIDelayTimer = false
          McuEcmErrorOutputMask = true
        McuEcmErrorSource37_DataFlsSngBitEcc (McuEcmErrorSource37):
          McuNmiNotification = NULL_PTR
          McuMiNotification = NULL_PTR
          McuEcmErrorMaskableInterrupt = false
          McuEcmErrorNonMaskableInterrupt = false
          McuEcmErrorInternalReset = false
          McuEcmErrorNMIDelayTimer = false
          McuEcmErrorMIDelayTimer = false
          McuEcmErrorOutputMask = true
        McuEcmErrorSource38_DTSRamSngBitEcc (McuEcmErrorSource38):
          McuNmiNotification = FeNmiDtsEccSngBitErr
          McuMiNotification = NULL_PTR
          McuEcmErrorMaskableInterrupt = false
          McuEcmErrorNonMaskableInterrupt = true
          McuEcmErrorInternalReset = false
          McuEcmErrorNMIDelayTimer = false
          McuEcmErrorMIDelayTimer = false
          McuEcmErrorOutputMask = false
        McuEcmErrorSource39_AllPrphlSNgBitEcc (McuEcmErrorSource39):
          McuNmiNotification = NULL_PTR
          McuMiNotification = NULL_PTR
          McuEcmErrorMaskableInterrupt = false
          McuEcmErrorNonMaskableInterrupt = false
          McuEcmErrorInternalReset = false
          McuEcmErrorNMIDelayTimer = false
          McuEcmErrorMIDelayTimer = false
          McuEcmErrorOutputMask = true
        McuEcmErrorSource40_BISTCode1BitEccFailr (McuEcmErrorSource40):
          McuNmiNotification = NULL_PTR
          McuMiNotification = NULL_PTR
          McuEcmErrorMaskableInterrupt = false
          McuEcmErrorNonMaskableInterrupt = false
          McuEcmErrorInternalReset = false
          McuEcmErrorNMIDelayTimer = false
          McuEcmErrorMIDelayTimer = false
          McuEcmErrorOutputMask = true
        McuEcmErrorSource41_BISTCode2BitEccFailr (McuEcmErrorSource41):
          McuNmiNotification = NULL_PTR
          McuMiNotification = NULL_PTR
          McuEcmErrorMaskableInterrupt = false
          McuEcmErrorNonMaskableInterrupt = false
          McuEcmErrorInternalReset = false
          McuEcmErrorNMIDelayTimer = false
          McuEcmErrorMIDelayTimer = false
          McuEcmErrorOutputMask = false
        McuEcmErrorSource42_FACIRstTrfErr (McuEcmErrorSource42):
          McuNmiNotification = NULL_PTR
          McuMiNotification = NULL_PTR
          McuEcmErrorMaskableInterrupt = false
          McuEcmErrorNonMaskableInterrupt = false
          McuEcmErrorInternalReset = false
          McuEcmErrorNMIDelayTimer = false
          McuEcmErrorMIDelayTimer = false
          McuEcmErrorOutputMask = true
        McuEcmErrorSource5_ClkMonr0RtLowrLimFlt (McuEcmErrorSource5):
          McuNmiNotification = FeNmiClkMonr0RtLowrLimFlt
          McuMiNotification = NULL_PTR
          McuEcmErrorMaskableInterrupt = false
          McuEcmErrorNonMaskableInterrupt = true
          McuEcmErrorInternalReset = false
          McuEcmErrorNMIDelayTimer = false
          McuEcmErrorMIDelayTimer = false
          McuEcmErrorOutputMask = false
        McuEcmErrorSource6_ClkMonr2RtUpprLimFlt (McuEcmErrorSource6):
          McuNmiNotification = FeNmiClkMonr2RtUpprLimFlt
          McuMiNotification = NULL_PTR
          McuEcmErrorMaskableInterrupt = false
          McuEcmErrorNonMaskableInterrupt = true
          McuEcmErrorInternalReset = false
          McuEcmErrorNMIDelayTimer = false
          McuEcmErrorMIDelayTimer = false
          McuEcmErrorOutputMask = false
        McuEcmErrorSource7_ClkMonr2RtLowrLimFlt (McuEcmErrorSource7):
          McuNmiNotification = FeNmiClkMonr2RtLowrLimFlt
          McuMiNotification = NULL_PTR
          McuEcmErrorMaskableInterrupt = false
          McuEcmErrorNonMaskableInterrupt = true
          McuEcmErrorInternalReset = false
          McuEcmErrorNMIDelayTimer = false
          McuEcmErrorMIDelayTimer = false
          McuEcmErrorOutputMask = false
        McuEcmErrorSource8_ClkMonr1RtUpprLimFlt (McuEcmErrorSource8):
          McuNmiNotification = FeNmiClkMonr1RtUpprLimFlt
          McuMiNotification = NULL_PTR
          McuEcmErrorMaskableInterrupt = false
          McuEcmErrorNonMaskableInterrupt = true
          McuEcmErrorInternalReset = false
          McuEcmErrorNMIDelayTimer = false
          McuEcmErrorMIDelayTimer = false
          McuEcmErrorOutputMask = false
        McuEcmErrorSource9_ClkMonr1RtLowrLimFlt (McuEcmErrorSource9):
          McuNmiNotification = FeNmiClkMonr1RtLowrLimFlt
          McuMiNotification = NULL_PTR
          McuEcmErrorMaskableInterrupt = false
          McuEcmErrorNonMaskableInterrupt = true
          McuEcmErrorInternalReset = false
          McuEcmErrorNMIDelayTimer = false
          McuEcmErrorMIDelayTimer = false
          McuEcmErrorOutputMask = false
        McuEcmErrorSource129: McuEcmErrorInternalReset=false, McuEcmErrorOutputMask=true
      McuClockSettingConfig: McuClockSettingId=0, McuMainOsciFrequency=16000000, McuCpuMainSysClk=160000000, McuUnitName=CLK_CPU
        McuExternalClkOutSetting:
          McuExternalClk0SourceSel = MCU_NO_OUTPUT
          McuExternalClk0DividerSel = 1
          McuExternalClock0 = 0
          McuExternalClk1SourceSel = MCU_NO_OUTPUT
          McuExternalClk1DividerSel = 1
          McuExternalClock1 = 0
        McuAdcClk: McuDivClockSel=CLK_LSB, McuUnitName=ADC, McuPeripheralClock=40000000
        McuClockReferencePoint: McuClockReferencePointFrequency=0
        McuHighspeedPeriClk0 (McuHighspeedPeriClk): McuUnitName=CLK_HSB, McuPeripheralClock=80000000
        McuLowspeedPeriClk: McuUnitName=CLK_LSB, McuPeripheralClock=40000000
        McuWdtacounterClk: McuWdtCounterDivider=DIVBY_1_ID_1, McuUnitName=WDTCLKI, McuPeripheralClock=8000000
      McuDemEventParameterRefs:
        MCU_E_CLOCK_FAILURE = MCU_E_CLOCK_FAILURE
        MCU_E_WRITE_TIMEOUT_FAILURE = MCU_E_WRITE_TIMEOUT_FAILURE
        MCU_E_CLM_SELFDIAG_FAILURE = MCU_E_CLM_SELFDIAG_FAILURE
        MCU_E_CVM_SELFDIAG_FAILURE = MCU_E_CVM_SELFDIAG_FAILURE
        MCU_E_ECM_SELFDIAG_FAILURE = MCU_E_ECM_SELFDIAG_FAILURE
        MCU_E_LOCKSTEP_SELFDIAG_FAILURE = MCU_E_LOCKSTEP_SELFDIAG_FAILURE
        MCU_E_REG_WRITE_VERIFY = MCU_E_REG_WRITE_VERIFY
        MCU_E_INT_INCONSISTENT = MCU_E_INT_INCONSISTENT
        MCU_E_RESETCONTROLLER_STARTUP_FAILURE = MCU_E_RESETCONTROLLER_STARTUP_FAILURE
      McuModeSettingConf: McuModeType=RUN_MODE, McuMode=0
      DummySection (McuRamSectorSettingConf): McuRamDefaultValue=0, McuRamSectionBaseAddress=4273991680, McuRamSectionSize=1, McuRamTypeSel=LOCAL_RAM_4273864704_4273995775
    McuGeneralConfiguration:
      McuVersionCheckExternalModules = false
      McuDevErrorDetect = true
      McuGetRamStateApi = false
      McuInitClock = true
      McuNoPll = true
      McuPerformResetApi = true
      McuVersionInfoApi = false
      McuCriticalSectionProtection = true
      McuSwResetCallApi = false
      McuEcmDelayTimerOverflowValue = 65535
      McuEcmErrorOutputMode = NON_DYNAMIC_MODE
      McuEcmErrorOutTimer = false
      McuRamSectorSetting = false
      McuDeviceName = R7F701319
      McuClm0Operation = true
      McuClm0MonitoringClockAccuracy = 6
      McuClm0SamplingClockAccuracy = 10
      McuClm1Operation = true
      McuClm1MonitoringClockAccuracy = 6
      McuClm1SamplingClockAccuracy = 6
      McuClm2Operation = true
      McuClm2MonitoringClockAccuracy = 10
      McuClm2SamplingClockAccuracy = 6
      McuClm3Operation = true
      McuClm3MonitoringClockAccuracy = 6
      McuClm3SamplingClockAccuracy = 6
      McuCvmSelfDiagnosticTest = false
      McuClma{0..3}SelfDiagnosticTest = false
      McuEcmSelfDiagnosticTest = false
      McuWriteVerify = WV_DISABLE
      McuLoopCount = 5
      McuLockStepSelfDiagnosticTest = false
      McuStartUpSWResetTest = false
      McuStartUpECMResetTest = false
      McuInterruptConsistencyCheck = false
      McuWVErrorNotification = HndlMcalWrVrfyErr
      Mcu_UseWVErrorInterface = true
    McuPublishedInformation
      McuResetReasonConf: McuResetReason=0
      McuRstRsnConfPowOnClr: McuResetReason=0
      McuRstRsnConfPinRst: McuResetReason=1
      McuRstRsnConfSwRst: McuResetReason=2
      McuRstRsnConfWdta: McuResetReason=3
      McuRstRsnConfLockStepCompare: McuResetReason=4
      McuRstRsnConfClkMonUprLimErMosc: McuResetReason=5
      McuRstRsnConfClkMonLwrLimErMosc: McuResetReason=6
      McuRstRsnConfClkMonUprLimErWdt: McuResetReason=7
      McuRstRsnConfClkMonLwrLimErWdt: McuResetReason=8
      McuRstRsnConfClkMonUprLimErPclk: McuResetReason=9
      McuRstRsnConfClkMonLwrLimErPclk: McuResetReason=10
      McuRstRsnConfClkMonUprLimErPe1: McuResetReason=11
      McuRstRsnConfClkMonLwrLimErPe1: McuResetReason=12
      McuRstRsnConfLRamEcc2AddPrty: McuResetReason=13
      McuRstRsnConfInstCacheRamEcc2: McuResetReason=14
      McuRstRsnConfCodeFlsEcc2AddPrty: McuResetReason=15
      McuRstRsnConfDataFlsEcc2: McuResetReason=16
      McuRstRsnConfDtsRamEcc2: McuResetReason=17
      McuRstRsnConfCsihRamEcc2: McuResetReason=18
      McuRstRsnConfCanRamEcc2: McuResetReason=19
      McuRstRsnConfFrRamEcc2: McuResetReason=20
      McuRstRsnConfFlsProgMode: McuResetReason=21
      McuRstRsnConfTestMode: McuResetReason=22
      McuRstRsnConfSingChipModInact: McuResetReason=23
      McuRstRsnConfPeGuard: McuResetReason=24
      McuRstRsnConfPBusGuard: McuResetReason=25
      McuRstRsnConfSarAdcPrty: McuResetReason=26
      McuRstRsnConfBusDataPrty: McuResetReason=27
      McuRstRsnConfEcmCompare: McuResetReason=28
      McuRstRsnConfLvi: McuResetReason=29
      McuRstRsnConfTempSensor: McuResetReason=30
      McuRstRsnConfDmaTrans: McuResetReason=31
      McuRstRsnConfDmaViol: McuResetReason=32
      McuRstRsnConfLRamEcc1: McuResetReason=33
      McuRstRsnConfCodeFlsEcc1: McuResetReason=34
      McuRstRsnConfDataFlsEcc1: McuResetReason=35
      McuRstRsnConfDtsRamEcc1: McuResetReason=36
      McuRstRsnConfPeriRamEcc1: McuResetReason=37
      McuRstRsnConfBistCodeEcc1: McuResetReason=38
      McuRstRsnConfBistCodeEcc2: McuResetReason=39
      McuRstRsnConfFaci: McuResetReason=40
      McuRstRsnConfEcmDelayOverFlow: McuResetReason=41
      McuRstRsnConfCvmRst: McuResetReason=42
      McuRstRsnConfRstUndefined: McuResetReason=43
      McuRstRsnConfRstUnknown: McuResetReason=44
