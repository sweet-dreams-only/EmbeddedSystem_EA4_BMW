AUTOSAR XML (schema 4-3-0)
package /ActiveEcuC
  module config Dem: implementation-config-variant=VARIANT-PRE-COMPILE, module-description=Dem_Impl
    DemConfigSet
      50 x DemEventParameter, all with DemEventTimeSeries=DEM_TIMESERIES_SNAPSHOT_NONE, DemEventAvailable=true, DemEventAvailableInVariant=true, DemEventLatchTestFailed=false:
        MCU_E_CLM_SELFDIAG_FAILURE: DemEventId=2, DemEventKind=DEM_EVENT_KIND_BSW
          DemEventClass:
            DemAgingAllowed = false
            DemConsiderPtoStatus = false
            DemEventDestination = DEM_DTC_ORIGIN_PRIMARY_MEMORY
            DemEventPriority = 2
            DemFFPrestorageSupported = false
            DemOperationCycleRef = NON_OBD
            DemDebounceAlgorithmClass
              DemDebounceCounterBased:
                DemDebounceBehavior = DEM_DEBOUNCE_FREEZE
                DemDebounceCounterDecrementStepSize = 1
                DemDebounceCounterFailedThreshold = 127
                DemDebounceCounterIncrementStepSize = 1
                DemDebounceCounterJumpDown = true
                DemDebounceCounterJumpDownValue = 0
                DemDebounceCounterJumpUp = true
                DemDebounceCounterJumpUpValue = 0
                DemDebounceCounterPassedThreshold = -128
                DemDebounceCounterStorage = false
                DemDebounceContinuous = false
        MCU_E_CLOCK_FAILURE: DemEventId=4, DemEventKind=DEM_EVENT_KIND_BSW
          DemEventClass:
            DemAgingAllowed = false
            DemConsiderPtoStatus = false
            DemEventDestination = DEM_DTC_ORIGIN_PRIMARY_MEMORY
            DemEventPriority = 2
            DemFFPrestorageSupported = false
            DemOperationCycleRef = NON_OBD
            DemDebounceAlgorithmClass
              DemDebounceCounterBased:
                DemDebounceBehavior = DEM_DEBOUNCE_FREEZE
                DemDebounceCounterDecrementStepSize = 1
                DemDebounceCounterFailedThreshold = 127
                DemDebounceCounterIncrementStepSize = 1
                DemDebounceCounterJumpDown = true
                DemDebounceCounterJumpDownValue = 0
                DemDebounceCounterJumpUp = true
                DemDebounceCounterJumpUpValue = 0
                DemDebounceCounterPassedThreshold = -128
                DemDebounceCounterStorage = false
                DemDebounceContinuous = false
        MCU_E_CVM_SELFDIAG_FAILURE: DemEventId=6, DemEventKind=DEM_EVENT_KIND_BSW
          DemEventClass:
            DemAgingAllowed = false
            DemConsiderPtoStatus = false
            DemEventDestination = DEM_DTC_ORIGIN_PRIMARY_MEMORY
            DemEventPriority = 2
            DemFFPrestorageSupported = false
            DemOperationCycleRef = NON_OBD
            DemDebounceAlgorithmClass
              DemDebounceCounterBased:
                DemDebounceBehavior = DEM_DEBOUNCE_FREEZE
                DemDebounceCounterDecrementStepSize = 1
                DemDebounceCounterFailedThreshold = 127
                DemDebounceCounterIncrementStepSize = 1
                DemDebounceCounterJumpDown = true
                DemDebounceCounterJumpDownValue = 0
                DemDebounceCounterJumpUp = true
                DemDebounceCounterJumpUpValue = 0
                DemDebounceCounterPassedThreshold = -128
                DemDebounceCounterStorage = false
                DemDebounceContinuous = false
        MCU_E_ECM_SELFDIAG_FAILURE: DemEventId=8, DemEventKind=DEM_EVENT_KIND_BSW
          DemEventClass:
            DemAgingAllowed = false
            DemConsiderPtoStatus = false
            DemEventDestination = DEM_DTC_ORIGIN_PRIMARY_MEMORY
            DemEventPriority = 2
            DemFFPrestorageSupported = false
            DemOperationCycleRef = NON_OBD
            DemDebounceAlgorithmClass
              DemDebounceCounterBased:
                DemDebounceBehavior = DEM_DEBOUNCE_FREEZE
                DemDebounceCounterDecrementStepSize = 1
                DemDebounceCounterFailedThreshold = 127
                DemDebounceCounterIncrementStepSize = 1
                DemDebounceCounterJumpDown = true
                DemDebounceCounterJumpDownValue = 0
                DemDebounceCounterJumpUp = true
                DemDebounceCounterJumpUpValue = 0
                DemDebounceCounterPassedThreshold = -128
                DemDebounceCounterStorage = false
                DemDebounceContinuous = false
        MCU_E_LOCKSTEP_SELFDIAG_FAILURE: DemEventId=10, DemEventKind=DEM_EVENT_KIND_BSW
          DemEventClass:
            DemAgingAllowed = false
            DemConsiderPtoStatus = false
            DemEventDestination = DEM_DTC_ORIGIN_PRIMARY_MEMORY
            DemEventPriority = 2
            DemFFPrestorageSupported = false
            DemOperationCycleRef = NON_OBD
            DemDebounceAlgorithmClass
              DemDebounceCounterBased:
                DemDebounceBehavior = DEM_DEBOUNCE_FREEZE
                DemDebounceCounterDecrementStepSize = 1
                DemDebounceCounterFailedThreshold = 127
                DemDebounceCounterIncrementStepSize = 1
                DemDebounceCounterJumpDown = true
                DemDebounceCounterJumpDownValue = 0
                DemDebounceCounterJumpUp = true
                DemDebounceCounterJumpUpValue = 0
                DemDebounceCounterPassedThreshold = -128
                DemDebounceCounterStorage = false
                DemDebounceContinuous = false
        MCU_E_WRITE_TIMEOUT_FAILURE: DemEventId=12, DemEventKind=DEM_EVENT_KIND_BSW
          DemEventClass:
            DemAgingAllowed = false
            DemConsiderPtoStatus = false
            DemEventDestination = DEM_DTC_ORIGIN_PRIMARY_MEMORY
            DemEventPriority = 2
            DemFFPrestorageSupported = false
            DemOperationCycleRef = NON_OBD
            DemDebounceAlgorithmClass
              DemDebounceCounterBased:
                DemDebounceBehavior = DEM_DEBOUNCE_FREEZE
                DemDebounceCounterDecrementStepSize = 1
                DemDebounceCounterFailedThreshold = 127
                DemDebounceCounterIncrementStepSize = 1
                DemDebounceCounterJumpDown = true
                DemDebounceCounterJumpDownValue = 0
                DemDebounceCounterJumpUp = true
                DemDebounceCounterJumpUpValue = 0
                DemDebounceCounterPassedThreshold = -128
                DemDebounceCounterStorage = false
                DemDebounceContinuous = false
        MCU_E_REG_WRITE_VERIFY: DemEventId=47, DemEventKind=DEM_EVENT_KIND_BSW
          DemEventClass:
            DemAgingAllowed = false
            DemConsiderPtoStatus = false
            DemEventDestination = DEM_DTC_ORIGIN_PRIMARY_MEMORY
            DemEventPriority = 2
            DemFFPrestorageSupported = false
            DemOperationCycleRef = NON_OBD
            DemDebounceAlgorithmClass
              DemDebounceCounterBased:
                DemDebounceBehavior = DEM_DEBOUNCE_FREEZE
                DemDebounceCounterDecrementStepSize = 1
                DemDebounceCounterFailedThreshold = 127
                DemDebounceCounterIncrementStepSize = 1
                DemDebounceCounterJumpDown = true
                DemDebounceCounterJumpDownValue = 0
                DemDebounceCounterJumpUp = true
                DemDebounceCounterJumpUpValue = 0
                DemDebounceCounterPassedThreshold = -128
                DemDebounceCounterStorage = false
                DemDebounceContinuous = false
        MCU_E_INT_INCONSISTENT: DemEventId=48, DemEventKind=DEM_EVENT_KIND_BSW
          DemEventClass:
            DemAgingAllowed = false
            DemConsiderPtoStatus = false
            DemEventDestination = DEM_DTC_ORIGIN_PRIMARY_MEMORY
            DemEventPriority = 2
            DemFFPrestorageSupported = false
            DemOperationCycleRef = NON_OBD
            DemDebounceAlgorithmClass
              DemDebounceCounterBased:
                DemDebounceBehavior = DEM_DEBOUNCE_FREEZE
                DemDebounceCounterDecrementStepSize = 1
                DemDebounceCounterFailedThreshold = 127
                DemDebounceCounterIncrementStepSize = 1
                DemDebounceCounterJumpDown = true
                DemDebounceCounterJumpDownValue = 0
                DemDebounceCounterJumpUp = true
                DemDebounceCounterJumpUpValue = 0
                DemDebounceCounterPassedThreshold = -128
                DemDebounceCounterStorage = false
                DemDebounceContinuous = false
        MCU_E_RESETCONTROLLER_STARTUP_FAILURE: DemEventId=49, DemEventKind=DEM_EVENT_KIND_BSW
          DemEventClass:
            DemAgingAllowed = false
            DemConsiderPtoStatus = false
            DemEventDestination = DEM_DTC_ORIGIN_PRIMARY_MEMORY
            DemEventPriority = 2
            DemFFPrestorageSupported = false
            DemOperationCycleRef = NON_OBD
            DemDebounceAlgorithmClass
              DemDebounceCounterBased:
                DemDebounceBehavior = DEM_DEBOUNCE_FREEZE
                DemDebounceCounterDecrementStepSize = 1
                DemDebounceCounterFailedThreshold = 127
                DemDebounceCounterIncrementStepSize = 1
                DemDebounceCounterJumpDown = true
                DemDebounceCounterJumpDownValue = 0
                DemDebounceCounterJumpUp = true
                DemDebounceCounterJumpUpValue = 0
                DemDebounceCounterPassedThreshold = -128
                DemDebounceCounterStorage = false
                DemDebounceContinuous = false
        DIO_E_REG_WRITE_VERIFY: DemEventId=46, DemEventKind=DEM_EVENT_KIND_BSW
          DemEventClass:
            DemAgingAllowed = false
            DemConsiderPtoStatus = false
            DemEventDestination = DEM_DTC_ORIGIN_PRIMARY_MEMORY
            DemEventPriority = 2
            DemFFPrestorageSupported = false
            DemOperationCycleRef = NON_OBD
            DemDebounceAlgorithmClass
              DemDebounceCounterBased:
                DemDebounceBehavior = DEM_DEBOUNCE_FREEZE
                DemDebounceCounterDecrementStepSize = 1
                DemDebounceCounterFailedThreshold = 127
                DemDebounceCounterIncrementStepSize = 1
                DemDebounceCounterJumpDown = true
                DemDebounceCounterJumpDownValue = 0
                DemDebounceCounterJumpUp = true
                DemDebounceCounterJumpUpValue = 0
                DemDebounceCounterPassedThreshold = -128
                DemDebounceCounterStorage = false
                DemDebounceContinuous = false
        FLS_E_COMPARE_FAILED: DemEventId=36, DemEventKind=DEM_EVENT_KIND_BSW
          DemEventClass:
            DemAgingAllowed = false
            DemConsiderPtoStatus = false
            DemEventDestination = DEM_DTC_ORIGIN_PRIMARY_MEMORY
            DemEventPriority = 2
            DemFFPrestorageSupported = false
            DemOperationCycleRef = NON_OBD
            DemDebounceAlgorithmClass
              DemDebounceCounterBased:
                DemDebounceBehavior = DEM_DEBOUNCE_FREEZE
                DemDebounceCounterDecrementStepSize = 1
                DemDebounceCounterFailedThreshold = 127
                DemDebounceCounterIncrementStepSize = 1
                DemDebounceCounterJumpDown = true
                DemDebounceCounterJumpDownValue = 0
                DemDebounceCounterJumpUp = true
                DemDebounceCounterJumpUpValue = 0
                DemDebounceCounterPassedThreshold = -128
                DemDebounceCounterStorage = false
                DemDebounceContinuous = false
        FLS_E_ERASE_FAILED: DemEventId=37, DemEventKind=DEM_EVENT_KIND_BSW
          DemEventClass:
            DemAgingAllowed = false
            DemConsiderPtoStatus = false
            DemEventDestination = DEM_DTC_ORIGIN_PRIMARY_MEMORY
            DemEventPriority = 2
            DemFFPrestorageSupported = false
            DemOperationCycleRef = NON_OBD
            DemDebounceAlgorithmClass
              DemDebounceCounterBased:
                DemDebounceBehavior = DEM_DEBOUNCE_FREEZE
                DemDebounceCounterDecrementStepSize = 1
                DemDebounceCounterFailedThreshold = 127
                DemDebounceCounterIncrementStepSize = 1
                DemDebounceCounterJumpDown = true
                DemDebounceCounterJumpDownValue = 0
                DemDebounceCounterJumpUp = true
                DemDebounceCounterJumpUpValue = 0
                DemDebounceCounterPassedThreshold = -128
                DemDebounceCounterStorage = false
                DemDebounceContinuous = false
        FLS_E_READ_FAILED: DemEventId=38, DemEventKind=DEM_EVENT_KIND_BSW
          DemEventClass:
            DemAgingAllowed = false
            DemConsiderPtoStatus = false
            DemEventDestination = DEM_DTC_ORIGIN_PRIMARY_MEMORY
            DemEventPriority = 2
            DemFFPrestorageSupported = false
            DemOperationCycleRef = NON_OBD
            DemDebounceAlgorithmClass
              DemDebounceCounterBased:
                DemDebounceBehavior = DEM_DEBOUNCE_FREEZE
                DemDebounceCounterDecrementStepSize = 1
                DemDebounceCounterFailedThreshold = 127
                DemDebounceCounterIncrementStepSize = 1
                DemDebounceCounterJumpDown = true
                DemDebounceCounterJumpDownValue = 0
                DemDebounceCounterJumpUp = true
                DemDebounceCounterJumpUpValue = 0
                DemDebounceCounterPassedThreshold = -128
                DemDebounceCounterStorage = false
                DemDebounceContinuous = false
        FLS_E_INT_INCONSISTENT: DemEventId=39, DemEventKind=DEM_EVENT_KIND_BSW
          DemEventClass:
            DemAgingAllowed = false
            DemConsiderPtoStatus = false
            DemEventDestination = DEM_DTC_ORIGIN_PRIMARY_MEMORY
            DemEventPriority = 2
            DemFFPrestorageSupported = false
            DemOperationCycleRef = NON_OBD
            DemDebounceAlgorithmClass
              DemDebounceCounterBased:
                DemDebounceBehavior = DEM_DEBOUNCE_FREEZE
                DemDebounceCounterDecrementStepSize = 1
                DemDebounceCounterFailedThreshold = 127
                DemDebounceCounterIncrementStepSize = 1
                DemDebounceCounterJumpDown = true
                DemDebounceCounterJumpDownValue = 0
                DemDebounceCounterJumpUp = true
                DemDebounceCounterJumpUpValue = 0
                DemDebounceCounterPassedThreshold = -128
                DemDebounceCounterStorage = false
                DemDebounceContinuous = false
        FLS_E_REG_WRITE_VERIFY: DemEventId=40, DemEventKind=DEM_EVENT_KIND_BSW
          DemEventClass:
            DemAgingAllowed = false
            DemConsiderPtoStatus = false
            DemEventDestination = DEM_DTC_ORIGIN_PRIMARY_MEMORY
            DemEventPriority = 2
            DemFFPrestorageSupported = false
            DemOperationCycleRef = NON_OBD
            DemDebounceAlgorithmClass
              DemDebounceCounterBased:
                DemDebounceBehavior = DEM_DEBOUNCE_FREEZE
                DemDebounceCounterDecrementStepSize = 1
                DemDebounceCounterFailedThreshold = 127
                DemDebounceCounterIncrementStepSize = 1
                DemDebounceCounterJumpDown = true
                DemDebounceCounterJumpDownValue = 0
                DemDebounceCounterJumpUp = true
                DemDebounceCounterJumpUpValue = 0
                DemDebounceCounterPassedThreshold = -128
                DemDebounceCounterStorage = false
                DemDebounceContinuous = false
        FLS_E_READ_FAILED_DED: DemEventId=41, DemEventKind=DEM_EVENT_KIND_BSW
          DemEventClass:
            DemAgingAllowed = false
            DemConsiderPtoStatus = false
            DemEventDestination = DEM_DTC_ORIGIN_PRIMARY_MEMORY
            DemEventPriority = 2
            DemFFPrestorageSupported = false
            DemOperationCycleRef = NON_OBD
            DemDebounceAlgorithmClass
              DemDebounceCounterBased:
                DemDebounceBehavior = DEM_DEBOUNCE_FREEZE
                DemDebounceCounterDecrementStepSize = 1
                DemDebounceCounterFailedThreshold = 127
                DemDebounceCounterIncrementStepSize = 1
                DemDebounceCounterJumpDown = true
                DemDebounceCounterJumpDownValue = 0
                DemDebounceCounterJumpUp = true
                DemDebounceCounterJumpUpValue = 0
                DemDebounceCounterPassedThreshold = -128
                DemDebounceCounterStorage = false
                DemDebounceContinuous = false
        FLS_E_HW_FAILURE: DemEventId=42, DemEventKind=DEM_EVENT_KIND_BSW
          DemEventClass:
            DemAgingAllowed = false
            DemConsiderPtoStatus = false
            DemEventDestination = DEM_DTC_ORIGIN_PRIMARY_MEMORY
            DemEventPriority = 2
            DemFFPrestorageSupported = false
            DemOperationCycleRef = NON_OBD
            DemDebounceAlgorithmClass
              DemDebounceCounterBased:
                DemDebounceBehavior = DEM_DEBOUNCE_FREEZE
                DemDebounceCounterDecrementStepSize = 1
                DemDebounceCounterFailedThreshold = 127
                DemDebounceCounterIncrementStepSize = 1
                DemDebounceCounterJumpDown = true
                DemDebounceCounterJumpDownValue = 0
                DemDebounceCounterJumpUp = true
                DemDebounceCounterJumpUpValue = 0
                DemDebounceCounterPassedThreshold = -128
                DemDebounceCounterStorage = false
                DemDebounceContinuous = false
        FLS_E_ECC_FAILED: DemEventId=43, DemEventKind=DEM_EVENT_KIND_BSW
          DemEventClass:
            DemAgingAllowed = false
            DemConsiderPtoStatus = false
            DemEventDestination = DEM_DTC_ORIGIN_PRIMARY_MEMORY
            DemEventPriority = 2
            DemFFPrestorageSupported = false
            DemOperationCycleRef = NON_OBD
            DemDebounceAlgorithmClass
              DemDebounceCounterBased:
                DemDebounceBehavior = DEM_DEBOUNCE_FREEZE
                DemDebounceCounterDecrementStepSize = 1
                DemDebounceCounterFailedThreshold = 127
                DemDebounceCounterIncrementStepSize = 1
                DemDebounceCounterJumpDown = true
                DemDebounceCounterJumpDownValue = 0
                DemDebounceCounterJumpUp = true
                DemDebounceCounterJumpUpValue = 0
                DemDebounceCounterPassedThreshold = -128
                DemDebounceCounterStorage = false
                DemDebounceContinuous = false
        FLS_E_UNEXPECTED_FLASH_ID: DemEventId=44, DemEventKind=DEM_EVENT_KIND_BSW
          DemEventClass:
            DemAgingAllowed = false
            DemConsiderPtoStatus = false
            DemEventDestination = DEM_DTC_ORIGIN_PRIMARY_MEMORY
            DemEventPriority = 2
            DemFFPrestorageSupported = false
            DemOperationCycleRef = NON_OBD
            DemDebounceAlgorithmClass
              DemDebounceCounterBased:
                DemDebounceBehavior = DEM_DEBOUNCE_FREEZE
                DemDebounceCounterDecrementStepSize = 1
                DemDebounceCounterFailedThreshold = 127
                DemDebounceCounterIncrementStepSize = 1
                DemDebounceCounterJumpDown = true
                DemDebounceCounterJumpDownValue = 0
                DemDebounceCounterJumpUp = true
                DemDebounceCounterJumpUpValue = 0
                DemDebounceCounterPassedThreshold = -128
                DemDebounceCounterStorage = false
                DemDebounceContinuous = false
        FLS_E_WRITE_FAILED: DemEventId=45, DemEventKind=DEM_EVENT_KIND_BSW
          DemEventClass:
            DemAgingAllowed = false
            DemConsiderPtoStatus = false
            DemEventDestination = DEM_DTC_ORIGIN_PRIMARY_MEMORY
            DemEventPriority = 2
            DemFFPrestorageSupported = false
            DemOperationCycleRef = NON_OBD
            DemDebounceAlgorithmClass
              DemDebounceCounterBased:
                DemDebounceBehavior = DEM_DEBOUNCE_FREEZE
                DemDebounceCounterDecrementStepSize = 1
                DemDebounceCounterFailedThreshold = 127
                DemDebounceCounterIncrementStepSize = 1
                DemDebounceCounterJumpDown = true
                DemDebounceCounterJumpDownValue = 0
                DemDebounceCounterJumpUp = true
                DemDebounceCounterJumpUpValue = 0
                DemDebounceCounterPassedThreshold = -128
                DemDebounceCounterStorage = false
                DemDebounceContinuous = false
        SPI_E_DATA_TX_TIMEOUT_FAILURE: DemEventId=14, DemEventKind=DEM_EVENT_KIND_BSW
          DemEventClass:
            DemAgingAllowed = false
            DemConsiderPtoStatus = false
            DemEventDestination = DEM_DTC_ORIGIN_PRIMARY_MEMORY
            DemEventPriority = 2
            DemFFPrestorageSupported = false
            DemOperationCycleRef = NON_OBD
            DemDebounceAlgorithmClass
              DemDebounceCounterBased:
                DemDebounceBehavior = DEM_DEBOUNCE_FREEZE
                DemDebounceCounterDecrementStepSize = 1
                DemDebounceCounterFailedThreshold = 127
                DemDebounceCounterIncrementStepSize = 1
                DemDebounceCounterJumpDown = true
                DemDebounceCounterJumpDownValue = 0
                DemDebounceCounterJumpUp = true
                DemDebounceCounterJumpUpValue = 0
                DemDebounceCounterPassedThreshold = -128
                DemDebounceCounterStorage = false
                DemDebounceContinuous = false
        SPI_E_ECC_SELFTEST_FAILURE: DemEventId=16, DemEventKind=DEM_EVENT_KIND_BSW
          DemEventClass:
            DemAgingAllowed = false
            DemConsiderPtoStatus = false
            DemEventDestination = DEM_DTC_ORIGIN_PRIMARY_MEMORY
            DemEventPriority = 2
            DemFFPrestorageSupported = false
            DemOperationCycleRef = NON_OBD
            DemDebounceAlgorithmClass
              DemDebounceCounterBased:
                DemDebounceBehavior = DEM_DEBOUNCE_FREEZE
                DemDebounceCounterDecrementStepSize = 1
                DemDebounceCounterFailedThreshold = 127
                DemDebounceCounterIncrementStepSize = 1
                DemDebounceCounterJumpDown = true
                DemDebounceCounterJumpDownValue = 0
                DemDebounceCounterJumpUp = true
                DemDebounceCounterJumpUpValue = 0
                DemDebounceCounterPassedThreshold = -128
                DemDebounceCounterStorage = false
                DemDebounceContinuous = false
        SPI_E_HARDWARE_ERROR: DemEventId=18, DemEventKind=DEM_EVENT_KIND_BSW
          DemEventClass:
            DemAgingAllowed = false
            DemConsiderPtoStatus = false
            DemEventDestination = DEM_DTC_ORIGIN_PRIMARY_MEMORY
            DemEventPriority = 2
            DemFFPrestorageSupported = false
            DemOperationCycleRef = NON_OBD
            DemDebounceAlgorithmClass
              DemDebounceCounterBased:
                DemDebounceBehavior = DEM_DEBOUNCE_FREEZE
                DemDebounceCounterDecrementStepSize = 1
                DemDebounceCounterFailedThreshold = 127
                DemDebounceCounterIncrementStepSize = 1
                DemDebounceCounterJumpDown = true
                DemDebounceCounterJumpDownValue = 0
                DemDebounceCounterJumpUp = true
                DemDebounceCounterJumpUpValue = 0
                DemDebounceCounterPassedThreshold = -128
                DemDebounceCounterStorage = false
                DemDebounceContinuous = false
        SPI_E_INT_INCONSISTENT: DemEventId=20, DemEventKind=DEM_EVENT_KIND_BSW
          DemEventClass:
            DemAgingAllowed = false
            DemConsiderPtoStatus = false
            DemEventDestination = DEM_DTC_ORIGIN_PRIMARY_MEMORY
            DemEventPriority = 2
            DemFFPrestorageSupported = false
            DemOperationCycleRef = NON_OBD
            DemDebounceAlgorithmClass
              DemDebounceCounterBased:
                DemDebounceBehavior = DEM_DEBOUNCE_FREEZE
                DemDebounceCounterDecrementStepSize = 1
                DemDebounceCounterFailedThreshold = 127
                DemDebounceCounterIncrementStepSize = 1
                DemDebounceCounterJumpDown = true
                DemDebounceCounterJumpDownValue = 0
                DemDebounceCounterJumpUp = true
                DemDebounceCounterJumpUpValue = 0
                DemDebounceCounterPassedThreshold = -128
                DemDebounceCounterStorage = false
                DemDebounceContinuous = false
        SPI_E_LOOPBACK_SELFTEST_FAILURE: DemEventId=22, DemEventKind=DEM_EVENT_KIND_BSW
          DemEventClass:
            DemAgingAllowed = false
            DemConsiderPtoStatus = false
            DemEventDestination = DEM_DTC_ORIGIN_PRIMARY_MEMORY
            DemEventPriority = 2
            DemFFPrestorageSupported = false
            DemOperationCycleRef = NON_OBD
            DemDebounceAlgorithmClass
              DemDebounceCounterBased:
                DemDebounceBehavior = DEM_DEBOUNCE_FREEZE
                DemDebounceCounterDecrementStepSize = 1
                DemDebounceCounterFailedThreshold = 127
                DemDebounceCounterIncrementStepSize = 1
                DemDebounceCounterJumpDown = true
                DemDebounceCounterJumpDownValue = 0
                DemDebounceCounterJumpUp = true
                DemDebounceCounterJumpUpValue = 0
                DemDebounceCounterPassedThreshold = -128
                DemDebounceCounterStorage = false
                DemDebounceContinuous = false
        SPI_E_REG_WRITE_VERIFY: DemEventId=24, DemEventKind=DEM_EVENT_KIND_BSW
          DemEventClass:
            DemAgingAllowed = false
            DemConsiderPtoStatus = false
            DemEventDestination = DEM_DTC_ORIGIN_PRIMARY_MEMORY
            DemEventPriority = 2
            DemFFPrestorageSupported = false
            DemOperationCycleRef = NON_OBD
            DemDebounceAlgorithmClass
              DemDebounceCounterBased:
                DemDebounceBehavior = DEM_DEBOUNCE_FREEZE
                DemDebounceCounterDecrementStepSize = 1
                DemDebounceCounterFailedThreshold = 127
                DemDebounceCounterIncrementStepSize = 1
                DemDebounceCounterJumpDown = true
                DemDebounceCounterJumpDownValue = 0
                DemDebounceCounterJumpUp = true
                DemDebounceCounterJumpUpValue = 0
                DemDebounceCounterPassedThreshold = -128
                DemDebounceCounterStorage = false
                DemDebounceContinuous = false
        WDGM_E_IMPROPER_CALLER: DemEventId=26, DemEventKind=DEM_EVENT_KIND_BSW
          DemEventClass:
            DemAgingAllowed = false
            DemConsiderPtoStatus = false
            DemEventDestination = DEM_DTC_ORIGIN_PRIMARY_MEMORY
            DemEventPriority = 2
            DemFFPrestorageSupported = false
            DemOperationCycleRef = NON_OBD
            DemDebounceAlgorithmClass
              DemDebounceCounterBased:
                DemDebounceBehavior = DEM_DEBOUNCE_FREEZE
                DemDebounceCounterDecrementStepSize = 1
                DemDebounceCounterFailedThreshold = 127
                DemDebounceCounterIncrementStepSize = 1
                DemDebounceCounterJumpDown = true
                DemDebounceCounterJumpDownValue = 0
                DemDebounceCounterJumpUp = true
                DemDebounceCounterJumpUpValue = 0
                DemDebounceCounterPassedThreshold = -128
                DemDebounceCounterStorage = false
                DemDebounceContinuous = false
        WDGM_E_MONITORING: DemEventId=28, DemEventKind=DEM_EVENT_KIND_BSW
          DemEventClass:
            DemAgingAllowed = false
            DemConsiderPtoStatus = false
            DemEventDestination = DEM_DTC_ORIGIN_PRIMARY_MEMORY
            DemEventPriority = 2
            DemFFPrestorageSupported = false
            DemOperationCycleRef = NON_OBD
            DemDebounceAlgorithmClass
              DemDebounceCounterBased:
                DemDebounceBehavior = DEM_DEBOUNCE_FREEZE
                DemDebounceCounterDecrementStepSize = 1
                DemDebounceCounterFailedThreshold = 127
                DemDebounceCounterIncrementStepSize = 1
                DemDebounceCounterJumpDown = true
                DemDebounceCounterJumpDownValue = 0
                DemDebounceCounterJumpUp = true
                DemDebounceCounterJumpUpValue = 0
                DemDebounceCounterPassedThreshold = -128
                DemDebounceCounterStorage = false
                DemDebounceContinuous = false
        WDGM_E_SET_MODE: DemEventId=29, DemEventKind=DEM_EVENT_KIND_BSW
          DemEventClass:
            DemAgingAllowed = false
            DemConsiderPtoStatus = false
            DemEventDestination = DEM_DTC_ORIGIN_PRIMARY_MEMORY
            DemEventPriority = 2
            DemFFPrestorageSupported = false
            DemOperationCycleRef = NON_OBD
            DemDebounceAlgorithmClass
              DemDebounceCounterBased:
                DemDebounceBehavior = DEM_DEBOUNCE_FREEZE
                DemDebounceCounterDecrementStepSize = 1
                DemDebounceCounterFailedThreshold = 127
                DemDebounceCounterIncrementStepSize = 1
                DemDebounceCounterJumpDown = true
                DemDebounceCounterJumpDownValue = 0
                DemDebounceCounterJumpUp = true
                DemDebounceCounterJumpUpValue = 0
                DemDebounceCounterPassedThreshold = -128
                DemDebounceCounterStorage = false
                DemDebounceContinuous = false
        WDG_E_DISABLE_REJECTED: DemEventId=32, DemEventKind=DEM_EVENT_KIND_BSW
          DemEventClass:
            DemAgingAllowed = false
            DemConsiderPtoStatus = false
            DemEventDestination = DEM_DTC_ORIGIN_PRIMARY_MEMORY
            DemEventPriority = 2
            DemFFPrestorageSupported = false
            DemOperationCycleRef = NON_OBD
            DemDebounceAlgorithmClass
              DemDebounceCounterBased:
                DemDebounceBehavior = DEM_DEBOUNCE_FREEZE
                DemDebounceCounterDecrementStepSize = 1
                DemDebounceCounterFailedThreshold = 127
                DemDebounceCounterIncrementStepSize = 1
                DemDebounceCounterJumpDown = true
                DemDebounceCounterJumpDownValue = 0
                DemDebounceCounterJumpUp = true
                DemDebounceCounterJumpUpValue = 0
                DemDebounceCounterPassedThreshold = -128
                DemDebounceCounterStorage = false
                DemDebounceContinuous = false
        WDG_E_INT_INCONSISTENT: DemEventId=33, DemEventKind=DEM_EVENT_KIND_BSW
          DemEventClass:
            DemAgingAllowed = false
            DemConsiderPtoStatus = false
            DemEventDestination = DEM_DTC_ORIGIN_PRIMARY_MEMORY
            DemEventPriority = 2
            DemFFPrestorageSupported = false
            DemOperationCycleRef = NON_OBD
            DemDebounceAlgorithmClass
              DemDebounceCounterBased:
                DemDebounceBehavior = DEM_DEBOUNCE_FREEZE
                DemDebounceCounterDecrementStepSize = 1
                DemDebounceCounterFailedThreshold = 127
                DemDebounceCounterIncrementStepSize = 1
                DemDebounceCounterJumpDown = true
                DemDebounceCounterJumpDownValue = 0
                DemDebounceCounterJumpUp = true
                DemDebounceCounterJumpUpValue = 0
                DemDebounceCounterPassedThreshold = -128
                DemDebounceCounterStorage = false
                DemDebounceContinuous = false
        WDG_E_MODE_FAILED: DemEventId=34, DemEventKind=DEM_EVENT_KIND_BSW
          DemEventClass:
            DemAgingAllowed = false
            DemConsiderPtoStatus = false
            DemEventDestination = DEM_DTC_ORIGIN_PRIMARY_MEMORY
            DemEventPriority = 2
            DemFFPrestorageSupported = false
            DemOperationCycleRef = NON_OBD
            DemDebounceAlgorithmClass
              DemDebounceCounterBased:
                DemDebounceBehavior = DEM_DEBOUNCE_FREEZE
                DemDebounceCounterDecrementStepSize = 1
                DemDebounceCounterFailedThreshold = 127
                DemDebounceCounterIncrementStepSize = 1
                DemDebounceCounterJumpDown = true
                DemDebounceCounterJumpDownValue = 0
                DemDebounceCounterJumpUp = true
                DemDebounceCounterJumpUpValue = 0
                DemDebounceCounterPassedThreshold = -128
                DemDebounceCounterStorage = false
                DemDebounceContinuous = false
        WDG_E_REG_WRITE_VERIFY: DemEventId=35, DemEventKind=DEM_EVENT_KIND_BSW
          DemEventClass:
            DemAgingAllowed = false
            DemConsiderPtoStatus = false
            DemEventDestination = DEM_DTC_ORIGIN_PRIMARY_MEMORY
            DemEventPriority = 2
            DemFFPrestorageSupported = false
            DemOperationCycleRef = NON_OBD
            DemDebounceAlgorithmClass
              DemDebounceCounterBased:
                DemDebounceBehavior = DEM_DEBOUNCE_FREEZE
                DemDebounceCounterDecrementStepSize = 1
                DemDebounceCounterFailedThreshold = 127
                DemDebounceCounterIncrementStepSize = 1
                DemDebounceCounterJumpDown = true
                DemDebounceCounterJumpDownValue = 0
                DemDebounceCounterJumpUp = true
                DemDebounceCounterJumpUpValue = 0
                DemDebounceCounterPassedThreshold = -128
                DemDebounceCounterStorage = false
                DemDebounceContinuous = false
        PORT_E_WRITE_TIMEOUT_FAILURE: DemEventId=30, DemEventKind=DEM_EVENT_KIND_BSW
          DemEventClass:
            DemAgingAllowed = false
            DemConsiderPtoStatus = false
            DemEventDestination = DEM_DTC_ORIGIN_PRIMARY_MEMORY
            DemEventPriority = 2
            DemFFPrestorageSupported = false
            DemOperationCycleRef = NON_OBD
            DemDebounceAlgorithmClass
              DemDebounceCounterBased:
                DemDebounceBehavior = DEM_DEBOUNCE_FREEZE
                DemDebounceCounterDecrementStepSize = 1
                DemDebounceCounterFailedThreshold = 127
                DemDebounceCounterIncrementStepSize = 1
                DemDebounceCounterJumpDown = true
                DemDebounceCounterJumpDownValue = 0
                DemDebounceCounterJumpUp = true
                DemDebounceCounterJumpUpValue = 0
                DemDebounceCounterPassedThreshold = -128
                DemDebounceCounterStorage = false
                DemDebounceContinuous = false
        PORT_E_REG_WRITE_VERIFY: DemEventId=31, DemEventKind=DEM_EVENT_KIND_BSW
          DemEventClass:
            DemAgingAllowed = false
            DemConsiderPtoStatus = false
            DemEventDestination = DEM_DTC_ORIGIN_PRIMARY_MEMORY
            DemEventPriority = 2
            DemFFPrestorageSupported = false
            DemOperationCycleRef = NON_OBD
            DemDebounceAlgorithmClass
              DemDebounceCounterBased:
                DemDebounceBehavior = DEM_DEBOUNCE_FREEZE
                DemDebounceCounterDecrementStepSize = 1
                DemDebounceCounterFailedThreshold = 127
                DemDebounceCounterIncrementStepSize = 1
                DemDebounceCounterJumpDown = true
                DemDebounceCounterJumpDownValue = 0
                DemDebounceCounterJumpUp = true
                DemDebounceCounterJumpUpValue = 0
                DemDebounceCounterPassedThreshold = -128
                DemDebounceCounterStorage = false
                DemDebounceContinuous = false
        CodingEventNotCoded: DemEventKind=DEM_EVENT_KIND_SWC, DemMaxNumberFreezeFrameRecords=2, DemEventId=1, DemDTCClassRef=DTC_023008, DemExtendedDataClassRef=ExtendedDataClass_DTC_023008_Props, DemFreezeFrameClassRef=FreezeFrameClass_DTC_023008_Props, DemFreezeFrameRecNumClassRef=DemFreezeFrameRecNumClass
          DemCallbackClearEventAllowed: DemClearEventAllowedBehavior=DEM_NO_STATUS_BYTE_CHANGE
          DemEventClass:
            DemAgingAllowed = false
            DemEventDestination = DEM_DTC_ORIGIN_PRIMARY_MEMORY
            DemEventFailureCycleCounterThreshold = 1
            DemEventSignificance = DEM_EVENT_SIGNIFICANCE_FAULT
            DemConsiderPtoStatus = false
            DemEventPriority = 2
            DemFFPrestorageSupported = false
            DemOperationCycleRef = NON_OBD
            DemAgingCycleRef = NON_OBD
            DemDebounceAlgorithmClass
              DemDebounceCounterBased:
                DemDebounceBehavior = DEM_DEBOUNCE_FREEZE
                DemDebounceCounterDecrementStepSize = 1
                DemDebounceCounterFailedThreshold = 127
                DemDebounceCounterIncrementStepSize = 1
                DemDebounceCounterJumpDown = true
                DemDebounceCounterJumpDownValue = 0
                DemDebounceCounterJumpUp = true
                DemDebounceCounterJumpUpValue = 0
                DemDebounceCounterPassedThreshold = -128
                DemDebounceCounterStorage = false
                DemDebounceContinuous = false
        CodingEventUnqualifiedData: DemEventKind=DEM_EVENT_KIND_SWC, DemMaxNumberFreezeFrameRecords=2, DemEventId=3, DemDTCClassRef=DTC_02300A, DemExtendedDataClassRef=ExtendedDataClass_DTC_02300A_Props, DemFreezeFrameClassRef=FreezeFrameClass_DTC_02300A_Props, DemFreezeFrameRecNumClassRef=DemFreezeFrameRecNumClass
          DemEventClass:
            DemAgingAllowed = false
            DemEventDestination = DEM_DTC_ORIGIN_PRIMARY_MEMORY
            DemEventFailureCycleCounterThreshold = 1
            DemEventSignificance = DEM_EVENT_SIGNIFICANCE_FAULT
            DemConsiderPtoStatus = false
            DemEventPriority = 2
            DemFFPrestorageSupported = false
            DemOperationCycleRef = NON_OBD
            DemEnableConditionGroupRef = DEM_CONDITION_GROUP_DefaultErrorLock
            DemAgingCycleRef = NON_OBD
            DemDebounceAlgorithmClass
              DemDebounceCounterBased:
                DemDebounceBehavior = DEM_DEBOUNCE_FREEZE
                DemDebounceCounterDecrementStepSize = 1
                DemDebounceCounterFailedThreshold = 127
                DemDebounceCounterIncrementStepSize = 1
                DemDebounceCounterJumpDown = true
                DemDebounceCounterJumpDownValue = 0
                DemDebounceCounterJumpUp = true
                DemDebounceCounterJumpUpValue = 0
                DemDebounceCounterPassedThreshold = -128
                DemDebounceCounterStorage = false
                DemDebounceContinuous = false
        CodingEventWrongVehicle: DemEventKind=DEM_EVENT_KIND_SWC, DemMaxNumberFreezeFrameRecords=2, DemEventId=5, DemDTCClassRef=DTC_023009, DemExtendedDataClassRef=ExtendedDataClass_DTC_023009_Props, DemFreezeFrameClassRef=FreezeFrameClass_DTC_023009_Props, DemFreezeFrameRecNumClassRef=DemFreezeFrameRecNumClass
          DemEventClass:
            DemAgingAllowed = false
            DemEventDestination = DEM_DTC_ORIGIN_PRIMARY_MEMORY
            DemEventFailureCycleCounterThreshold = 1
            DemEventSignificance = DEM_EVENT_SIGNIFICANCE_FAULT
            DemConsiderPtoStatus = false
            DemEventPriority = 2
            DemFFPrestorageSupported = false
            DemOperationCycleRef = NON_OBD
            DemEnableConditionGroupRef = DEM_CONDITION_GROUP_DefaultErrorLock
            DemAgingCycleRef = NON_OBD
            DemDebounceAlgorithmClass
              DemDebounceCounterBased:
                DemDebounceBehavior = DEM_DEBOUNCE_FREEZE
                DemDebounceCounterDecrementStepSize = 1
                DemDebounceCounterFailedThreshold = 127
                DemDebounceCounterIncrementStepSize = 1
                DemDebounceCounterJumpDown = true
                DemDebounceCounterJumpDownValue = 0
                DemDebounceCounterJumpUp = true
                DemDebounceCounterJumpUpValue = 0
                DemDebounceCounterPassedThreshold = -128
                DemDebounceCounterStorage = false
                DemDebounceContinuous = false
        DmTestAppl: DemEventKind=DEM_EVENT_KIND_SWC, DemMaxNumberFreezeFrameRecords=2, DemEventId=7, DemDTCClassRef=DTC_02FF30, DemExtendedDataClassRef=ExtendedDataClass_DTC_02FF30_Props, DemFreezeFrameClassRef=FreezeFrameClass_DTC_02FF30_Props, DemFreezeFrameRecNumClassRef=DemFreezeFrameRecNumClass
          DemEventClass:
            DemAgingAllowed = false
            DemEventDestination = DEM_DTC_ORIGIN_PRIMARY_MEMORY
            DemEventFailureCycleCounterThreshold = 1
            DemEventSignificance = DEM_EVENT_SIGNIFICANCE_OCCURRENCE
            DemConsiderPtoStatus = false
            DemEventPriority = 2
            DemFFPrestorageSupported = false
            DemOperationCycleRef = NON_OBD
            DemEnableConditionGroupRef = DEM_CONDITION_GROUP_DefaultErrorLock
            DemAgingCycleRef = NON_OBD
            DemDebounceAlgorithmClass
              DemDebounceCounterBased:
                DemDebounceBehavior = DEM_DEBOUNCE_FREEZE
                DemDebounceCounterDecrementStepSize = 1
                DemDebounceCounterFailedThreshold = 127
                DemDebounceCounterIncrementStepSize = 1
                DemDebounceCounterJumpDown = true
                DemDebounceCounterJumpDownValue = 0
                DemDebounceCounterJumpUp = true
                DemDebounceCounterJumpUpValue = 0
                DemDebounceCounterPassedThreshold = -128
                DemDebounceCounterStorage = false
                DemDebounceContinuous = false
        DmTestCom: DemEventKind=DEM_EVENT_KIND_SWC, DemMaxNumberFreezeFrameRecords=2, DemEventId=9, DemDTCClassRef=DTC_D50BFF, DemExtendedDataClassRef=ExtendedDataClass_DTC_D50BFF_Props, DemFreezeFrameClassRef=FreezeFrameClass_DTC_D50BFF_Props, DemFreezeFrameRecNumClassRef=DemFreezeFrameRecNumClass
          DemEventClass:
            DemAgingAllowed = false
            DemEventDestination = DEM_DTC_ORIGIN_PRIMARY_MEMORY
            DemEventFailureCycleCounterThreshold = 1
            DemEventSignificance = DEM_EVENT_SIGNIFICANCE_OCCURRENCE
            DemConsiderPtoStatus = false
            DemEventPriority = 2
            DemFFPrestorageSupported = false
            DemOperationCycleRef = NON_OBD
            DemEnableConditionGroupRef = DEM_CONDITION_GROUP_ComErrorLock
            DemAgingCycleRef = NON_OBD
            DemDebounceAlgorithmClass
              DemDebounceCounterBased:
                DemDebounceBehavior = DEM_DEBOUNCE_FREEZE
                DemDebounceCounterDecrementStepSize = 1
                DemDebounceCounterFailedThreshold = 127
                DemDebounceCounterIncrementStepSize = 1
                DemDebounceCounterJumpDown = true
                DemDebounceCounterJumpDownValue = 0
                DemDebounceCounterJumpUp = true
                DemDebounceCounterJumpUpValue = 0
                DemDebounceCounterPassedThreshold = -128
                DemDebounceCounterStorage = false
                DemDebounceContinuous = false
        FrsmEClusterSyncLoss: DemEventKind=DEM_EVENT_KIND_SWC, DemMaxNumberFreezeFrameRecords=2, DemEventId=11, DemDTCClassRef=DTC_D50420, DemExtendedDataClassRef=ExtendedDataClass_DTC_D50420_Props, DemFreezeFrameClassRef=FreezeFrameClass_DTC_D50420_Props, DemFreezeFrameRecNumClassRef=DemFreezeFrameRecNumClass
          DemEventClass:
            DemAgingAllowed = true
            DemEventDestination = DEM_DTC_ORIGIN_PRIMARY_MEMORY
            DemEventSignificance = DEM_EVENT_SIGNIFICANCE_FAULT
            DemConsiderPtoStatus = false
            DemEventPriority = 2
            DemFFPrestorageSupported = false
            DemEventFailureCycleCounterThreshold = 1
            DemOperationCycleRef = NON_OBD
            DemEnableConditionGroupRef = DEM_CONDITION_GROUP_ComErrorLock
            DemAgingCycleRef = NON_OBD
            DemDebounceAlgorithmClass
              DemDebounceCounterBased:
                DemDebounceBehavior = DEM_DEBOUNCE_FREEZE
                DemDebounceCounterDecrementStepSize = 1
                DemDebounceCounterFailedThreshold = 127
                DemDebounceCounterIncrementStepSize = 1
                DemDebounceCounterJumpDown = true
                DemDebounceCounterJumpDownValue = 0
                DemDebounceCounterJumpUp = true
                DemDebounceCounterJumpUpValue = 0
                DemDebounceCounterPassedThreshold = -128
                DemDebounceCounterStorage = false
                DemDebounceContinuous = false
        FrtrcvEFrBuserrorTrcv0: DemEventKind=DEM_EVENT_KIND_SWC, DemMaxNumberFreezeFrameRecords=2, DemEventId=13, DemDTCClassRef=DTC_D5041F, DemExtendedDataClassRef=ExtendedDataClass_DTC_D5041F_Props, DemFreezeFrameClassRef=FreezeFrameClass_DTC_D5041F_Props, DemFreezeFrameRecNumClassRef=DemFreezeFrameRecNumClass
          DemEventClass:
            DemAgingAllowed = true
            DemEventDestination = DEM_DTC_ORIGIN_PRIMARY_MEMORY
            DemEventFailureCycleCounterThreshold = 1
            DemEventSignificance = DEM_EVENT_SIGNIFICANCE_FAULT
            DemConsiderPtoStatus = false
            DemEventPriority = 2
            DemFFPrestorageSupported = false
            DemOperationCycleRef = NON_OBD
            DemEnableConditionGroupRef = DEM_CONDITION_GROUP_ComErrorLock
            DemAgingCycleRef = NON_OBD
            DemDebounceAlgorithmClass
              DemDebounceCounterBased:
                DemDebounceBehavior = DEM_DEBOUNCE_FREEZE
                DemDebounceCounterDecrementStepSize = 1
                DemDebounceCounterFailedThreshold = 127
                DemDebounceCounterIncrementStepSize = 1
                DemDebounceCounterJumpDown = true
                DemDebounceCounterJumpDownValue = 0
                DemDebounceCounterJumpUp = true
                DemDebounceCounterJumpUpValue = 0
                DemDebounceCounterPassedThreshold = -128
                DemDebounceCounterStorage = false
                DemDebounceContinuous = false
        GlobalOvervoltageExt: DemEventKind=DEM_EVENT_KIND_SWC, DemMaxNumberFreezeFrameRecords=2, DemEventId=15, DemDTCClassRef=DTC_023043, DemExtendedDataClassRef=ExtendedDataClass_DTC_023043_Props, DemFreezeFrameClassRef=FreezeFrameClass_DTC_023043_Props, DemFreezeFrameRecNumClassRef=DemFreezeFrameRecNumClass
          DemEventClass:
            DemAgingAllowed = false
            DemEventDestination = DEM_DTC_ORIGIN_PRIMARY_MEMORY
            DemEventFailureCycleCounterThreshold = 1
            DemEventSignificance = DEM_EVENT_SIGNIFICANCE_OCCURRENCE
            DemConsiderPtoStatus = false
            DemEventPriority = 2
            DemFFPrestorageSupported = false
            DemOperationCycleRef = NON_OBD
            DemEnableConditionGroupRef = DEM_CONDITION_GROUP_DefaultErrorLock
            DemAgingCycleRef = NON_OBD
            DemDebounceAlgorithmClass
              DemDebounceCounterBased:
                DemDebounceBehavior = DEM_DEBOUNCE_FREEZE
                DemDebounceCounterDecrementStepSize = 1
                DemDebounceCounterFailedThreshold = 127
                DemDebounceCounterIncrementStepSize = 1
                DemDebounceCounterJumpDown = true
                DemDebounceCounterJumpDownValue = 0
                DemDebounceCounterJumpUp = true
                DemDebounceCounterJumpUpValue = 0
                DemDebounceCounterPassedThreshold = -128
                DemDebounceCounterStorage = false
                DemDebounceContinuous = false
        GlobalOvervoltageInt: DemEventKind=DEM_EVENT_KIND_SWC, DemMaxNumberFreezeFrameRecords=2, DemEventId=17, DemDTCClassRef=DTC_023042, DemExtendedDataClassRef=ExtendedDataClass_DTC_023042_Props, DemFreezeFrameClassRef=FreezeFrameClass_DTC_023042_Props, DemFreezeFrameRecNumClassRef=DemFreezeFrameRecNumClass, DemEventParameterSystemTemplateDiagnosticEventRef=GlobalOvervoltageInt
          DemEventClass:
            DemAgingAllowed = false
            DemEventDestination = DEM_DTC_ORIGIN_PRIMARY_MEMORY
            DemEventFailureCycleCounterThreshold = 1
            DemEventSignificance = DEM_EVENT_SIGNIFICANCE_OCCURRENCE
            DemConsiderPtoStatus = false
            DemEventPriority = 2
            DemFFPrestorageSupported = false
            DemOperationCycleRef = NON_OBD
            DemEnableConditionGroupRef = DEM_CONDITION_GROUP_DefaultErrorLock
            DemAgingCycleRef = NON_OBD
            DemDebounceAlgorithmClass
              DemDebounceCounterBased:
                DemDebounceBehavior = DEM_DEBOUNCE_FREEZE
                DemDebounceCounterDecrementStepSize = 1
                DemDebounceCounterFailedThreshold = 127
                DemDebounceCounterIncrementStepSize = 1
                DemDebounceCounterJumpDown = true
                DemDebounceCounterJumpDownValue = 0
                DemDebounceCounterJumpUp = true
                DemDebounceCounterJumpUpValue = 0
                DemDebounceCounterPassedThreshold = -128
                DemDebounceCounterStorage = false
                DemDebounceContinuous = false
        GlobalUndervoltageExt: DemEventKind=DEM_EVENT_KIND_SWC, DemMaxNumberFreezeFrameRecords=2, DemEventId=19, DemDTCClassRef=DTC_023045, DemExtendedDataClassRef=ExtendedDataClass_DTC_023045_Props, DemFreezeFrameClassRef=FreezeFrameClass_DTC_023045_Props, DemFreezeFrameRecNumClassRef=DemFreezeFrameRecNumClass
          DemEventClass:
            DemAgingAllowed = false
            DemEventDestination = DEM_DTC_ORIGIN_PRIMARY_MEMORY
            DemEventFailureCycleCounterThreshold = 1
            DemEventSignificance = DEM_EVENT_SIGNIFICANCE_OCCURRENCE
            DemConsiderPtoStatus = false
            DemEventPriority = 2
            DemFFPrestorageSupported = false
            DemOperationCycleRef = NON_OBD
            DemEnableConditionGroupRef = DEM_CONDITION_GROUP_DefaultErrorLock
            DemAgingCycleRef = NON_OBD
            DemDebounceAlgorithmClass
              DemDebounceCounterBased:
                DemDebounceBehavior = DEM_DEBOUNCE_FREEZE
                DemDebounceCounterDecrementStepSize = 1
                DemDebounceCounterFailedThreshold = 127
                DemDebounceCounterIncrementStepSize = 1
                DemDebounceCounterJumpDown = true
                DemDebounceCounterJumpDownValue = 0
                DemDebounceCounterJumpUp = true
                DemDebounceCounterJumpUpValue = 0
                DemDebounceCounterPassedThreshold = -128
                DemDebounceCounterStorage = false
                DemDebounceContinuous = false
        GlobalUndervoltageInt: DemEventKind=DEM_EVENT_KIND_SWC, DemMaxNumberFreezeFrameRecords=2, DemEventId=21, DemDTCClassRef=DTC_023044, DemExtendedDataClassRef=ExtendedDataClass_DTC_023044_Props, DemFreezeFrameClassRef=FreezeFrameClass_DTC_023044_Props, DemFreezeFrameRecNumClassRef=DemFreezeFrameRecNumClass
          DemEventClass:
            DemAgingAllowed = false
            DemEventDestination = DEM_DTC_ORIGIN_PRIMARY_MEMORY
            DemEventFailureCycleCounterThreshold = 1
            DemEventSignificance = DEM_EVENT_SIGNIFICANCE_OCCURRENCE
            DemConsiderPtoStatus = false
            DemEventPriority = 2
            DemFFPrestorageSupported = false
            DemOperationCycleRef = NON_OBD
            DemEnableConditionGroupRef = DEM_CONDITION_GROUP_DefaultErrorLock
            DemAgingCycleRef = NON_OBD
            DemDebounceAlgorithmClass
              DemDebounceCounterBased:
                DemDebounceBehavior = DEM_DEBOUNCE_FREEZE
                DemDebounceCounterDecrementStepSize = 1
                DemDebounceCounterFailedThreshold = 127
                DemDebounceCounterIncrementStepSize = 1
                DemDebounceCounterJumpDown = true
                DemDebounceCounterJumpDownValue = 0
                DemDebounceCounterJumpUp = true
                DemDebounceCounterJumpUpValue = 0
                DemDebounceCounterPassedThreshold = -128
                DemDebounceCounterStorage = false
                DemDebounceContinuous = false
        LocalOvervoltage: DemEventKind=DEM_EVENT_KIND_SWC, DemMaxNumberFreezeFrameRecords=2, DemEventId=23, DemDTCClassRef=DTC_023040, DemExtendedDataClassRef=ExtendedDataClass_DTC_023040_Props, DemFreezeFrameClassRef=FreezeFrameClass_DTC_023040_Props, DemFreezeFrameRecNumClassRef=DemFreezeFrameRecNumClass
          DemEventClass:
            DemAgingAllowed = false
            DemEventDestination = DEM_DTC_ORIGIN_PRIMARY_MEMORY
            DemEventFailureCycleCounterThreshold = 1
            DemEventSignificance = DEM_EVENT_SIGNIFICANCE_FAULT
            DemConsiderPtoStatus = false
            DemEventPriority = 2
            DemFFPrestorageSupported = false
            DemOperationCycleRef = NON_OBD
            DemEnableConditionGroupRef = DEM_CONDITION_GROUP_DefaultErrorLock
            DemAgingCycleRef = NON_OBD
            DemDebounceAlgorithmClass
              DemDebounceCounterBased:
                DemDebounceBehavior = DEM_DEBOUNCE_FREEZE
                DemDebounceCounterDecrementStepSize = 1
                DemDebounceCounterFailedThreshold = 127
                DemDebounceCounterIncrementStepSize = 1
                DemDebounceCounterJumpDown = true
                DemDebounceCounterJumpDownValue = 0
                DemDebounceCounterJumpUp = true
                DemDebounceCounterJumpUpValue = 0
                DemDebounceCounterPassedThreshold = -128
                DemDebounceCounterStorage = false
                DemDebounceContinuous = false
        LocalUndervoltage: DemEventKind=DEM_EVENT_KIND_SWC, DemMaxNumberFreezeFrameRecords=2, DemEventId=25, DemDTCClassRef=DTC_023041, DemExtendedDataClassRef=ExtendedDataClass_DTC_023041_Props, DemFreezeFrameClassRef=FreezeFrameClass_DTC_023041_Props, DemFreezeFrameRecNumClassRef=DemFreezeFrameRecNumClass
          DemEventClass:
            DemAgingAllowed = false
            DemEventDestination = DEM_DTC_ORIGIN_PRIMARY_MEMORY
            DemEventFailureCycleCounterThreshold = 1
            DemEventSignificance = DEM_EVENT_SIGNIFICANCE_FAULT
            DemConsiderPtoStatus = false
            DemEventPriority = 2
            DemFFPrestorageSupported = false
            DemOperationCycleRef = NON_OBD
            DemEnableConditionGroupRef = DEM_CONDITION_GROUP_DefaultErrorLock
            DemAgingCycleRef = NON_OBD
            DemDebounceAlgorithmClass
              DemDebounceCounterBased:
                DemDebounceBehavior = DEM_DEBOUNCE_FREEZE
                DemDebounceCounterDecrementStepSize = 1
                DemDebounceCounterFailedThreshold = 127
                DemDebounceCounterIncrementStepSize = 1
                DemDebounceCounterJumpDown = true
                DemDebounceCounterJumpDownValue = 0
                DemDebounceCounterJumpUp = true
                DemDebounceCounterJumpUpValue = 0
                DemDebounceCounterPassedThreshold = -128
                DemDebounceCounterStorage = false
                DemDebounceContinuous = false
        VsmEventOpmode: DemEventKind=DEM_EVENT_KIND_SWC, DemMaxNumberFreezeFrameRecords=2, DemEventId=27, DemDTCClassRef=DTC_023000, DemExtendedDataClassRef=ExtendedDataClass_DTC_023000_Props, DemFreezeFrameClassRef=FreezeFrameClass_DTC_023000_Props, DemFreezeFrameRecNumClassRef=DemFreezeFrameRecNumClass
          DemCallbackClearEventAllowed: DemClearEventAllowedBehavior=DEM_NO_STATUS_BYTE_CHANGE
          DemEventClass:
            DemAgingAllowed = false
            DemEventDestination = DEM_DTC_ORIGIN_PRIMARY_MEMORY
            DemEventFailureCycleCounterThreshold = 1
            DemEventSignificance = DEM_EVENT_SIGNIFICANCE_FAULT
            DemConsiderPtoStatus = false
            DemEventPriority = 2
            DemFFPrestorageSupported = false
            DemOperationCycleRef = NON_OBD
            DemAgingCycleRef = NON_OBD
            DemDebounceAlgorithmClass
              DemDebounceCounterBased:
                DemDebounceBehavior = DEM_DEBOUNCE_FREEZE
                DemDebounceCounterDecrementStepSize = 1
                DemDebounceCounterFailedThreshold = 127
                DemDebounceCounterIncrementStepSize = 1
                DemDebounceCounterJumpDown = true
                DemDebounceCounterJumpDownValue = 0
                DemDebounceCounterJumpUp = true
                DemDebounceCounterJumpUpValue = 0
                DemDebounceCounterPassedThreshold = -128
                DemDebounceCounterStorage = false
                DemDebounceContinuous = false
        PriEve4822E4_SecEve21F100: DemEventId=50, DemEventKind=DEM_EVENT_KIND_SWC, DemDTCClassRef=Primary_DTC_4822E4
          DemEventClass:
            DemAgingAllowed = true
            DemConsiderPtoStatus = false
            DemEventDestination = DEM_DTC_ORIGIN_PRIMARY_MEMORY
            DemEventPriority = 2
            DemFFPrestorageSupported = false
            DemEventFailureCycleCounterThreshold = 0
            DemAgingCycleCounterThreshold = 64
            DemOperationCycleRef = NON_OBD
            DemAgingCycleRef = NON_OBD
            DemEventFailureCycleRef = NON_OBD
            DemDebounceAlgorithmClass
              DemDebounceCounterBased:
                DemDebounceBehavior = DEM_DEBOUNCE_FREEZE
                DemDebounceCounterDecrementStepSize = 1
                DemDebounceCounterFailedThreshold = 127
                DemDebounceCounterIncrementStepSize = 1
                DemDebounceCounterJumpDown = true
                DemDebounceCounterJumpDownValue = 0
                DemDebounceCounterJumpUp = true
                DemDebounceCounterJumpUpValue = 0
                DemDebounceCounterPassedThreshold = -128
                DemDebounceCounterStorage = false
                DemDebounceContinuous = false
            DemIndicatorAttribute:
              DemIndicatorFailureCycleSource = DEM_FAILURE_CYCLE_EVENT
              DemIndicatorBehaviour = DEM_INDICATOR_CONTINUOUS
              DemIndicatorHealingCycleCounterThreshold = 3
              DemIndicatorHealingCycleRef = NON_OBD
              DemIndicatorRef = NormWarnLamp
          SetSecondaryDTC21F100_Oper (DemCallbackEventStatusChanged): DemCallbackEventStatusChangedFnc=SetSecondaryDTC21F100_Oper
      22 x DemDTCClass, all with DemImmediateNvStorage=false:
        DTC_023000: DemUdsDTC=143360
        DTC_023008: DemUdsDTC=143368, DemDTCSeverity=DEM_DTC_SEV_NO_SEVERITY
        DTC_023009: DemUdsDTC=143369, DemDTCSeverity=DEM_DTC_SEV_NO_SEVERITY
        DTC_02300A: DemUdsDTC=143370, DemDTCSeverity=DEM_DTC_SEV_NO_SEVERITY
        DTC_023040: DemUdsDTC=143424
        DTC_023041: DemUdsDTC=143425
        DTC_023042: DemUdsDTC=143426
        DTC_023043: DemUdsDTC=143427
        DTC_023044: DemUdsDTC=143428
        DTC_023045: DemUdsDTC=143429
        DTC_02FF30: DemUdsDTC=196400
        DTC_D5041F: DemUdsDTC=13960223
        DTC_D50420: DemUdsDTC=13960224
        DTC_D50BFF: DemUdsDTC=13962239
        Primary_DTC_4822E4: DemUdsDTC=4727524
        Primary_DTC_4822F5: DemUdsDTC=4727541
        Secondary_DTC_20F300: DemUdsDTC=2159360
        Secondary_DTC_21F100: DemUdsDTC=2224384
        Secondary_DTC_21F300: DemUdsDTC=2224896
        Secondary_DTC_30F300: DemUdsDTC=3207936
        Secondary_DTC_31F100: DemUdsDTC=3272960
        Secondary_DTC_31F300: DemUdsDTC=3273472
      9 x DemEventParameter, all with DemEventTimeSeries=DEM_TIMESERIES_SNAPSHOT_NONE, DemEventAvailable=true, DemEventKind=DEM_EVENT_KIND_SWC, DemEventAvailableInVariant=true, DemEventLatchTestFailed=false:
        PriEve4822E4_SecEve31F100: DemEventId=51, DemDTCClassRef=Primary_DTC_4822E4
          DemEventClass:
            DemAgingAllowed = true
            DemConsiderPtoStatus = false
            DemEventDestination = DEM_DTC_ORIGIN_PRIMARY_MEMORY
            DemEventPriority = 2
            DemFFPrestorageSupported = false
            DemEventFailureCycleCounterThreshold = 0
            DemAgingCycleCounterThreshold = 64
            DemOperationCycleRef = NON_OBD
            DemAgingCycleRef = NON_OBD
            DemEventFailureCycleRef = NON_OBD
            DemDebounceAlgorithmClass
              DemDebounceCounterBased:
                DemDebounceBehavior = DEM_DEBOUNCE_FREEZE
                DemDebounceCounterDecrementStepSize = 1
                DemDebounceCounterFailedThreshold = 127
                DemDebounceCounterIncrementStepSize = 1
                DemDebounceCounterJumpDown = true
                DemDebounceCounterJumpDownValue = 0
                DemDebounceCounterJumpUp = true
                DemDebounceCounterJumpUpValue = 0
                DemDebounceCounterPassedThreshold = -128
                DemDebounceCounterStorage = false
                DemDebounceContinuous = false
            DemIndicatorAttribute:
              DemIndicatorFailureCycleSource = DEM_FAILURE_CYCLE_EVENT
              DemIndicatorBehaviour = DEM_INDICATOR_CONTINUOUS
              DemIndicatorHealingCycleCounterThreshold = 3
              DemIndicatorHealingCycleRef = NON_OBD
              DemIndicatorRef = NormWarnLamp
          SetSecondaryDTC31F100_Oper (DemCallbackEventStatusChanged): DemCallbackEventStatusChangedFnc=SetSecondaryDTC31F100_Oper
        PriEve4822F5_SecEve21F300: DemEventId=52, DemDTCClassRef=Primary_DTC_4822F5
          DemEventClass:
            DemAgingAllowed = true
            DemConsiderPtoStatus = false
            DemEventDestination = DEM_DTC_ORIGIN_PRIMARY_MEMORY
            DemEventPriority = 2
            DemFFPrestorageSupported = false
            DemEventFailureCycleCounterThreshold = 0
            DemAgingCycleCounterThreshold = 64
            DemOperationCycleRef = NON_OBD
            DemAgingCycleRef = NON_OBD
            DemEventFailureCycleRef = NON_OBD
            DemDebounceAlgorithmClass
              DemDebounceCounterBased:
                DemDebounceBehavior = DEM_DEBOUNCE_FREEZE
                DemDebounceCounterDecrementStepSize = 1
                DemDebounceCounterFailedThreshold = 127
                DemDebounceCounterIncrementStepSize = 1
                DemDebounceCounterJumpDown = true
                DemDebounceCounterJumpDownValue = 0
                DemDebounceCounterJumpUp = true
                DemDebounceCounterJumpUpValue = 0
                DemDebounceCounterPassedThreshold = -128
                DemDebounceCounterStorage = false
                DemDebounceContinuous = false
            DemIndicatorAttribute:
              DemIndicatorFailureCycleSource = DEM_FAILURE_CYCLE_EVENT
              DemIndicatorBehaviour = DEM_INDICATOR_CONTINUOUS
              DemIndicatorHealingCycleCounterThreshold = 3
              DemIndicatorHealingCycleRef = NON_OBD
              DemIndicatorRef = NormWarnLamp
          SetSecondaryDTC21F300_Oper (DemCallbackEventStatusChanged): DemCallbackEventStatusChangedFnc=SetSecondaryDTC21F300_Oper
        PriEve4822F5_SecEve31F300: DemEventId=53, DemDTCClassRef=Primary_DTC_4822F5
          DemEventClass:
            DemAgingAllowed = true
            DemConsiderPtoStatus = false
            DemEventDestination = DEM_DTC_ORIGIN_PRIMARY_MEMORY
            DemEventPriority = 2
            DemFFPrestorageSupported = false
            DemEventFailureCycleCounterThreshold = 0
            DemAgingCycleCounterThreshold = 64
            DemOperationCycleRef = NON_OBD
            DemAgingCycleRef = NON_OBD
            DemEventFailureCycleRef = NON_OBD
            DemDebounceAlgorithmClass
              DemDebounceCounterBased:
                DemDebounceBehavior = DEM_DEBOUNCE_FREEZE
                DemDebounceCounterDecrementStepSize = 1
                DemDebounceCounterFailedThreshold = 127
                DemDebounceCounterIncrementStepSize = 1
                DemDebounceCounterJumpDown = true
                DemDebounceCounterJumpDownValue = 0
                DemDebounceCounterJumpUp = true
                DemDebounceCounterJumpUpValue = 0
                DemDebounceCounterPassedThreshold = -128
                DemDebounceCounterStorage = false
                DemDebounceContinuous = false
            DemIndicatorAttribute:
              DemIndicatorFailureCycleSource = DEM_FAILURE_CYCLE_EVENT
              DemIndicatorBehaviour = DEM_INDICATOR_CONTINUOUS
              DemIndicatorHealingCycleCounterThreshold = 3
              DemIndicatorHealingCycleRef = NON_OBD
              DemIndicatorRef = NormWarnLamp
          SetSecondaryDTC31F300_Oper (DemCallbackEventStatusChanged): DemCallbackEventStatusChangedFnc=SetSecondaryDTC31F300_Oper
        SecondaryEve_20F300: DemEventId=59, DemDTCClassRef=Secondary_DTC_20F300
          DemEventClass:
            DemAgingAllowed = true
            DemConsiderPtoStatus = false
            DemEventDestination = DEM_DTC_ORIGIN_SECONDARY_MEMORY
            DemEventPriority = 2
            DemFFPrestorageSupported = false
            DemEventFailureCycleCounterThreshold = 0
            DemAgingCycleCounterThreshold = 64
            DemOperationCycleRef = NON_OBD
            DemAgingCycleRef = NON_OBD
            DemEventFailureCycleRef = NON_OBD
            DemDebounceAlgorithmClass
              DemDebounceCounterBased:
                DemDebounceBehavior = DEM_DEBOUNCE_FREEZE
                DemDebounceCounterDecrementStepSize = 1
                DemDebounceCounterFailedThreshold = 127
                DemDebounceCounterIncrementStepSize = 1
                DemDebounceCounterJumpDown = true
                DemDebounceCounterJumpDownValue = 0
                DemDebounceCounterJumpUp = true
                DemDebounceCounterJumpUpValue = 0
                DemDebounceCounterPassedThreshold = -128
                DemDebounceCounterStorage = false
                DemDebounceContinuous = false
        SecondaryEve_21F100: DemEventId=58, DemDTCClassRef=Secondary_DTC_21F100
          DemEventClass:
            DemAgingAllowed = true
            DemConsiderPtoStatus = false
            DemEventDestination = DEM_DTC_ORIGIN_SECONDARY_MEMORY
            DemEventPriority = 2
            DemFFPrestorageSupported = false
            DemEventFailureCycleCounterThreshold = 0
            DemAgingCycleCounterThreshold = 64
            DemOperationCycleRef = NON_OBD
            DemAgingCycleRef = NON_OBD
            DemEventFailureCycleRef = NON_OBD
            DemDebounceAlgorithmClass
              DemDebounceCounterBased:
                DemDebounceBehavior = DEM_DEBOUNCE_FREEZE
                DemDebounceCounterDecrementStepSize = 1
                DemDebounceCounterFailedThreshold = 127
                DemDebounceCounterIncrementStepSize = 1
                DemDebounceCounterJumpDown = true
                DemDebounceCounterJumpDownValue = 0
                DemDebounceCounterJumpUp = true
                DemDebounceCounterJumpUpValue = 0
                DemDebounceCounterPassedThreshold = -128
                DemDebounceCounterStorage = false
                DemDebounceContinuous = false
        SecondaryEve_21F300: DemEventId=54, DemDTCClassRef=Secondary_DTC_21F300
          DemEventClass:
            DemAgingAllowed = true
            DemConsiderPtoStatus = false
            DemEventDestination = DEM_DTC_ORIGIN_SECONDARY_MEMORY
            DemEventPriority = 2
            DemFFPrestorageSupported = false
            DemEventFailureCycleCounterThreshold = 0
            DemAgingCycleCounterThreshold = 64
            DemOperationCycleRef = NON_OBD
            DemAgingCycleRef = NON_OBD
            DemEventFailureCycleRef = NON_OBD
            DemDebounceAlgorithmClass
              DemDebounceCounterBased:
                DemDebounceBehavior = DEM_DEBOUNCE_FREEZE
                DemDebounceCounterDecrementStepSize = 1
                DemDebounceCounterFailedThreshold = 127
                DemDebounceCounterIncrementStepSize = 1
                DemDebounceCounterJumpDown = true
                DemDebounceCounterJumpDownValue = 0
                DemDebounceCounterJumpUp = true
                DemDebounceCounterJumpUpValue = 0
                DemDebounceCounterPassedThreshold = -128
                DemDebounceCounterStorage = false
                DemDebounceContinuous = false
        SecondaryEve_30F300: DemEventId=55, DemDTCClassRef=Secondary_DTC_30F300
          DemEventClass:
            DemAgingAllowed = true
            DemConsiderPtoStatus = false
            DemEventDestination = DEM_DTC_ORIGIN_SECONDARY_MEMORY
            DemEventPriority = 2
            DemFFPrestorageSupported = false
            DemEventFailureCycleCounterThreshold = 0
            DemAgingCycleCounterThreshold = 64
            DemOperationCycleRef = NON_OBD
            DemAgingCycleRef = NON_OBD
            DemEventFailureCycleRef = NON_OBD
            DemDebounceAlgorithmClass
              DemDebounceCounterBased:
                DemDebounceBehavior = DEM_DEBOUNCE_FREEZE
                DemDebounceCounterDecrementStepSize = 1
                DemDebounceCounterFailedThreshold = 127
                DemDebounceCounterIncrementStepSize = 1
                DemDebounceCounterJumpDown = true
                DemDebounceCounterJumpDownValue = 0
                DemDebounceCounterJumpUp = true
                DemDebounceCounterJumpUpValue = 0
                DemDebounceCounterPassedThreshold = -128
                DemDebounceCounterStorage = false
                DemDebounceContinuous = false
        SecondaryEve_31F100: DemEventId=56, DemDTCClassRef=Secondary_DTC_31F100
          DemEventClass:
            DemAgingAllowed = true
            DemConsiderPtoStatus = false
            DemEventDestination = DEM_DTC_ORIGIN_SECONDARY_MEMORY
            DemEventPriority = 2
            DemFFPrestorageSupported = false
            DemEventFailureCycleCounterThreshold = 0
            DemAgingCycleCounterThreshold = 64
            DemOperationCycleRef = NON_OBD
            DemAgingCycleRef = NON_OBD
            DemEventFailureCycleRef = NON_OBD
            DemDebounceAlgorithmClass
              DemDebounceCounterBased:
                DemDebounceBehavior = DEM_DEBOUNCE_FREEZE
                DemDebounceCounterDecrementStepSize = 1
                DemDebounceCounterFailedThreshold = 127
                DemDebounceCounterIncrementStepSize = 1
                DemDebounceCounterJumpDown = true
                DemDebounceCounterJumpDownValue = 0
                DemDebounceCounterJumpUp = true
                DemDebounceCounterJumpUpValue = 0
                DemDebounceCounterPassedThreshold = -128
                DemDebounceCounterStorage = false
                DemDebounceContinuous = false
        SecondaryEve_31F300: DemEventId=57, DemDTCClassRef=Secondary_DTC_31F300
          DemEventClass:
            DemAgingAllowed = true
            DemConsiderPtoStatus = false
            DemEventDestination = DEM_DTC_ORIGIN_SECONDARY_MEMORY
            DemEventPriority = 2
            DemFFPrestorageSupported = false
            DemEventFailureCycleCounterThreshold = 0
            DemAgingCycleCounterThreshold = 64
            DemOperationCycleRef = NON_OBD
            DemAgingCycleRef = NON_OBD
            DemEventFailureCycleRef = NON_OBD
            DemDebounceAlgorithmClass
              DemDebounceCounterBased:
                DemDebounceBehavior = DEM_DEBOUNCE_FREEZE
                DemDebounceCounterDecrementStepSize = 1
                DemDebounceCounterFailedThreshold = 127
                DemDebounceCounterIncrementStepSize = 1
                DemDebounceCounterJumpDown = true
                DemDebounceCounterJumpDownValue = 0
                DemDebounceCounterJumpUp = true
                DemDebounceCounterJumpUpValue = 0
                DemDebounceCounterPassedThreshold = -128
                DemDebounceCounterStorage = false
                DemDebounceContinuous = false
    DemGeneral:
      DemAgingRequieresTestedCycle = false
      DemClearDTCLimitation = DEM_ALL_SUPPORTED_DTCS
      DemDataElementDefaultEndianness = LITTLE_ENDIAN
      DemDcmSupport = true
      DemEventDisplacementStrategy = DEM_DISPLACEMENT_FULL
      DemEventMemoryEntryStorageTrigger = DEM_STORAGE_ON_TEST_FAILED
      DemOccurrenceCounterProcessing = DEM_PROCESS_OCCCTR_TF
      DemResetConfirmedBitOnOverflow = true
      DemStatusBitHandlingTestFailedSinceLastClear = DEM_STATUS_BIT_AGING_AND_DISPLACEMENT
      DemStatusBitStorageTestFailed = true
      DemTypeOfDTCSupported = DEM_DTC_TRANSLATION_ISO14229_1
      DemTypeOfFreezeFrameRecordNumeration = DEM_FF_RECNUM_CALCULATED
      DemAgingCycleCounterProcessing = DEM_PROCESS_AGINGCTR_INTERN
      DemGeneralInterfaceSupport = false
      DemMaxNumberEventEntryMirror = 0
      DemPTOSupport = false
      DemTriggerMonitorInitBeforeClearOk = true
      DemExtendedDataCapture = DEM_TRIGGER_EVENT_MEMORY_STORAGE
      DemFreezeFrameCapture = DEM_TRIGGER_EVENT_MEMORY_STORAGE
      DemOperationCycleProcessing = DEM_PROCESS_OPCYC_STATE
      DemMaxNumberTimeSeriesSnapshots = 0
      DemPendingDtcProcessing = DEM_PROCESS_PDTC_STOREDONLY
      DemWarningIndicatorRequestedProcessing = DEM_PROCESS_WIR_STOREDONLY
      DemExtendedDataVisibility = DEM_VISIBILITY_STOREDONLY
      DemEventDisplacementFallbackStrategy = DEM_FALLBACK_DISCARD_NEW_EVENT
      DemAgingRetainEnvironmentalData = false
      DemClearDTCBehavior = DEM_CLRRESP_NONVOLATILE_FINISH
      DemAvailabilitySupport = DEM_NO_AVAILABILITY
      DemAvailabilityStorage = false
      DemBswErrorBufferSize = 25
      DemDebounceCounterBasedSupport = true
      DemDebounceTimeBasedSupport = false
      DemDevErrorDetect = true
      DemDtcStatusAvailabilityMask = 255
      DemEnableConditionSupport = true
      DemEventCombinationSupport = DEM_EVCOMB_TYPE1
      DemMaxNumberEventEntryOBDFreezeFrame = 0
      DemMaxNumberEventEntryPermanent = 0
      DemMaxNumberEventEntryPrimary = 8
      DemMaxNumberEventEntrySecondary = 24
      DemMaxNumberPrestoredFF = 0
      DemOBDSupport = DEM_OBD_NO_OBD_SUPPORT
      DemOperationCycleStatusStorage = false
      DemStorageConditionSupport = false
      DemSuppressionSupport = DEM_NO_SUPPRESSION
      DemTaskTime = 0.01
      DemTriggerDcmReports = false
      DemTriggerDltReports = false
      DemTriggerFiMReports = false
      DemTriggerMonitorInitForEnableConditions = false
      DemVersionInfoApi = false
      DemBswApiVersion = DEM_BSW_API_4_XX_XX
      DemBswApiVersionNvM = DEM_BSW_API_4_XX_XX
      DemBswApiVersionFiM = DEM_BSW_API_4_XX_XX
      DemAgingAfterHealing = DEM_AGING_WHILE_HEALING
      DemAgingBehavior = DEM_AGING_TYPE_3
      DemAgingCounterBehavior = DEM_AGING_COUNT_ALWAYS
      DemAgingCounterReporting = DEM_AGING_NORMAL_REPORTING
      DemCompiledPostbuildCrc = 150482983
      DemCompiledPostbuildCrcMode = DEM_POSTBUILD_CRC_AUTOMATIC
      DemGeneralDiagnosticInfoSupport = true
      DemJ1939Support = false
      DemNvSynchronizeSupport = false
      DemResetDebounceBehavior = DEM_RESET_DEBOUNCE_ON_DISABLE_ENABLE_CONDITIONS
      DemResetTestFailedOnOperationCycleStart = false
      DemRetryStorageSupport = false
      DemSafeBswChecks = true
      DemUseMemcopyMacros = false
      DemUseRte = true
      DemUserControlledWirBehavior = DEM_DISABLED_DURING_CONTROLDTCSETTING
      DemUserDefinedCompareAndSwap = false
      DemUseNvm = true
      DemTriggerGlobalEventStatusChangedCallback = false
      DemTriggerGlobalEventDataChangedCallback = true
      DemHeaderFileInclusion = DTCMapping.h
      3 x DemEnableCondition, all with DemEnableConditionStatus=true:
        DemEnableCondition_Omc: DemEnableConditionId=1
        DemEnableCondition_StdDiag: DemEnableConditionId=2
        DemEnableCondition_Stm: DemEnableConditionId=3
      3 x DemEnableConditionGroup, all with DemEnableConditionRef=DemEnableCondition_StdDiag:
        DEM_CONDITION_GROUP_ComErrorLock: DemEnableConditionRef=DemEnableCondition_Stm
        DEM_CONDITION_GROUP_ComErrorLockFlAsTr: DemEnableConditionRef=DemEnableCondition_Omc, DemEnableConditionRef=DemEnableCondition_Stm
        DEM_CONDITION_GROUP_DefaultErrorLock
      NON_OBD (DemOperationCycle): DemOperationCycleType=DEM_OPCYC_POWER, DemOperationCycleAutomaticEnd=false, DemOperationCycleAutostart=false
      DemPostbuild: DemEventAvailableDefaultSupport=true, DemMaxSizeFreezeFrame=19, DemMaxNumberDtr=0
      34 x DemNvRamBlockId:
        Dem_AdminData: DemNvRamBlockIdType=DEM_NVBLOCK_ADMIN, DemNvRamBlockIdRef=DemAdminDataBlock
        Dem_StatusData: DemNvRamBlockIdType=DEM_NVBLOCK_STATUS, DemNvRamBlockIdRef=DemStatusDataBlock
        Dem_PrimaryEntry{0..3}: DemNvRamBlockIdType=DEM_NVBLOCK_PRIMARY, DemNvRamBlockIdIndex={0..3}, DemNvRamBlockIdRef=DemPrimaryDataBlock{0..3}
        Dem_PrimaryEntry{5..7}: DemNvRamBlockIdType=DEM_NVBLOCK_PRIMARY, DemNvRamBlockIdIndex={5..7}, DemNvRamBlockIdRef=DemPrimaryDataBlock{5..7}
        Dem_PrimaryEntry4: DemNvRamBlockIdType=DEM_NVBLOCK_PRIMARY, DemNvRamBlockIdIndex=4, DemNvRamBlockIdRef=DemPrimaryDataBlock4
        Dem_SecondaryEntry{11..23}: DemNvRamBlockIdType=DEM_NVBLOCK_SECONDARY, DemNvRamBlockIdIndex={11..23}, DemNvRamBlockIdRef=DemSecondaryDataBlock{11..23}
        Dem_SecondaryEntry{0..10}: DemNvRamBlockIdType=DEM_NVBLOCK_SECONDARY, DemNvRamBlockIdIndex={0..10}, DemNvRamBlockIdRef=DemSecondaryDataBlock{0..10}
      NormWarnLamp (DemIndicator): DemIndicatorID=0
      OccurrenceCounter (DemExtendedDataRecordClass): DemExtendedDataRecordNumber=2, DemExtendedDataRecordUpdate=DEM_UPDATE_RECORD_YES, DemDataClassRef=EDR_02_OccurrenceCounter
      Systemzeit (DemDidClass): DemDidIdentifier=5889, DemDidSystemTemplateDiagnosticDataIdentifierRef=Systemzeit, DemDidDataClassRef=DID_1701_Systemzeit
      ExtendedDataClass_DTC_023000_Props (DemExtendedDataClass): DemExtendedDataRecordClassRef=ConditionByte, DemExtendedDataRecordClassRef=OccurrenceCounter  # DTC_023000_Props
      3 x DemDidClass:
        Fahrzeuggeschwindigkeit: DemDidIdentifier=10343, DemDidDataClassRef=DID_2867_Fahrzeuggeschwindigkeit, DemDidSystemTemplateDiagnosticDataIdentifierRef=Fahrzeuggeschwindigkeit
        FUwBn: DemDidIdentifier=5968, DemDidDataClassRef=DID_1750_FUwBn, DemDidSystemTemplateDiagnosticDataIdentifierRef=FUwBn
        KmStand: DemDidIdentifier=5888, DemDidSystemTemplateDiagnosticDataIdentifierRef=KmStand, DemDidDataClassRef=DID_1700_KmStand
      ConditionByte (DemExtendedDataRecordClass): DemExtendedDataRecordNumber=1, DemExtendedDataRecordUpdate=DEM_UPDATE_RECORD_YES, DemDataClassRef=EDR_01_ConditionByte
      Betriebsspannung (DemDidClass): DemDidIdentifier=10342, DemDidDataClassRef=DID_2866_Betriebsspannung, DemDidSystemTemplateDiagnosticDataIdentifierRef=Betriebsspannung
      FreezeFrameClass_DTC_023040_Props (DemFreezeFrameClass):  # DTC_023040_Props
        DemDidClassRef = Aussentemperatur
        DemDidClassRef = Betriebsspannung
        DemDidClassRef = FUwBn
        DemDidClassRef = Fahrzeuggeschwindigkeit
        DemDidClassRef = KmStand
        DemDidClassRef = Systemzeit
        DemDidClassRef = HwAg
        DemDidClassRef = HwTq
        DemDidClassRef = MotTq
        DemDidClassRef = PscmSts
      FreezeFrameClass_DTC_023000_Props (DemFreezeFrameClass):  # DTC_023000_Props
        DemDidClassRef = FUwBn
        DemDidClassRef = KmStand
        DemDidClassRef = Systemzeit
        DemDidClassRef = Aussentemperatur
        DemDidClassRef = Betriebsspannung
        DemDidClassRef = Fahrzeuggeschwindigkeit
        DemDidClassRef = HwAg
        DemDidClassRef = HwTq
        DemDidClassRef = MotTq
        DemDidClassRef = PscmSts
      Aussentemperatur (DemDidClass): DemDidIdentifier=10245, DemDidSystemTemplateDiagnosticDataIdentifierRef=Aussentemperatur, DemDidDataClassRef=DID_2805_Aussentemperatur
      ExtendedDataClass_DTC_D5041F_Props (DemExtendedDataClass): DemExtendedDataRecordClassRef=ConditionByte, DemExtendedDataRecordClassRef=HealingCounter, DemExtendedDataRecordClassRef=OccurrenceCounter  # DTC_D5041F_Props
      HealingCounter (DemExtendedDataRecordClass): DemExtendedDataRecordNumber=3, DemExtendedDataRecordUpdate=DEM_UPDATE_RECORD_YES, DemDataClassRef=EDR_03_HealingCounter
      DemFreezeFrameRecNumClass: DemFreezeFrameRecordNumber=0, DemFreezeFrameRecordUpdate=DEM_UPDATE_RECORD_YES, DemFreezeFrameRecordTrigger=DEM_RECORD_TRIGGER_CONFIRMED
      DemFreezeFrameClass_Systemzeit (DemFreezeFrameClass):
        DemDidClassRef = Systemzeit
        DemDidClassRef = Aussentemperatur
        DemDidClassRef = Betriebsspannung
        DemDidClassRef = Fahrzeuggeschwindigkeit
        DemDidClassRef = FUwBn
        DemDidClassRef = HwAg
        DemDidClassRef = HwTq
        DemDidClassRef = KmStand
        DemDidClassRef = MotTq
        DemDidClassRef = PscmSts
        DemDidClassRef = Systemzeit
      DemClient_DCM (DemClient): DemClientId=2
      DemClient_CDD (DemClient): DemClientId=1
      DemEventMemorySet
      9 x DemDataClass, all with DemDataElementStoreNonVolatile=true, DemDataElementUsePort=USE_DATA_CLIENT_SERVER_PORT:
        DID_2866_Betriebsspannung: DemDataElementDataSize=1, DemDataElementDataType=UINT8, DemDataElementSystemTemplateDiagnosticDataElementRef=Betriebsspannung  # Betriebsspannung
        DID_1750_FUwBn: DemDataElementDataSize=1, DemDataElementDataType=UINT8, DemDataElementSystemTemplateDiagnosticDataElementRef=FUwBn  # FUwBn
        DID_2805_Aussentemperatur: DemDataElementDataSize=1  # Aussentemperatur
        EDR_02_OccurrenceCounter: DemDataElementDataSize=1, DemDataElementDataType=UINT8, DemDataElementSystemTemplateDiagnosticDataElementRef=OccurrenceCounter  # OccurrenceCounter
        DID_2867_Fahrzeuggeschwindigkeit: DemDataElementDataSize=1, DemDataElementDataType=UINT8, DemDataElementSystemTemplateDiagnosticDataElementRef=Fahrzeuggeschwindigkeit  # Fahrzeuggeschwindigkeit
        DID_1701_Systemzeit: DemDataElementDataSize=4  # Systemzeit
        EDR_03_HealingCounter: DemDataElementDataSize=1, DemDataElementDataType=UINT8, DemDataElementSystemTemplateDiagnosticDataElementRef=HealingCounter  # HealingCounter
        DID_1700_KmStand: DemDataElementDataSize=3  # KmStand
        EDR_01_ConditionByte: DemDataElementDataSize=1, DemDataElementDataType=UINT8, DemDataElementSystemTemplateDiagnosticDataElementRef=ConditionByte  # ConditionByte
      DiagcMgr (DemClient): DemClientId=0
      12 x DemExtendedDataClass, all with DemExtendedDataRecordClassRef=ConditionByte, DemExtendedDataRecordClassRef=OccurrenceCounter:
        ExtendedDataClass_DTC_02FF30_Props
        ExtendedDataClass_DTC_02300A_Props
        ExtendedDataClass_DTC_023008_Props
        ExtendedDataClass_DTC_023009_Props
        ExtendedDataClass_DTC_{023040..023045}_Props
        ExtendedDataClass_DTC_D50BFF_Props
        ExtendedDataClass_DTC_D50420_Props: DemExtendedDataRecordClassRef=HealingCounter
      12 x DemFreezeFrameClass, all with DemDidClassRef=FUwBn, DemDidClassRef=HwAg, DemDidClassRef=HwTq, DemDidClassRef=KmStand, DemDidClassRef=MotTq, DemDidClassRef=PscmSts, DemDidClassRef=Systemzeit:
        FreezeFrameClass_DTC_02FF30_Props: DemDidClassRef=Aussentemperatur, DemDidClassRef=Betriebsspannung, DemDidClassRef=Fahrzeuggeschwindigkeit
        FreezeFrameClass_DTC_02300A_Props: DemDidClassRef=Aussentemperatur, DemDidClassRef=Betriebsspannung, DemDidClassRef=Fahrzeuggeschwindigkeit
        FreezeFrameClass_DTC_023008_Props: DemDidClassRef=Aussentemperatur, DemDidClassRef=Betriebsspannung, DemDidClassRef=Fahrzeuggeschwindigkeit
        FreezeFrameClass_DTC_023009_Props: DemDidClassRef=Aussentemperatur, DemDidClassRef=Betriebsspannung, DemDidClassRef=Fahrzeuggeschwindigkeit
        FreezeFrameClass_DTC_{023041..023045}_Props: DemDidClassRef=Aussentemperatur, DemDidClassRef=Betriebsspannung, DemDidClassRef=Fahrzeuggeschwindigkeit
        FreezeFrameClass_DTC_D50BFF_Props
        FreezeFrameClass_DTC_D5041F_Props: DemDidClassRef=Aussentemperatur, DemDidClassRef=Betriebsspannung, DemDidClassRef=Fahrzeuggeschwindigkeit
        FreezeFrameClass_DTC_D50420_Props: DemDidClassRef=Aussentemperatur, DemDidClassRef=Betriebsspannung, DemDidClassRef=Fahrzeuggeschwindigkeit
      ThermWarnLamp (DemIndicator): DemIndicatorID=1
      EptiInspnRlvLamp (DemIndicator): DemIndicatorID=2
      DID_5003_HwAg (DemDataClass):
        DemDataElementDataSize = 2
        DemDataElementStoreNonVolatile = true
        DemDataElementUsePort = USE_DATA_CLIENT_SERVER_PORT
        DemDataElementDataType = SINT16
        DemDataElementEndianness = opaque
      HwAg (DemDidClass): DemDidIdentifier=20483, DemDidDataClassRef=DID_5003_HwAg
      DID_500C_PscmSts (DemDataClass):
        DemDataElementDataSize = 2
        DemDataElementStoreNonVolatile = true
        DemDataElementUsePort = USE_DATA_CLIENT_SERVER_PORT
        DemDataElementDataType = UINT16
        DemDataElementEndianness = opaque
      PscmSts (DemDidClass): DemDidIdentifier=20492, DemDidDataClassRef=DID_500C_PscmSts
      DID_500E_HwTq (DemDataClass): DemDataElementDataSize=2, DemDataElementStoreNonVolatile=true, DemDataElementUsePort=USE_DATA_CLIENT_SERVER_PORT, DemDataElementDataType=SINT16
      HwTq (DemDidClass): DemDidIdentifier=20494, DemDidDataClassRef=DID_500E_HwTq
      DID_500F_MotTq (DemDataClass): DemDataElementDataSize=2, DemDataElementStoreNonVolatile=true, DemDataElementUsePort=USE_DATA_CLIENT_SERVER_PORT, DemDataElementDataType=SINT16
      MotTq (DemDidClass): DemDidIdentifier=20495, DemDidDataClassRef=DID_500F_MotTq
