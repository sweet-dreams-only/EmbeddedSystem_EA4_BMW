AUTOSAR XML (schema 4-3-0)
package /ActiveEcuC
  module config MotAg1Meas: implementation-config-variant=VARIANT-PRE-COMPILE
    MotAg1MeasGeneral: DIQEPIF=false, MOTAG1PRTCLFLTNTCNR=NTCNR_0X085
