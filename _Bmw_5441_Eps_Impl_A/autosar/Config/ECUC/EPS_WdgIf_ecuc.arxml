AUTOSAR XML (schema 4-3-0)
package /ActiveEcuC
  module config WdgIf: implementation-config-variant=VARIANT-PRE-COMPILE, module-description=WdgIf_Impl
    WdgIfDevice:
      WdgIfDeviceIndex = 0
      WdgIfDeviceIncludeFile = Wdg_59_DriverA.h
      WdgIfDeviceSetMode = Wdg_59_DriverA_SetMode
      WdgIfDeviceSetTriggerCondition = Wdg_59_DriverA_SetTriggerCondition
      WdgIfDriverRef = WdgGeneral
    WdgIfGeneral: WdgIfDevErrorDetect=true, WdgIfVersionInfoApi=false, WdgIfUseStateCombiner=false
