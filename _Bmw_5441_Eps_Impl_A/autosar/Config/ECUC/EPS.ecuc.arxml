AUTOSAR XML (schema 4-3-0)
package /ActiveEcuC
  ecuc value collection ActiveEcuC: ecu-extract=SYSTEM
    ecuc-values:
      BswM
      Det
      EcuM
      Mcu
      Fls
      Wdg
      Crc
      Fee
      MemIf
      NvM
      WdgIf
      WdgM
      ExcpnHndlg
      ElecGlbPrm
      IoHwAb
      SyncCrc
      Adc0CfgAndUse
      Adc1CfgAndUse
      FlsMem
      ChkPt
      Com
      EcuC
      FrIf
      FrSM
      FrTp
      FrTrcv
      Fr
      IpduM
      PduR
      Srv
      Vin
      GateDrv0Ctrl
      Spi
      Dio
      MotCtrlMgr
      NvMProxy
      NxtrSwIds
      ComM
      NxtrMfgSrv
      E2EPW
      Rte
      Xcp
      MotAg0Meas
      BmwHwAgArbnAndEotPosn
      VrfyCritReg
      DiagcMgr
      XcpIf
      RvsBattProtn
      BattRtnCurr
      DlogClassic
      Dlog
      StdDiagClassic
      StdDiag
      Omc
      Darh
      DarhClassic
      StmClassic
      RmhClassic
      SysTime
      SysTimeClassic
      Crypto
      CryptoClassic
      BmwTunSetHndlr
      CodingClassic
      Os
      MotAg3Meas
      MotAg4Meas
      SerlComTrcvIf
      MotAg1Meas
      TunSelnMngt
      Dcm
      Dem
      Port
      EcuTMeas
      Coding
      DlogShared
