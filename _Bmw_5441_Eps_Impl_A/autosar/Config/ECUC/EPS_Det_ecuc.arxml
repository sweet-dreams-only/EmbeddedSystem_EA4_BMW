AUTOSAR XML (schema 4-3-0)
package /ActiveEcuC
  module config Det: implementation-config-variant=VARIANT-PRE-COMPILE, module-description=Det_Impl
    DetGeneral:
      DetVersionInfoApi = false
      DetEnableDet = true
      DetExtDebugSupport = false
      DetGlobalFilterSize = 0
      DetBreakFilterSize = 0
      DetLogBufferSize = 0
      DetReportErrorRecursionLimit = 0
      DetReportRuntimeErrorRecursionLimit = 0
      DetReportTransientFaultRecursionLimit = 0
      DetDltFilterSize = 0
      DetForwardToDlt = false
    DetConfigSet
      DetModule: DetModuleId=4096
        DetModuleInstance: DetInstanceId=0
