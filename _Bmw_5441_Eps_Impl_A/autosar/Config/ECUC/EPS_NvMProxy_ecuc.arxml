AUTOSAR XML (schema 4-3-0)
package /ActiveEcuC
  module config NvMProxy: implementation-config-variant=VARIANT-PRE-COMPILE, module-description=NvMProxy_Impl
    NvMProxyCommon: NvMOsApplicationRef=Appl10
    47 x NvMProxyBlkSet, all with NvMProxyApplCallCbk=NULL_PTR:
      Rte_NvmBlock_CDD_NvMProxy_ShtdwnClsChk: NvMBlkFlt=None, NvMBlkRef=Rte_NvmBlock_CDD_NvMProxy_ShtdwnClsChk
      Rte_NvmBlock_DiagcMgr_DiagcMgrApplCrc: NvMBlkFlt=NTC_0x06, NvMBlkRef=Rte_NvmBlock_DiagcMgr_DiagcMgrApplCrc
      Rte_NvmBlock_DiagcMgr_DiagcMgrLtchCntrAry: NvMBlkFlt=NTC_0x06, NvMBlkRef=Rte_NvmBlock_DiagcMgr_DiagcMgrLtchCntrAry
      Rte_NvmBlock_DiagcMgr_DiagcMgrNtcFltAry: NvMBlkFlt=NTC_0x06, NvMBlkRef=Rte_NvmBlock_DiagcMgr_DiagcMgrNtcFltAry
      Rte_NvmBlock_PolarityCfg_PolarityCfgSaved: NvMBlkFlt=NTC_0x0A, NvMBlkRef=Rte_NvmBlock_PolarityCfg_PolarityCfgSaved
      Rte_NvmBlock_CDD_MotAgCmp_MotAgCmpMotAgBackEmf: NvMBlkFlt=NTC_0x0A, NvMBlkRef=Rte_NvmBlock_CDD_MotAgCmp_MotAgCmpMotAgBackEmf
      Rte_NvmBlock_HwTqCorrln_HwTqChACmnModCmpLpFilSt: NvMBlkFlt=NTC_0x06, NvMBlkRef=Rte_NvmBlock_HwTqCorrln_HwTqChACmnModCmpLpFilSt
      Rte_NvmBlock_MotTqCmdSca_MotTqScaFac: NvMBlkFlt=NTC_0x06, NvMBlkRef=Rte_NvmBlock_MotTqCmdSca_MotTqScaFac
      Rte_NvmBlock_MotCtrlPrmEstimn_MotPrmNom: NvMBlkFlt=NTC_0x06, NvMBlkRef=Rte_NvmBlock_MotCtrlPrmEstimn_MotPrmNom
      Rte_NvmBlock_CDD_CurrMeas_CurrMeasEolGainCalSetABC: NvMBlkFlt=NTC_0x06, NvMBlkRef=Rte_NvmBlock_CDD_CurrMeas_CurrMeasEolGainCalSetABC
      Rte_NvmBlock_CDD_CurrMeas_CurrMeasEolOffsCalSetABC: NvMBlkFlt=NTC_0x06, NvMBlkRef=Rte_NvmBlock_CDD_CurrMeas_CurrMeasEolOffsCalSetABC
      Rte_NvmBlock_CDD_HwTq4Meas_HwTq4Offs_MirrorBlock: NvMBlkFlt=NTC_0x0A, NvMBlkRef=Rte_NvmBlock_CDD_HwTq4Meas_HwTq4Offs_MirrorBlock
      Rte_NvmBlock_CDD_HwTq4Meas_HwTq4Sca_MirrorBlock: NvMBlkFlt=NTC_0x0A, NvMBlkRef=Rte_NvmBlock_CDD_HwTq4Meas_HwTq4Sca_MirrorBlock
      Rte_NvmBlock_CDD_HwTq5Meas_HwTq5Offs_MirrorBlock: NvMBlkFlt=NTC_0x0A, NvMBlkRef=Rte_NvmBlock_CDD_HwTq5Meas_HwTq5Offs_MirrorBlock
      Rte_NvmBlock_CDD_HwTq5Meas_HwTq5Sca_MirrorBlock: NvMBlkFlt=NTC_0x0A, NvMBlkRef=Rte_NvmBlock_CDD_HwTq5Meas_HwTq5Sca_MirrorBlock
      Rte_NvmBlock_CDD_MotAg0Meas_MotAg0CoeffTbl: NvMBlkFlt=NTC_0x08, NvMBlkRef=Rte_NvmBlock_CDD_MotAg0Meas_MotAg0CoeffTbl
      Rte_NvmBlock_CDD_MotAg1Meas_MotAg1CoeffTbl: NvMBlkFlt=NTC_0x08, NvMBlkRef=Rte_NvmBlock_CDD_MotAg1Meas_MotAg1CoeffTbl
      Rte_NvmBlock_CmnMfgSrv_CcaHwPartNr: NvMBlkFlt=NTC_0x06, NvMBlkRef=Rte_NvmBlock_CmnMfgSrv_CcaHwPartNr
      Rte_NvmBlock_CmnMfgSrv_CcaSerlNr: NvMBlkFlt=NTC_0x06, NvMBlkRef=Rte_NvmBlock_CmnMfgSrv_CcaSerlNr
      Rte_NvmBlock_CmnMfgSrv_DiRestore: NvMBlkFlt=NTC_0x06, NvMBlkRef=Rte_NvmBlock_CmnMfgSrv_DiRestore
      Rte_NvmBlock_CmnMfgSrv_EpsSysSerlNr: NvMBlkFlt=NTC_0x06, NvMBlkRef=Rte_NvmBlock_CmnMfgSrv_EpsSysSerlNr
      Rte_NvmBlock_CmnMfgSrv_IgnCntr: NvMBlkFlt=NTC_0x06, NvMBlkRef=Rte_NvmBlock_CmnMfgSrv_IgnCntr
      Rte_NvmBlock_CmnMfgSrv_MfgTmpBuf{0..4}: NvMBlkFlt=NTC_0x06, NvMBlkRef=Rte_NvmBlock_CmnMfgSrv_MfgTmpBuf{0..4}
      Rte_NvmBlock_CmnMfgSrv_NxtrMfgEnaCntr: NvMBlkFlt=NTC_0x06, NvMBlkRef=Rte_NvmBlock_CmnMfgSrv_NxtrMfgEnaCntr
      Rte_NvmBlock_CmnMfgSrv_SeedKey: NvMBlkFlt=NTC_0x06, NvMBlkRef=Rte_NvmBlock_CmnMfgSrv_SeedKey
      Rte_NvmBlock_DutyCycThermProtn_FilStVal: NvMBlkFlt=NTC_0x08, NvMBlkRef=Rte_NvmBlock_DutyCycThermProtn_FilStVal
      Rte_NvmBlock_CDD_VrfyCritReg_MCalReadVrfyCritRegFltInfo: NvMBlkFlt=None, NvMBlkRef=Rte_NvmBlock_CDD_VrfyCritReg_MCalReadVrfyCritRegFltInfo
      Rte_NvmBlock_BmwHwAgArbnAndEotPosn_BmwVehCentrOffs: NvMBlkFlt=NTC_0x06, NvMBlkRef=Rte_NvmBlock_BmwHwAgArbnAndEotPosn_BmwVehCentrOffs
      Rte_NvmBlock_LrndRackCentr_LrndRackCentr: NvMBlkFlt=NTC_0x07, NvMBlkRef=Rte_NvmBlock_LrndRackCentr_LrndRackCentr
      Rte_NvmBlock_ExcpnHndlg_McuDiagcData: NvMBlkFlt=NTC_0x06, NvMBlkRef=Rte_NvmBlock_ExcpnHndlg_McuDiagcData
      Rte_NvmBlock_TEstimn_TFilStVal: NvMBlkFlt=NTC_0x08, NvMBlkRef=Rte_NvmBlock_TEstimn_TFilStVal
      NVM_BLOCK_DLOG_SVK_ENTRY: NvMBlkFlt=None, NvMBlkRef=NVM_BLOCK_DLOG_SVK_ENTRY
      Rte_NvmBlock_Darh_DiagnoseMasterEnable: NvMBlkFlt=None, NvMBlkRef=Rte_NvmBlock_Darh_DiagnoseMasterEnable
      Rte_NvmBlock_Coding_CodingData: NvMBlkFlt=None, NvMBlkRef=Rte_NvmBlock_Coding_CodingData
      Rte_NvmBlock_BmwTunSetHndlr_BmwDesIninIdx: NvMBlkFlt=NTC_0x06, NvMBlkRef=Rte_NvmBlock_BmwTunSetHndlr_BmwDesIninIdx
      Rte_NvmBlock_BmwTunSetHndlr_NvmBmwDesIninOptSetAIdx: NvMBlkFlt=NTC_0x06, NvMBlkRef=Rte_NvmBlock_BmwTunSetHndlr_NvmBmwDesIninOptSetAIdx
      Rte_NvmBlock_BmwDiagcSrvHndlg_MilesKmEeprom: NvMBlkFlt=None, NvMBlkRef=Rte_NvmBlock_BmwDiagcSrvHndlg_MilesKmEeprom
      Rte_NvmBlock_BmwDiagcSrvHndlg_ProgCntr: NvMBlkFlt=None, NvMBlkRef=Rte_NvmBlock_BmwDiagcSrvHndlg_ProgCntr
      Rte_NvmBlock_BmwDiagcSrvHndlg_ProgCntrMaxVal: NvMBlkFlt=None, NvMBlkRef=Rte_NvmBlock_BmwDiagcSrvHndlg_ProgCntrMaxVal
      Rte_NvmBlock_BmwDiagcSrvHndlg_TestStamp: NvMBlkFlt=None, NvMBlkRef=Rte_NvmBlock_BmwDiagcSrvHndlg_TestStamp
      Rte_NvmBlock_SysFricLrng_FricNonLrngData: NvMBlkFlt=NTC_0x06, NvMBlkRef=Rte_NvmBlock_SysFricLrng_FricNonLrngData
      Rte_NvmBlock_SysFricLrng_FricLrngData: NvMBlkFlt=NTC_0x06, NvMBlkRef=Rte_NvmBlock_SysFricLrng_FricLrngData
      Rte_NvmBlock_PullCmpActv_PullCmpLongTerm: NvMBlkFlt=None, NvMBlkRef=Rte_NvmBlock_PullCmpActv_PullCmpLongTerm
