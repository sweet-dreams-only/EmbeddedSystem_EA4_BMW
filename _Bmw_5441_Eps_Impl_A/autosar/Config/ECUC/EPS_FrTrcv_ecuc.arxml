AUTOSAR XML (schema 4-3-0)
package /ActiveEcuC
  module config FrTrcv: implementation-config-variant=VARIANT-PRE-COMPILE, module-description=FrTrcv_Impl
    FrTrcvChannel:
      FrTrcvChannelId = 0
      FrTrcvChannelUsed = true
      FrTrcvControlsPowerSupply = false
      FrTrcvInitState = FRTRCV_TRCVMODE_NORMAL
      FrTrcvMaxBaudrate = FR_10M
      FrTrcvWakeupByBusUsed = false
      FrTrcvAccess
        FrTrcvDioAccess
          STBN (FrTrcvDioChannelAccess): FrTrcvHardwareInterfaceName=STBN, FrTrcvDioSymNameRef=FrStb
          ERRN (FrTrcvDioChannelAccess): FrTrcvHardwareInterfaceName=ERRN, FrTrcvDioSymNameRef=FrErr
      FrTrcvBranchIdContainer: FrTrcvBranchId=0
    FrTrcvGeneral:
      FrTrcvDevErrorDetect = false
      FrTrcvErrorCheckDuringCommunication = false
      FrTrcvErrorCheckInInit = false
      FrTrcvGetVersionInfo = true
      FrTrcvIndex = 0
      FrTrcvMainFunctionCycleTime = 0.005
      FrTrcvRetryCountInInit = 0
      FrTrcvWaitCount = 0
      FrTrcvWakeUpSupport = FRTRCV_WAKEUP_NOT_SUPPORTED
      FrTrcvUserConfigFile = 
      FrTrcvDemCallback = false
      FrTrcvSafeBswChecks = true
