AUTOSAR XML (schema 4-0-3)
package /Renesas/EcucDefs_Mcu
  ecuc value collection ECUConfiguration: ecuc-values=Mcu0
  module config Mcu0: definition=Mcu, implementation-config-variant=VARIANT-POST-BUILD, module-description=Mcu_Impl
    McuPublishedInformation0 (McuPublishedInformation)
      McuResetReasonConf0 (McuResetReasonConf): McuResetReason=0
      McuRstRsnConfPowOnClr0 (McuRstRsnConfPowOnClr): McuResetReason=0
      McuRstRsnConfPinRst0 (McuRstRsnConfPinRst): McuResetReason=1
      McuRstRsnConfSwRst0 (McuRstRsnConfSwRst): McuResetReason=2
      McuRstRsnConfWdta0 (McuRstRsnConfWdta): McuResetReason=3
      McuRstRsnConfLockStepCompare0 (McuRstRsnConfLockStepCompare): McuResetReason=4
      McuRstRsnConfClkMonUprLimErMosc0 (McuRstRsnConfClkMonUprLimErMosc): McuResetReason=5
      McuRstRsnConfClkMonLwrLimErMosc0 (McuRstRsnConfClkMonLwrLimErMosc): McuResetReason=6
      McuRstRsnConfClkMonUprLimErWdt0 (McuRstRsnConfClkMonUprLimErWdt): McuResetReason=7
      McuRstRsnConfClkMonLwrLimErWdt0 (McuRstRsnConfClkMonLwrLimErWdt): McuResetReason=8
      McuRstRsnConfClkMonUprLimErPclk0 (McuRstRsnConfClkMonUprLimErPclk): McuResetReason=9
      McuRstRsnConfClkMonLwrLimErPclk0 (McuRstRsnConfClkMonLwrLimErPclk): McuResetReason=10
      McuRstRsnConfClkMonUprLimErPe10 (McuRstRsnConfClkMonUprLimErPe1): McuResetReason=11
      McuRstRsnConfClkMonLwrLimErPe10 (McuRstRsnConfClkMonLwrLimErPe1): McuResetReason=12
      McuRstRsnConfLRamEcc2AddPrty0 (McuRstRsnConfLRamEcc2AddPrty): McuResetReason=13
      McuRstRsnConfInstCacheRamEcc20 (McuRstRsnConfInstCacheRamEcc2): McuResetReason=14
      McuRstRsnConfCodeFlsEcc2AddPrty0 (McuRstRsnConfCodeFlsEcc2AddPrty): McuResetReason=15
      McuRstRsnConfDataFlsEcc20 (McuRstRsnConfDataFlsEcc2): McuResetReason=16
      McuRstRsnConfDtsRamEcc20 (McuRstRsnConfDtsRamEcc2): McuResetReason=17
      McuRstRsnConfCsihRamEcc20 (McuRstRsnConfCsihRamEcc2): McuResetReason=18
      McuRstRsnConfCanRamEcc20 (McuRstRsnConfCanRamEcc2): McuResetReason=19
      McuRstRsnConfFrRamEcc20 (McuRstRsnConfFrRamEcc2): McuResetReason=20
      McuRstRsnConfFlsProgMode0 (McuRstRsnConfFlsProgMode): McuResetReason=21
      McuRstRsnConfTestMode0 (McuRstRsnConfTestMode): McuResetReason=22
      McuRstRsnConfSingChipModInact0 (McuRstRsnConfSingChipModInact): McuResetReason=23
      McuRstRsnConfPeGuard0 (McuRstRsnConfPeGuard): McuResetReason=24
      McuRstRsnConfPBusGuard0 (McuRstRsnConfPBusGuard): McuResetReason=25
      McuRstRsnConfSarAdcPrty0 (McuRstRsnConfSarAdcPrty): McuResetReason=26
      McuRstRsnConfBusDataPrty0 (McuRstRsnConfBusDataPrty): McuResetReason=27
      McuRstRsnConfEcmCompare0 (McuRstRsnConfEcmCompare): McuResetReason=28
      McuRstRsnConfLvi0 (McuRstRsnConfLvi): McuResetReason=29
      McuRstRsnConfTempSensor0 (McuRstRsnConfTempSensor): McuResetReason=30
      McuRstRsnConfDmaTrans0 (McuRstRsnConfDmaTrans): McuResetReason=31
      McuRstRsnConfDmaViol0 (McuRstRsnConfDmaViol): McuResetReason=32
      McuRstRsnConfLRamEcc10 (McuRstRsnConfLRamEcc1): McuResetReason=33
      McuRstRsnConfCodeFlsEcc10 (McuRstRsnConfCodeFlsEcc1): McuResetReason=34
      McuRstRsnConfDataFlsEcc10 (McuRstRsnConfDataFlsEcc1): McuResetReason=35
      McuRstRsnConfDtsRamEcc10 (McuRstRsnConfDtsRamEcc1): McuResetReason=36
      McuRstRsnConfPeriRamEcc10 (McuRstRsnConfPeriRamEcc1): McuResetReason=37
      McuRstRsnConfBistCodeEcc10 (McuRstRsnConfBistCodeEcc1): McuResetReason=38
      McuRstRsnConfBistCodeEcc20 (McuRstRsnConfBistCodeEcc2): McuResetReason=39
      McuRstRsnConfFaci0 (McuRstRsnConfFaci): McuResetReason=40
      McuRstRsnConfEcmDelayOverFlow0 (McuRstRsnConfEcmDelayOverFlow): McuResetReason=41
      McuRstRsnConfCvmRst0 (McuRstRsnConfCvmRst): McuResetReason=42
      McuRstRsnConfRstUndefined0 (McuRstRsnConfRstUndefined): McuResetReason=43
      McuRstRsnConfRstUnknown0 (McuRstRsnConfRstUnknown): McuResetReason=44
    McuGeneralConfiguration0 (McuGeneralConfiguration):
      McuVersionCheckExternalModules = 1
      McuDevErrorDetect = 1
      McuGetRamStateApi = 1
      McuInitClock = 1
      McuNoPll = 1
      McuPerformResetApi = 1
      McuVersionInfoApi = 1
      McuCriticalSectionProtection = 1
      McuSwResetCallApi = 0
      McuEcmDelayTimerOverflowValue = 65535
      McuEcmErrorOutputMode = NON_DYNAMIC_MODE
      McuEcmErrorOutTimer = 0
      McuRamSectorSetting = 1
      McuDeviceName = R7F701319
      McuClm0Operation = 1
      McuClm0MonitoringClockAccuracy = 9
      McuClm0SamplingClockAccuracy = 9
      McuClm1Operation = 1
      McuClm1MonitoringClockAccuracy = 9
      McuClm1SamplingClockAccuracy = 9
      McuClm2Operation = 1
      McuClm2MonitoringClockAccuracy = 14
      McuClm2SamplingClockAccuracy = 14
      McuClm3Operation = 1
      McuClm3MonitoringClockAccuracy = 14
      McuClm3SamplingClockAccuracy = 14
      McuCvmSelfDiagnosticTest = 1
      McuClma{0..3}SelfDiagnosticTest = 1
      McuEcmSelfDiagnosticTest = 1
      McuWriteVerify = WV_DISABLE
      McuLoopCount = 5
      McuLockStepSelfDiagnosticTest = 0
      McuStartUpSWResetTest = 0
      McuStartUpECMResetTest = 0
      McuInterruptConsistencyCheck = 0
      Mcu_UseWVErrorInterface = 0
      McuWVErrorNotification = NULL
    McuModuleConfiguration0 (McuModuleConfiguration):
      McuClockSrcFailureNotification = DISABLED
      McuLviDetectionLevel = DETECTION_LEVEL_0
      McuLviResetMask = 0
      McuNumberOfMcuModes = 1
      McuRamSectors = 1
      McuResetSetting = 1
      McuCvmOutMaskFbist = 0
      McuCvmOutMaskDiag = 0
      McuCvmOutputFilter = 0
      McuCvmDiagLockBit = 1
      McuCvmResetEnable = 0
      McuClockSettingConfig0 (McuClockSettingConfig): McuClockSettingId=0, McuMainOsciFrequency=16000000, McuCpuMainSysClk=160000000, McuUnitName=CLK_CPU
        McuHighspeedPeriClk0 (McuHighspeedPeriClk): McuUnitName=CLK_HSB, McuPeripheralClock=80000000
        McuLowspeedPeriClk0 (McuLowspeedPeriClk): McuUnitName=CLK_LSB, McuPeripheralClock=40000000
        McuWdtacounterClk0 (McuWdtacounterClk): McuWdtCounterDivider=DIVBY_1_ID_1, McuUnitName=WDTCLKI, McuPeripheralClock=8000000
        McuExternalClkOutSetting0 (McuExternalClkOutSetting):
          McuExternalClk0SourceSel = MCU_MAIN_OSCILLATOR
          McuExternalClk0DividerSel = 1
          McuExternalClock0 = 16000000
          McuExternalClk1SourceSel = MCU_INTERNAL_OSCILLATION_CLOCK
          McuExternalClk1DividerSel = 1
          McuExternalClock1 = 8000000
        McuAdcClk0 (McuAdcClk): McuDivClockSel=CLK_LSB, McuUnitName=ADC, McuPeripheralClock=40000000
        McuClockReferencePoint0 (McuClockReferencePoint): McuClockReferencePointFrequency=0
      McuEcmErrorSourcesCfg0 (McuEcmErrorSourcesCfg)
        McuEcmErrorSource00 (McuEcmErrorSource0):
          McuEcmErrorMaskableInterrupt = 1
          McuEcmErrorNonMaskableInterrupt = 0
          McuEcmErrorInternalReset = 0
          McuEcmErrorNMIDelayTimer = 0
          McuEcmErrorMIDelayTimer = 0
          McuEcmErrorOutputMask = 0
          McuMiNotification = NULL_PTR
          McuNmiNotification = NULL_PTR
          McuEcmInitialNotification = NULL_PTR
        McuEcmErrorSource10 (McuEcmErrorSource1):
          McuEcmErrorMaskableInterrupt = 1
          McuEcmErrorNonMaskableInterrupt = 0
          McuEcmErrorInternalReset = 0
          McuEcmErrorNMIDelayTimer = 0
          McuEcmErrorMIDelayTimer = 0
          McuEcmErrorOutputMask = 0
          McuMiNotification = NULL_PTR
          McuNmiNotification = NULL_PTR
          McuEcmInitialNotification = NULL_PTR
        McuEcmErrorSource40 (McuEcmErrorSource4):
          McuEcmErrorMaskableInterrupt = 1
          McuEcmErrorNonMaskableInterrupt = 0
          McuEcmErrorInternalReset = 0
          McuEcmErrorNMIDelayTimer = 0
          McuEcmErrorMIDelayTimer = 0
          McuEcmErrorOutputMask = 0
          McuMiNotification = NULL_PTR
          McuNmiNotification = NULL_PTR
          McuEcmInitialNotification = NULL_PTR
        McuEcmErrorSource50 (McuEcmErrorSource5):
          McuEcmErrorMaskableInterrupt = 0
          McuEcmErrorNonMaskableInterrupt = 0
          McuEcmErrorInternalReset = 0
          McuEcmErrorNMIDelayTimer = 0
          McuEcmErrorMIDelayTimer = 0
          McuEcmErrorOutputMask = 0
          McuMiNotification = NULL_PTR
          McuNmiNotification = NULL_PTR
          McuEcmInitialNotification = NULL_PTR
        McuEcmErrorSource60 (McuEcmErrorSource6):
          McuEcmErrorMaskableInterrupt = 1
          McuEcmErrorNonMaskableInterrupt = 0
          McuEcmErrorInternalReset = 0
          McuEcmErrorNMIDelayTimer = 0
          McuEcmErrorMIDelayTimer = 0
          McuEcmErrorOutputMask = 0
          McuMiNotification = NULL_PTR
          McuNmiNotification = NULL_PTR
          McuEcmInitialNotification = NULL_PTR
        McuEcmErrorSource70 (McuEcmErrorSource7):
          McuEcmErrorMaskableInterrupt = 1
          McuEcmErrorNonMaskableInterrupt = 0
          McuEcmErrorInternalReset = 0
          McuEcmErrorNMIDelayTimer = 0
          McuEcmErrorMIDelayTimer = 0
          McuEcmErrorOutputMask = 0
          McuMiNotification = NULL_PTR
          McuNmiNotification = NULL_PTR
          McuEcmInitialNotification = NULL_PTR
        McuEcmErrorSource80 (McuEcmErrorSource8):
          McuEcmErrorMaskableInterrupt = 1
          McuEcmErrorNonMaskableInterrupt = 0
          McuEcmErrorInternalReset = 0
          McuEcmErrorNMIDelayTimer = 0
          McuEcmErrorMIDelayTimer = 0
          McuEcmErrorOutputMask = 0
          McuMiNotification = NULL_PTR
          McuNmiNotification = NULL_PTR
          McuEcmInitialNotification = NULL_PTR
        McuEcmErrorSource90 (McuEcmErrorSource9):
          McuEcmErrorMaskableInterrupt = 1
          McuEcmErrorNonMaskableInterrupt = 0
          McuEcmErrorInternalReset = 0
          McuEcmErrorNMIDelayTimer = 0
          McuEcmErrorMIDelayTimer = 0
          McuEcmErrorOutputMask = 0
          McuMiNotification = NULL_PTR
          McuNmiNotification = NULL_PTR
          McuEcmInitialNotification = NULL_PTR
        McuEcmErrorSource100 (McuEcmErrorSource10):
          McuEcmErrorMaskableInterrupt = 1
          McuEcmErrorNonMaskableInterrupt = 0
          McuEcmErrorInternalReset = 0
          McuEcmErrorNMIDelayTimer = 0
          McuEcmErrorMIDelayTimer = 0
          McuEcmErrorOutputMask = 0
          McuMiNotification = NULL_PTR
          McuNmiNotification = NULL_PTR
          McuEcmInitialNotification = NULL_PTR
        McuEcmErrorSource110 (McuEcmErrorSource11):
          McuEcmErrorMaskableInterrupt = 1
          McuEcmErrorNonMaskableInterrupt = 0
          McuEcmErrorInternalReset = 0
          McuEcmErrorNMIDelayTimer = 0
          McuEcmErrorMIDelayTimer = 0
          McuEcmErrorOutputMask = 0
          McuMiNotification = NULL_PTR
          McuNmiNotification = NULL_PTR
          McuEcmInitialNotification = NULL_PTR
        McuEcmErrorSource120 (McuEcmErrorSource12):
          McuEcmErrorMaskableInterrupt = 1
          McuEcmErrorNonMaskableInterrupt = 0
          McuEcmErrorInternalReset = 0
          McuEcmErrorNMIDelayTimer = 0
          McuEcmErrorMIDelayTimer = 0
          McuEcmErrorOutputMask = 0
          McuMiNotification = MI_Notification
          McuNmiNotification = NULL_PTR
          McuEcmInitialNotification = NULL_PTR
        McuEcmErrorSource140 (McuEcmErrorSource14):
          McuEcmErrorMaskableInterrupt = 1
          McuEcmErrorNonMaskableInterrupt = 0
          McuEcmErrorInternalReset = 0
          McuEcmErrorNMIDelayTimer = 0
          McuEcmErrorMIDelayTimer = 0
          McuEcmErrorOutputMask = 0
          McuMiNotification = NULL_PTR
          McuNmiNotification = NULL_PTR
          McuEcmInitialNotification = NULL_PTR
        McuEcmErrorSource150 (McuEcmErrorSource15):
          McuEcmErrorMaskableInterrupt = 1
          McuEcmErrorNonMaskableInterrupt = 0
          McuEcmErrorInternalReset = 0
          McuEcmErrorNMIDelayTimer = 0
          McuEcmErrorMIDelayTimer = 0
          McuEcmErrorOutputMask = 0
          McuMiNotification = NULL_PTR
          McuNmiNotification = NULL_PTR
          McuEcmInitialNotification = NULL_PTR
        McuEcmErrorSource160 (McuEcmErrorSource16):
          McuEcmErrorMaskableInterrupt = 1
          McuEcmErrorNonMaskableInterrupt = 0
          McuEcmErrorInternalReset = 0
          McuEcmErrorNMIDelayTimer = 0
          McuEcmErrorMIDelayTimer = 0
          McuEcmErrorOutputMask = 0
          McuMiNotification = NULL_PTR
          McuNmiNotification = NULL_PTR
          McuEcmInitialNotification = NULL_PTR
        McuEcmErrorSource170 (McuEcmErrorSource17):
          McuEcmErrorMaskableInterrupt = 1
          McuEcmErrorNonMaskableInterrupt = 0
          McuEcmErrorInternalReset = 0
          McuEcmErrorNMIDelayTimer = 0
          McuEcmErrorMIDelayTimer = 0
          McuEcmErrorOutputMask = 0
          McuMiNotification = NULL_PTR
          McuNmiNotification = NULL_PTR
          McuEcmInitialNotification = NULL_PTR
        McuEcmErrorSource180 (McuEcmErrorSource18):
          McuEcmErrorMaskableInterrupt = 1
          McuEcmErrorNonMaskableInterrupt = 0
          McuEcmErrorInternalReset = 0
          McuEcmErrorNMIDelayTimer = 0
          McuEcmErrorMIDelayTimer = 0
          McuEcmErrorOutputMask = 0
          McuMiNotification = NULL_PTR
          McuNmiNotification = NULL_PTR
          McuEcmInitialNotification = NULL_PTR
        McuEcmErrorSource190 (McuEcmErrorSource19):
          McuEcmErrorMaskableInterrupt = 1
          McuEcmErrorNonMaskableInterrupt = 0
          McuEcmErrorInternalReset = 0
          McuEcmErrorNMIDelayTimer = 0
          McuEcmErrorMIDelayTimer = 0
          McuEcmErrorOutputMask = 0
          McuMiNotification = NULL_PTR
          McuNmiNotification = NULL_PTR
          McuEcmInitialNotification = NULL_PTR
        McuEcmErrorSource200 (McuEcmErrorSource20):
          McuEcmErrorMaskableInterrupt = 1
          McuEcmErrorNonMaskableInterrupt = 0
          McuEcmErrorInternalReset = 0
          McuEcmErrorNMIDelayTimer = 0
          McuEcmErrorMIDelayTimer = 0
          McuEcmErrorOutputMask = 0
          McuMiNotification = NULL_PTR
          McuNmiNotification = NULL_PTR
          McuEcmInitialNotification = NULL_PTR
        McuEcmErrorSource210 (McuEcmErrorSource21):
          McuEcmErrorMaskableInterrupt = 1
          McuEcmErrorNonMaskableInterrupt = 0
          McuEcmErrorInternalReset = 0
          McuEcmErrorNMIDelayTimer = 0
          McuEcmErrorMIDelayTimer = 0
          McuEcmErrorOutputMask = 0
          McuMiNotification = NULL_PTR
          McuNmiNotification = NULL_PTR
          McuEcmInitialNotification = NULL_PTR
        McuEcmErrorSource220 (McuEcmErrorSource22):
          McuEcmErrorMaskableInterrupt = 1
          McuEcmErrorNonMaskableInterrupt = 0
          McuEcmErrorInternalReset = 0
          McuEcmErrorNMIDelayTimer = 0
          McuEcmErrorMIDelayTimer = 0
          McuEcmErrorOutputMask = 0
          McuMiNotification = NULL_PTR
          McuNmiNotification = NULL_PTR
          McuEcmInitialNotification = NULL_PTR
        McuEcmErrorSource230 (McuEcmErrorSource23):
          McuEcmErrorMaskableInterrupt = 1
          McuEcmErrorNonMaskableInterrupt = 0
          McuEcmErrorInternalReset = 0
          McuEcmErrorNMIDelayTimer = 0
          McuEcmErrorMIDelayTimer = 0
          McuEcmErrorOutputMask = 0
          McuMiNotification = NULL_PTR
          McuNmiNotification = NULL_PTR
          McuEcmInitialNotification = NULL_PTR
        McuEcmErrorSource240 (McuEcmErrorSource24):
          McuEcmErrorMaskableInterrupt = 1
          McuEcmErrorNonMaskableInterrupt = 0
          McuEcmErrorInternalReset = 0
          McuEcmErrorNMIDelayTimer = 0
          McuEcmErrorMIDelayTimer = 0
          McuEcmErrorOutputMask = 0
          McuMiNotification = NULL_PTR
          McuNmiNotification = NULL_PTR
          McuEcmInitialNotification = NULL_PTR
        McuEcmErrorSource260 (McuEcmErrorSource26):
          McuEcmErrorMaskableInterrupt = 0
          McuEcmErrorNonMaskableInterrupt = 0
          McuEcmErrorInternalReset = 0
          McuEcmErrorNMIDelayTimer = 0
          McuEcmErrorMIDelayTimer = 0
          McuEcmErrorOutputMask = 1
          McuMiNotification = NULL_PTR
          McuNmiNotification = NULL_PTR
          McuEcmInitialNotification = NULL_PTR
        McuEcmErrorSource270 (McuEcmErrorSource27):
          McuEcmErrorMaskableInterrupt = 0
          McuEcmErrorNonMaskableInterrupt = 0
          McuEcmErrorInternalReset = 0
          McuEcmErrorNMIDelayTimer = 0
          McuEcmErrorMIDelayTimer = 0
          McuEcmErrorOutputMask = 1
          McuMiNotification = NULL_PTR
          McuNmiNotification = NULL_PTR
          McuEcmInitialNotification = NULL_PTR
        McuEcmErrorSource280 (McuEcmErrorSource28):
          McuEcmErrorMaskableInterrupt = 1
          McuEcmErrorNonMaskableInterrupt = 0
          McuEcmErrorInternalReset = 0
          McuEcmErrorNMIDelayTimer = 0
          McuEcmErrorMIDelayTimer = 0
          McuEcmErrorOutputMask = 0
          McuMiNotification = NULL_PTR
          McuNmiNotification = NULL_PTR
          McuEcmInitialNotification = NULL_PTR
        McuEcmErrorSource290 (McuEcmErrorSource29):
          McuEcmErrorMaskableInterrupt = 0
          McuEcmErrorNonMaskableInterrupt = 0
          McuEcmErrorInternalReset = 0
          McuEcmErrorNMIDelayTimer = 0
          McuEcmErrorMIDelayTimer = 0
          McuEcmErrorOutputMask = 1
          McuMiNotification = NULL_PTR
          McuNmiNotification = NULL_PTR
          McuEcmInitialNotification = NULL_PTR
        McuEcmErrorSource300 (McuEcmErrorSource30):
          McuEcmErrorMaskableInterrupt = 1
          McuEcmErrorNonMaskableInterrupt = 0
          McuEcmErrorInternalReset = 0
          McuEcmErrorNMIDelayTimer = 0
          McuEcmErrorMIDelayTimer = 0
          McuEcmErrorOutputMask = 0
          McuMiNotification = NULL_PTR
          McuNmiNotification = NULL_PTR
          McuEcmInitialNotification = NULL_PTR
        McuEcmErrorSource310 (McuEcmErrorSource31):
          McuEcmErrorMaskableInterrupt = 1
          McuEcmErrorNonMaskableInterrupt = 0
          McuEcmErrorInternalReset = 0
          McuEcmErrorNMIDelayTimer = 0
          McuEcmErrorMIDelayTimer = 0
          McuEcmErrorOutputMask = 0
          McuMiNotification = NULL_PTR
          McuNmiNotification = NULL_PTR
          McuEcmInitialNotification = NULL_PTR
        McuEcmErrorSource320 (McuEcmErrorSource32):
          McuEcmErrorMaskableInterrupt = 1
          McuEcmErrorNonMaskableInterrupt = 0
          McuEcmErrorInternalReset = 0
          McuEcmErrorNMIDelayTimer = 0
          McuEcmErrorMIDelayTimer = 0
          McuEcmErrorOutputMask = 0
          McuMiNotification = NULL_PTR
          McuNmiNotification = NULL_PTR
          McuEcmInitialNotification = NULL_PTR
        McuEcmErrorSource330 (McuEcmErrorSource33):
          McuEcmErrorMaskableInterrupt = 1
          McuEcmErrorNonMaskableInterrupt = 0
          McuEcmErrorInternalReset = 0
          McuEcmErrorNMIDelayTimer = 0
          McuEcmErrorMIDelayTimer = 0
          McuEcmErrorOutputMask = 0
          McuMiNotification = NULL_PTR
          McuNmiNotification = NULL_PTR
          McuEcmInitialNotification = NULL_PTR
        McuEcmErrorSource340 (McuEcmErrorSource34):
          McuEcmErrorMaskableInterrupt = 1
          McuEcmErrorNonMaskableInterrupt = 0
          McuEcmErrorInternalReset = 0
          McuEcmErrorNMIDelayTimer = 0
          McuEcmErrorMIDelayTimer = 0
          McuEcmErrorOutputMask = 0
          McuMiNotification = NULL_PTR
          McuNmiNotification = NULL_PTR
          McuEcmInitialNotification = NULL_PTR
        McuEcmErrorSource360 (McuEcmErrorSource36):
          McuEcmErrorMaskableInterrupt = 1
          McuEcmErrorNonMaskableInterrupt = 0
          McuEcmErrorInternalReset = 0
          McuEcmErrorNMIDelayTimer = 0
          McuEcmErrorMIDelayTimer = 0
          McuEcmErrorOutputMask = 0
          McuMiNotification = NULL_PTR
          McuNmiNotification = NULL_PTR
          McuEcmInitialNotification = NULL_PTR
        McuEcmErrorSource370 (McuEcmErrorSource37):
          McuEcmErrorMaskableInterrupt = 1
          McuEcmErrorNonMaskableInterrupt = 0
          McuEcmErrorInternalReset = 0
          McuEcmErrorNMIDelayTimer = 0
          McuEcmErrorMIDelayTimer = 0
          McuEcmErrorOutputMask = 0
          McuMiNotification = NULL_PTR
          McuNmiNotification = NULL_PTR
          McuEcmInitialNotification = NULL_PTR
        McuEcmErrorSource380 (McuEcmErrorSource38):
          McuEcmErrorMaskableInterrupt = 1
          McuEcmErrorNonMaskableInterrupt = 0
          McuEcmErrorInternalReset = 0
          McuEcmErrorNMIDelayTimer = 0
          McuEcmErrorMIDelayTimer = 0
          McuEcmErrorOutputMask = 0
          McuMiNotification = NULL_PTR
          McuNmiNotification = NULL_PTR
          McuEcmInitialNotification = NULL_PTR
        McuEcmErrorSource390 (McuEcmErrorSource39):
          McuEcmErrorMaskableInterrupt = 1
          McuEcmErrorNonMaskableInterrupt = 0
          McuEcmErrorInternalReset = 0
          McuEcmErrorNMIDelayTimer = 0
          McuEcmErrorMIDelayTimer = 0
          McuEcmErrorOutputMask = 0
          McuMiNotification = NULL_PTR
          McuNmiNotification = NULL_PTR
          McuEcmInitialNotification = NULL_PTR
        McuEcmErrorSource400 (McuEcmErrorSource40):
          McuEcmErrorMaskableInterrupt = 1
          McuEcmErrorNonMaskableInterrupt = 0
          McuEcmErrorInternalReset = 0
          McuEcmErrorNMIDelayTimer = 0
          McuEcmErrorMIDelayTimer = 0
          McuEcmErrorOutputMask = 0
          McuMiNotification = NULL_PTR
          McuNmiNotification = NULL_PTR
          McuEcmInitialNotification = NULL_PTR
        McuEcmErrorSource410 (McuEcmErrorSource41):
          McuEcmErrorMaskableInterrupt = 1
          McuEcmErrorNonMaskableInterrupt = 0
          McuEcmErrorInternalReset = 0
          McuEcmErrorNMIDelayTimer = 0
          McuEcmErrorMIDelayTimer = 0
          McuEcmErrorOutputMask = 0
          McuMiNotification = NULL_PTR
          McuNmiNotification = NULL_PTR
          McuEcmInitialNotification = NULL_PTR
        McuEcmErrorSource420 (McuEcmErrorSource42):
          McuEcmErrorMaskableInterrupt = 1
          McuEcmErrorNonMaskableInterrupt = 0
          McuEcmErrorInternalReset = 0
          McuEcmErrorNMIDelayTimer = 0
          McuEcmErrorMIDelayTimer = 0
          McuEcmErrorOutputMask = 0
          McuMiNotification = NULL_PTR
          McuNmiNotification = NULL_PTR
          McuEcmInitialNotification = NULL_PTR
        McuEcmErrorSource1290 (McuEcmErrorSource129): McuEcmErrorInternalReset=0, McuEcmErrorOutputMask=1, McuEcmInitialNotification=NULL_PTR
      McuDemEventParameterRefs0 (McuDemEventParameterRefs):
        MCU_E_CLOCK_FAILURE = DemEventParameter0
        MCU_E_WRITE_TIMEOUT_FAILURE = DemEventParameter1
        MCU_E_CVM_SELFDIAG_FAILURE = DemEventParameter2
        MCU_E_CLM_SELFDIAG_FAILURE = DemEventParameter3
        MCU_E_ECM_SELFDIAG_FAILURE = DemEventParameter4
        MCU_E_LOCKSTEP_SELFDIAG_FAILURE = 
        MCU_E_RESETCONTROLLER_STARTUP_FAILURE = 
        MCU_E_INT_INCONSISTENT = 
        MCU_E_REG_WRITE_VERIFY = DemEventParameter8
      McuModeSettingConf0 (McuModeSettingConf): McuModeType=RUN_MODE, McuMode=0
      McuRamSectorSettingConf0 (McuRamSectorSettingConf): McuRamDefaultValue=255, McuRamSectionBaseAddress=4273926144, McuRamSectionSize=256, McuRamTypeSel=LOCAL_RAM_4273864704_4273995775
