AUTOSAR XML (schema 4-3-0)
package /ActiveEcuC
  module config MemIf: implementation-config-variant=VARIANT-PRE-COMPILE, module-description=MemIf_Impl
    MemIfGeneral: MemIfSafeBswChecks=true, MemIfDevErrorDetect=true, MemIfVersionInfoApi=false
    Fee (MemIfMemHwA): MemIfMemHwAId=0, MemIfMemHwARef=FeeGeneral
