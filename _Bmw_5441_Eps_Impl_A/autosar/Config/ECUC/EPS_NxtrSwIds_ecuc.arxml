AUTOSAR XML (schema 4-3-0)
package /ActiveEcuC
  module config NxtrSwIds: implementation-config-variant=VARIANT-PRE-COMPILE
    NxtrSwIdsGeneral: SwRelNr=BMW_5441, SwRelVer=04.00.00, PrototypeBuild=false, PsrId=0, PsrRev=0
