AUTOSAR XML (schema 4-0-3)
# The material contained in this specification is protected by copyright and
# other types of Intellectual Property Rights. The commercial exploitation of
# the material contained in this specification requires a license to such
# Intellectual Property Rights.
# This specification may be utilized or reproduced without any modification, in
# any form or by any means, for informational purposes only.
# For any other purpose, no part of the specification may be utilized or
# reproduced, in any form or by any means, without permission in writing from
# the publisher.
# licensed under the same rules as applicable to the AUTOSAR Standard.
package /AUTOSAR/EcucDefs
  module definition DoIP [0..1]: variants link-time/post-build/pre-compile  # Configuration of the DoIP (Diagnostic over IP) module.
    container DoIPConfigSet: multiple-configuration-container=true  # This container contains the configuration parameters and sub containers of the AUTOSAR DoIP module. This container is a MultipleConfigurationContainer, i.e. this container and its sub-containers exist once per configuration set.
      integer DoIPEid [0..1]: 1..281474976710656, set at link in variant link-time / post-build in variant post-build / pre-compile in variant pre-compile  # Configured EID (Entity ID of) for vehicle identification/vehicle announcement. Only necessary if DoIPUseMacAddressForIdentification is set to FALSE.
      integer DoIPGid [0..1]: 1..281474976710656, set at link in variant link-time / post-build in variant post-build / pre-compile in variant pre-compile  # Configured GID (Group ID of) for vehicle identification/vehicle announcement.
      integer DoIPLogicalAddress: 1..65535, set at link in variant link-time / post-build in variant post-build / pre-compile in variant pre-compile  # Describes the logical address of the DoIP entity, i.e. the SA that will route diagnostic requests to the Dcm of the DoIP entity.
      container DoIPChannel [1..65536]  # Configuration of one DoIPChannel.
        reference DoIPChannelSARef: destination=DoIPTester  # Reference to the DoIPTester.
        reference DoIPChannelTARef: destination=DoIPTargetAddress  # Reference to the target address.
        container DoIPPduRRxPdu  # This container contains the Rx Pdus to connect with the Rx Pdus of the PduR.
          integer DoIPPduRRxPduId: 1..65535, set at link in variant link-time / post-build in variant post-build / pre-compile in variant pre-compile, symbolic-name-value=true  # The DoIPPduRRxPduId is required by the API call DoIP_CancelReceive.
          reference DoIPPduRRxPduRef: set at link in variant link-time / post-build in variant post-build / pre-compile in variant pre-compile, destination=Pdu  # Reference to the "global" Pdu structure to allow harmonization of handle IDs in the COM-Stack.
        container DoIPPduRTxPdu  # This container contains the Tx Pdus to connect with the Tx Pdus of the PduR.
          integer DoIPPduRTxPduId: 1..65535, set at link in variant link-time / post-build in variant post-build / pre-compile in variant pre-compile, symbolic-name-value=true  # The DoIPPduRTxPduId is required by DoIP_Transmit and DoIP_CancelTransmit.
          reference DoIPPduRTxPduRef: set at link in variant link-time / post-build in variant post-build / pre-compile in variant pre-compile, destination=Pdu  # Reference to the "global" Pdu structure to allow harmonization of handle IDs in the COM-Stack.
      container DoIPConnections  # Container contains all lower layer connection specific information, i.e. the single Pdu References and Handle IDs to the SoAd.
        container DoIPTargetAddress [1..255]  # This container describes a possible TargetAddress that is supported by DoIP.
          integer DoIPTargetAddressValue: 1..65535, set at link in variant link-time / post-build in variant post-build / pre-compile in variant pre-compile  # Valid Target Address of a DoIP target address.
        container DoIPTcpConnection [1..255]  # Each container describes a tcp connection to the lower layer SoAd module.
          container DoIPSoAdRxPdu  # This container contains the Rx Pdus received by DoIP
            integer DoIPSoAdRxPduId: 1..65535, set at link in variant link-time / post-build in variant post-build / pre-compile in variant pre-compile, symbolic-name-value=true  # The DoIPSoAdRxPduId is required by the API call DoIP_SoAdTpRxIndication to receive I-PDUs from the SoAd.
            reference DoIPSoAdRxPduRef: set at link in variant link-time / post-build in variant post-build / pre-compile in variant pre-compile, destination=Pdu  # Reference to the "global" Pdu structure to allow harmonization of handle IDs in the COM-Stack.
          container DoIPSoAdTxPdu  # This container describes the TxPdu sent via the SoAd
            integer DoIPSoAdTxPduId: 1..65535, set at link in variant link-time / post-build in variant post-build / pre-compile in variant pre-compile, symbolic-name-value=true  # The DoIPSoAdTxPduId is required by the API call DoIP_SoAdTpTxConfirmation that is called by the SoAd to confirm that the IPdu has been transmitted successfully.
            reference DoIPSoAdTxPduRef: set at link in variant link-time / post-build in variant post-build / pre-compile in variant pre-compile, destination=Pdu  # Reference to the "global" Pdu structure to allow harmonization of handle IDs in the COM-Stack.
        container DoIPUdpConnection [1..255]  # This Container describes the udp connection to the lower layer SoAd module.
          container DoIPSoAdRxPdu  # This container contains the Rx Pdus received by DoIP
            integer DoIPSoAdRxPduId: 1..65535, set at link in variant link-time / post-build in variant post-build / pre-compile in variant pre-compile, symbolic-name-value=true  # The DoIPSoAdRxPduId is required by the API call DoIP_SoAdTpRxIndication to receive I-PDUs from the SoAd.
            reference DoIPSoAdRxPduRef: set at link in variant link-time / post-build in variant post-build / pre-compile in variant pre-compile, destination=Pdu  # Reference to the "global" Pdu structure to allow harmonization of handle IDs in the COM-Stack.
          container DoIPSoAdTxPdu  # This container describes the TxPdu sent via the SoAd
            integer DoIPSoAdTxPduId: 1..65535, set at link in variant link-time / post-build in variant post-build / pre-compile in variant pre-compile, symbolic-name-value=true  # The DoIPSoAdTxPduId is required by the API call DoIP_SoAdTpTxConfirmation that is called by the SoAd to confirm that the IPdu has been transmitted successfully.
            reference DoIPSoAdTxPduRef: set at link in variant link-time / post-build in variant post-build / pre-compile in variant pre-compile, destination=Pdu  # Reference to the "global" Pdu structure to allow harmonization of handle IDs in the COM-Stack.
      container DoIPRoutingActivation [0..255]: post-build-changeable=true  # This container describes the routing activation possibilities by representing for each container a possible routing activation request message to the DoIP entity and the according references to the activated diagnostic messages.
        integer DoIPRoutingActivationNumber: 0..255, set at link in variant link-time / post-build in variant post-build / pre-compile in variant pre-compile  # Identifies the Routing activation Number which is received for a DoIP routing activation request message.
        reference DoIPTargetAddressRef [1..255]: set at link in variant link-time / post-build in variant post-build / pre-compile in variant pre-compile, destination=DoIPTargetAddress  # Reference to all DoIPTargetAddress which are activated on this Routing activation.
        container DoIPRoutingActivationAuthenticationCallback [0..1]  # Container describes the Callbackfunction to call on a Routing Activation Request for Authentication. If this container is configured but the DoIPRoutingAcivationAuthenticationFunc parameter is not present, the DoIP module will use an RPort of ServiceInterface <RoutingActivation>_RoutingActivation with the name "CB<RoutingActivation>RoutingActivation". <RoutingActivation> is the ShortName of the DoIPRoutingActiviation container.
          function name DoIPRoutingAcivationAuthenticationFunc [0..1]: set at link in variant link-time+post-build / pre-compile in variant pre-compile  # Direct C Callback function to trigger the authentication function for routing activation. If the DoIPRoutingAcivationAuthenticationFunc parameter is present, the DoIP module will not use an RPort of ServiceInterface <RoutingActivation>_RoutingActivation but call the configured function.
          integer DoIPRoutingActivationAuthenticationReqLength: 0..4, set at link in variant link-time+post-build / pre-compile in variant pre-compile  # Describes the amount of bytes used to handle to the authentication function on routing activation. If 0 is configured as length the parameter AuthenticationReqData will not be handled to the API.
          integer DoIPRoutingActivationAuthenticationResLength: 0..4, set at link in variant link-time+post-build / pre-compile in variant pre-compile  # Describes the amount of bytes used to read by the authentication function on routing activation. If 0 is configured as length the parameter AuthenticationResData will not be fetched via the API.
        container DoIPRoutingActivationConfirmationCallback [0..1]  # Container describes the Callbackfunction to call on a Routing Activation Request for Confirmation. If this container is configured but the DoIPRoutingAcivationConfirmationFunc parameter is not present the DoIP module will use an RPort of ServiceInterface <RoutingActivation>_RoutingActivation with the name "CB<RoutingActivation>RoutingActivation". <RoutingActivation> is the ShortName of the DoIPRoutingActiviation container.
          function name DoIPRoutingAcivationConfirmationFunc [0..1]: set at link in variant link-time+post-build / pre-compile in variant pre-compile  # Direct C Callback function to trigger the confirmation function for routing activation. If the DoIPRoutingAcivationConfirmationFunc parameter is present the DoIP module will not use an RPort of ServiceInterface <RoutingActivation>_RoutingActivation but call the configured function.
          integer DoIPRoutingActivationConfirmationReqLength: 0..4, set at link in variant link-time+post-build / pre-compile in variant pre-compile  # Describes the amount of bytes used to handle to the confirmation function on routing activation. If 0 is configured as length the parameter ConfirmedReqData will not be handled to the API.
          integer DoIPRoutingActivationConfirmationResLength: 0..4, set at link in variant link-time+post-build / pre-compile in variant pre-compile  # Describes the amount of bytes used to read by the confirmation function on routing activation. If 0 is configured as length the parameter ConfirmedResData will not be fetched via the API.
      container DoIPTester [0..255]: post-build-changeable=true  # This container describes the properties of the possible connectable Tester for the DoIP entity.
        integer DoIPNumByteDiagAckNack: 1..18446744073709551611, set at link in variant link-time / post-build in variant post-build / pre-compile in variant pre-compile  # Specifies the number of original Diagnostic request bytes the DoIP entity responses on a NACK of a diagnostic response message to the Tester.
        integer DoIPTesterSA: 1..65535, set at link in variant link-time / post-build in variant post-build / pre-compile in variant pre-compile  # Source Address of the Tester sent via routing activation or diagnostic message.
        reference DoIPRoutingActivationRef [1..255]: set at link in variant link-time / post-build in variant post-build / pre-compile in variant pre-compile, destination=DoIPRoutingActivation  # Reference to a DoIPRoutingActivation describing the possible routing activations of the DoIPTester
    container DoIPGeneral  # This container specifies the general configuration parameters of the DoIP module.
      float DoIPAliveCheckResponseTimeout: 0..Inf, set at pre-compile  # Timeout in [s] for waiting for a response to an Alive Check request before the connection is considered to be disconnected. Represents parameter T_TCP_AliveCheck of ISO 13400-2:2012.
      boolean DoIPDevelopmentErrorDetect: set at pre-compile  # Pre-processor switch for enabling development error detection support.
      boolean DoIPDhcpOptionVinUse: set at pre-compile  # If DoIPDhcpOptionVinUse is set to true the DoIP module will add the VIN to the Dhcp host name if no valid Dhcp host name is already set.
      boolean DoIPEntityStatusMaxByteFieldUse: set at pre-compile  # This parameter is used to distinguish the optional support of the Max data size element of a diagnostic entity status response.
      integer DoIPGIDInvalidityPattern: 0..255, set at pre-compile  # Specifies the Byte pattern that is used for response messages if no valid GID could be retrieved.
      float DoIPGeneralInactivityTime: 0..Inf, set at pre-compile  # Timeout in [s] for maximum inactivity of a TCP socket connection before the DoIP module will close the according socket connection. Represents parameter T_TCP_General_Inactivity of ISO 13400-2:2012
      string DoIPHeaderFileInclusion [0..*]: set at pre-compile  # Name of the header file(s) to be included by the DoIP module containing the used C-callback declarations.
      float DoIPInitialInactivityTime: 0..Inf, set at pre-compile  # Timeout in [s] used for initial inactivity of a connected TCP socket connection directly after socket connection. Represents parameter T_TCP_Initial_Inactivity of ISO 13400-2:2012
      float DoIPInitialVehicleAnnouncementTime: 0..Inf, set at pre-compile  # Time to wait in [s] for sending first vehicle anouncement message after IP address assignment. Represents parameter A_DoIP_Announce_Wait of ISO 13400-2:2012
      float DoIPMainFunctionPeriod: 0..Inf, set at pre-compile  # Determines the frequency at which the DoIP_MainFunction() is called in [s].
      integer DoIPMaxRequestBytes: 1..18446744073709551615, set at pre-compile  # Specifies the maximum allowed bytes of a DoIP message request without the DoIP header.
      integer DoIPMaxTesterConnections: 1..255, set at pre-compile  # Maximum ammount of tester connections that shall be maintained at one time before alive check is performed.
      enumeration DoIPNodeType: {DOIP_GATEWAY, DOIP_NODE}, set at pre-compile  # Describes the Type of the DoIP node.
      boolean DoIPUseEIDasGID: set at pre-compile  # Specifies if the DoIP entity shall use its EID if it is the Master for vehicle identification gid on the vehicle identification/vehicle announcement.
      boolean DoIPUseMacAddressForIdentification: set at pre-compile  # Provided the information if a configured EID at vehicle identification response/vehicle announment is used or the MAC address. | TRUE: Use MAC Address instead of EID for Vehicle identification/announcement. FALSE: Use configured EID for vehicle identification/announcement. Dependencies: DoIPEID
      boolean DoIPUseVehicleIdentificationSyncStatus: set at pre-compile  # Defines if the optional VIN/GID synchronization status is used additionally in the vehicle identification/announcement.
      float DoIPVehicleAnnouncementInterval: 0..Inf, set at pre-compile  # Time to wait in [s] for sending subsequent vehicle anouncement messages. Represents parameter A_DoIP_Announce_Interval of ISO 13400-2:2012
      integer DoIPVehicleAnnouncementRepetition: 1..255, set at pre-compile  # Amount of repetitions of the vehicle announcement message on IP address assignment. Represents parameter A_DoIP_Annunce_Num of ISO 13400-2:2012
      boolean DoIPVersionInfoApi: set at pre-compile  # Activates the DoIP_GetVersionInfo() API. | TRUE: Enables the DoIP_GetVersionInfo() API. FALSE: DoIP_GetVersionInfo() API is not included.
      boolean DoIPVinGidMaster: set at pre-compile  # Specifies if the DoIP entity is the Vehicle identification Master for the GID (Group ID).
      integer DoIPVinInvalidityPattern: 0..255, set at pre-compile  # Specifies the Byte pattern that is used for response messages if no valid VIN could be retrieved.
      container DoIPGetGid [0..1]  # This container describes the Callbackfunction to get the GID. | If this container is not configured no Callbackfunction will be used. If this container is configured but the DoIPGetGID parameter is not present, the DoIP module will use an RPort of ServiceInterface CallbackGetGID with the name "CBGetGID".
        function name DoIPGetGID [0..1]: set at link in variant link-time+post-build / pre-compile in variant pre-compile  # Direct C Callback function to get the GID of the DoIP entity. If the DoIPGetGID parameter is present, the DoIP module will not use an RPort of ServiceInterface CallbackGetGID but call the configured function.
      container DoIPPowerModeCallback  # This container describes the Callbackfunction to get the Power Mode. This container shall always be present. | If the DoIPPowerMode parameter is not present, the DoIP module will use an RPort of ServiceInterface CallbackGetPowerMode with the name "CBGetPowerMode".
        function name DoIPPowerMode [0..1]: set at link in variant link-time+post-build / pre-compile in variant pre-compile  # Direct C Callback function to get the Power Mode of the DoIP entity. If the DoIPPowerMode parameter is present, the DoIP module will not use an RPort of ServiceInterface CallbackGetPowerMode but will call the configured function.
      container DoIPTriggerGidSynchronization [0..1]  # This container describes the Callbackfunction to trigger the GID synchronisation. | If this container is not configured no Callbackfunction will be used. If this container is configured but the DoIPTriggerGIDSynchronzation parameter is not present, the DoIP module will use an RPort of ServiceInterface CallbackTriggerGIDSynchronization with the name "CBTriggerGIDSynchronization".
        function name DoIPTriggerGIDSynchronzation [0..1]: set at link in variant link-time+post-build / pre-compile in variant pre-compile  # Direct C Callback function to trigger the synchronization of the GID. If the DoIPTriggerGIDSynchronzation parameter is present, the DoIP module will not use an RPort of ServiceInterface CallbackTriggerGIDSynchronization but call the configured function.
