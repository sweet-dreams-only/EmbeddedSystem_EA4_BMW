AUTOSAR XML (schema 4-0-3)
# The material contained in this specification is protected by copyright and
# other types of Intellectual Property Rights. The commercial exploitation of
# the material contained in this specification requires a license to such
# Intellectual Property Rights.
# This specification may be utilized or reproduced without any modification, in
# any form or by any means, for informational purposes only.
# For any other purpose, no part of the specification may be utilized or
# reproduced, in any form or by any means, without permission in writing from
# the publisher.
# licensed under the same rules as applicable to the AUTOSAR Standard.
package /AUTOSAR/EcucDefs
  module definition MemMap [0..1]: variants pre-compile  # Configuration of the MemMap module.
    container MemMapAddressingModeSet [0..*]  # Defines a set of addressing modes which might apply to a SwAddrMethod.
      string MemMapSupportedAddressingMethodOption [0..*]: set at pre-compile, regular-expression=[a-zA-Z]([a-zA-Z0-9]|_[a-zA-Z0-9])*_?  # This constrains the usage of this addressing mode set for Generic Mappings to swAddrMethods. | The attribute option of a swAddrMethod mapped via MemMapGenericMapping to this MemMapAddressingModeSet shall be equal to one of the configured MemMapSupportedAddressMethodOption's
      enumeration MemMapSupportedMemoryAllocationKeywordPolicy [0..*]: {MEMMAP_ALLOCATION_KEYWORD_POLICY_ADDR_METHOD_SHORT_NAME, MEMMAP_ALLOCATION_KEYWORD_POLICY_ADDR_METHOD_SHORT_NAME_AND_ALIGNMENT}, set at pre-compile  # This constrains the usage of this addressing mode set for Generic Mappings to swAddrMethods. | The attribute MemoryAllocationKeywordPolicy of a swAddrMethod mapped via MemMapGenericMapping to this MemMapAddressingModeSet shall be equal to one of the configured MemMapSupportedMemoryAllocationKeywordPolicy's
      string MemMapSupportedSectionInitializationPolicy [0..*]: set at pre-compile  # This constrains the usage of this addressing mode set for Generic Mappings to swAddrMethods. | The sectionIntializationPolicy attribute value of a swAddrMethod mapped via MemMapGenericMapping to this MemMapAddressingModeSet shall be equal to one of the configured MemMapSupportedSectionIntializationPolicy's Please note that SectionInitializationPolicyType describes the intended initialization of MemorySections. The following values are standardized in AUTOSAR Methodology: * '''NO-INIT''': No initialization and no clearing is performed. Such data elements must not be read before one has written a value into it. * '''INIT''': To be used for data that are initialized by every reset to the specified value (initValue). * '''POWER-ON-INIT''': To be used for data that are initialized by "Power On" to the specified value (initValue). Note: there might be several resets between power on resets. * '''CLEARED''': To be used for data that are initialized by every reset to zero. * '''POWER-ON-CLEARED''': To be used for data that are initialized by "Power On" to zero. Note: there might be several resets between power on resets. Please note that the values are defined similar to the representation of enumeration types in the XML schema to ensure backward compatibility.
      enumeration MemMapSupportedSectionType [0..*]: {MEMMAP_SECTION_TYPE_CALIBRATION_OFFLINE, MEMMAP_SECTION_TYPE_CALIBRATION_ONLINE, MEMMAP_SECTION_TYPE_CAL_PRM, MEMMAP_SECTION_TYPE_CODE, MEMMAP_SECTION_TYPE_CONFIG_DATA, MEMMAP_SECTION_TYPE_CONST, MEMMAP_SECTION_TYPE_EXCLUDE_FROM_FLASH, MEMMAP_SECTION_TYPE_USER_DEFINED, MEMMAP_SECTION_TYPE_VAR, MEMMAP_SECTION_TYPE_VAR_FAST, MEMMAP_SECTION_TYPE_VAR_NO_INIT, MEMMAP_SECTION_TYPE_VAR_POWER_ON_INIT}, set at pre-compile  # This constrains the usage of this addressing mode set for Generic Mappings to swAddrMethods. | The attribute sectionType of a swAddrMethod mapped via MemMapGenericMapping or MemMapSectionSpecificMapping to this MemMapAddressingModeSet shall be equal to one of the configured MemMapSupportedSectionType's.
      container MemMapAddressingMode [1..*]  # Defines a addressing mode with a set of #pragma statements implementing the start and the stop of a section.
        multiline string MemMapAddressingModeStart: set at pre-compile  # Defines a set of #pragma statements implementing the start of a section.
        multiline string MemMapAddressingModeStop: set at pre-compile  # Defines a set of #pragma statements implementing the start of a section.
        string MemMapAlignmentSelector [1..*]: set at pre-compile, regular-expression=[1-9][0-9]*|0x[0-9a-f]*|0[0-7]*|0b[0-1]*|UNSPECIFIED|UNKNOWN|BOOLEAN|  # Defines a the alignments for which the MemMapAddressingMode applies. | The to be used alignment is defined in the alignment attribute of the MemorySection. If the MemMapAlignmentSelector fits to alignment attribute of the MemorySection the set of #pragmas of the related MemMapAddressingMode shall be used to implement the start and the stop of a section. Please note that the same MemMapAddressingMode can be applicable for several alignments, e.g. "8" bit and "UNSPECIFIED".
    container MemMapAllocation [0..*]  # Defines a set of addressing modes which might apply to a SwAddrMethod.
      container MemMapGenericMapping [0..*]  # Defines which SwAddrMethod is implemented with which MemMapAddressingModeSet. | The pragmas for the implementation of the MemorySelectorKeywords are taken from the MemMapAddressingModeStart and MemMapAddressingModeStop parameters of the MemMapAddressingModeSet for the individual alignments. That this mapping becomes valid requires matching MemMapSupportedSectionType's, MemMapSupportedSectionInitializationPolicy's and MemMapSupportedAddressingMethodOption's. The MemMapGenericMapping applies only if it is not overruled by an MemMapSectionSpecificMapping
        foreign reference MemMapSwAddressMethodRef: set at pre-compile, destination-type=SW-ADDR-METHOD  # Reference to the SwAddrMethod which applies to the MemMapGenericMapping.
        reference MemMapAddressingModeSetRef: set at pre-compile, destination=MemMapAddressingModeSet  # Reference to the MemMapAddressingModeSet which applies to the MemMapGenericMapping.
      container MemMapSectionSpecificMapping [0..*]  # Defines which MemorySection of a BSW Module or a Software Component is implemented with which MemMapAddressingModeSet. | The pragmas for the implementation of the MemorySelectorKeywords are taken from the MemMapAddressingModeStart and MemMapAddressingModeStop parameters of the MemMapAddressingModeSet for the specific alignment of the MemorySection. The MemMapSectionSpecificMapping precedes a mapping defined by MemMapGenericMapping.
        foreign reference MemMapMemorySectionRef: set at pre-compile, destination-type=MEMORY-SECTION  # Reference to the MemorySection which applies to the MemMapSectionSpecificMapping.
        reference MemMapAddressingModeSetRef: set at pre-compile, destination=MemMapAddressingModeSet  # Reference to the MemMapAddressingModeSet which applies to the MemMapModuleSectionSpecificMapping.
