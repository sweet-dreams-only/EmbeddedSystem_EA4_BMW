AUTOSAR XML (schema 4-0-3)
# The material contained in this specification is protected by copyright and
# other types of Intellectual Property Rights. The commercial exploitation of
# the material contained in this specification requires a license to such
# Intellectual Property Rights.
# This specification may be utilized or reproduced without any modification, in
# any form or by any means, for informational purposes only.
# For any other purpose, no part of the specification may be utilized or
# reproduced, in any form or by any means, without permission in writing from
# the publisher.
# licensed under the same rules as applicable to the AUTOSAR Standard.
package /AUTOSAR/EcucDefs
  module definition J1939Nm [0..1]: variants link-time/post-build/pre-compile  # The SAE J1939 Nm module
    container J1939NmConfigSet: multiple-configuration-container=true  # This container is a MultipleConfigurationContainer, i.e. this container and its sub-containers exist once per configuration set.
      container J1939NmChannel [1..*]: post-build-changeable=true  # Physical CAN channel handled by J1939Nm.
        symbolic name reference J1939NmComMNetworkHandleRef: set at link in variant link-time+post-build / pre-compile in variant pre-compile, destination=ComMChannel  # Reference to the channel defined by the ComMChannel providing access to the unique channel index ComMChannelId.
        container J1939NmRxPdu  # Contains the configuration of the I-PDU used to receive the AddressClaimed PG.
          integer J1939NmRxPduId: 0..65535, set at link in variant link-time+post-build / pre-compile in variant pre-compile, symbolic-name-value=true  # The I-PDU identifier used for RxIndication from CanIf.
          reference J1939NmRxPduRef: set at link in variant link-time+post-build / pre-compile in variant pre-compile, destination=Pdu  # Reference to the Pdu object representing the I-PDU.
        container J1939NmTxPdu  # Contains the configuration of the I-PDU used to transmit the AddressClaimed PG.
          integer J1939NmTxPduId: 0..65535, set at link in variant link-time+post-build / pre-compile in variant pre-compile, symbolic-name-value=true  # The I-PDU identifier used for TxConfirmation from CanIf.
          reference J1939NmTxPduRef: set at link in variant link-time+post-build / pre-compile in variant pre-compile, destination=Pdu  # Reference to the Pdu object representing the I-PDU.
      container J1939NmNode [1..*]: post-build-changeable=true  # Logical node representing one function handled by J1939Nm.
        integer J1939NmNodeId: 0..255, set at pre-compile, symbolic-name-value=true  # Unique identifier of this node. May be chosen to be identical with J1939NmNodePreferredAddress, if the same address shall not be used by different nodes on different channels.
        boolean J1939NmNodeNameArbitraryAddressCapable: set at pre-compile  # Arbitrary Address Capable field of the NAME of this node.
        integer J1939NmNodeNameECUInstance: 0..7, set at link in variant link-time / post-build in variant post-build / pre-compile in variant pre-compile  # ECU Instance field of the NAME of this node.
        integer J1939NmNodeNameFunction: 0..255, set at link in variant link-time / post-build in variant post-build / pre-compile in variant pre-compile  # Function field of the NAME of this node.
        integer J1939NmNodeNameFunctionInstance: 0..31, set at link in variant link-time / post-build in variant post-build / pre-compile in variant pre-compile  # Function Instance field of the NAME of this node.
        integer J1939NmNodeNameIdentityNumber: 0..2097151, set at link in variant link-time / post-build in variant post-build / pre-compile in variant pre-compile  # Identity Number field of the NAME of this node.
        integer J1939NmNodeNameIndustryGroup: 0..7, set at link in variant link-time / post-build in variant post-build / pre-compile in variant pre-compile  # Industry Group field of the NAME of this node.
        integer J1939NmNodeNameManufacturerCode: 0..2047, set at link in variant link-time / post-build in variant post-build / pre-compile in variant pre-compile  # Manufacturer Code field of the NAME of this node.
        integer J1939NmNodeNameVehicleSystem: 0..127, set at link in variant link-time / post-build in variant post-build / pre-compile in variant pre-compile  # Vehicle System field of the NAME of this node.
        integer J1939NmNodeNameVehicleSystemInstance: 0..15, set at link in variant link-time / post-build in variant post-build / pre-compile in variant pre-compile  # Vehicle System Instance field of the NAME of this node.
        integer J1939NmNodePreferredAddress: 0..253, set at link in variant link-time / post-build in variant post-build / pre-compile in variant pre-compile  # Source address of this node used for address claiming.
        boolean J1939NmNodeStartUpDelay: set at pre-compile  # If enabled, the communication will start after a delay of 250ms after transmission of the initial AddressClaimed. If disabled, communication will start immediately at start-up. | Please note: According to J1939/81, the 250ms delay is not required for single address CAs with desired source addresses in the ranges 0..127 or 248..253.
        reference J1939NmNodeChannelRef [1..*]: set at link in variant link-time+post-build / pre-compile in variant pre-compile, destination=J1939NmChannel  # Reference to the channels this node has access to.
    container J1939NmDemEventParameterRefs [0..1]  # Container for the references to DemEventParameter elements which shall be invoked using the API Dem_ReportErrorStatus in case the corresponding error occurs. The EventId is taken from the referenced DemEventParameter's DemEventId value. The standardized errors are provided in the container and can be extended by vendor specific error references.
      symbolic name reference J1939NM_E_ADDRESS_LOST: set at pre-compile, destination=DemEventParameter  # Reference to the DemEventParameter which shall be issued when the ECU failed to claim one of its addresses.
    container J1939NmGeneral  # Contains the general configuration parameters of the module.
      boolean J1939NmDevErrorDetect: set at pre-compile  # Pre-processor switch for enabling development error detection support.
      float J1939NmMainFunctionPeriod: 0.001..0.255, set at link in variant link-time+post-build / pre-compile in variant pre-compile  # Call cycle in seconds of J1939Nm_MainFunction.
      float J1939NmTxConfirmationTimeout: 0..65.535, set at link in variant link-time+post-build / pre-compile in variant pre-compile  # Time in seconds to wait for a confirmation after transmission of a message. The behaviour when the time elapses depends on the transmitted message.
      function name J1939NmUserCallout [0..1]: set at pre-compile  # Pre-processor switch for enabling the <User_AddressClaimedIndication> and defining the name of the callout function.
      string J1939NmUserCalloutHeaderFile [0..1]: set at pre-compile  # Header file which is included by J1939Nm when J1939NmUserCallout is enabled. This header file must provide the prototype of the <User_AddressClaimedIndication> defined in J1939NmUserCallout.
      boolean J1939NmVersionInfoApi: set at pre-compile  # Pre-processor switch for enabling version info API support.
