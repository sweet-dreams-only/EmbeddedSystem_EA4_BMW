AUTOSAR XML (schema 4-0-3)
# The material contained in this specification is protected by copyright and
# other types of Intellectual Property Rights. The commercial exploitation of
# the material contained in this specification requires a license to such
# Intellectual Property Rights.
# This specification may be utilized or reproduced without any modification, in
# any form or by any means, for informational purposes only.
# For any other purpose, no part of the specification may be utilized or
# reproduced, in any form or by any means, without permission in writing from
# the publisher.
# licensed under the same rules as applicable to the AUTOSAR Standard.
package /AUTOSAR/EcucDefs
  module definition FrArTp [0..1]: variants post-build/pre-compile  # Configuration of the FrArTp (FlexRay Transport Protocol) module.
    container FrArTpGeneral  # This container contains the general configuration (parameters) of the FlexRay TP.
      integer FrArTpChanNum: 1..32, set at pre-compile  # Preprocessor switch for defining the number of concurrent channels the module supports. Up to 32 channels shall be definable here.
      boolean FrArTpDevErrorDetect: set at pre-compile  # Preprocessor switch for enabling development error detection.
      boolean FrArTpHaveAckRt: set at pre-compile  # Preprocessor switch for enabling the Acknowledgement and retry mechanisms.
      boolean FrArTpHaveGrpSeg: set at pre-compile  # Preprocessor switch for enabling segmentation of 1:n messages.
      boolean FrArTpHaveLm: set at pre-compile  # Preprocessor switch for enabling the mechanism for message longer than allowed by.
      boolean FrArTpHaveTc: set at pre-compile  # Preprocessor switch for enabling Transmit Cancellation.
      float FrArTpMainFuncCycle: 0..1.024, set at post-build in variant post-build / pre-compile in variant pre-compile  # This parameter contains the calling period of the TPs Main Function. The parameter is specified in seconds.
      boolean FrArTpVersionInfoApi: set at pre-compile  # Preprocessor switch for enabling the Version info API.
    container FrArTpMultipleConfig: multiple-configuration-container=true  # This container holds one or several multiple configuration sets.
      container FrArTpChannel [1..*]  # This container contains the configuration (parameters) of one FlexRay TP channel.
        enumeration FrArTpAckType: {FRARTP_ACK_WITHOUT_RT, FRARTP_ACK_WITH_RT, FRARTP_NO}, set at post-build in variant post-build / pre-compile in variant pre-compile  # This parameter defines the type of acknowledgement which is used for the specific channel.
        enumeration FrArTpAdrType: {FRARTP_OB, FRARTP_TB}, set at post-build in variant post-build / pre-compile in variant pre-compile  # This parameter states the addressing type this connection has. The meanings of the values are one byte and two byte.
        integer FrArTpChannelId: 0..255, set at post-build in variant post-build / pre-compile in variant pre-compile, symbolic-name-value=true  # The Id of the channel.
        integer FrArTpConNum: 0..65536, set at post-build in variant post-build / pre-compile in variant pre-compile  # This parameter states the number of connections used in this channel. At least 256 shall be configurable here.
        boolean FrArTpGrpSeg: set at post-build in variant post-build / pre-compile in variant pre-compile  # Here can be specified, whether segmentation within a 1:n connection is allowed or not.
        enumeration FrArTpLm: {FRARTP_ISO, FRARTP_ISO6, FRARTP_L4G}, set at post-build in variant post-build / pre-compile in variant pre-compile  # This specifies the maximum message length for the particular channel.
        integer FrArTpMaxAr: 0..255, set at post-build in variant post-build / pre-compile in variant pre-compile  # This parameter defines the maximum number of trying to send a frame when a TIMEOUT AR occurs (depending on whether retry is configured).
        integer FrArTpMaxAs: 0..255, set at post-build in variant post-build / pre-compile in variant pre-compile  # This parameter defines the maximum number of trying t osend a frame when a TIMEOUT AS occurs (depending on whether retry is configured)
        integer FrArTpMaxBs: 0..255, set at post-build in variant post-build / pre-compile in variant pre-compile  # This parameter defines number of consecutive CFs between two FCs (block size). Valid values are 1 .. 16 when retry is activated, and 0 .. 255 otherwise.
        integer FrArTpMaxBufReq: 0..255, set at post-build in variant post-build / pre-compile in variant pre-compile  # This parameter defines the maximum number of times the FrArTp should send a wait frame FC(WT). It is also used to limit the number of retries for PduR_FrArTpCopyTxData and PduR_FrArTpCopyRxData when no timer is active.
        integer FrArTpMaxFrIf: 0..255, set at post-build in variant post-build / pre-compile in variant pre-compile  # This parameter defines the maximum number of trying to send a frame when the FrIf returns an error.
        integer FrArTpMaxRn: 0..255, set at post-build in variant post-build / pre-compile in variant pre-compile  # This parameter defines the maximum number of retries (if retry is configured for the particular channel).
        float FrArTpStMin: 0..1, set at post-build in variant post-build / pre-compile in variant pre-compile  # This parameter defines the minimum amount of time between two succeeding CFs in seconds. Valid values are 0, 100µs, 200µs .. 900µs, 1ms, 2ms .. 127ms. The value can be changed at runtime using the FrArTp_ChangeParameter interface.
        boolean FrArTpTc: set at post-build in variant post-build / pre-compile in variant pre-compile  # With this switch Transmit Cancellation can be turned on or off for this channel.
        float FrArTpTimeBr: 0..65.535, set at pre-compile  # This parameter defines the time in seconds between receiving the last CF of a block or an FF-x (or SF-x) and sending out an FC or AF. | It is obvious that FRARTP_TIME_BR + FRARTP_TIMEOUT_AR < FRARTP_TIMEOUT_BS must hold (because the transmission duration on the bus has also to be considered). This parameter is defined in ISO 15765-2. It is contained in the configuration as a performance requirement.
        float FrArTpTimeBuffer: 0..0.255, set at post-build in variant post-build / pre-compile in variant pre-compile  # This parameter defines the time in seconds of waiting for the next try (if retry is activated) to get a Tx or Rx buffer.
        float FrArTpTimeCs: 0..65.535, set at pre-compile  # This parameter defines the time in seconds between the sending of two consecutive CFs or between reception of an FC or AF and sending of the next CF . It is obvious that FRARTP_TIME_CS + FRARTP_TIMEOUT_AS < FRARTP_TIMEOUT_CR must hold (because the transmission duration on the bus has also to be considered). This parameter is defined in ISO 15765-2. It is contained in the configuration as a performance requirement.
        float FrArTpTimeFrIf: 0..0.255, set at post-build in variant post-build / pre-compile in variant pre-compile  # This parameter defines the time in seconds of waiting for the next try (if retry is activated) to send via FrIf_Transmit.
        float FrArTpTimeoutAr: 0..65.535, set at post-build in variant post-build / pre-compile in variant pre-compile  # This parameter states the timeout in seconds between the PDU transmit request of the Transport Layer to the FlexRay Interface and the corresponding confirmation of the FlexRay Interface on the receiver side (for FC or AF).
        float FrArTpTimeoutAs: 0..65.535, set at post-build in variant post-build / pre-compile in variant pre-compile  # This parameter states the timeout in seconds between the PDU transmit request for the first PDU of the group used in the current connection of the Transport Layer to the FlexRay Interface and the corresponding confirmation of the FlexRay Interface (when having sent the last PDU of the | group used in this connection) on the sender side (SF-x, FF-x, CF).
        float FrArTpTimeoutBs: 0..65.535, set at post-build in variant post-build / pre-compile in variant pre-compile  # This parameter defines the timeout in seconds for waiting for an FC or AF on the sender side in a 1:1 connection.
        float FrArTpTimeoutCr: 0..65.535, set at post-build in variant post-build / pre-compile in variant pre-compile  # This parameter defines the timeout value in seconds for waiting for a CF or FF-x (in case of retry) after receiving the last CF or after sending an FC or AF on the receiver side.
        boolean FrArTpUsePduFc: set at post-build in variant post-build / pre-compile in variant pre-compile  # This switch defines, whether within this channel the dedicated FC/ACK PDU (FrArTpPduFc) shall be used or not. If this is not used FC / ACK frames are sent using the normal IDs, otherwise only FrArTpPduFc shall be used for sending / receiving FC / ACK frames.
        container FrArTpConnection [1..*]  # This container contains the configuration (parameters) of one FlexRay TP connection. | A connection can only belong to one channel.
          integer FrArTpLa: 0..65535, set at post-build in variant post-build / pre-compile in variant pre-compile  # This parameter defines the Local Address for the respective connection. | When the local instance is the sender, this is the Source Address within the TP frame. When the local instance is the receiver, this is the Target Address within the TP frame. Note that in case of 1 byte addressing only the values from 0x0000 - 0x00FF are valid.
          boolean FrArTpMultRec: set at post-build in variant post-build / pre-compile in variant pre-compile  # This parameter defines, whether this connection is an 1:1 ('false') or an 1:n ('true') connection. | Of course, if the channel to which the connection is configured has retry or acknowledgement enabled, no retry or acknowledgement will occur in case the connection is an 1:n connection.
          integer FrArTpRa: 0..65535, set at post-build in variant post-build / pre-compile in variant pre-compile  # This parameter defines the Remote Address for the respective connection. | When the local instance is the sender, this is the Target Address within the TP frame. When the local instance is the receiver, this is the Source Address within the TP frame. Note that in case of 1 byte addressing only the values from 0x0000 - 0x00FF are valid.
          reference FrArTpConPduRef [1..*]: set at post-build in variant post-build / pre-compile in variant pre-compile, destination=FrArTpPdu  # Each value defines a PDU to be used for this connection. Thus each value is a PDU-ID given in FrArTpPdu and this array cannot be longer than the array FrArTpPdu. | Please note: Only PDUs of the same size shall be used within a connection. Of course the PDU having the TxConfirmation configured has to be used by every connection.
          container FrArTpRxSdu [0..1]  # Describes the Rx SDU
            integer FrArTpSduRxId: 0..65536, set at post-build in variant post-build / pre-compile in variant pre-compile, symbolic-name-value=true  # This is a unique identifier for a received message. This Id is used in the CancelReceive API call. | ImplementationType: PduIdType
            reference FrArTpRxSduRef: set at post-build in variant post-build / pre-compile in variant pre-compile, destination=Pdu  # Reference to a PDU in the global PDU structure.
          container FrArTpTxSdu [0..1]  # Describes the Tx SDU
            integer FrArTpSduTxId: 0..65536, set at post-build in variant post-build / pre-compile in variant pre-compile, symbolic-name-value=true  # This is a unique identifier for a received or a to be transmitted message. With this (and by means of e.g. a lookup table) the PDU Router can route the message appropriately without dealing with the particularities of the Transport Layer. This parameter can also be seen as the identifier of a connection. | ImplementationType: PduIdType
            reference FrArTpTxSduRef: set at post-build in variant post-build / pre-compile in variant pre-compile, destination=Pdu  # Reference to a PDU in the global PDU structure.
        container FrArTpPdu [1..*]  # Container to hold the PDU parameters. | ImplementationType: PduInfoType
          enumeration FrArTpPduDirection: {FRARTP_RX, FRARTP_TX}, set at post-build in variant post-build / pre-compile in variant pre-compile  # This parameter defines the direction of the PDU.
          integer FrArTpPduId: 0..65536, set at post-build in variant post-build / pre-compile in variant pre-compile, symbolic-name-value=true  # This is the identifier of the FlexRay Interface PDUs (Fr N-PDU, Fr L-SDU) in which the Transport Layer Frames of this channel should be transmitted. | ImplementationType: PduIdType
          reference FrArTpPduRef: set at post-build in variant post-build / pre-compile in variant pre-compile, destination=Pdu
        container FrArTpPduFc [0..2]  # This is the identifier of the FlexRay Interface PDUs (Fr N-PDU, Fr L-SDU) in which the Transport Layer Flow Control and Acknowledgement Frames of this channel should be transmitted. | ImplementationType: PduInfoType
          enumeration FrArTpPduFcDirection: {FRARTP_FC_RX, FRARTP_FC_TX}, set at post-build in variant post-build / pre-compile in variant pre-compile  # This parameter defines the direction of the PDU.
          integer FrArTpPduFcId: 0..65536, set at post-build in variant post-build / pre-compile in variant pre-compile, symbolic-name-value=true  # This is the identifier of the FlexRay Interface PDUs (Fr N-PDU, Fr L-SDU) in which the Transport Layer Flow Control and Acknowledgement Frames of this channel should be transmitted.
          reference FrArTpPduFcRef: set at post-build in variant post-build / pre-compile in variant pre-compile, destination=Pdu
