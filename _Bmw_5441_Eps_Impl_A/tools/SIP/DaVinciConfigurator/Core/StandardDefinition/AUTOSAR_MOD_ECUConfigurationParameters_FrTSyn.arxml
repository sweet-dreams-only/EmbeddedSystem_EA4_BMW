AUTOSAR XML (schema 4-0-3)
# The material contained in this specification is protected by copyright and
# other types of Intellectual Property Rights. The commercial exploitation of
# the material contained in this specification requires a license to such
# Intellectual Property Rights.
# This specification may be utilized or reproduced without any modification, in
# any form or by any means, for informational purposes only.
# For any other purpose, no part of the specification may be utilized or
# reproduced, in any form or by any means, without permission in writing from
# the publisher.
# licensed under the same rules as applicable to the AUTOSAR Standard.
package /AUTOSAR/EcucDefs
  module definition FrTSyn [0..1]: category=VENDOR_SPECIFIC_MODULE_DEFINITION, variants post-build/pre-compile  # This represents the specific configuration variant for the TSyn on Flexray.
    container FrTSynGeneral  # This container holds the general parameters of the Flexray-specific Synchronized Time-base Manager
      boolean FrTSynDevErrorDetect: default-value=true  # Switch for enabling the development error detection.
      float FrTSynMainFunctionPeriod: 0..1.7976931348623157E+308  # Schedule period of the main function FrTSyn_MainFunction. Unit: [s].
      boolean FrTSynVersionInfo: default-value=false  # Activate/Deactivate the version information API (FrTSyn_GetVersionInfo). True: version information API activated False: version information API deactivated.
      container FrTSynGlobalTimeOfsDataIDList  # The DataIDList for OFS messages ensures the identification of data elements due to CRC calculation process.
        container FrTSynGlobalTimeOfsDataIDListElement [16..16]  # Element of the DataIDList for OFS messages ensures the identification of data elements due to CRC calculation process.
          integer FrTSynGlobalTimeOfsDataIDListIndex: 0..15  # Index of the DataIDList for OFS messages ensures the identification of data elements due to CRC calculation process.
          integer FrTSynGlobalTimeOfsDataIDListValue: 0..255  # Value of the DataIDList for OFS messages ensures the identification of data elements due to CRC calculation process.
      container FrTSynGlobalTimeSyncDataIDList  # The DataIDList for SYNC messages ensures the identification of data elements due to CRC calculation process.
        container FrTSynGlobalTimeSyncDataIDListElement [16..16]  # Element of the DataIDList for SYNC messages ensures the identification of data elements due to CRC calculation process.
          integer FrTSynGlobalTimeSyncDataIDListIndex: 0..15  # Index of the DataIDList for SYNC messages ensures the identification of data elements due to CRC calculation process.
          integer FrTSynGlobalTimeSyncDataIDListValue: 0..255  # Value of the DataIDList for SYNC messages ensures the identification of data elements due to CRC calculation process.
    container FrTSynGlobalTimeDomain [1..*]  # This represents the existence of a global time domain on Flexray. The FrTSyn module can administrate several global time domains at the same time that in itself form a hierarchy of domains and sub-domains. | If the FrTSyn exists it is assumed that at least one global time domain exists.
      integer FrTSynGlobalTimeDomainId: 0..31  # The global time domain ID.
      integer FrTSynGlobalTimeSequenceCounterJumpWidth: 1..15  # The SequenceCounterJumpWidth specifies the maximum allowed gap of the Sequence Counter between two SYNC resp. two OFS messages.
      symbolic name reference FrTSynSynchronizedTimeBaseRef: destination=StbMSynchronizedTimeBase  # Mandatory reference to the required synchronized time-base.
      container FrTSynGlobalTimeMaster [0..*]  # Configuration of the global time master. Each global time domain is required to have exactly one global time master. This master may or may not exist on the configured ECU.
        enumeration FrTSynGlobalTimeTxCrcSecured: {CRC_NOT_SUPPORTED, CRC_SUPPORTED}  # This represents the configuration of whether or not CRC is supported.
        float FrTSynGlobalTimeTxPeriod: 0..1.7976931348623157E+308  # This represents the TX period. Unit: seconds
        container FrTSynGlobalTimeMasterPdu  # This container carries all properties required to configure the PDU sent by the global time master for the given global time domain.
          integer FrTSynGlobalTimeMasterConfirmationHandleId: 0..65535, symbolic-name-value=true, default-value=0  # This represents the handle ID of the PDU that contains the global time information.
          reference FrTSynGlobalTimePduRef: destination=Pdu  # This represents the reference to the Pdu taken to transmit the global time information. The global time master of a global time domain acts as the sender of the Pdu while all the time slaves are supposed to receive the Pdu.
      container FrTSynGlobalTimeSlave [0..1]  # This represents the time slave for the enclosing global time domain.
        enumeration FrTSynRxCrcValidated: {CRC_IGNORED, CRC_NOT_VALIDATED, CRC_VALIDATED}  # This parameter controls whether or not CRC validation shall be supported.
        container FrTSynGlobalTimeSlavePdu  # This container carries all properties required to configure the PDU received by the time slave for the given global time domain.
          integer FrTSynGlobalTimeSlaveHandleId: 0..65535, symbolic-name-value=true, default-value=0  # This represents the handle ID of the PDU that contains the global time information.
          reference FrTSynGlobalTimePduRef: destination=Pdu  # This represents the reference to the Pdu taken to transmit the global time information. The global time master of a global time domain acts as the sender of the Pdu while all the time slaves are supposed to receive the Pdu.
