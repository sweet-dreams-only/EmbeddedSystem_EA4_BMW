AUTOSAR XML (schema 4-0-3)
package /AUTOSAR/EcucDefs
  module definition CryIf [0..1]: category=STANDARDIZED_MODULE_DEFINITION, variants pre-compile  # Configuration of the Crypto Interface.
    container CryIfChannel [0..*]  # Container for incorporation of CryIfChannel.
      integer CryIfChannelId: 1..4294967295, set at pre-compile, symbolic-name-value=true  # Identifier of the crypto channel | Specifies to which crypto channel the CSM queue is connected to.
      symbolic name reference CryIfDriverObjectRef: set at pre-compile, destination=CryptoDriverObject  # This parameter refers to a Crypto Driver Object. | Specifies to which Crypto Driver Object the crypto channel is connected to
    container CryIfGeneral  # Container for common configuration options.
      boolean CryIfDevErrorDetect: set at pre-compile, default-value=true  # Switches the development error detection and notification on or off.  true: detection and notification is enabled.  false: detection and notification is disabled. | True: Development error detection enabled. False: Development error detection disabled
      boolean CryIfVersionInfoApi: set at pre-compile, default-value=false  # Pre-processor switch to enable and disable availability of the API CryIf_GetVersionInfo(). | True: API CryIf_GetVersionInfo() is available False: API CryIf_GetVersionInfo() is not available.
    container CryIfKey [0..*]  # Container for Channel configuration
      integer CryIfKeyId: 1..4294967295, set at pre-compile, symbolic-name-value=true  # Identifier of the key. | Specifies to which CryIf key the CSM key is mapped to.
      symbolic name reference CryIfKeyRef: set at pre-compile, destination=CryptoKey  # This parameter refers to the crypto driver key. | Specifies to which crypto driver key the CryIf key is mapped to.
