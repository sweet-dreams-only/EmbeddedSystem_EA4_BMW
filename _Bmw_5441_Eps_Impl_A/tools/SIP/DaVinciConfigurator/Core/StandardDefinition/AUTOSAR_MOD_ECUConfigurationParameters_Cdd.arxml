AUTOSAR XML (schema 4-0-3)
# The material contained in this specification is protected by copyright and
# other types of Intellectual Property Rights. The commercial exploitation of
# the material contained in this specification requires a license to such
# Intellectual Property Rights.
# This specification may be utilized or reproduced without any modification, in
# any form or by any means, for informational purposes only.
# For any other purpose, no part of the specification may be utilized or
# reproduced, in any form or by any means, without permission in writing from
# the publisher.
# licensed under the same rules as applicable to the AUTOSAR Standard.
package /AUTOSAR/EcucDefs
  module definition Cdd [0..*]  # The CDD module describes the minimal requirements that are necessary for the configuration of a CDD with respect to the surrounding standardized BSW modules.
    container CddComStackContribution [0..1]  # Contribution of COM Stack modules.
      container CddComIfUpperLayerContribution [0..1]  # Parameters that are necessary for the configuration of a Complex Device Driver that serves as the UpperLayer of the Com Interface module.
        container CddComIfUpperLayerRxPdu [1..*]  # This container specifies Rx PDUs that are exchanged between the CDD and the standardized BSW module.
          integer CddComIfHandleId [0..1]: 0..65535, symbolic-name-value=true  # ECU wide unique, symbolic handle for the Pdu.
          reference CddComIfPduRef: destination=Pdu  # Reference to the "global" Pdu structure to allow harmonization of handle IDs in the COM-Stack.
        container CddComIfUpperLayerTxPdu [1..*]  # This container specifies Tx PDUs that are exchanged between the CDD and the standardized BSW module.
          integer CddComIfHandleId [0..1]: 0..65535, symbolic-name-value=true  # ECU wide unique, symbolic handle for the Pdu.
          reference CddComIfPduRef: destination=Pdu  # Reference to the "global" Pdu structure to allow harmonization of handle IDs in the COM-Stack.
      container CddComMLowerLayerContribution [0..1]  # Parameters that are necessary for the configuration of a Complex Device Driver that serves as the LowerLayer of the Communication Manager module.
        container CddComMLowerLayerChannel [1..*]  # This container contains the network specific parameters.
          reference CddComMLowerLayerChannelRef: destination=ComMChannel  # Unique handle to identify one certain network. Reference to one of the network handles configured for the ComM.
      container CddGenericNmLowerLayerContribution [0..1]  # Parameters that are necessary for the configuration of a Complex Device Driver that serves as the LowerLayer of the Generic NM module.
        container CddGenericNmLowerLayerChannel [1..*]  # NM Channel specific configuration parameters.
          reference CddGenericNmComMNetworkHandleRef: destination=ComMChannel  # This reference points to the unique channel defined by the ComMChannel and provides access to the unique channel index value in ComMChannelId.
      container CddPduRLowerLayerContribution [0..1]  # Parameters that are necessary for the configuration of a Complex Device Driver that serves as the LowerLayer of the Pdu Router module.
        container CddPduRLowerLayerRxPdu [1..*]  # This container specifies Rx PDUs that are exchanged between the CDD and the standardized BSW module.
          integer CddPduRLowerLayerHandleId [0..1]: 0..65535, symbolic-name-value=true  # ECU wide unique, symbolic handle for the Pdu.
          reference CddPduRLowerLayerPduRef: destination=Pdu  # Reference to the "global" Pdu structure to allow harmonization of handle IDs in the COM-Stack.
        container CddPduRLowerLayerTxPdu [1..*]  # This container specifies Tx PDUs that are exchanged between the CDD and the standardized BSW module.
          integer CddPduRLowerLayerHandleId [0..1]: 0..65535, symbolic-name-value=true  # ECU wide unique, symbolic handle for the Pdu.
          reference CddPduRLowerLayerPduRef: destination=Pdu  # Reference to the "global" Pdu structure to allow harmonization of handle IDs in the COM-Stack.
      container CddPduRUpperLayerContribution [0..1]  # Parameters that are necessary for the configuration of a Complex Device Driver that serves as the UpperLayer of the Pdu Router module.
        container CddPduRUpperLayerRxPdu [1..*]  # This container specifies Rx PDUs that are exchanged between the CDD and the standardized BSW module.
          integer CddPduRUpperLayerHandleId [0..1]: 0..65535, symbolic-name-value=true  # ECU wide unique, symbolic handle for the Pdu.
          reference CddPduRUpperLayerPduRef: destination=Pdu  # Reference to the "global" Pdu structure to allow harmonization of handle IDs in the COM-Stack.
        container CddPduRUpperLayerTxPdu [1..*]  # This container specifies Tx PDUs that are exchanged between the CDD and the standardized BSW module.
          integer CddPduRUpperLayerHandleId [0..1]: 0..65535, symbolic-name-value=true  # ECU wide unique, symbolic handle for the Pdu.
          reference CddPduRUpperLayerPduRef: destination=Pdu  # Reference to the "global" Pdu structure to allow harmonization of handle IDs in the COM-Stack.
      container CddSoAdUpperLayerContribution [0..1]  # Parameters that are necessary for the configuration of a Complex Driver that serves as the UpperLayer of the SoAd module.
        container CddSoAdUpperLayerRxPdu [0..*]  # This container specifies Rx PDUs that are exchanged between the CDD and the standardized BSW module.
          integer CddSoAdUpperLayerHandleId: 0..65535, symbolic-name-value=true  # ECU wide unique, symbolic handle for the Pdu.
          reference CddSoAdUpperLayerPduRef: destination=Pdu  # Reference to the "global" Pdu structure to allow harmonization of handle IDs in the COM-Stack.
        container CddSoAdUpperLayerTxPdu [0..*]  # This container specifies Tx PDUs that are exchanged between the CDD and the standardized BSW module.
          integer CddSoAdUpperLayerHandleId [0..1]: 0..65535, symbolic-name-value=true  # ECU wide unique, symbolic handle for the Pdu.
          reference CddSoAdUpperLayerPduRef: destination=Pdu  # Reference to the "global" Pdu structure to allow harmonization of handle IDs in the COM-Stack.
    container CddEcucPartitionInteraction [0..1]  # This optional container holds the partition interaction configuration.
      function name CddPartitionStoppedFunctionName  # Function name to be called when the partition which is triggering the complex driver is stopped.
      reference CddEcucPartitionRef: destination=EcucPartition  # Reference to the "EcucPartition" which executes the software which triggers the CDD.
