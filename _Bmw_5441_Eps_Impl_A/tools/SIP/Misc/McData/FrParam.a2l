/begin MEASUREMENT FR_CIDX_GDCYCLE "" ULONG NO_COMPU_METHOD 0 0 0 4294967295 BYTE_ORDER MSB_LAST ECU_ADDRESS 0x0 ECU_ADDRESS_EXTENSION 0xFF FORMAT "%.15" /end MEASUREMENT
/begin MEASUREMENT FR_CIDX_PMICROPERCYCLE "" ULONG NO_COMPU_METHOD 0 0 0 4294967295 BYTE_ORDER MSB_LAST ECU_ADDRESS 0x4 ECU_ADDRESS_EXTENSION 0xFF FORMAT "%.15" /end MEASUREMENT
/begin MEASUREMENT FR_CIDX_PDLISTENTIMEOUT "" ULONG NO_COMPU_METHOD 0 0 0 4294967295 BYTE_ORDER MSB_LAST ECU_ADDRESS 0x8 ECU_ADDRESS_EXTENSION 0xFF FORMAT "%.15" /end MEASUREMENT
/begin MEASUREMENT FR_CIDX_GMACROPERCYCLE "" ULONG NO_COMPU_METHOD 0 0 0 4294967295 BYTE_ORDER MSB_LAST ECU_ADDRESS 0xC ECU_ADDRESS_EXTENSION 0xFF FORMAT "%.15" /end MEASUREMENT
/begin MEASUREMENT FR_CIDX_GDMACROTICK "" ULONG NO_COMPU_METHOD 0 0 0 4294967295 BYTE_ORDER MSB_LAST ECU_ADDRESS 0x10 ECU_ADDRESS_EXTENSION 0xFF FORMAT "%.15" /end MEASUREMENT
/begin MEASUREMENT FR_CIDX_GNUMBEROFMINISLOTS "" ULONG NO_COMPU_METHOD 0 0 0 4294967295 BYTE_ORDER MSB_LAST ECU_ADDRESS 0x14 ECU_ADDRESS_EXTENSION 0xFF FORMAT "%.15" /end MEASUREMENT
/begin MEASUREMENT FR_CIDX_GNUMBEROFSTATICSLOTS "" ULONG NO_COMPU_METHOD 0 0 0 4294967295 BYTE_ORDER MSB_LAST ECU_ADDRESS 0x18 ECU_ADDRESS_EXTENSION 0xFF FORMAT "%.15" /end MEASUREMENT
/begin MEASUREMENT FR_CIDX_GDNIT "" ULONG NO_COMPU_METHOD 0 0 0 4294967295 BYTE_ORDER MSB_LAST ECU_ADDRESS 0x1C ECU_ADDRESS_EXTENSION 0xFF FORMAT "%.15" /end MEASUREMENT
/begin MEASUREMENT FR_CIDX_GDSTATICSLOT "" ULONG NO_COMPU_METHOD 0 0 0 4294967295 BYTE_ORDER MSB_LAST ECU_ADDRESS 0x20 ECU_ADDRESS_EXTENSION 0xFF FORMAT "%.15" /end MEASUREMENT
/begin MEASUREMENT FR_CIDX_GDWAKEUPRXWINDOW "" ULONG NO_COMPU_METHOD 0 0 0 4294967295 BYTE_ORDER MSB_LAST ECU_ADDRESS 0x24 ECU_ADDRESS_EXTENSION 0xFF FORMAT "%.15" /end MEASUREMENT
/begin MEASUREMENT FR_CIDX_PKEYSLOTID "" ULONG NO_COMPU_METHOD 0 0 0 4294967295 BYTE_ORDER MSB_LAST ECU_ADDRESS 0x28 ECU_ADDRESS_EXTENSION 0xFF FORMAT "%.15" /end MEASUREMENT
/begin MEASUREMENT FR_CIDX_PLATESTTX "" ULONG NO_COMPU_METHOD 0 0 0 4294967295 BYTE_ORDER MSB_LAST ECU_ADDRESS 0x2C ECU_ADDRESS_EXTENSION 0xFF FORMAT "%.15" /end MEASUREMENT
/begin MEASUREMENT FR_CIDX_POFFSETCORRECTIONOUT "" ULONG NO_COMPU_METHOD 0 0 0 4294967295 BYTE_ORDER MSB_LAST ECU_ADDRESS 0x30 ECU_ADDRESS_EXTENSION 0xFF FORMAT "%.15" /end MEASUREMENT
/begin MEASUREMENT FR_CIDX_POFFSETCORRECTIONSTART "" ULONG NO_COMPU_METHOD 0 0 0 4294967295 BYTE_ORDER MSB_LAST ECU_ADDRESS 0x34 ECU_ADDRESS_EXTENSION 0xFF FORMAT "%.15" /end MEASUREMENT
/begin MEASUREMENT FR_CIDX_PRATECORRECTIONOUT "" ULONG NO_COMPU_METHOD 0 0 0 4294967295 BYTE_ORDER MSB_LAST ECU_ADDRESS 0x38 ECU_ADDRESS_EXTENSION 0xFF FORMAT "%.15" /end MEASUREMENT
/begin MEASUREMENT FR_CIDX_PSECONDKEYSLOTID "" ULONG NO_COMPU_METHOD 0 0 0 4294967295 BYTE_ORDER MSB_LAST ECU_ADDRESS 0x3C ECU_ADDRESS_EXTENSION 0xFF FORMAT "%.15" /end MEASUREMENT
/begin MEASUREMENT FR_CIDX_PDACCEPTEDSTARTUPRANGE "" ULONG NO_COMPU_METHOD 0 0 0 4294967295 BYTE_ORDER MSB_LAST ECU_ADDRESS 0x40 ECU_ADDRESS_EXTENSION 0xFF FORMAT "%.15" /end MEASUREMENT
/begin MEASUREMENT FR_CIDX_GCOLDSTARTATTEMPTS "" ULONG NO_COMPU_METHOD 0 0 0 4294967295 BYTE_ORDER MSB_LAST ECU_ADDRESS 0x44 ECU_ADDRESS_EXTENSION 0xFF FORMAT "%.15" /end MEASUREMENT
/begin MEASUREMENT FR_CIDX_GCYCLECOUNTMAX "" ULONG NO_COMPU_METHOD 0 0 0 4294967295 BYTE_ORDER MSB_LAST ECU_ADDRESS 0x48 ECU_ADDRESS_EXTENSION 0xFF FORMAT "%.15" /end MEASUREMENT
/begin MEASUREMENT FR_CIDX_GLISTENNOISE "" ULONG NO_COMPU_METHOD 0 0 0 4294967295 BYTE_ORDER MSB_LAST ECU_ADDRESS 0x4C ECU_ADDRESS_EXTENSION 0xFF FORMAT "%.15" /end MEASUREMENT
/begin MEASUREMENT FR_CIDX_GMAXWITHOUTCLOCKCORRECTFATAL "" ULONG NO_COMPU_METHOD 0 0 0 4294967295 BYTE_ORDER MSB_LAST ECU_ADDRESS 0x50 ECU_ADDRESS_EXTENSION 0xFF FORMAT "%.15" /end MEASUREMENT
/begin MEASUREMENT FR_CIDX_GMAXWITHOUTCLOCKCORRECTPASSIVE "" ULONG NO_COMPU_METHOD 0 0 0 4294967295 BYTE_ORDER MSB_LAST ECU_ADDRESS 0x54 ECU_ADDRESS_EXTENSION 0xFF FORMAT "%.15" /end MEASUREMENT
/begin MEASUREMENT FR_CIDX_GNETWORKMANAGEMENTVECTORLENGTH "" ULONG NO_COMPU_METHOD 0 0 0 4294967295 BYTE_ORDER MSB_LAST ECU_ADDRESS 0x58 ECU_ADDRESS_EXTENSION 0xFF FORMAT "%.15" /end MEASUREMENT
/begin MEASUREMENT FR_CIDX_GPAYLOADLENGTHSTATIC "" ULONG NO_COMPU_METHOD 0 0 0 4294967295 BYTE_ORDER MSB_LAST ECU_ADDRESS 0x5C ECU_ADDRESS_EXTENSION 0xFF FORMAT "%.15" /end MEASUREMENT
/begin MEASUREMENT FR_CIDX_GSYNCFRAMEIDCOUNTMAX "" ULONG NO_COMPU_METHOD 0 0 0 4294967295 BYTE_ORDER MSB_LAST ECU_ADDRESS 0x60 ECU_ADDRESS_EXTENSION 0xFF FORMAT "%.15" /end MEASUREMENT
/begin MEASUREMENT FR_CIDX_GDACTIONPOINTOFFSET "" ULONG NO_COMPU_METHOD 0 0 0 4294967295 BYTE_ORDER MSB_LAST ECU_ADDRESS 0x64 ECU_ADDRESS_EXTENSION 0xFF FORMAT "%.15" /end MEASUREMENT
/begin MEASUREMENT FR_CIDX_GDBIT "" ULONG NO_COMPU_METHOD 0 0 0 4294967295 BYTE_ORDER MSB_LAST ECU_ADDRESS 0x68 ECU_ADDRESS_EXTENSION 0xFF FORMAT "%.15" /end MEASUREMENT
/begin MEASUREMENT FR_CIDX_GDCASRXLOWMAX "" ULONG NO_COMPU_METHOD 0 0 0 4294967295 BYTE_ORDER MSB_LAST ECU_ADDRESS 0x6C ECU_ADDRESS_EXTENSION 0xFF FORMAT "%.15" /end MEASUREMENT
/begin MEASUREMENT FR_CIDX_GDDYNAMICSLOTIDLEPHASE "" ULONG NO_COMPU_METHOD 0 0 0 4294967295 BYTE_ORDER MSB_LAST ECU_ADDRESS 0x70 ECU_ADDRESS_EXTENSION 0xFF FORMAT "%.15" /end MEASUREMENT
/begin MEASUREMENT FR_CIDX_GDMINISLOTACTIONPOINTOFFSET "" ULONG NO_COMPU_METHOD 0 0 0 4294967295 BYTE_ORDER MSB_LAST ECU_ADDRESS 0x74 ECU_ADDRESS_EXTENSION 0xFF FORMAT "%.15" /end MEASUREMENT
/begin MEASUREMENT FR_CIDX_GDMINISLOT "" ULONG NO_COMPU_METHOD 0 0 0 4294967295 BYTE_ORDER MSB_LAST ECU_ADDRESS 0x78 ECU_ADDRESS_EXTENSION 0xFF FORMAT "%.15" /end MEASUREMENT
/begin MEASUREMENT FR_CIDX_GDSAMPLECLOCKPERIOD "" ULONG NO_COMPU_METHOD 0 0 0 4294967295 BYTE_ORDER MSB_LAST ECU_ADDRESS 0x7C ECU_ADDRESS_EXTENSION 0xFF FORMAT "%.15" /end MEASUREMENT
/begin MEASUREMENT FR_CIDX_GDSYMBOLWINDOW "" ULONG NO_COMPU_METHOD 0 0 0 4294967295 BYTE_ORDER MSB_LAST ECU_ADDRESS 0x80 ECU_ADDRESS_EXTENSION 0xFF FORMAT "%.15" /end MEASUREMENT
/begin MEASUREMENT FR_CIDX_GDSYMBOLWINDOWACTIONPOINTOFFSET "" ULONG NO_COMPU_METHOD 0 0 0 4294967295 BYTE_ORDER MSB_LAST ECU_ADDRESS 0x84 ECU_ADDRESS_EXTENSION 0xFF FORMAT "%.15" /end MEASUREMENT
/begin MEASUREMENT FR_CIDX_GDTSSTRANSMITTER "" ULONG NO_COMPU_METHOD 0 0 0 4294967295 BYTE_ORDER MSB_LAST ECU_ADDRESS 0x88 ECU_ADDRESS_EXTENSION 0xFF FORMAT "%.15" /end MEASUREMENT
/begin MEASUREMENT FR_CIDX_GDWAKEUPRXIDLE "" ULONG NO_COMPU_METHOD 0 0 0 4294967295 BYTE_ORDER MSB_LAST ECU_ADDRESS 0x8C ECU_ADDRESS_EXTENSION 0xFF FORMAT "%.15" /end MEASUREMENT
/begin MEASUREMENT FR_CIDX_GDWAKEUPRXLOW "" ULONG NO_COMPU_METHOD 0 0 0 4294967295 BYTE_ORDER MSB_LAST ECU_ADDRESS 0x90 ECU_ADDRESS_EXTENSION 0xFF FORMAT "%.15" /end MEASUREMENT
/begin MEASUREMENT FR_CIDX_GDWAKEUPTXACTIVE "" ULONG NO_COMPU_METHOD 0 0 0 4294967295 BYTE_ORDER MSB_LAST ECU_ADDRESS 0x94 ECU_ADDRESS_EXTENSION 0xFF FORMAT "%.15" /end MEASUREMENT
/begin MEASUREMENT FR_CIDX_GDWAKEUPTXIDLE "" ULONG NO_COMPU_METHOD 0 0 0 4294967295 BYTE_ORDER MSB_LAST ECU_ADDRESS 0x98 ECU_ADDRESS_EXTENSION 0xFF FORMAT "%.15" /end MEASUREMENT
/begin MEASUREMENT FR_CIDX_PALLOWPASSIVETOACTIVE "" ULONG NO_COMPU_METHOD 0 0 0 4294967295 BYTE_ORDER MSB_LAST ECU_ADDRESS 0x9C ECU_ADDRESS_EXTENSION 0xFF FORMAT "%.15" /end MEASUREMENT
/begin MEASUREMENT FR_CIDX_PCHANNELS "" ULONG NO_COMPU_METHOD 0 0 0 4294967295 BYTE_ORDER MSB_LAST ECU_ADDRESS 0xA0 ECU_ADDRESS_EXTENSION 0xFF FORMAT "%.15" /end MEASUREMENT
/begin MEASUREMENT FR_CIDX_PCLUSTERDRIFTDAMPING "" ULONG NO_COMPU_METHOD 0 0 0 4294967295 BYTE_ORDER MSB_LAST ECU_ADDRESS 0xA4 ECU_ADDRESS_EXTENSION 0xFF FORMAT "%.15" /end MEASUREMENT
/begin MEASUREMENT FR_CIDX_PDECODINGCORRECTION "" ULONG NO_COMPU_METHOD 0 0 0 4294967295 BYTE_ORDER MSB_LAST ECU_ADDRESS 0xA8 ECU_ADDRESS_EXTENSION 0xFF FORMAT "%.15" /end MEASUREMENT
/begin MEASUREMENT FR_CIDX_PDELAYCOMPENSATIONA "" ULONG NO_COMPU_METHOD 0 0 0 4294967295 BYTE_ORDER MSB_LAST ECU_ADDRESS 0xAC ECU_ADDRESS_EXTENSION 0xFF FORMAT "%.15" /end MEASUREMENT
/begin MEASUREMENT FR_CIDX_PDELAYCOMPENSATIONB "" ULONG NO_COMPU_METHOD 0 0 0 4294967295 BYTE_ORDER MSB_LAST ECU_ADDRESS 0xB0 ECU_ADDRESS_EXTENSION 0xFF FORMAT "%.15" /end MEASUREMENT
/begin MEASUREMENT FR_CIDX_PMACROINITIALOFFSETA "" ULONG NO_COMPU_METHOD 0 0 0 4294967295 BYTE_ORDER MSB_LAST ECU_ADDRESS 0xB4 ECU_ADDRESS_EXTENSION 0xFF FORMAT "%.15" /end MEASUREMENT
/begin MEASUREMENT FR_CIDX_PMACROINITIALOFFSETB "" ULONG NO_COMPU_METHOD 0 0 0 4294967295 BYTE_ORDER MSB_LAST ECU_ADDRESS 0xB8 ECU_ADDRESS_EXTENSION 0xFF FORMAT "%.15" /end MEASUREMENT
/begin MEASUREMENT FR_CIDX_PMICROINITIALOFFSETA "" ULONG NO_COMPU_METHOD 0 0 0 4294967295 BYTE_ORDER MSB_LAST ECU_ADDRESS 0xBC ECU_ADDRESS_EXTENSION 0xFF FORMAT "%.15" /end MEASUREMENT
/begin MEASUREMENT FR_CIDX_PMICROINITIALOFFSETB "" ULONG NO_COMPU_METHOD 0 0 0 4294967295 BYTE_ORDER MSB_LAST ECU_ADDRESS 0xC0 ECU_ADDRESS_EXTENSION 0xFF FORMAT "%.15" /end MEASUREMENT
/begin MEASUREMENT FR_CIDX_PPAYLOADLENGTHDYNMAX "" ULONG NO_COMPU_METHOD 0 0 0 4294967295 BYTE_ORDER MSB_LAST ECU_ADDRESS 0xC4 ECU_ADDRESS_EXTENSION 0xFF FORMAT "%.15" /end MEASUREMENT
/begin MEASUREMENT FR_CIDX_PSAMPLESPERMICROTICK "" ULONG NO_COMPU_METHOD 0 0 0 4294967295 BYTE_ORDER MSB_LAST ECU_ADDRESS 0xC8 ECU_ADDRESS_EXTENSION 0xFF FORMAT "%.15" /end MEASUREMENT
/begin MEASUREMENT FR_CIDX_PWAKEUPCHANNEL "" ULONG NO_COMPU_METHOD 0 0 0 4294967295 BYTE_ORDER MSB_LAST ECU_ADDRESS 0xCC ECU_ADDRESS_EXTENSION 0xFF FORMAT "%.15" /end MEASUREMENT
/begin MEASUREMENT FR_CIDX_PWAKEUPPATTERN "" ULONG NO_COMPU_METHOD 0 0 0 4294967295 BYTE_ORDER MSB_LAST ECU_ADDRESS 0xD0 ECU_ADDRESS_EXTENSION 0xFF FORMAT "%.15" /end MEASUREMENT
/begin MEASUREMENT FR_CIDX_PDMICROTICK "" ULONG NO_COMPU_METHOD 0 0 0 4294967295 BYTE_ORDER MSB_LAST ECU_ADDRESS 0xD4 ECU_ADDRESS_EXTENSION 0xFF FORMAT "%.15" /end MEASUREMENT
/begin MEASUREMENT FR_CIDX_PDEXTERNRATECORRECTION "" ULONG NO_COMPU_METHOD 0 0 0 4294967295 BYTE_ORDER MSB_LAST ECU_ADDRESS 0xD8 ECU_ADDRESS_EXTENSION 0xFF FORMAT "%.15" /end MEASUREMENT
/begin MEASUREMENT FR_CIDX_PDEXTERNOFFSETCORRECTION "" ULONG NO_COMPU_METHOD 0 0 0 4294967295 BYTE_ORDER MSB_LAST ECU_ADDRESS 0xDC ECU_ADDRESS_EXTENSION 0xFF FORMAT "%.15" /end MEASUREMENT
/begin MEASUREMENT FR_CIDX_GDIGNOREAFTERTX "" ULONG NO_COMPU_METHOD 0 0 0 4294967295 BYTE_ORDER MSB_LAST ECU_ADDRESS 0xE0 ECU_ADDRESS_EXTENSION 0xFF FORMAT "%.15" /end MEASUREMENT
/begin MEASUREMENT FR_CIDX_PALLOWHALTDUETOCLOCK "" ULONG NO_COMPU_METHOD 0 0 0 4294967295 BYTE_ORDER MSB_LAST ECU_ADDRESS 0xE4 ECU_ADDRESS_EXTENSION 0xFF FORMAT "%.15" /end MEASUREMENT
/begin MEASUREMENT FR_CIDX_PEXTERNALSYNC "" ULONG NO_COMPU_METHOD 0 0 0 4294967295 BYTE_ORDER MSB_LAST ECU_ADDRESS 0xE8 ECU_ADDRESS_EXTENSION 0xFF FORMAT "%.15" /end MEASUREMENT
/begin MEASUREMENT FR_CIDX_PFALLBACKINTERNAL "" ULONG NO_COMPU_METHOD 0 0 0 4294967295 BYTE_ORDER MSB_LAST ECU_ADDRESS 0xEC ECU_ADDRESS_EXTENSION 0xFF FORMAT "%.15" /end MEASUREMENT
/begin MEASUREMENT FR_CIDX_PKEYSLOTONLYENABLED "" ULONG NO_COMPU_METHOD 0 0 0 4294967295 BYTE_ORDER MSB_LAST ECU_ADDRESS 0xF0 ECU_ADDRESS_EXTENSION 0xFF FORMAT "%.15" /end MEASUREMENT
/begin MEASUREMENT FR_CIDX_PKEYSLOTUSEDFORSTARTUP "" ULONG NO_COMPU_METHOD 0 0 0 4294967295 BYTE_ORDER MSB_LAST ECU_ADDRESS 0xF4 ECU_ADDRESS_EXTENSION 0xFF FORMAT "%.15" /end MEASUREMENT
/begin MEASUREMENT FR_CIDX_PKEYSLOTUSEDFORSYNC "" ULONG NO_COMPU_METHOD 0 0 0 4294967295 BYTE_ORDER MSB_LAST ECU_ADDRESS 0xF8 ECU_ADDRESS_EXTENSION 0xFF FORMAT "%.15" /end MEASUREMENT
/begin MEASUREMENT FR_CIDX_PNMVECTOREARLYUPDATE "" ULONG NO_COMPU_METHOD 0 0 0 4294967295 BYTE_ORDER MSB_LAST ECU_ADDRESS 0xFC ECU_ADDRESS_EXTENSION 0xFF FORMAT "%.15" /end MEASUREMENT
/begin MEASUREMENT FR_CIDX_PTWOKEYSLOTMODE "" ULONG NO_COMPU_METHOD 0 0 0 4294967295 BYTE_ORDER MSB_LAST ECU_ADDRESS 0x100 ECU_ADDRESS_EXTENSION 0xFF FORMAT "%.15" /end MEASUREMENT
