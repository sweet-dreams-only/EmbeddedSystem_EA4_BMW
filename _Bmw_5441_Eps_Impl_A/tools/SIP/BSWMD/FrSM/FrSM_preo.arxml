AUTOSAR XML (schema 4-0-3)
package /MICROSAR
  module config FrSM_Pre: definition=FrSM
  module config FrSM_Rec: definition=FrSM, implementation-config-variant=VARIANT-PRE-COMPILE
