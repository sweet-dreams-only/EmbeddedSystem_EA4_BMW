[part 1 of 2: package /Renesas/EcucDefs_Mcu]
AUTOSAR XML (schema 4-0-3)
# COPYRIGHT
# Copyright(c) 2014-2017 Renesas Electronics Corporation
package /Renesas/EcucDefs_Mcu
  ecuc definition collection RenesasParameterDefinition_Mcu: module=Mcu
  module definition Mcu: refined-module-def=Mcu, variants post-build  # Configuration of the MCU (Microcontroller Unit) module.
    container McuPublishedInformation  # Container holding all MCU specific published information parameters.
      container McuResetReasonConf [1..*]  # This container contains the configuration for the different type of reset reason that can be retrieved from Mcu_GetResetReason API.
        integer McuResetReason: 0..255, set at published-information, symbolic-name-value=true, default-value=0  # The parameter represents the different type of reset that a Micro supports. This parameter is referenced by the parameter EcuMResetReason in the ECU State manager module. This parameter is not used for implementation.
      container McuRstRsnConfPowOnClr  # This container contains the configuration for the different type of reset reason that can be retrieved from Mcu_GetResetReason API.
        integer McuResetReason: 0..0, set at published-information, origin=Renesas_v1.0.0, symbolic-name-value=true, default-value=0  # The parameter represents the different type of reset that a Micro supports. This parameter is referenced by the parameter EcuMResetReason in the ECU State manager module, POWER_ON_CLEAR_RST.
      container McuRstRsnConfPinRst  # This container contains the configuration for the different type of reset reason that can be retrieved from Mcu_GetResetReason API.
        integer McuResetReason: 1..1, set at published-information, origin=Renesas_v1.0.0, symbolic-name-value=true, default-value=1  # The parameter represents the different type of reset that a Micro supports. This parameter is referenced by the parameter EcuMResetReason in the ECU State manager module, MCU_PIN_RST.
      container McuRstRsnConfSwRst  # This container contains the configuration for the different type of reset reason that can be retrieved from Mcu_GetResetReason API.
        integer McuResetReason: 2..2, set at published-information, origin=Renesas_v1.0.0, symbolic-name-value=true, default-value=2  # The parameter represents the different type of reset that a Micro supports. This parameter is referenced by the parameter EcuMResetReason in the ECU State manager module, MCU_SW_RESET.
      container McuRstRsnConfWdta  # This container contains the configuration for the different type of reset reason that can be retrieved from Mcu_GetResetReason API.
        integer McuResetReason: 3..3, set at published-information, origin=Renesas_v1.0.0, symbolic-name-value=true, default-value=3  # The parameter represents the different type of reset that a Micro supports. This parameter is referenced by the parameter EcuMResetReason in the ECU State manager module, MCU_WDTA_RST.
      container McuRstRsnConfLockStepCompare  # This container contains the configuration for the different type of reset reason that can be retrieved from Mcu_GetResetReason API.
        integer McuResetReason: 4..4, set at published-information, origin=Renesas_v1.0.0, symbolic-name-value=true, default-value=4  # The parameter represents the different type of reset that a Micro supports. This parameter is referenced by the parameter EcuMResetReason in the ECU State manager module, MCU_LOCK_STEP_COMPARE_RST.
      container McuRstRsnConfClkMonUprLimErMosc  # This container contains the configuration for the different type of reset reason that can be retrieved from Mcu_GetResetReason API.
        integer McuResetReason: 5..5, set at published-information, origin=Renesas_v1.0.0, symbolic-name-value=true, default-value=5  # The parameter represents the different type of reset that a Micro supports. This parameter is referenced by the parameter EcuMResetReason in the ECU State manager module, MCU_CLK_MON_UPR_LIM_ER_MOSC_RST.
      container McuRstRsnConfClkMonLwrLimErMosc  # This container contains the configuration for the different type of reset reason that can be retrieved from Mcu_GetResetReason API.
        integer McuResetReason: 6..6, set at published-information, origin=Renesas_v1.0.0, symbolic-name-value=true, default-value=6  # The parameter represents the different type of reset that a Micro supports. This parameter is referenced by the parameter EcuMResetReason in the ECU State manager module, MCU_CLK_MON_LWR_LIM_ER_MOSC_RST.
      container McuRstRsnConfClkMonUprLimErWdt  # This container contains the configuration for the different type of reset reason that can be retrieved from Mcu_GetResetReason API.
        integer McuResetReason: 7..7, set at published-information, origin=Renesas_v1.0.0, symbolic-name-value=true, default-value=7  # The parameter represents the different type of reset that a Micro supports. This parameter is referenced by the parameter EcuMResetReason in the ECU State manager module, MCU_CLK_MON_UPR_LIM_ER_WDT_RST.
      container McuRstRsnConfClkMonLwrLimErWdt  # This container contains the configuration for the different type of reset reason that can be retrieved from Mcu_GetResetReason API.
        integer McuResetReason: 8..8, set at published-information, origin=Renesas_v1.0.0, symbolic-name-value=true, default-value=8  # The parameter represents the different type of reset that a Micro supports. This parameter is referenced by the parameter EcuMResetReason in the ECU State manager module, MCU_CLK_MON_LWR_LIM_ER_WDT_RST.
      container McuRstRsnConfClkMonUprLimErPclk  # This container contains the configuration for the different type of reset reason that can be retrieved from Mcu_GetResetReason API.
        integer McuResetReason: 9..9, set at published-information, origin=Renesas_v1.0.0, symbolic-name-value=true, default-value=9  # The parameter represents the different type of reset that a Micro supports. This parameter is referenced by the parameter EcuMResetReason in the ECU State manager module, MCU_CLK_MON_UPR_LIM_ER_PCLK_RST.
      container McuRstRsnConfClkMonLwrLimErPclk  # This container contains the configuration for the different type of reset reason that can be retrieved from Mcu_GetResetReason API.
        integer McuResetReason: 10..10, set at published-information, origin=Renesas_v1.0.0, symbolic-name-value=true, default-value=10  # The parameter represents the different type of reset that a Micro supports. This parameter is referenced by the parameter EcuMResetReason in the ECU State manager module, MCU_CLK_MON_LWR_LIM_ER_PCLK_RST.
      container McuRstRsnConfClkMonUprLimErPe1  # This container contains the configuration for the different type of reset reason that can be retrieved from Mcu_GetResetReason API.
        integer McuResetReason: 11..11, set at published-information, origin=Renesas_v1.0.0, symbolic-name-value=true, default-value=11  # The parameter represents the different type of reset that a Micro supports. This parameter is referenced by the parameter EcuMResetReason in the ECU State manager module, MCU_CLK_MON_UPR_LIM_ER_PE1_RST.
      container McuRstRsnConfClkMonLwrLimErPe1  # This container contains the configuration for the different type of reset reason that can be retrieved from Mcu_GetResetReason API.
        integer McuResetReason: 12..12, set at published-information, origin=Renesas_v1.0.0, symbolic-name-value=true, default-value=12  # The parameter represents the different type of reset that a Micro supports. This parameter is referenced by the parameter EcuMResetReason in the ECU State manager module, MCU_CLK_MON_LWR_LIM_ER_PE1_RST.
      container McuRstRsnConfLRamEcc2AddPrty  # This container contains the configuration for the different type of reset reason that can be retrieved from Mcu_GetResetReason API.
        integer McuResetReason: 13..13, set at published-information, origin=Renesas_v1.0.0, symbolic-name-value=true, default-value=13  # The parameter represents the different type of reset that a Micro supports. This parameter is referenced by the parameter EcuMResetReason in the ECU State manager module, MCU_LRAM_ECC2_ADDPTY_RST.
      container McuRstRsnConfInstCacheRamEcc2  # This container contains the configuration for the different type of reset reason that can be retrieved from Mcu_GetResetReason API.
        integer McuResetReason: 14..14, set at published-information, origin=Renesas_v1.0.0, symbolic-name-value=true, default-value=14  # The parameter represents the different type of reset that a Micro supports. This parameter is referenced by the parameter EcuMResetReason in the ECU State manager module, MCU_INST_CACHE_RAM_ECC2_RST.
      container McuRstRsnConfCodeFlsEcc2AddPrty  # This container contains the configuration for the different type of reset reason that can be retrieved from Mcu_GetResetReason API.
        integer McuResetReason: 15..15, set at published-information, origin=Renesas_v1.0.0, symbolic-name-value=true, default-value=15  # The parameter represents the different type of reset that a Micro supports. This parameter is referenced by the parameter EcuMResetReason in the ECU State manager module, MCU_CODE_FLS_ECC2_ADDPTY_RST.
      container McuRstRsnConfDataFlsEcc2  # This container contains the configuration for the different type of reset reason that can be retrieved from Mcu_GetResetReason API.
        integer McuResetReason: 16..16, set at published-information, origin=Renesas_v1.0.0, symbolic-name-value=true, default-value=16  # The parameter represents the different type of reset that a Micro supports. This parameter is referenced by the parameter EcuMResetReason in the ECU State manager module, MCU_DATA_FLS_ECC2_RST.
      container McuRstRsnConfDtsRamEcc2  # This container contains the configuration for the different type of reset reason that can be retrieved from Mcu_GetResetReason API.
        integer McuResetReason: 17..17, set at published-information, origin=Renesas_v1.0.0, symbolic-name-value=true, default-value=17  # The parameter represents the different type of reset that a Micro supports. This parameter is referenced by the parameter EcuMResetReason in the ECU State manager module, MCU_DTS_RAM_ECC2_RST.
      container McuRstRsnConfCsihRamEcc2  # This container contains the configuration for the different type of reset reason that can be retrieved from Mcu_GetResetReason API.
        integer McuResetReason: 18..18, set at published-information, origin=Renesas_v1.0.0, symbolic-name-value=true, default-value=18  # The parameter represents the different type of reset that a Micro supports. This parameter is referenced by the parameter EcuMResetReason in the ECU State manager module, MCU_CSIH_RAM_ECC2_RST.
      container McuRstRsnConfCanRamEcc2  # This container contains the configuration for the different type of reset reason that can be retrieved from Mcu_GetResetReason API.
        integer McuResetReason: 19..19, set at published-information, origin=Renesas_v1.0.0, symbolic-name-value=true, default-value=19  # The parameter represents the different type of reset that a Micro supports. This parameter is referenced by the parameter EcuMResetReason in the ECU State manager module, MCU_CAN_RAM_ECC2_RST.
      container McuRstRsnConfFrRamEcc2  # This container contains the configuration for the different type of reset reason that can be retrieved from Mcu_GetResetReason API.
        integer McuResetReason: 20..20, set at published-information, origin=Renesas_v1.0.0, symbolic-name-value=true, default-value=20  # The parameter represents the different type of reset that a Micro supports. This parameter is referenced by the parameter EcuMResetReason in the ECU State manager module, MCU_FR_RAM_ECC2_RST.
      container McuRstRsnConfFlsProgMode  # This container contains the configuration for the different type of reset reason that can be retrieved from Mcu_GetResetReason API.
        integer McuResetReason: 21..21, set at published-information, origin=Renesas_v1.0.0, symbolic-name-value=true, default-value=21  # The parameter represents the different type of reset that a Micro supports. This parameter is referenced by the parameter EcuMResetReason in the ECU State manager module, MCU_FLS_PROG_MODE_RST.
      container McuRstRsnConfTestMode  # This container contains the configuration for the different type of reset reason that can be retrieved from Mcu_GetResetReason API.
        integer McuResetReason: 22..22, set at published-information, origin=Renesas_v1.0.0, symbolic-name-value=true, default-value=22  # The parameter represents the different type of reset that a Micro supports. This parameter is referenced by the parameter EcuMResetReason in the ECU State manager module, MCU_TEST_MODE_RST.
      container McuRstRsnConfSingChipModInact  # This container contains the configuration for the different type of reset reason that can be retrieved from Mcu_GetResetReason API.
        integer McuResetReason: 23..23, set at published-information, origin=Renesas_v1.0.0, symbolic-name-value=true, default-value=23  # The parameter represents the different type of reset that a Micro supports. This parameter is referenced by the parameter EcuMResetReason in the ECU State manager module, MCU_SING_CHIP_MOD_INACT_RST.
      container McuRstRsnConfPeGuard  # This container contains the configuration for the different type of reset reason that can be retrieved from Mcu_GetResetReason API.
        integer McuResetReason: 24..24, set at published-information, origin=Renesas_v1.0.0, symbolic-name-value=true, default-value=24  # The parameter represents the different type of reset that a Micro supports. This parameter is referenced by the parameter EcuMResetReason in the ECU State manager module, MCU_PEGUARD_RST.
      container McuRstRsnConfPBusGuard  # This container contains the configuration for the different type of reset reason that can be retrieved from Mcu_GetResetReason API.
        integer McuResetReason: 25..25, set at published-information, origin=Renesas_v1.0.0, symbolic-name-value=true, default-value=25  # The parameter represents the different type of reset that a Micro supports. This parameter is referenced by the parameter EcuMResetReason in the ECU State manager module, MCU_PBUS_GUARD_RST.
      container McuRstRsnConfSarAdcPrty  # This container contains the configuration for the different type of reset reason that can be retrieved from Mcu_GetResetReason API.
        integer McuResetReason: 26..26, set at published-information, origin=Renesas_v1.0.0, symbolic-name-value=true, default-value=26  # The parameter represents the different type of reset that a Micro supports. This parameter is referenced by the parameter EcuMResetReason in the ECU State manager module, MCU_SAR_ADC_PRTY_ERR_RST.
      container McuRstRsnConfBusDataPrty  # This container contains the configuration for the different type of reset reason that can be retrieved from Mcu_GetResetReason API.
        integer McuResetReason: 27..27, set at published-information, origin=Renesas_v1.0.0, symbolic-name-value=true, default-value=27  # The parameter represents the different type of reset that a Micro supports. This parameter is referenced by the parameter EcuMResetReason in the ECU State manager module, MCU_BUS_DATA_PRTY_RST.
      container McuRstRsnConfEcmCompare  # This container contains the configuration for the different type of reset reason that can be retrieved from Mcu_GetResetReason API.
        integer McuResetReason: 28..28, set at published-information, origin=Renesas_v1.0.0, symbolic-name-value=true, default-value=28  # The parameter represents the different type of reset that a Micro supports. This parameter is referenced by the parameter EcuMResetReason in the ECU State manager module, MCU_ECM_COMPARE_RST.
      container McuRstRsnConfLvi  # This container contains the configuration for the different type of reset reason that can be retrieved from Mcu_GetResetReason API.
        integer McuResetReason: 29..29, set at published-information, origin=Renesas_v1.0.0, symbolic-name-value=true, default-value=29  # The parameter represents the different type of reset that a Micro supports. This parameter is referenced by the parameter EcuMResetReason in the ECU State manager module, MCU_LVI_RST.
      container McuRstRsnConfTempSensor  # This container contains the configuration for the different type of reset reason that can be retrieved from Mcu_GetResetReason API.
        integer McuResetReason: 30..30, set at published-information, origin=Renesas_v1.0.0, symbolic-name-value=true, default-value=30  # The parameter represents the different type of reset that a Micro supports. This parameter is referenced by the parameter EcuMResetReason in the ECU State manager module, MCU_TEMP_SENSOR_RST.
      container McuRstRsnConfDmaTrans  # This container contains the configuration for the different type of reset reason that can be retrieved from Mcu_GetResetReason API.
        integer McuResetReason: 31..31, set at published-information, origin=Renesas_v1.0.0, symbolic-name-value=true, default-value=31  # The parameter represents the different type of reset that a Micro supports. This parameter is referenced by the parameter EcuMResetReason in the ECU State manager module, MCU_DMA_TRANS_RST.
      container McuRstRsnConfDmaViol  # This container contains the configuration for the different type of reset reason that can be retrieved from Mcu_GetResetReason API.
        integer McuResetReason: 32..32, set at published-information, origin=Renesas_v1.0.0, symbolic-name-value=true, default-value=32  # The parameter represents the different type of reset that a Micro supports. This parameter is referenced by the parameter EcuMResetReason in the ECU State manager module, MCU_DMA_VIOL_RST.
      container McuRstRsnConfLRamEcc1  # This container contains the configuration for the different type of reset reason that can be retrieved from Mcu_GetResetReason API.
        integer McuResetReason: 33..33, set at published-information, origin=Renesas_v1.0.0, symbolic-name-value=true, default-value=33  # The parameter represents the different type of reset that a Micro supports. This parameter is referenced by the parameter EcuMResetReason in the ECU State manager module, MCU_LRAM_ECC1_RST.
      container McuRstRsnConfCodeFlsEcc1  # This container contains the configuration for the different type of reset reason that can be retrieved from Mcu_GetResetReason API.
        integer McuResetReason: 34..34, set at published-information, origin=Renesas_v1.0.0, symbolic-name-value=true, default-value=34  # The parameter represents the different type of reset that a Micro supports. This parameter is referenced by the parameter EcuMResetReason in the ECU State manager module, MCU_CODE_FLS_ECC1_RST.
      container McuRstRsnConfDataFlsEcc1  # This container contains the configuration for the different type of reset reason that can be retrieved from Mcu_GetResetReason API.
        integer McuResetReason: 35..35, set at published-information, origin=Renesas_v1.0.0, symbolic-name-value=true, default-value=35  # The parameter represents the different type of reset that a Micro supports. This parameter is referenced by the parameter EcuMResetReason in the ECU State manager module, MCU_DATA_FLS_ECC1_RST.
      container McuRstRsnConfDtsRamEcc1  # This container contains the configuration for the different type of reset reason that can be retrieved from Mcu_GetResetReason API.
        integer McuResetReason: 36..36, set at published-information, origin=Renesas_v1.0.0, symbolic-name-value=true, default-value=36  # The parameter represents the different type of reset that a Micro supports. This parameter is referenced by the parameter EcuMResetReason in the ECU State manager module, MCU_DTS_RAM_ECC1_RST.
      container McuRstRsnConfPeriRamEcc1  # This container contains the configuration for the different type of reset reason that can be retrieved from Mcu_GetResetReason API.
        integer McuResetReason: 37..37, set at published-information, origin=Renesas_v1.0.0, symbolic-name-value=true, default-value=37  # The parameter represents the different type of reset that a Micro supports. This parameter is referenced by the parameter EcuMResetReason in the ECU State manager module, MCU_PERI_RAM_ECC1_RST.
      container McuRstRsnConfBistCodeEcc1  # This container contains the configuration for the different type of reset reason that can be retrieved from Mcu_GetResetReason API.
        integer McuResetReason: 38..38, set at published-information, origin=Renesas_v1.0.0, symbolic-name-value=true, default-value=38  # The parameter represents the different type of reset that a Micro supports. This parameter is referenced by the parameter EcuMResetReason in the ECU State manager module, MCU_BIST_CODE_ECC1_RST.
      container McuRstRsnConfBistCodeEcc2  # This container contains the configuration for the different type of reset reason that can be retrieved from Mcu_GetResetReason API.
        integer McuResetReason: 39..39, set at published-information, origin=Renesas_v1.0.0, symbolic-name-value=true, default-value=39  # The parameter represents the different type of reset that a Micro supports. This parameter is referenced by the parameter EcuMResetReason in the ECU State manager module, MCU_BIST_CODE_ECC2_RST.
      container McuRstRsnConfFaci  # This container contains the configuration for the different type of reset reason that can be retrieved from Mcu_GetResetReason API.
        integer McuResetReason: 40..40, set at published-information, origin=Renesas_v1.0.0, symbolic-name-value=true, default-value=40  # The parameter represents the different type of reset that a Micro supports. This parameter is referenced by the parameter EcuMResetReason in the ECU State manager module, MCU_FACI_RST.
      container McuRstRsnConfEcmDelayOverFlow  # This container contains the configuration for the different type of reset reason that can be retrieved from Mcu_GetResetReason API.
        integer McuResetReason: 41..41, set at published-information, origin=Renesas_v1.0.0, symbolic-name-value=true, default-value=41  # The parameter represents the different type of reset that a Micro supports. This parameter is referenced by the parameter EcuMResetReason in the ECU State manager module, MCU_ECM_DELY_OVRFLW_RST.
      container McuRstRsnConfCvmRst  # This container contains the configuration for the different type of reset reason that can be retrieved from Mcu_GetResetReason API.
        integer McuResetReason: 42..42, set at published-information, origin=Renesas_v1.0.0, symbolic-name-value=true, default-value=42  # The parameter represents the different type of reset that a Micro supports. This parameter is referenced by the parameter EcuMResetReason in the ECU State manager module, MCU_CVM_RST.
      container McuRstRsnConfRstUndefined  # This container contains the configuration for the different type of reset reason that can be retrieved from Mcu_GetResetReason API.
        integer McuResetReason: 43..43, set at published-information, origin=Renesas_v1.0.0, symbolic-name-value=true, default-value=43  # The parameter represents the different type of reset that a Micro supports. This parameter is referenced by the parameter EcuMResetReason in the ECU State manager module, MCU_RESET_UNDEFINED.
      container McuRstRsnConfRstUnknown  # This container contains the configuration for the different type of reset reason that can be retrieved from Mcu_GetResetReason API.
        integer McuResetReason: 44..44, set at published-information, origin=Renesas_v1.0.0, symbolic-name-value=true, default-value=44  # The parameter represents the different type of reset that a Micro supports. This parameter is referenced by the parameter EcuMResetReason in the ECU State manager module, MCU_RESET_UNKNOWN.
    container McuGeneralConfiguration  # This container contains the configuration (parameters) of the MCU driver.
      boolean McuVersionCheckExternalModules: set at pre-compile, origin=Renesas_v1.0.0, default-value=true  # Enable / disable AUTOSAR Version check for inter-module dependencies. | true: AUTOSAR Version check for inter-module dependencies is enabled. false: AUTOSAR Version check for inter-module dependencies is disabled.
      boolean McuDevErrorDetect: set at pre-compile, default-value=false  # Pre-processor switch for enabling the development error detection and reporting. | true: Enables development error detection and reporting. false: Disables development error detection and reporting.
      boolean McuGetRamStateApi: set at pre-compile, default-value=false  # Pre-processor switch to enable/disable the API Mcu_GetRamState. | (e.g. If the H/W does not support the functionality, this parameter can be used to disable the API). true: API Mcu_GetRamState is enabled. false: API Mcu_GetRamState is disabled.
      boolean McuInitClock: set at pre-compile, default-value=true  # If this parameter is set to FALSE, the clock initialization has to be disabled from the MCU driver. This concept applies when there are some write once clock registers and a bootloader is present. If this parameter is set to TRUE, the MCU driver is responsible for the clock initialization. | true: The MCU driver is responsible for the clock initialization. false: The clock initialization is disabled from the MCU driver.
      boolean McuNoPll: set at pre-compile, default-value=true  # This parameter shall be set true, if the H/W does not have a PLL or the PLL circuitry is enabled after the power on without S/W intervention. In this case MCU_DistributePllClock has to be disabled and MCU_GetPllStatus has to return MCU_PLL_STATUS_UNDEFINED. Otherwise this parameter has to be set False. | true: The H/W does not have a PLL or the PLL circuitry is enabled after the power on without S/W intervention. false: The H/W have a PLL or the PLL circuitry is disabled after the power on without S/W intervention.
      boolean McuPerformResetApi: set at pre-compile, default-value=false  # Pre-processor switch to enable or disable the use of the function Mcu_PerformReset(). | true: Enables the use of the function Mcu_PerformReset(). false: Disables the use of the function Mcu_PerformReset().
      boolean McuVersionInfoApi: set at pre-compile, default-value=false  # Pre-processor switch to enable or disable the API to read out the modules version information. | true: Enables the API to read out the modules version information. false: Disables the API to read out the modules version information.
      boolean McuCriticalSectionProtection: set at pre-compile, origin=Renesas_v1.0.0, default-value=true  # This parameter specifies if the MCU driver CPU load can be reduced by disabling the enter/exit critical section functionality by adding a precompiled configuration parameter to the MCU driver configuration. | true: Enables the critical section functionality for the restricted area. false: Disables the critical section functionality for the restricted area.
      boolean McuSwResetCallApi: set at pre-compile, origin=Renesas_v1.0.0, default-value=false  # This parameter shall decide if MCU_RESET_CALLOUT API will be used for to reset software. | true: MCU_RESET_CALLOUT API will be used for reset software. false: MCU_RESET_CALLOUT API will not be used for reset software.
      integer McuEcmDelayTimerOverflowValue: 0..65535, set at pre-compile, origin=Renesas_v1.0.0, default-value=65535  # This parameter specifies to configure the overflow value for the ECM delay timer. This value will be compared with ECM delay timer register. The ECM delay timer uses high speed peripheral clock signal for counting.
      enumeration McuEcmErrorOutputMode: {NON_DYNAMIC_MODE, DYNAMIC_MODE}, set at pre-compile, origin=Renesas_v1.0.0, default-value=NON_DYNAMIC_MODE  # This parameter used to configure the error output either in Dynamic or Non-Dynamic mode. | NON_DYNAMIC_MODE: error output in Non-Dynamic mode. DYNAMIC_MODE: error output in Dynamic mode.
      boolean McuEcmErrorOutTimer: set at pre-compile, origin=Renesas_v1.0.0, default-value=false  # This parameter used to selects the timer output in Dynamic mode. | true: Timer output selection to OSTM1. false: Timer output selection to Channel 15 in TAUD1.
      boolean McuRamSectorSetting: set at pre-compile, origin=Renesas_v1.0.0, default-value=false  # This parameter enable or disable Mcu_InitRamSection API. If McuRamSectorSetting = FALSE, the local RAM error sources must be configured as part of Mcu_Init API. If McuRamSectorSetting = TRUE, the local RAM error sources must be configured as part of Mcu_InitRamSection API. | true: enables Mcu_InitRamSection API. false: disables Mcu_InitRamSection API.
      enumeration McuDeviceName: {R7F701310, R7F701311, R7F701312, R7F701313, R7F701314, R7F701315, R7F701318, R7F701319, R7F701320, R7F701321, R7F701322, R7F701323}, set at pre-compile, origin=Renesas_v1.0.0, default-value=R7F701312  # This parameter contains the supported device name to identify the device specific C header file through Translation XML File. | R7F701310, R7F701311, R7F701312, R7F701313, R7F701314, R7F701315, R7F701318, R7F701319, R7F701320, R7F701321, R7F701322 and R7F701323: This value should be child tag of TRANSLATION-FILE-PATH and DEVICE-FILE-PATH tag in Translation XML File.
      boolean McuClm0Operation: set at post-build, origin=Renesas_v1.0.0, default-value=false  # This parameter enables or disables operation of clock monitor function for CLMA0. | true: Enables operation of clock monitor function for CLMA0. false: Disables operation of clock monitor function for CLMA0.
      float McuClm0MonitoringClockAccuracy: 0..20, set at pre-compile, origin=Renesas_v1.0.0, default-value=9  # This parameter specifies the monitoring clock accuracy of CLMA0 in percentage.
      float McuClm0SamplingClockAccuracy: 0..20, set at pre-compile, origin=Renesas_v1.0.0, default-value=9  # This parameter specifies the sampling clock accuracy of CLMA0 in percentage.
      boolean McuClm1Operation: set at post-build, origin=Renesas_v1.0.0, default-value=false  # This parameter enables or disables operation of clock monitor function for CLMA1. | true: Enables operation of clock monitor function for CLMA1. false: Disables operation of clock monitor function for CLMA1.
      float McuClm1MonitoringClockAccuracy: 0..20, set at pre-compile, origin=Renesas_v1.0.0, default-value=9  # This parameter specifies the monitoring clock accuracy of CLMA1 in percentage.
      float McuClm1SamplingClockAccuracy: 0..20, set at pre-compile, origin=Renesas_v1.0.0, default-value=9  # This parameter specifies the sampling clock accuracy of CLMA1 in percentage.
      boolean McuClm2Operation: set at post-build, origin=Renesas_v1.0.0, default-value=false  # This parameter enables or disables operation of clock monitor function for CLMA2. | true: Enables operation of clock monitor function for CLMA2. false: Disables operation of clock monitor function for CLMA2.
      float McuClm2MonitoringClockAccuracy: 0..20, set at pre-compile, origin=Renesas_v1.0.0, default-value=14  # This parameter specifies the monitoring clock accuracy of CLMA2 in percentage.
      float McuClm2SamplingClockAccuracy: 0..20, set at pre-compile, origin=Renesas_v1.0.0, default-value=14  # This parameter specifies the sampling clock accuracy of CLMA2 in percentage.
      boolean McuClm3Operation: set at post-build, origin=Renesas_v1.0.0, default-value=false  # This parameter enables or disables operation of clock monitor function for CLMA3. | true: Enables operation of clock monitor function for CLMA3. false: Disables operation of clock monitor function for CLMA3.
      float McuClm3MonitoringClockAccuracy: 0..20, set at pre-compile, origin=Renesas_v1.0.0, default-value=14  # This parameter specifies the monitoring clock accuracy of CLMA3 in percentage.
      float McuClm3SamplingClockAccuracy: 0..20, set at pre-compile, origin=Renesas_v1.0.0, default-value=14  # This parameter specifies the sampling clock accuracy of CLMA3 in percentage.
      boolean McuCvmSelfDiagnosticTest: set at pre-compile, origin=Renesas_v1.0.0, default-value=false  # This parameter enables or disables operation of self diagnostic test supported for CVM. This test shall be performed during initialization phase in the module specific initialization function. If self diagnostic test fails then DEM error will be reported. | true: Enables operation of self diagnostic test supported for CVM. false: Disables operation of self diagnostic test supported for CVM.
      boolean McuClma0SelfDiagnosticTest: set at pre-compile, origin=Renesas_v1.0.0, default-value=false  # This parameter enables or disables operation of self diagnostic test supported for CLMA0. CLMA0 Self-diagnostic tests shall be performed during initialization phase in the module specific initialization function. If self diagnostic test fails then DEM error will be reported. | true: Enables operation of self diagnostic test supported for CLMA0. false: Disables operation of self diagnostic test supported for CLMA0.
      boolean McuClma1SelfDiagnosticTest: set at pre-compile, origin=Renesas_v1.0.0, default-value=false  # This parameter enables or disables operation of self diagnostic test supported for CLMA1. CLMA1 Self-diagnostic tests shall be performed during initialization phase in the module specific initialization function. If self diagnostic test fails then DEM error will be reported. | true: Enables operation of self diagnostic test supported for CLMA1. false: Disables operation of self diagnostic test supported for CLMA1.
      boolean McuClma2SelfDiagnosticTest: set at pre-compile, origin=Renesas_v1.0.0, default-value=false  # This parameter enables or disables operation of self diagnostic test supported for CLMA2. CLMA2 Self-diagnostic tests shall be performed during initialization phase in the module specific initialization function. If self diagnostic test fails then DEM error will be reported. | true: Enables operation of self diagnostic test supported for CLMA2. false: Disables operation of self diagnostic test supported for CLMA2.
      boolean McuClma3SelfDiagnosticTest: set at pre-compile, origin=Renesas_v1.0.0, default-value=false  # This parameter enables or disables operation of self diagnostic test supported for CLMA3. CLMA3 Self-diagnostic tests shall be performed during initialization phase in the module specific initialization function. If self diagnostic test fails then DEM error will be reported. | true: Enables operation of self diagnostic test supported for CLMA3. false: Disables operation of self diagnostic test supported for CLMA3.
      boolean McuEcmSelfDiagnosticTest: set at pre-compile, origin=Renesas_v1.0.0, default-value=false  # This parameter enables or disables operation of self diagnostic test supported for ECM(Error Control Module) in order to test the ERROROUTZ signal. ECM Self-diagnostic tests shall be performed during initialization phase in the module specific initialization function. | true: Enables operation of self diagnostic test supported for ECM. false: Disables operation of self diagnostic test supported for ECM.
      enumeration McuWriteVerify: {WV_DISABLE, WV_INIT_ONLY, WV_INIT_RUNTIME}, set at pre-compile, origin=Renesas_v1.0.4, default-value=WV_DISABLE  # This parameter enables selection and support of the register write-verify functionality of all Mcu registers. | WV_INIT_ONLY: Enables register write-verify functionality during initialize API. WV_INIT_RUNTIME: Enables register write-verify functionality for Init and all other APIs. WV_DISABLE: Disables register write-verify functionality of all Mcu registers.
      integer McuLoopCount: 1..255, set at pre-compile, origin=Renesas_v1.0.0, default-value=5  # The count value for the feed back loop in Mcu module. The loop can be minimum 1 to maximum 255.The user shall configure this parameter to standard default value 5 for avoiding unwanted reporting of DEM due to stabilization issues.
      boolean McuLockStepSelfDiagnosticTest: set at pre-compile, origin=Renesas_v1.0.1, default-value=false  # This parameter is used to monitor the functionalities of the lockstep mode. | true: Enables the Compare Unit Self-diagnostic test during initialisation phase. false: Disables the Compare Unit Self-diagnostic test during initialisation phase.
      boolean McuStartUpSWResetTest: set at pre-compile, origin=Renesas_v1.0.4, default-value=false  # This parameter is used to monitor the functionalities of the Software Start Up Test. | true: Enables the Software reset Start-Up test during initialisation phase. Dem parameter MCU_E_RESETCONTROLLER_STARTUP_FAILURE should be configured if this parameter is enabled. false: Disables the Software reset Start-Up test during initialisation phase.
      boolean McuStartUpECMResetTest: set at pre-compile, origin=Renesas_v1.0.4, default-value=false  # This parameter is used to monitor the functionalities of the ECM reset Start Up Test. | true: Enables the ECM reset Start-Up test during initialisation phase. Dem parameter MCU_E_RESETCONTROLLER_STARTUP_FAILURE should be configured if this parameter is enabled. false: Disables the ECM reset Start-Up test during initialisation phase.
      boolean McuInterruptConsistencyCheck: set at pre-compile, origin=Renesas_v1.1.5, default-value=false  # This parameter enables / disables the Interrupt Consistency Check functionality. | true: Interrupt Consistency Checks are enabled. false: Interrupt Consistency Checks are disabled.
      boolean Mcu_UseWVErrorInterface [0..1]: set at post-build, origin=Renesas_v1.0.4, default-value=false  # This parameter specifies whether user can configure McuWriteverifyErrorInterface instead of DEM error for Write-Verify functionality. | true: user can configure error notification interface via McuWriteVerifyErrorInterface parameter. false: Error notification for Write-Verify functionality shall be handled via DEM error.
      function name McuWVErrorNotification [0..1]: set at post-build, origin=Renesas_v1.0.4, default-value=NULL, regular-expression=[a-zA-Z][a-zA-Z0-9_]*  # This parameter is used to configure the name of the WriteVerifyErrorInterface which shall be called with the ApiID and ErrorId when Write Verify error occurs.
