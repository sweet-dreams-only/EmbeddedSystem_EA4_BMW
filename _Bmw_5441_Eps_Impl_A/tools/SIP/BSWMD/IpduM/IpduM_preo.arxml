AUTOSAR XML (schema 4-0-3)
package /MICROSAR
  module config IpduM_Pre: definition=IpduM
  module config IpduM_Rec: definition=IpduM, implementation-config-variant=VARIANT-PRE-COMPILE
