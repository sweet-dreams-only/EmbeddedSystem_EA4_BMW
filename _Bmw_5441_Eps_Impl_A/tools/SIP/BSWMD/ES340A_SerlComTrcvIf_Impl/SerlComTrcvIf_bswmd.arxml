AUTOSAR XML (schema 4-0-3)
package /Nxtr
  module definition SerlComTrcvIf [0..1]: variants pre-compile  # Configuration of the SerlComTrcvIf.
    container SerlComTrcvIfGeneral  # This container contains the configuration (parameters) of the SerlComTrcvIf.
      integer PASSSTEP: 0..65535, set at pre-compile, origin=NXTR, default-value=16384  # Error accumulator pass step
