AUTOSAR XML (schema 4-2-2)
# \copyright BMW AG 2015
package /BMW_DEF
  module definition Srv: variants pre-compile  # Configuration of the Srv module.
    container General  # General configuration parameters.
      boolean HandleEccRam: set at pre-compile, origin=BMW, default-value=false  # Defines whether RAM ECC errors are handled
      boolean HandleEccRom: set at pre-compile, origin=BMW, default-value=false  # Defines whether ROM ECC errors are handled
      boolean MultiCpuEnable: set at pre-compile, origin=BMW, default-value=false  # Selects, whether this ECU is a multi CPU ECU. If enabled, some modules like Dlog and Prog require additional user defined functions to handle communication with slave CPUs.
    container CommonPublishedInformation  # Common container, aggregated by all modules. It contains published information about vendor and versions.
      integer SwMajorVersion: set at published-information, origin=BMW, default-value=3  # Major version number of the vendor specific implementation of the module.
      integer SwMinorVersion: set at published-information, origin=BMW, default-value=1  # Minor version number of the vendor specific implementation of the module.
      integer SwPatchVersion: set at published-information, origin=BMW, default-value=0  # Patch version number of the vendor specific implementation of the module.
    container Features
      enumeration BootMode: set at pre-compile, origin=BMW, default-value=SRV_BM_DISABLED  # Defines, which features of BootMode shall be enabled.
        SRV_BM_DISABLED  # BootMode featue completely disabled. Use this for Blu.
        SRV_BM_ENABLED  # BootMode feature is enabled. Use this for Bootmanager.
        SRV_BM_ENABLED_DCM  # BootMode feature including DCM and PFM interface is enabled. Use this in Application and Bootloader.
