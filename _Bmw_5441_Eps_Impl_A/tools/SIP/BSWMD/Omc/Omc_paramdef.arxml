AUTOSAR XML (schema 4-2-2)
# \copyright BMW AG 2014 - 2017
package /BMW_DEF
  module definition Omc [0..1]: variants pre-compile  # Configuration of the OMC (Operating Mode Control)
    container OmcGeneral  # This container contains the configuration (parameters) of the OMC
      boolean OmcDevErrorDetect: set at pre-compile, origin=BMW AG, default-value=false  # Activate/Deactivate the Development Error Detection and Notification. true: Development Error Detection andNotification activated false: Development Error Detection and Notification deactivated
      boolean OmcOperatingModeCallout: set at pre-compile, origin=BMW AG, default-value=false  # Activate/Deactivate the user call to decide if an OperationMode and ExtendedOperationMode switch is allowed by the application.
    container CommonPublishedInformation  # This container contains information about common published information e.g. Software version.
      integer SwMajorVersion: set at published-information, origin=BMW AG, default-value=5  # Software Major version
      integer SwMinorVersion: set at published-information, origin=BMW AG, default-value=1  # Software Minor version
      integer SwPatchVersion: set at published-information, origin=BMW AG, default-value=0  # Software patch version
