AUTOSAR XML (schema 4-3-0)
package /BMW_DEF
  module definition Crypto: category=VENDOR_SPECIFIC_MODULE_DEFINITION, variants pre-compile
    container CommonPublishedInformation
      integer SwMajorVersion: origin=BMW, set at published-information, default-value=5  # Major version number of the vendor specific implementation of the module.
      integer SwMinorVersion: origin=BMW, set at published-information, default-value=2  # Minor version number of the vendor specific implementation of the module.
      integer SwPatchVersion: origin=BMW, set at published-information, default-value=0  # Patch version number of the vendor specific implementation of the module.
    container Crypto_Optimization
      boolean Enable_ShamirsTrick: origin=BMW, set at pre-compile, default-value=false
      boolean Enable_SizeSpecificCombaFunction: origin=BMW, set at pre-compile, default-value=false
      enumeration MaxSigSize: {RSA_4096, RSA_3072, RSA_2048, ECC_521, ECC_384, ECC_256}, origin=BMW, set at pre-compile, default-value=RSA_4096  # Maximal size of the signature.
