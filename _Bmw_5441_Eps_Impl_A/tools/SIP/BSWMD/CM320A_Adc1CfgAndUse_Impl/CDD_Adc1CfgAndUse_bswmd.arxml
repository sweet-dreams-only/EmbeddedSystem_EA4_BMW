AUTOSAR XML (schema 4-0-3)
package /Nxtr
  module definition Adc1CfgAndUse [0..1]: variants pre-compile  # Configuration of the ADC0.
    container Adc1CfgAndUseGeneral  # This container contains the configuration (parameters) of the Adc1CfgAndUse.
      integer ADCD1VCR{00..20}: 0..262143, set at pre-compile, origin=Nxtr  # .
      integer ADCD1SGVCSP2: 0..63, set at pre-compile, origin=Nxtr  # .
      integer ADCD1SGVCSP3: 0..63, set at pre-compile, origin=Nxtr  # .
      integer ADCD1SGVCEP2: 0..63, set at pre-compile, origin=Nxtr  # .
      integer ADCD1SGVCEP3: 0..63, set at pre-compile, origin=Nxtr  # .
