AUTOSAR XML (schema 4-0-3)
package /MICROSAR/Fr_V85xEray
  module config Fr_Rec: definition=Fr
    FrGeneral: FrSafeBswChecks=1
