AUTOSAR XML (schema 4-3-0)
# \copyright BMW AG 2015 - 2017
package /BMW_DEF
  module definition StdDiag [0..1]: category=VENDOR_SPECIFIC_MODULE_DEFINITION, variants pre-compile  # Configuration of the StdDiag module
    container StdDiagGeneral  # General configuration parameters for the StdDiag.
      boolean StdDiagDevErrorDetect: origin=BMW, set at pre-compile, default-value=false  # With this parameter development error tracing can be enabled (TRUE) or disabled (FALSE).
      boolean StdDiagUserEstablishIntrinsicSafety: origin=BMW, set at pre-compile, default-value=false  # Defines if user specific callout function is called to establish intrinsic safety during preparation for programming.
      boolean StdDiagUserActiveSessionState: origin=BMW, set at pre-compile, default-value=false  # Defines if user specific callout function is called to get the active session state for UDS service 0x22 F1 00.
    container StdDiagUserProgrammingPreconditionsCheck [0..1]: multiplicity set at pre-compile  # Defines if user specific function for checking additional programming preconditions is used.
      integer MaxNumberUserProgrammingPrecondition: 1..255, origin=BMW, set at pre-compile, default-value=1  # The maximum number of failed user programming preconditions.
    container StdDiagProvideIDRL [0..1]: multiplicity set at pre-compile  # Defines if the StdDiag module provides the implementation of the IDRL functions.
      integer DIDTableFormatIdentifier: 0..65535, origin=BMW, set at pre-compile, default-value=1  # The format identifier of the table of the individual DIDs.
      container IDRLClient [0..65535]: multiplicity set at pre-compile  # The software components using the IDRL feature.
        container IndivData [0..65535]: multiplicity set at pre-compile  # The individual data of an IDRL Client.
          integer DIDValue: 0..65535, origin=BMW, set at pre-compile, default-value=0  # The DID value of this individual data.
          integer MaxDataSize: 1..65535, origin=BMW, set at pre-compile, default-value=1  # The maximum size of individual data (in Byte) related to this DID.
    container CommonPublishedInformation  # Common container, contains published version information.
      integer SwMajorVersion: origin=BMW, set at published-information, default-value=5  # Major version number of the module.
      integer SwMinorVersion: origin=BMW, set at published-information, default-value=3  # Minor version number of the module.
      integer SwPatchVersion: origin=BMW, set at published-information, default-value=0  # Patch version number of the module.
