AUTOSAR XML (schema 4-3-0)
# \copyright BMW AG 2015 - 2017
package /BMW_DEF
  module definition StdDiagClassic [0..1]: category=VENDOR_SPECIFIC_MODULE_DEFINITION, post-build-variant-support=true, variants pre-compile/post-build  # Configuration of the StdDiag module
    container StdDiagGeneral  # General configuration parameters for the StdDiag.
      boolean StdDiagClearSecondaryErrorMemory: origin=BMW, set at pre-compile, default-value=true  # Defines if the StdDiag module provides the interface to clear the secondary error memory via the UDS service 0x31 01 0F 06.
    container StdDiagSgbdIndex
      integer SgbdIndex: 0..16777215, origin=BMW, post-build-variant-value=true, set at pre-compile in variant pre-compile / post-build in variant post-build, default-value=0
    container StdDiagUserDefinedMemory [0..1]  # This container has to be provided if parameter StdDiagClearSecondaryErrorMemory is enabled.
      string StdDiagUserDefinedMemoryName: origin=BMW, set at pre-compile, default-value=BMWSecondaryErrorMemory  # This parameter shall be set to the short-name of the configuration container DemUserDefinedMemory, which represents the secondary error memory.
      integer StdDiagUserDefinedMemoryId: 0..65535, origin=BMW, set at pre-compile, default-value=257  # This parameter shall be set to the value of Dem_DTCOriginType, which represents the secondary error memory.
    container StdDiagProvideDLTSupport [0..1]  # Defines if the StdDiag module provides the implementation for BMW specific support of Diagnostic Log and Trace (DLT).
      integer StdDiagNumberSupportedDLTLogChannels: 1..4294967295, origin=BMW, set at pre-compile, default-value=1  # Number of supported DLT log channels. Has to be equal to the number of DltLogChannel containers in Dlt module configuration.
    container StdDiagApplicationDataTransfer [0..1]
      container ApplicationRoutineControlIdentifier [1..*]: multiplicity set at pre-compile
        integer RoutineIdentifierValue: 0..65535, origin=BMW, set at pre-compile, default-value=0
        container ApplicationSubRoutineControlIdentifier [1..*]
          integer SubRoutineIdentifierValue: 0..65535, origin=BMW, set at pre-compile, default-value=0
          integer controlIDs [1..*]: 0..18446744073709551615, multiplicity set at pre-compile, origin=BMW, set at pre-compile, default-value=0
    container CommonPublishedInformation  # Common container, contains published version information.
      integer SwMajorVersion: origin=BMW, set at published-information, default-value=5  # Major version number of the module.
      integer SwMinorVersion: origin=BMW, set at published-information, default-value=4  # Minor version number of the module.
      integer SwPatchVersion: origin=BMW, set at published-information, default-value=0  # Patch version number of the module.
