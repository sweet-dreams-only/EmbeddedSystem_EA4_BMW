AUTOSAR XML (schema 4-3-0)
# \copyright BMW AG 2016
package /BMW_DEF
  module definition Darh: variants pre-compile  # Configuration of the Darh (Diagnostic Active Response Handler)
    container CommonPublishedInformation  # Common container, aggregated by all modules. It contains published information about vendor and versions.
      integer SwMajorVersion: origin=BMW AG, set at published-information, default-value=5  # Major version number of the vendor specific implementation of the module.
      integer SwMinorVersion: origin=BMW AG, set at published-information, default-value=1  # Minor version number of the vendor specific implementation of the module. The numbering is vendor specific.
      integer SwPatchVersion: origin=BMW AG, set at published-information, default-value=0  # Patch level version number of the vendor specific implementation of the module. The numbering is vendor specific.
    container DarhGeneral  # This container contains the configuration (parameters) of the Darh.
      boolean DarhDevErrorDetect: origin=BMW AG, set at pre-compile, default-value=false  # Activate/Deactivate the Development Error Detection and Notification. true : Development Error Detection and Notification activated false : Development Error Detection and Notification deactivated
      float DarhQueueHandlerCycleTime: 1.0..16.0, origin=BMW AG, set at pre-compile, default-value=1.0  # Cycle time of the Queue handler functionality. This value determines in which interval the queue is checked for pending entries that have to be sent.
      integer DarhQueueSize: 1..100, origin=BMW AG, set at pre-compile, default-value=3  # Max. number of entries (of type Darh_QueueElementType) the queue can contain.
      integer DarhRetryCount: 0..255, origin=BMW AG, set at pre-compile, default-value=3  # Max. number of retry times to send a message which fails to transmit. Behavior example for different configurations: 0 : Darh tries to send once. If fails, it does not retry to send = 1 attempt total 1 : Darh tries to send once. If fails, it retries to send 1 more time = up to 2 attempts total 2 : Darh tries to send once. If fails, it retries up to 2 more times = up to 3 attempts total
      enumeration DarhActiveReportListType: {POSITIVE_LIST, DYNAMICALLY}, origin=BMW AG, set at pre-compile, default-value=POSITIVE_LIST  # This parameter defines how and if Darh handles the DarhActiveReportedEvent to report errors to the diagnose master.
