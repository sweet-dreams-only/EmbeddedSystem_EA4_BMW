AUTOSAR XML (schema 4-3-0)
# \copyright BMW AG 2016
package /BMW_DEF
  module definition DarhClassic: variants pre-compile  # Configuration of the Darh (Diagnostic Active Response Handler) Classic Adapter.
    container CommonPublishedInformation  # Common container, aggregated by all modules. It contains published information about vendor and versions.
      integer SwMajorVersion: origin=BMW AG, set at published-information, default-value=5  # Major version number of the vendor specific implementation of the module.
      integer SwMinorVersion: origin=BMW AG, set at published-information, default-value=1  # Minor version number of the vendor specific implementation of the module. The numbering is vendor specific.
      integer SwPatchVersion: origin=BMW AG, set at published-information, default-value=0  # Patch level version number of the vendor specific implementation of the module. The numbering is vendor specific.
    container DarhActiveReportedEvent [1..21845]  # Depending on DarhActiveReportListType this container contains the definition of events that shall or not be actively reported by Darh.
      reference DarhDemEvent: origin=BMW AG, set at pre-compile, destination=DemEventParameter  # Reference to the event in the Dem configuration that shall be actively reported.
