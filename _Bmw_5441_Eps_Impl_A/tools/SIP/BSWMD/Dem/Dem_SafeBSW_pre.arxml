AUTOSAR XML (schema 4-1-2)
package /MICROSAR
  module config Dem_Rec: definition=Dem
    DemGeneral: DemSafeBswChecks=1
