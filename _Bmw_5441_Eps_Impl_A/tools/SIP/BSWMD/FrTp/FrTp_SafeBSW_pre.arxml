AUTOSAR XML (schema 4-0-3)
package /MICROSAR
  module config FrTp_Rec: definition=FrTp
    FrTpGeneral: FrTpSafeBswChecks=1
