AUTOSAR XML (schema 4-0-3)
package /MICROSAR
  module config FrTp_Pre: definition=FrTp
  module config FrTp_Rec: definition=FrTp, implementation-config-variant=VARIANT-PRE-COMPILE
