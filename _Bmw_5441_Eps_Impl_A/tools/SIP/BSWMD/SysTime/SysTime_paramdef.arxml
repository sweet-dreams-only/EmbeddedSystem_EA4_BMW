AUTOSAR XML (schema 4-3-0)
# \copyright BMW AG 2015 - 2017
package /BMW_DEF
  module definition SysTime [0..1]: category=VENDOR_SPECIFIC_MODULE_DEFINITION, variants pre-compile  # Configuration of the SysTime module
    container SysTimeGeneral  # General parameter definitions for the System Time Client
      boolean SysTimeDevErrorDetect: origin=BMW, set at pre-compile, default-value=false  # Describes whether tracing of development errors is enabled (TRUE) or disabled (FALSE).
      float SysTimeMainTaskCycle: 0.010..0.1, origin=BMW, set at pre-compile, default-value=0.010  # Describes the frequency of the main task in seconds.
      float SysTimeInitialTimeout: 1..60, origin=BMW, set at pre-compile, default-value=5  # Describes the inital timeout in seconds. If no valid system time signal has been received until this timeout, the system time will be set to 0xFFFFFFFF. Value has to be a multiple of SysTimeMainTaskCycle.
    container CommonPublishedInformation  # Common container, contains published version information.
      integer SwMajorVersion: origin=BMW, set at published-information, default-value=5  # Major version number of the module.
      integer SwMinorVersion: origin=BMW, set at published-information, default-value=0  # Minor version number of the module.
      integer SwPatchVersion: origin=BMW, set at published-information, default-value=3  # Patch version number of the module.
