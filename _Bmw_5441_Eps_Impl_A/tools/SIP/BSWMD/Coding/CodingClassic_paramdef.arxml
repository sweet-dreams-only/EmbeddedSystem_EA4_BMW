AUTOSAR XML (schema 4-3-0)
# \copyright BMW AG 2016 - 2017
package /BMW_DEF
  module definition CodingClassic: category=VENDOR_SPECIFIC_MODULE_DEFINITION, variants pre-compile  # This container holds the configuration of the Coding classic adapter.
    container CodingClassicGeneral  # This container contains the configuration parameter for the call cycle of the Coding time after qualification of net coding data is not longer allowed.
      float CodingCycleTime: 0.005..0.5, origin=BMW, set at pre-compile, default-value=0.1  # Specifies the call cycle of the Coding timer function in seconds.
    container CommonPublishedInformation  # Common container, aggregated by all modules. It contains published information about vendor and versions.
      integer SwMajorVersion: origin=BMW, set at published-information, default-value=5  # Major version number of the vendor specific implementation of the module.
      integer SwMinorVersion: origin=BMW, set at published-information, default-value=2  # Minor version number of the vendor specific implementation of the module.
      integer SwPatchVersion: origin=BMW, set at published-information, default-value=1  # Patch version number of the vendor specific implementation of the module.
