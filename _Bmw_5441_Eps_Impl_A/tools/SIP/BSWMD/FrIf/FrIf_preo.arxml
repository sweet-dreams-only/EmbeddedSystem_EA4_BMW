AUTOSAR XML (schema 4-0-3)
package /MICROSAR
  module config FrIf_Pre: definition=FrIf
  module config FrIf_Rec: definition=FrIf, implementation-config-variant=VARIANT-PRE-COMPILE
