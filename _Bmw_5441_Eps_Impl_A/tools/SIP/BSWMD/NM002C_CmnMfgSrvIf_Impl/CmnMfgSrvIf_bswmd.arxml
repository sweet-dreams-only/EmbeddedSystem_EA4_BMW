AUTOSAR XML (schema 4-0-3)
package /Nxtr
  module definition CmnMfgSrvIf [0..1]: variants pre-compile  # Configuration of Nxtr Common Manufacturing Services Interface (to DCM Interface).
