AUTOSAR XML (schema 4-0-3)
package /ActiveEcuC
  module config TunSelnMngt: implementation-config-variant=VARIANT-PRE-COMPILE
    TunSelnMngtCommon: OnlineCalibrationRamSize=4096
    CalibrationConfiguration
    CalRegn01 (CalRegions)
    XcpWriteAccess: EnableDevelopmentMode=STD_OFF
