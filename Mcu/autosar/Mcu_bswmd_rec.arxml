AUTOSAR XML (schema 4-0-3)
package /Renesas/EcucDefs_Mcu
  module config Mcu_Rec: definition=Mcu
    McuModuleConfiguration
      McuEcmErrorSourcesCfg
        McuEcmErrorSource0: McuMiNotification=NULL_PTR, McuNmiNotification=NULL_PTR
        McuEcmErrorSource1: McuMiNotification=NULL_PTR, McuNmiNotification=NULL_PTR
        McuEcmErrorSource4: McuNmiNotification=NULL_PTR, McuMiNotification=NULL_PTR
        McuEcmErrorSource{10..12}: McuNmiNotification=NULL_PTR, McuMiNotification=NULL_PTR
        McuEcmErrorSource{14..24}: McuNmiNotification=NULL_PTR, McuMiNotification=NULL_PTR
        McuEcmErrorSource{26..34}: McuNmiNotification=NULL_PTR, McuMiNotification=NULL_PTR
        McuEcmErrorSource{36..42}: McuNmiNotification=NULL_PTR, McuMiNotification=NULL_PTR
        McuEcmErrorSource{5..9}: McuNmiNotification=NULL_PTR, McuMiNotification=NULL_PTR
    McuGeneralConfiguration: McuVersionCheckExternalModules=0
  bsw implementation Mcu_Impl: programming-language=C, behavior=McuBehavior, recommended-configuration=Mcu_Rec, vendor-specific-module-def=Mcu
