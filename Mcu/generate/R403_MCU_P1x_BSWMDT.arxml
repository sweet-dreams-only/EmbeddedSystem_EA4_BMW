AUTOSAR XML (schema 4-0-3)
# COPYRIGHT
# Copyright(c) 2013-2017 Renesas Electronics Corporation
package /Renesas/EcucDefs_Mcu
  bsw implementation Mcu_Impl: programming-language=C, sw-version=1.0.8, vendor-id=59, ar-release-version=4.0.3, behavior=BswInternalBehavior_0, vendor-api-infix=Renesas, vendor-specific-module-def=Mcu
  module config Mcu_Preconfiguration: definition=Renesas, implementation-config-variant=VARIANT-PRE-COMPILE
    McuResetReason_0 (McuRstRsnConfPowOnClr): McuResetReason=0
    McuResetReason_1 (McuRstRsnConfPinRst): McuResetReason=1
    McuResetReason_2 (McuRstRsnConfSwRst): McuResetReason=2
    McuResetReason_3 (McuRstRsnConfWdta): McuResetReason=3
    McuResetReason_4 (McuRstRsnConfLockStepCompare): McuResetReason=4
    McuResetReason_5 (McuRstRsnConfClkMonUprLimErMosc): McuResetReason=5
    McuResetReason_6 (McuRstRsnConfClkMonLwrLimErMosc): McuResetReason=6
    McuResetReason_7 (McuRstRsnConfClkMonUprLimErWdt): McuResetReason=7
    McuResetReason_8 (McuRstRsnConfClkMonLwrLimErWdt): McuResetReason=8
    McuResetReason_9 (McuRstRsnConfClkMonUprLimErPclk): McuResetReason=9
    McuResetReason_10 (McuRstRsnConfClkMonLwrLimErPclk): McuResetReason=10
    McuResetReason_11 (McuRstRsnConfClkMonUprLimErPe1): McuResetReason=11
    McuResetReason_12 (McuRstRsnConfClkMonLwrLimErPe1): McuResetReason=12
    McuResetReason_13 (McuRstRsnConfLRamEcc2AddPrty): McuResetReason=13
    McuResetReason_14 (McuRstRsnConfInstCacheRamEcc2): McuResetReason=14
    McuResetReason_15 (McuRstRsnConfCodeFlsEcc2AddPrty): McuResetReason=15
    McuResetReason_16 (McuRstRsnConfDataFlsEcc2): McuResetReason=16
    McuResetReason_17 (McuRstRsnConfDtsRamEcc2): McuResetReason=17
    McuResetReason_18 (McuRstRsnConfCsihRamEcc2): McuResetReason=18
    McuResetReason_19 (McuRstRsnConfCanRamEcc2): McuResetReason=19
    McuResetReason_20 (McuRstRsnConfFrRamEcc2): McuResetReason=20
    McuResetReason_21 (McuRstRsnConfFlsProgMode): McuResetReason=21
    McuResetReason_22 (McuRstRsnConfTestMode): McuResetReason=22
    McuResetReason_23 (McuRstRsnConfSingChipModInact): McuResetReason=23
    McuResetReason_24 (McuRstRsnConfPeGuard): McuResetReason=24
    McuResetReason_25 (McuRstRsnConfPBusGuard): McuResetReason=25
    McuResetReason_26 (McuRstRsnConfSarAdcPrty): McuResetReason=26
    McuResetReason_27 (McuRstRsnConfBusDataPrty): McuResetReason=27
    McuResetReason_28 (McuRstRsnConfEcmCompare): McuResetReason=28
    McuResetReason_29 (McuRstRsnConfLvi): McuResetReason=29
    McuResetReason_30 (McuRstRsnConfTempSensor): McuResetReason=30
    McuResetReason_31 (McuRstRsnConfDmaTrans): McuResetReason=31
    McuResetReason_32 (McuRstRsnConfDmaViol): McuResetReason=32
    McuResetReason_33 (McuRstRsnConfLRamEcc1): McuResetReason=33
    McuResetReason_34 (McuRstRsnConfCodeFlsEcc1): McuResetReason=34
    McuResetReason_35 (McuRstRsnConfDataFlsEcc1): McuResetReason=35
    McuResetReason_36 (McuRstRsnConfDtsRamEcc1): McuResetReason=36
    McuResetReason_37 (McuRstRsnConfPeriRamEcc1): McuResetReason=37
    McuResetReason_38 (McuRstRsnConfBistCodeEcc1): McuResetReason=38
    McuResetReason_39 (McuRstRsnConfBistCodeEcc2): McuResetReason=39
    McuResetReason_40 (McuRstRsnConfFaci): McuResetReason=40
    McuResetReason_41 (McuRstRsnConfEcmDelayOverFlow): McuResetReason=41
    McuResetReason_42 (McuRstRsnConfCvmRst): McuResetReason=42
    McuResetReason_43 (McuRstRsnConfRstUndefined): McuResetReason=43
    McuResetReason_44 (McuRstRsnConfRstUnknown): McuResetReason=44
  bsw module description Mcu: module-id=101
    bsw internal behavior BswInternalBehavior_0
      exclusive area MCU_REGISTER_PROTECTION
      exclusive area MCU_VARIABLE_PROTECTION
      4 x bsw interrupt entity, all with can-enter-exclusive-area=MCU_REGISTER_PROTECTION, interrupt-source=INTECM:
        BswInterruptEntity_1: implemented-entry=MCU_FEINT_ISR, interrupt-category=CAT-1
        BswInterruptEntity_2: implemented-entry=MCU_FEINT_CAT2_ISR, interrupt-category=CAT-2
        BswInterruptEntity_3: implemented-entry=MCU_ECM_EIC_ISR, interrupt-category=CAT-1
        BswInterruptEntity_4: implemented-entry=MCU_ECM_EIC_CAT2_ISR, interrupt-category=CAT-2
      12 x bsw called entity:
        BswCalledEntity_0: can-enter-exclusive-area=MCU_REGISTER_PROTECTION, implemented-entry=Mcu_Init
        BswCalledEntity_1: can-enter-exclusive-area=MCU_REGISTER_PROTECTION, implemented-entry=Mcu_InitRamSection
        BswCalledEntity_2: implemented-entry=Mcu_InitClock
        BswCalledEntity_3: implemented-entry=Mcu_DistributePllClock
        BswCalledEntity_4: implemented-entry=Mcu_GetPllStatus
        BswCalledEntity_5: implemented-entry=Mcu_GetResetReason
        BswCalledEntity_6: implemented-entry=Mcu_GetResetRawValue
        BswCalledEntity_7: implemented-entry=Mcu_PerformReset
        BswCalledEntity_8: implemented-entry=Mcu_SetMode
        BswCalledEntity_9: can-enter-exclusive-area=MCU_VARIABLE_PROTECTION, implemented-entry=Mcu_GetRamState
        BswCalledEntity_10: implemented-entry=Mcu_EcmReleaseErrorOutPin
        BswCalledEntity_11: implemented-entry=Mcu_GetVersionInfo
  16 x bsw module entry, all with is-synchronous=true, sw-service-impl-policy=STANDARD:
    MCU_FEINT_ISR: is-reentrant=true, call-type=INTERRUPT, execution-context=INTERRUPT-CAT-1
    MCU_FEINT_CAT2_ISR: is-reentrant=true, call-type=INTERRUPT, execution-context=INTERRUPT-CAT-2
    MCU_ECM_EIC_ISR: is-reentrant=true, call-type=INTERRUPT, execution-context=INTERRUPT-CAT-1
    MCU_ECM_EIC_CAT2_ISR: is-reentrant=true, call-type=INTERRUPT, execution-context=INTERRUPT-CAT-2
    Mcu_Init: service-id=0, is-reentrant=false, call-type=REGULAR, execution-context=TASK
    Mcu_InitRamSection: service-id=1, is-reentrant=false, call-type=REGULAR, execution-context=TASK
    Mcu_InitClock: service-id=2, is-reentrant=false, call-type=REGULAR, execution-context=TASK
    Mcu_DistributePllClock: service-id=3, is-reentrant=false, call-type=REGULAR, execution-context=TASK
    Mcu_GetPllStatus: service-id=4, is-reentrant=true, call-type=REGULAR, execution-context=TASK
    Mcu_GetResetReason: service-id=5, is-reentrant=true, call-type=REGULAR, execution-context=TASK
    Mcu_GetResetRawValue: service-id=6, is-reentrant=true, call-type=REGULAR, execution-context=TASK
    Mcu_PerformReset: service-id=7, is-reentrant=false, call-type=REGULAR, execution-context=TASK
    Mcu_SetMode: service-id=8, is-reentrant=false, call-type=REGULAR, execution-context=TASK
    Mcu_GetRamState: service-id=10, is-reentrant=true, call-type=REGULAR, execution-context=TASK
    Mcu_EcmReleaseErrorOutPin: service-id=11, is-reentrant=false, call-type=REGULAR, execution-context=TASK
    Mcu_GetVersionInfo: service-id=9, is-reentrant=true, call-type=REGULAR, execution-context=TASK
