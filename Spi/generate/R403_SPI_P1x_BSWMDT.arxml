AUTOSAR XML (schema 4-0-3)
# COPYRIGHT
# Copyright(c) 2013-2017 Renesas Electronics Corporation
package /Renesas/EcucDefs_Spi
  bsw implementation Spi_Impl: programming-language=C, sw-version=1.6.6, vendor-id=59, ar-release-version=4.0.3, behavior=BswInternalBehavior_0, vendor-api-infix=Renesas, vendor-specific-module-def=Spi
  bsw module description Spi: module-id=83
    bsw internal behavior BswInternalBehavior_0
      exclusive area SPI_CHIP_SELECT_PROTECTION
      exclusive area SPI_RAM_DATA_PROTECTION
      70 x bsw interrupt entity:
        BswInterruptEntity_0: can-enter-exclusive-area=[SPI_CHIP_SELECT_PROTECTION, SPI_RAM_DATA_PROTECTION], implemented-entry=SPI_CSIG0_TIRE_ISR, interrupt-category=CAT-1, interrupt-source=INTCSIG0IRE
        BswInterruptEntity_1: can-enter-exclusive-area=[SPI_CHIP_SELECT_PROTECTION, SPI_RAM_DATA_PROTECTION], implemented-entry=SPI_CSIG0_TIRE_CAT2_ISR, interrupt-category=CAT-2, interrupt-source=INTCSIG0IRE
        BswInterruptEntity_2: can-enter-exclusive-area=[SPI_CHIP_SELECT_PROTECTION, SPI_RAM_DATA_PROTECTION], implemented-entry=SPI_CSIG0_TIR_ISR, interrupt-category=CAT-1, interrupt-source=INTCSIG0IR
        BswInterruptEntity_3: can-enter-exclusive-area=[SPI_CHIP_SELECT_PROTECTION, SPI_RAM_DATA_PROTECTION], implemented-entry=SPI_CSIG0_TIR_CAT2_ISR, interrupt-category=CAT-2, interrupt-source=INTCSIG0IR
        BswInterruptEntity_4: can-enter-exclusive-area=[SPI_CHIP_SELECT_PROTECTION, SPI_RAM_DATA_PROTECTION], implemented-entry=SPI_CSIG0_TIC_ISR, interrupt-category=CAT-1, interrupt-source=INTCSIG0IC
        BswInterruptEntity_5: can-enter-exclusive-area=[SPI_CHIP_SELECT_PROTECTION, SPI_RAM_DATA_PROTECTION], implemented-entry=SPI_CSIG0_TIC_CAT2_ISR, interrupt-category=CAT-2, interrupt-source=INTCSIG0IC
        BswInterruptEntity_6: can-enter-exclusive-area=SPI_RAM_DATA_PROTECTION, implemented-entry=SPI_CSIH3_TIRE_ISR, interrupt-category=CAT-1, interrupt-source=INTCSIH3IRE
        BswInterruptEntity_7: can-enter-exclusive-area=SPI_RAM_DATA_PROTECTION, implemented-entry=SPI_CSIH3_TIRE_CAT2_ISR, interrupt-category=CAT-2, interrupt-source=INTCSIH3IRE
        BswInterruptEntity_8: can-enter-exclusive-area=SPI_RAM_DATA_PROTECTION, implemented-entry=SPI_CSIH3_TIR_ISR, interrupt-category=CAT-1, interrupt-source=INTCSIH3IR
        BswInterruptEntity_9: can-enter-exclusive-area=SPI_RAM_DATA_PROTECTION, implemented-entry=SPI_CSIH3_TIR_CAT2_ISR, interrupt-category=CAT-2, interrupt-source=INTCSIH3IR
        BswInterruptEntity_10: can-enter-exclusive-area=SPI_RAM_DATA_PROTECTION, implemented-entry=SPI_CSIH3_TIC_ISR, interrupt-category=CAT-1, interrupt-source=INTCSIH3IC
        BswInterruptEntity_11: can-enter-exclusive-area=SPI_RAM_DATA_PROTECTION, implemented-entry=SPI_CSIH3_TIC_CAT2_ISR, interrupt-category=CAT-2, interrupt-source=INTCSIH3IC
        BswInterruptEntity_12: can-enter-exclusive-area=SPI_RAM_DATA_PROTECTION, implemented-entry=SPI_CSIH3_TIJC_ISR, interrupt-category=CAT-1, interrupt-source=INTCSIH3IJC
        BswInterruptEntity_13: can-enter-exclusive-area=SPI_RAM_DATA_PROTECTION, implemented-entry=SPI_CSIH3_TIJC_CAT2_ISR, interrupt-category=CAT-2, interrupt-source=INTCSIH3IJC
        BswInterruptEntity_14: can-enter-exclusive-area=SPI_RAM_DATA_PROTECTION, implemented-entry=SPI_CSIH0_TIRE_ISR, interrupt-category=CAT-1, interrupt-source=INTCSIH0IRE
        BswInterruptEntity_15: can-enter-exclusive-area=SPI_RAM_DATA_PROTECTION, implemented-entry=SPI_CSIH0_TIRE_CAT2_ISR, interrupt-category=CAT-2, interrupt-source=INTCSIH0IRE
        BswInterruptEntity_16: can-enter-exclusive-area=SPI_RAM_DATA_PROTECTION, implemented-entry=SPI_CSIH0_TIR_ISR, interrupt-category=CAT-1, interrupt-source=INTCSIH0IR
        BswInterruptEntity_17: can-enter-exclusive-area=SPI_RAM_DATA_PROTECTION, implemented-entry=SPI_CSIH0_TIR_CAT2_ISR, interrupt-category=CAT-2, interrupt-source=INTCSIH0IR
        BswInterruptEntity_18: can-enter-exclusive-area=SPI_RAM_DATA_PROTECTION, implemented-entry=SPI_CSIH0_TIC_ISR, interrupt-category=CAT-1, interrupt-source=INTCSIH0IC
        BswInterruptEntity_19: can-enter-exclusive-area=SPI_RAM_DATA_PROTECTION, implemented-entry=SPI_CSIH0_TIC_CAT2_ISR, interrupt-category=CAT-2, interrupt-source=INTCSIH0IC
        BswInterruptEntity_20: can-enter-exclusive-area=SPI_RAM_DATA_PROTECTION, implemented-entry=SPI_CSIH0_TIJC_ISR, interrupt-category=CAT-1, interrupt-source=INTCSIH0IJC
        BswInterruptEntity_21: can-enter-exclusive-area=SPI_RAM_DATA_PROTECTION, implemented-entry=SPI_CSIH0_TIJC_CAT2_ISR, interrupt-category=CAT-2, interrupt-source=INTCSIH0IJC
        BswInterruptEntity_22: can-enter-exclusive-area=SPI_RAM_DATA_PROTECTION, implemented-entry=SPI_CSIH1_TIRE_ISR, interrupt-category=CAT-1, interrupt-source=INTCSIH1IRE
        BswInterruptEntity_23: can-enter-exclusive-area=SPI_RAM_DATA_PROTECTION, implemented-entry=SPI_CSIH1_TIRE_CAT2_ISR, interrupt-category=CAT-2, interrupt-source=INTCSIH1IRE
        BswInterruptEntity_24: can-enter-exclusive-area=SPI_RAM_DATA_PROTECTION, implemented-entry=SPI_CSIH1_TIR_ISR, interrupt-category=CAT-1, interrupt-source=INTCSIH1IR
        BswInterruptEntity_25: can-enter-exclusive-area=SPI_RAM_DATA_PROTECTION, implemented-entry=SPI_CSIH1_TIR_CAT2_ISR, interrupt-category=CAT-2, interrupt-source=INTCSIH1IR
        BswInterruptEntity_26: can-enter-exclusive-area=SPI_RAM_DATA_PROTECTION, implemented-entry=SPI_CSIH1_TIC_ISR, interrupt-category=CAT-1, interrupt-source=INTCSIH1IC
        BswInterruptEntity_27: can-enter-exclusive-area=SPI_RAM_DATA_PROTECTION, implemented-entry=SPI_CSIH1_TIC_CAT2_ISR, interrupt-category=CAT-2, interrupt-source=INTCSIH1IC
        BswInterruptEntity_28: can-enter-exclusive-area=SPI_RAM_DATA_PROTECTION, implemented-entry=SPI_CSIH1_TIJC_ISR, interrupt-category=CAT-1, interrupt-source=INTCSIH1IJC
        BswInterruptEntity_29: can-enter-exclusive-area=SPI_RAM_DATA_PROTECTION, implemented-entry=SPI_CSIH1_TIJC_CAT2_ISR, interrupt-category=CAT-2, interrupt-source=INTCSIH1IJC
        BswInterruptEntity_30: can-enter-exclusive-area=SPI_RAM_DATA_PROTECTION, implemented-entry=SPI_CSIH2_TIRE_ISR, interrupt-category=CAT-1, interrupt-source=INTCSIH2IRE
        BswInterruptEntity_31: can-enter-exclusive-area=SPI_RAM_DATA_PROTECTION, implemented-entry=SPI_CSIH2_TIR_ISR, interrupt-category=CAT-1, interrupt-source=INTCSIH2IR
        BswInterruptEntity_32: can-enter-exclusive-area=SPI_RAM_DATA_PROTECTION, implemented-entry=SPI_CSIH2_TIC_ISR, interrupt-category=CAT-1, interrupt-source=INTCSIH2IC
        BswInterruptEntity_33: can-enter-exclusive-area=SPI_RAM_DATA_PROTECTION, implemented-entry=SPI_CSIH2_TIJC_ISR, interrupt-category=CAT-1, interrupt-source=INTCSIH2IJC
        BswInterruptEntity_34: can-enter-exclusive-area=SPI_RAM_DATA_PROTECTION, implemented-entry=SPI_CSIH2_TIRE_CAT2_ISR, interrupt-category=CAT-2, interrupt-source=INTCSIH2IRE
        BswInterruptEntity_35: can-enter-exclusive-area=SPI_RAM_DATA_PROTECTION, implemented-entry=SPI_CSIH2_TIR_CAT2_ISR, interrupt-category=CAT-2, interrupt-source=INTCSIH2IR
        BswInterruptEntity_36: can-enter-exclusive-area=SPI_RAM_DATA_PROTECTION, implemented-entry=SPI_CSIH2_TIC_CAT2_ISR, interrupt-category=CAT-2, interrupt-source=INTCSIH2IC
        BswInterruptEntity_37: can-enter-exclusive-area=SPI_RAM_DATA_PROTECTION, implemented-entry=SPI_CSIH2_TIJC_CAT2_ISR, interrupt-category=CAT-2, interrupt-source=INTCSIH2IJC
        BswInterruptEntity_38: can-enter-exclusive-area=SPI_RAM_DATA_PROTECTION, implemented-entry=SPI_DMA00_ISR, interrupt-category=CAT-1, interrupt-source=INTDMA0
        BswInterruptEntity_39: can-enter-exclusive-area=SPI_RAM_DATA_PROTECTION, implemented-entry=SPI_DMA00_CAT2_ISR, interrupt-category=CAT-2, interrupt-source=INTDMA0
        BswInterruptEntity_40: can-enter-exclusive-area=SPI_RAM_DATA_PROTECTION, implemented-entry=SPI_DMA01_ISR, interrupt-category=CAT-1, interrupt-source=INTDMA1
        BswInterruptEntity_41: can-enter-exclusive-area=SPI_RAM_DATA_PROTECTION, implemented-entry=SPI_DMA01_CAT2_ISR, interrupt-category=CAT-2, interrupt-source=INTDMA1
        BswInterruptEntity_42: can-enter-exclusive-area=SPI_RAM_DATA_PROTECTION, implemented-entry=SPI_DMA02_ISR, interrupt-category=CAT-1, interrupt-source=INTDMA2
        BswInterruptEntity_43: can-enter-exclusive-area=SPI_RAM_DATA_PROTECTION, implemented-entry=SPI_DMA02_CAT2_ISR, interrupt-category=CAT-2, interrupt-source=INTDMA2
        BswInterruptEntity_44: can-enter-exclusive-area=SPI_RAM_DATA_PROTECTION, implemented-entry=SPI_DMA03_ISR, interrupt-category=CAT-1, interrupt-source=INTDMA3
        BswInterruptEntity_45: can-enter-exclusive-area=SPI_RAM_DATA_PROTECTION, implemented-entry=SPI_DMA03_CAT2_ISR, interrupt-category=CAT-2, interrupt-source=INTDMA3
        BswInterruptEntity_46: can-enter-exclusive-area=SPI_RAM_DATA_PROTECTION, implemented-entry=SPI_DMA04_ISR, interrupt-category=CAT-1, interrupt-source=INTDMA4
        BswInterruptEntity_47: can-enter-exclusive-area=SPI_RAM_DATA_PROTECTION, implemented-entry=SPI_DMA04_CAT2_ISR, interrupt-category=CAT-2, interrupt-source=INTDMA4
        BswInterruptEntity_48: can-enter-exclusive-area=SPI_RAM_DATA_PROTECTION, implemented-entry=SPI_DMA05_ISR, interrupt-category=CAT-1, interrupt-source=INTDMA5
        BswInterruptEntity_49: can-enter-exclusive-area=SPI_RAM_DATA_PROTECTION, implemented-entry=SPI_DMA05_CAT2_ISR, interrupt-category=CAT-2, interrupt-source=INTDMA5
        BswInterruptEntity_50: can-enter-exclusive-area=SPI_RAM_DATA_PROTECTION, implemented-entry=SPI_DMA06_ISR, interrupt-category=CAT-1, interrupt-source=INTDMA6
        BswInterruptEntity_51: can-enter-exclusive-area=SPI_RAM_DATA_PROTECTION, implemented-entry=SPI_DMA06_CAT2_ISR, interrupt-category=CAT-2, interrupt-source=INTDMA6
        BswInterruptEntity_52: can-enter-exclusive-area=SPI_RAM_DATA_PROTECTION, implemented-entry=SPI_DMA07_ISR, interrupt-category=CAT-1, interrupt-source=INTDMA7
        BswInterruptEntity_53: can-enter-exclusive-area=SPI_RAM_DATA_PROTECTION, implemented-entry=SPI_DMA07_CAT2_ISR, interrupt-category=CAT-2, interrupt-source=INTDMA7
        BswInterruptEntity_54: can-enter-exclusive-area=SPI_RAM_DATA_PROTECTION, implemented-entry=SPI_DMA08_ISR, interrupt-category=CAT-1, interrupt-source=INTDMA8
        BswInterruptEntity_55: can-enter-exclusive-area=SPI_RAM_DATA_PROTECTION, implemented-entry=SPI_DMA08_CAT2_ISR, interrupt-category=CAT-2, interrupt-source=INTDMA8
        BswInterruptEntity_56: can-enter-exclusive-area=SPI_RAM_DATA_PROTECTION, implemented-entry=SPI_DMA09_ISR, interrupt-category=CAT-1, interrupt-source=INTDMA9
        BswInterruptEntity_57: can-enter-exclusive-area=SPI_RAM_DATA_PROTECTION, implemented-entry=SPI_DMA09_CAT2_ISR, interrupt-category=CAT-2, interrupt-source=INTDMA9
        BswInterruptEntity_58: can-enter-exclusive-area=SPI_RAM_DATA_PROTECTION, implemented-entry=SPI_DMA10_ISR, interrupt-category=CAT-1, interrupt-source=INTDMA10
        BswInterruptEntity_59: can-enter-exclusive-area=SPI_RAM_DATA_PROTECTION, implemented-entry=SPI_DMA10_CAT2_ISR, interrupt-category=CAT-2, interrupt-source=INTDMA10
        BswInterruptEntity_60: can-enter-exclusive-area=SPI_RAM_DATA_PROTECTION, implemented-entry=SPI_DMA11_ISR, interrupt-category=CAT-1, interrupt-source=INTDMA11
        BswInterruptEntity_61: can-enter-exclusive-area=SPI_RAM_DATA_PROTECTION, implemented-entry=SPI_DMA11_CAT2_ISR, interrupt-category=CAT-2, interrupt-source=INTDMA11
        BswInterruptEntity_62: can-enter-exclusive-area=SPI_RAM_DATA_PROTECTION, implemented-entry=SPI_DMA12_ISR, interrupt-category=CAT-1, interrupt-source=INTDMA12
        BswInterruptEntity_63: can-enter-exclusive-area=SPI_RAM_DATA_PROTECTION, implemented-entry=SPI_DMA12_CAT2_ISR, interrupt-category=CAT-2, interrupt-source=INTDMA12
        BswInterruptEntity_64: can-enter-exclusive-area=SPI_RAM_DATA_PROTECTION, implemented-entry=SPI_DMA13_ISR, interrupt-category=CAT-1, interrupt-source=INTDMA13
        BswInterruptEntity_65: can-enter-exclusive-area=SPI_RAM_DATA_PROTECTION, implemented-entry=SPI_DMA13_CAT2_ISR, interrupt-category=CAT-2, interrupt-source=INTDMA13
        BswInterruptEntity_66: can-enter-exclusive-area=SPI_RAM_DATA_PROTECTION, implemented-entry=SPI_DMA14_ISR, interrupt-category=CAT-1, interrupt-source=INTDMA14
        BswInterruptEntity_67: can-enter-exclusive-area=SPI_RAM_DATA_PROTECTION, implemented-entry=SPI_DMA14_CAT2_ISR, interrupt-category=CAT-2, interrupt-source=INTDMA14
        BswInterruptEntity_68: can-enter-exclusive-area=SPI_RAM_DATA_PROTECTION, implemented-entry=SPI_DMA15_ISR, interrupt-category=CAT-1, interrupt-source=INTDMA15
        BswInterruptEntity_69: can-enter-exclusive-area=SPI_RAM_DATA_PROTECTION, implemented-entry=SPI_DMA15_CAT2_ISR, interrupt-category=CAT-2, interrupt-source=INTDMA15
      16 x bsw called entity:
        BswCalledEntity_0: implemented-entry=Spi_Init
        BswCalledEntity_1: can-enter-exclusive-area=SPI_CHIP_SELECT_PROTECTION, implemented-entry=Spi_DeInit
        BswCalledEntity_2: implemented-entry=Spi_WriteIB
        BswCalledEntity_3: can-enter-exclusive-area=[SPI_RAM_DATA_PROTECTION, SPI_CHIP_SELECT_PROTECTION], implemented-entry=Spi_AsyncTransmit
        BswCalledEntity_4: implemented-entry=Spi_ReadIB
        BswCalledEntity_5: implemented-entry=Spi_SetupEB
        BswCalledEntity_6: implemented-entry=Spi_GetStatus
        BswCalledEntity_7: implemented-entry=Spi_GetJobResult
        BswCalledEntity_8: implemented-entry=Spi_GetSequenceResult
        BswCalledEntity_9: can-enter-exclusive-area=[SPI_RAM_DATA_PROTECTION, SPI_CHIP_SELECT_PROTECTION], implemented-entry=Spi_SyncTransmit
        BswCalledEntity_10: implemented-entry=Spi_GetHWUnitStatus
        BswCalledEntity_11: can-enter-exclusive-area=SPI_RAM_DATA_PROTECTION, implemented-entry=Spi_Cancel
        BswCalledEntity_12: implemented-entry=Spi_SetAsyncMode
        BswCalledEntity_13: implemented-entry=Spi_GetVersionInfo
        BswCalledEntity_14: implemented-entry=Spi_SelfTest
        BswCalledEntity_15: implemented-entry=Spi_GetErrorInfo
      bsw schedulable entity Spi_MainFunction_Handling: can-enter-exclusive-area=[SPI_RAM_DATA_PROTECTION, SPI_CHIP_SELECT_PROTECTION], minimum-start-interval=0.0000035, implemented-entry=Spi_MainFunction_Handling
      bsw timing event Evt_Spi_MainFunction_Handling: starts-on-event=Spi_MainFunction_Handling, period=0.001
  87 x bsw module entry, all with sw-service-impl-policy=STANDARD:
    SPI_CSIG0_TIRE_ISR: is-reentrant=true, is-synchronous=true, call-type=INTERRUPT, execution-context=INTERRUPT-CAT-1
    SPI_CSIG0_TIRE_CAT2_ISR: is-reentrant=true, is-synchronous=true, call-type=INTERRUPT, execution-context=INTERRUPT-CAT-2
    SPI_CSIG0_TIR_ISR: is-reentrant=true, is-synchronous=true, call-type=INTERRUPT, execution-context=INTERRUPT-CAT-1
    SPI_CSIG0_TIR_CAT2_ISR: is-reentrant=true, is-synchronous=true, call-type=INTERRUPT, execution-context=INTERRUPT-CAT-2
    SPI_CSIG0_TIC_ISR: is-reentrant=true, is-synchronous=true, call-type=INTERRUPT, execution-context=INTERRUPT-CAT-1
    SPI_CSIG0_TIC_CAT2_ISR: is-reentrant=true, is-synchronous=true, call-type=INTERRUPT, execution-context=INTERRUPT-CAT-2
    SPI_CSIH2_TIRE_ISR: is-reentrant=true, is-synchronous=true, call-type=INTERRUPT, execution-context=INTERRUPT-CAT-1
    SPI_CSIH2_TIRE_CAT2_ISR: is-reentrant=true, is-synchronous=true, call-type=INTERRUPT, execution-context=INTERRUPT-CAT-2
    SPI_CSIH2_TIR_ISR: is-reentrant=true, is-synchronous=true, call-type=INTERRUPT, execution-context=INTERRUPT-CAT-1
    SPI_CSIH2_TIR_CAT2_ISR: is-reentrant=true, is-synchronous=true, call-type=INTERRUPT, execution-context=INTERRUPT-CAT-2
    SPI_CSIH2_TIC_ISR: is-reentrant=true, is-synchronous=true, call-type=INTERRUPT, execution-context=INTERRUPT-CAT-1
    SPI_CSIH2_TIC_CAT2_ISR: is-reentrant=true, is-synchronous=true, call-type=INTERRUPT, execution-context=INTERRUPT-CAT-2
    SPI_CSIH2_TIJC_ISR: is-reentrant=true, is-synchronous=true, call-type=INTERRUPT, execution-context=INTERRUPT-CAT-1
    SPI_CSIH2_TIJC_CAT2_ISR: is-reentrant=true, is-synchronous=true, call-type=INTERRUPT, execution-context=INTERRUPT-CAT-2
    SPI_CSIH3_TIRE_ISR: is-reentrant=true, is-synchronous=true, call-type=INTERRUPT, execution-context=INTERRUPT-CAT-1
    SPI_CSIH3_TIRE_CAT2_ISR: is-reentrant=true, is-synchronous=true, call-type=INTERRUPT, execution-context=INTERRUPT-CAT-2
    SPI_CSIH3_TIR_ISR: is-reentrant=true, is-synchronous=true, call-type=INTERRUPT, execution-context=INTERRUPT-CAT-1
    SPI_CSIH3_TIR_CAT2_ISR: is-reentrant=true, is-synchronous=true, call-type=INTERRUPT, execution-context=INTERRUPT-CAT-2
    SPI_CSIH3_TIC_ISR: is-reentrant=true, is-synchronous=true, call-type=INTERRUPT, execution-context=INTERRUPT-CAT-1
    SPI_CSIH3_TIC_CAT2_ISR: is-reentrant=true, is-synchronous=true, call-type=INTERRUPT, execution-context=INTERRUPT-CAT-2
    SPI_CSIH3_TIJC_ISR: is-reentrant=true, is-synchronous=true, call-type=INTERRUPT, execution-context=INTERRUPT-CAT-1
    SPI_CSIH3_TIJC_CAT2_ISR: is-reentrant=true, is-synchronous=true, call-type=INTERRUPT, execution-context=INTERRUPT-CAT-2
    SPI_CSIH0_TIRE_ISR: is-reentrant=true, is-synchronous=true, call-type=INTERRUPT, execution-context=INTERRUPT-CAT-1
    SPI_CSIH0_TIRE_CAT2_ISR: is-reentrant=true, is-synchronous=true, call-type=INTERRUPT, execution-context=INTERRUPT-CAT-2
    SPI_CSIH0_TIR_ISR: is-reentrant=true, is-synchronous=true, call-type=INTERRUPT, execution-context=INTERRUPT-CAT-1
    SPI_CSIH0_TIR_CAT2_ISR: is-reentrant=true, is-synchronous=true, call-type=INTERRUPT, execution-context=INTERRUPT-CAT-2
    SPI_CSIH0_TIC_ISR: is-reentrant=true, is-synchronous=true, call-type=INTERRUPT, execution-context=INTERRUPT-CAT-1
    SPI_CSIH0_TIC_CAT2_ISR: is-reentrant=true, is-synchronous=true, call-type=INTERRUPT, execution-context=INTERRUPT-CAT-2
    SPI_CSIH0_TIJC_ISR: is-reentrant=true, is-synchronous=true, call-type=INTERRUPT, execution-context=INTERRUPT-CAT-1
    SPI_CSIH0_TIJC_CAT2_ISR: is-reentrant=true, is-synchronous=true, call-type=INTERRUPT, execution-context=INTERRUPT-CAT-2
    SPI_CSIH1_TIRE_ISR: is-reentrant=true, is-synchronous=true, call-type=INTERRUPT, execution-context=INTERRUPT-CAT-1
    SPI_CSIH1_TIRE_CAT2_ISR: is-reentrant=true, is-synchronous=true, call-type=INTERRUPT, execution-context=INTERRUPT-CAT-2
    SPI_CSIH1_TIR_ISR: is-reentrant=true, is-synchronous=true, call-type=INTERRUPT, execution-context=INTERRUPT-CAT-1
    SPI_CSIH1_TIR_CAT2_ISR: is-reentrant=true, is-synchronous=true, call-type=INTERRUPT, execution-context=INTERRUPT-CAT-2
    SPI_CSIH1_TIC_ISR: is-reentrant=true, is-synchronous=true, call-type=INTERRUPT, execution-context=INTERRUPT-CAT-1
    SPI_CSIH1_TIC_CAT2_ISR: is-reentrant=true, is-synchronous=true, call-type=INTERRUPT, execution-context=INTERRUPT-CAT-2
    SPI_CSIH1_TIJC_ISR: is-reentrant=true, is-synchronous=true, call-type=INTERRUPT, execution-context=INTERRUPT-CAT-1
    SPI_CSIH1_TIJC_CAT2_ISR: is-reentrant=true, is-synchronous=true, call-type=INTERRUPT, execution-context=INTERRUPT-CAT-2
    SPI_DMA00_ISR: is-reentrant=true, is-synchronous=true, call-type=INTERRUPT, execution-context=INTERRUPT-CAT-1
    SPI_DMA00_CAT2_ISR: is-reentrant=true, is-synchronous=true, call-type=INTERRUPT, execution-context=INTERRUPT-CAT-2
    SPI_DMA01_ISR: is-reentrant=true, is-synchronous=true, call-type=INTERRUPT, execution-context=INTERRUPT-CAT-1
    SPI_DMA01_CAT2_ISR: is-reentrant=true, is-synchronous=true, call-type=INTERRUPT, execution-context=INTERRUPT-CAT-2
    SPI_DMA02_ISR: is-reentrant=true, is-synchronous=true, call-type=INTERRUPT, execution-context=INTERRUPT-CAT-1
    SPI_DMA02_CAT2_ISR: is-reentrant=true, is-synchronous=true, call-type=INTERRUPT, execution-context=INTERRUPT-CAT-2
    SPI_DMA03_ISR: is-reentrant=true, is-synchronous=true, call-type=INTERRUPT, execution-context=INTERRUPT-CAT-1
    SPI_DMA03_CAT2_ISR: is-reentrant=true, is-synchronous=true, call-type=INTERRUPT, execution-context=INTERRUPT-CAT-2
    SPI_DMA04_ISR: is-reentrant=true, is-synchronous=true, call-type=INTERRUPT, execution-context=INTERRUPT-CAT-1
    SPI_DMA04_CAT2_ISR: is-reentrant=true, is-synchronous=true, call-type=INTERRUPT, execution-context=INTERRUPT-CAT-2
    SPI_DMA05_ISR: is-reentrant=true, is-synchronous=true, call-type=INTERRUPT, execution-context=INTERRUPT-CAT-1
    SPI_DMA05_CAT2_ISR: is-reentrant=true, is-synchronous=true, call-type=INTERRUPT, execution-context=INTERRUPT-CAT-2
    SPI_DMA06_ISR: is-reentrant=true, is-synchronous=true, call-type=INTERRUPT, execution-context=INTERRUPT-CAT-1
    SPI_DMA06_CAT2_ISR: is-reentrant=true, is-synchronous=true, call-type=INTERRUPT, execution-context=INTERRUPT-CAT-2
    SPI_DMA07_ISR: is-reentrant=true, is-synchronous=true, call-type=INTERRUPT, execution-context=INTERRUPT-CAT-1
    SPI_DMA07_CAT2_ISR: is-reentrant=true, is-synchronous=true, call-type=INTERRUPT, execution-context=INTERRUPT-CAT-2
    SPI_DMA08_ISR: is-reentrant=true, is-synchronous=true, call-type=INTERRUPT, execution-context=INTERRUPT-CAT-1
    SPI_DMA08_CAT2_ISR: is-reentrant=true, is-synchronous=true, call-type=INTERRUPT, execution-context=INTERRUPT-CAT-2
    SPI_DMA09_ISR: is-reentrant=true, is-synchronous=true, call-type=INTERRUPT, execution-context=INTERRUPT-CAT-1
    SPI_DMA09_CAT2_ISR: is-reentrant=true, is-synchronous=true, call-type=INTERRUPT, execution-context=INTERRUPT-CAT-2
    SPI_DMA10_ISR: is-reentrant=true, is-synchronous=true, call-type=INTERRUPT, execution-context=INTERRUPT-CAT-1
    SPI_DMA10_CAT2_ISR: is-reentrant=true, is-synchronous=true, call-type=INTERRUPT, execution-context=INTERRUPT-CAT-2
    SPI_DMA11_ISR: is-reentrant=true, is-synchronous=true, call-type=INTERRUPT, execution-context=INTERRUPT-CAT-1
    SPI_DMA11_CAT2_ISR: is-reentrant=true, is-synchronous=true, call-type=INTERRUPT, execution-context=INTERRUPT-CAT-2
    SPI_DMA12_ISR: is-reentrant=true, is-synchronous=true, call-type=INTERRUPT, execution-context=INTERRUPT-CAT-1
    SPI_DMA12_CAT2_ISR: is-reentrant=true, is-synchronous=true, call-type=INTERRUPT, execution-context=INTERRUPT-CAT-2
    SPI_DMA13_ISR: is-reentrant=true, is-synchronous=true, call-type=INTERRUPT, execution-context=INTERRUPT-CAT-1
    SPI_DMA13_CAT2_ISR: is-reentrant=true, is-synchronous=true, call-type=INTERRUPT, execution-context=INTERRUPT-CAT-2
    SPI_DMA14_ISR: is-reentrant=true, is-synchronous=true, call-type=INTERRUPT, execution-context=INTERRUPT-CAT-1
    SPI_DMA14_CAT2_ISR: is-reentrant=true, is-synchronous=true, call-type=INTERRUPT, execution-context=INTERRUPT-CAT-2
    SPI_DMA15_ISR: is-reentrant=true, is-synchronous=true, call-type=INTERRUPT, execution-context=INTERRUPT-CAT-1
    SPI_DMA15_CAT2_ISR: is-reentrant=true, is-synchronous=true, call-type=INTERRUPT, execution-context=INTERRUPT-CAT-2
    Spi_Init: service-id=0, is-reentrant=false, is-synchronous=true, call-type=REGULAR, execution-context=TASK
    Spi_DeInit: service-id=1, is-reentrant=false, is-synchronous=true, call-type=REGULAR, execution-context=TASK
    Spi_WriteIB: service-id=2, is-reentrant=true, is-synchronous=true, call-type=REGULAR, execution-context=TASK
    Spi_AsyncTransmit: service-id=3, is-reentrant=true, is-synchronous=false, call-type=REGULAR, execution-context=TASK
    Spi_ReadIB: service-id=4, is-reentrant=true, is-synchronous=true, call-type=REGULAR, execution-context=TASK
    Spi_SetupEB: service-id=5, is-reentrant=true, is-synchronous=true, call-type=REGULAR, execution-context=TASK
    Spi_GetStatus: service-id=6, is-reentrant=true, is-synchronous=true, call-type=REGULAR, execution-context=TASK
    Spi_GetJobResult: service-id=7, is-reentrant=true, is-synchronous=true, call-type=REGULAR, execution-context=TASK
    Spi_GetSequenceResult: service-id=8, is-reentrant=true, is-synchronous=true, call-type=REGULAR, execution-context=TASK
    Spi_GetVersionInfo: service-id=9, is-reentrant=true, is-synchronous=true, call-type=REGULAR, execution-context=TASK
    Spi_SyncTransmit: service-id=10, is-reentrant=true, is-synchronous=false, call-type=REGULAR, execution-context=TASK
    Spi_GetHWUnitStatus: service-id=11, is-reentrant=true, is-synchronous=true, call-type=REGULAR, execution-context=TASK
    Spi_Cancel: service-id=12, is-reentrant=true, is-synchronous=false, call-type=REGULAR, execution-context=TASK
    Spi_SetAsyncMode: service-id=13, is-reentrant=false, is-synchronous=true, call-type=REGULAR, execution-context=TASK
    Spi_SelfTest: service-id=17, is-reentrant=false, is-synchronous=true, call-type=REGULAR, execution-context=TASK
    Spi_GetErrorInfo: service-id=18, call-type=REGULAR, execution-context=TASK
    Spi_MainFunction_Handling: service-id=16, call-type=SCHEDULED, execution-context=TASK
