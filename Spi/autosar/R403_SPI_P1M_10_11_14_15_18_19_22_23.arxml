AUTOSAR XML (schema 4-0-3)
# COPYRIGHT
# Copyright(c) 2013-2017 Renesas Electronics Corporation
package /Renesas/EcucDefs_Spi
  ecuc definition collection RenesasParameterDefinition_Spi: module=Spi
  module definition Spi: refined-module-def=Spi, variants post-build  # Configuration of the SPI (Serial Peripheral Interface) module.
    container SpiGeneral  # General configuration settings for SPI-Handler.
      boolean SpiCancelApi: set at pre-compile, default-value=true  # Switches the Spi_Cancel function ON or OFF. | true: Enables the Spi_Cancel function. false: Disables the Spi_Cancel function.
      integer SpiChannelBuffersAllowed: 0..2, set at pre-compile, default-value=2  # Selects the SPI Handler/Driver Channel Buffers usage allowed and delivered. | IB = 0; EB = 1; IB/EB = 2;
      boolean SpiDevErrorDetect: set at pre-compile, default-value=false  # Switches the Development Error Detection and Notification ON or OFF. | true: Enables the Development Error Detection and Notification. false: Disables the Development Error Detection and Notification.
      boolean SpiHwStatusApi: set at pre-compile, default-value=true  # Switches the Spi_GetHWUnitStatus function ON or OFF. | true: Enables the Spi_GetHWUnitStatus function. false: Disables the Spi_GetHWUnitStatus function.
      boolean SpiInterruptibleSeqAllowed: set at pre-compile, default-value=true  # Switches the Interruptible Sequences handling functionality ON or OFF. | true: Enables the functionality of Interruptible sequence handling. false: Disables the functionality of Interruptible sequence handling. This parameter depends on SPI_LEVEL_DELIVERED value. It is only used for SPI_LEVEL_DELIVERED configured to 1 or 2.
      integer SpiLevelDelivered: 0..2, set at pre-compile, default-value=2  # Selects the SPI Handler/Driver level of scalable functionality that is available and delivered. | 0: Level 0 Simple Synchronous SPI Handler/Driver. 1: Level 1 Basic Asynchronous SPI Handler/Driver. 2: Level 2 Enhanced (Synchronous/Asynchronous) SPI Handler/Driver.
      boolean SpiSupportConcurrentSyncTransmit: set at pre-compile, default-value=false  # Specifies whether concurrent Spi_SyncTransmit() calls for different sequences shall be configurable.
      boolean SpiVersionInfoApi: set at pre-compile, default-value=true  # Switches the Spi_GetVersionInfo function ON or OFF. | true: Enables the Spi_GetVersionInfo function. false: Disables the Spi_GetVersionInfo function.
      boolean SpiDmaMode: set at pre-compile, origin=Renesas_v1.0.0, default-value=false  # This parameter switches the Spi_DmaMode ON or OFF. | true: Enables the Spi_DmaMode function. false: Disables the Spi_DmaMode function.
      enumeration SpiDmaTypeUsed: {SPI_DMA_TYPE_TWO}, set at pre-compile, origin=Renesas_v1.0.0, default-value=SPI_DMA_TYPE_TWO  # This parameter is used to differentiate the DMA type used. | SPI_DMA_TYPE_TWO: DMA type two is selected.
      boolean SpiDataConsistencyCheckEnable: set at pre-compile, origin=Renesas_v1.0.0, default-value=false  # This parameter enables/disables Data Consistency check. | true: Enables the Data Consistency Check. false: Disables the Data Consistency Check.
      enumeration SpiDataWidthSelection: {BITS_8, BITS_16, BITS_32}, set at pre-compile, origin=Renesas_v1.0.0, default-value=BITS_16  # The value of the parameter is the maximum data width selected. | BITS_8: Data Width 8 bit is selected. BITS_16: Data Width 16 bit is selected. BITS_32: Data Width 32 bit is selected.
      boolean SpiCriticalSectionProtection: set at pre-compile, origin=Renesas_v1.0.0, default-value=true  # This parameter specifies if the SPI driver CPU load can be reduced by disabling the enter/exit critical section functionality by adding a precompiled configuration parameter to the SPI driver configuration. | true: Enables the critical section functionality for the restricted area. false: Disables the critical section functionality for the restricted area.
      boolean SpiVersionCheckExternalModules: set at pre-compile, origin=Renesas_v1.0.0, default-value=true  # Enable / disable AUTOSAR Version check for inter-module dependencies. | true: AUTOSAR Version check for inter-module dependencies is enabled. false: AUTOSAR Version check for inter-module dependencies is disabled.
      boolean SpiHighPriorityHwHandlingEnable: set at pre-compile, origin=Renesas_v1.0.0, default-value=false  # Enable / disable the Spi H/W priority. | true: Spi H/W priority is enabled. false: Spi H/W priority is disabled.
      enumeration SpiDeviceName: {R7F701310, R7F701311, R7F701314, R7F701315, R7F701318, R7F701319, R7F701322, R7F701323}, set at pre-compile, origin=Renesas_v1.0.0, default-value=R7F701310  # This parameter contains the supported device name to identify the device specific C header file through Translation XML File. | R7F701310, R7F701311, R7F701314, R7F701315, R7F701318, R7F701319, R7F701322, R7F701323: This value should be child tag of TRANSLATION-FILE-PATH and DEVICE-FILE-PATH tag in Translation XML File.
      boolean SpiAlreadyInitDetCheck: set at pre-compile, origin=Renesas_v1.0.0, default-value=true  # This parameter enables / disables the SPI_E_ALREADY_INITIALIZED Det check in Spi_Init API. | true: Enables the SPI_E_ALREADY_INITIALIZED Det error check in Spi_Init API. false: Disables the SPI_E_ALREADY_INITIALIZED Det error check in Spi_Init API. For re-initialization of Driver, this parameter is to be set as false to suppress the check for SPI_E_ALREADY_INITIALIZED Det error. This parameter has no impact when DET is disabled.
      boolean SpiSeqStartNotificationEnable: set at pre-compile, origin=Renesas_v1.0.0, default-value=false  # This parameter enables / disables the check for the names configured in SpiSeqStartNotification are unique. | true: Enables the check for the names configured in SpiSeqStartNotification. false: Disables the check for the names configured in SpiSeqStartNotification.
      boolean SpiSyncSeqEndNotificationEnable: set at pre-compile, origin=Renesas_v1.0.0, default-value=false  # This parameter enables / disables the check for the names configured for synchronous transmissions in SpiSeqEndNotification. | true: Enables the check for the names configured for synchronous transmissions in SpiSeqEndNotification. false: Disables the check for the names configured for synchronous transmissions in SpiSeqEndNotification.
      boolean SpiPersistentHWConfiguration: set at pre-compile, origin=Renesas_v1.0.0, default-value=false  # This parameter enables / disables the check when HW configuration is static or dynamic HW. | true: Enables the check when HW configuration is Static. false: Disables the check when HW configuration is Static.
      enumeration SpiMaxBaudrate: {PCLK_DIV_BY_8}, set at pre-compile, origin=Renesas_v1.0.0, default-value=PCLK_DIV_BY_8  # This parameter is used to differentiate the maximum baud rate between the variants | PCLK_DIV_BY_8: Maximum acceptable baud rate for the Job should be less than or equal to PCLK/8. The Maximum and Minimum value for this parameter is PCLK_DIV_BY_8.
      integer SpiTimeOut: 2819..65535, set at pre-compile, origin=Renesas_v1.0.0, default-value=2829  # This parameter is a scalar value associated to each data indicating the number of times a loop will be executed while polling. If exceeded the loop breaks reporting a production error. Default value is set to 2829 by testing below scenario on target: - CPU clock frequency is 160MHz - 8 bit data transmission synchronously in CSIH0 in Direct access mode
      integer SpiInternalErrorBufferSize [0..1]: 0..100, set at pre-compile, origin=Renesas_v1.0.6, default-value=0  # This parameter is the maximum array size of the Error Buffer used for the internal Diagnosis. | If this parameter Configures as Zero, the Hardware Errors generated will not be stored in an internal buffer for user reference. So Spi_GetErrorInfo is not available for user. If SpiInternalErrorBufferSize is configured with the value greater than 0, SPI_INTERNAL_DIAG_BUFF will be generated as STD_ON
      enumeration SpiLoopBackSelfTest: {LoopBack_None, LoopBack_Init, LoopBack_Init_RunTime}, set at pre-compile, origin=Renesas_v1.0.6, default-value=LoopBack_None  # This parameter is used to select if the Loop back self test functionality to be done only during initialization or during init and Run time or not required to be performed | LoopBack_None: Loop Back Self Test not required to be performed during Init/Runtime. LoopBack_Init: Loop Back Self Test is required to be performed only during Initialization. LoopBack_Init_RunTime: Loop Back Self Test is required to be performed both during Initialization and Runtime. If SpiLoopBackSelfTest is configured as LoopBack_Init_RunTime then, SPI_SELF_TEST_API will be generated as STD_ON
      enumeration SpiECCSelfTest: {ECC_None, ECC_Init, ECC_Init_RunTime}, set at pre-compile, origin=Renesas_v1.0.6, default-value=ECC_None  # This parameter is used to select if the ECC self test functionality to be done only during initialization or during init and Run time or not required to be performed | ECC_None: ECC Self Test is not required to be performed during Init/Runtime. ECC_Init: ECC Self Test is required to be performed only during Initialization. ECC_Init_RunTime: ECC Self Test is required to be performed both during Initialization and Runtime. If SpiECCSelfTest is configured as ECC_Init_RunTime then, SPI_SELF_TEST_API will be generated as STD_ON
      boolean SpiInterruptConsistencyCheck: set at pre-compile, origin=Renesas_v1.0.6, default-value=false  # This parameter shall enable/disable the Interrupt consistency check functionality. | TRUE - Interrupt Consistency checks are enabled. FALSE - Interrupt Consistency checks are disabled
      enumeration SpiCSIGHWriteVerify: {WV_INIT_ONLY, WV_INIT_RUNTIME, WV_DISABLE}, set at pre-compile, origin=Renesas_v1.0.6, default-value=WV_DISABLE  # This parameter shall enable/disable the write-verify check functionality. | WV_INIT_ONLY - Enable write verify for the selected peripheral/module CSIG and CSIH only during initialize API WV_INIT_RUNTIME - Enable write verify for the selected peripheral/module CSIG and CSIH for initialize and all other APIs WV_DISABLE - Disable write verify feature.
      enumeration SpiDMAWriteVerify: {WV_INIT_ONLY, WV_INIT_RUNTIME, WV_DISABLE}, set at pre-compile, origin=Renesas_v1.0.6, default-value=WV_DISABLE  # This parameter shall enable/disable the write-verify check functionality for DMA. | WV_INIT_ONLY - Enable write verify for the selected peripheral/module DMA only during initialize API WV_INIT_RUNTIME - Enable write verify for the selected peripheral/module DMA for initialize and all other APIs WV_DISABLE - Disable write verify feature.
      boolean Spi_UseWriteVerifyErrorInterface [0..1]: set at pre-compile, origin=Renesas_v1.0.7, default-value=false  # This parameter shall enable/disable the error notification interface instead of DEM error for Write-Verify functionality. | True: User can configure error notification interface via SpiWriteVerifyErrorInterface parameter. False: Error notification for Write-Verify functionality shall be handled via DEM error.
      function name SpiWriteVerifyErrorInterface [0..1]: set at post-build, origin=Renesas_v1.0.7, default-value=NULL, regular-expression=[a-zA-Z][a-zA-Z0-9_]*  # This parameter is used to configure the name of the error notification function which shall be called with the ApiID and ErrorId when there is a Write Verify error when Spi_UseWriteVerifyErrorInterface is configured as True.
    container SpiDriver: multiple-configuration-container=true  # Configuration of one instance (if multiplicity is 1, it is the sole configuration) of an SPI driver.
      integer SpiMaxChannel: 1..256, set at pre-compile, default-value=1  # This parameter contains the number of Channels configured. It will be gathered by tools during the configuration stage.
      integer SpiMaxJob: 1..65536, set at pre-compile, default-value=1  # This parameter contains the number of jobs configured. It will be gathered by tools during the configuration stage.
      integer SpiMaxSequence: 1..256, set at pre-compile, default-value=1  # This parameter contains the number of sequences configured. It will be gathered by tools during the configuration stage.
      container SpiChannel [1..256]  # This container contains all data needed to configure one SPI-channel.
        integer SpiChannelId: 0..255, set at pre-compile, symbolic-name-value=true, default-value=0  # This parameter contains Channel ID of the SPI channel. This value will be assigned to the symbolic name derived of the SpiChannel container short name.
        enumeration SpiChannelType: {EB, IB}, set at pre-compile, default-value=IB  # This parameter contains the buffer usage with EB/IB channel. | EB: External Buffer is used. IB: SPI Handler/Driver Internal Buffer is used.
        integer SpiDataWidth: 2..32, set at post-build, default-value=16  # This parameter is the width of a transmitted data unit. If data width is greater than 16bit, then CSIHnCTL1.CSIHnEDLE bit is set to enable Extended Data Length.
        integer SpiDefaultData [0..1]: 0..4294967295, set at post-build, default-value=0  # The default data to be transmitted when (for internal buffer or external buffer) the pointer passed to Spi_WriteIB (for internal buffer) or to Spi_SetupEB (for external buffer) is NULL.
        integer SpiEbMaxLength: 1..65535, set at pre-compile, default-value=1  # This parameter contains the maximum size (in bytes) of data buffers in case of EB Channels.
        integer SpiIbNBuffers: 1..65535, set at pre-compile, default-value=1  # This parameter contains the maximum number of data buffers in case of IB Channels.
        enumeration SpiTransferStart: {LSB, MSB}, set at post-build, default-value=LSB  # This parameter defines the first starting bit for transmission. | LSB: Transmission starts with the Least Significant Bit first. MSB: Transmission starts with the Most Significant Bit first. It is linked to a hardware bit CSIHnCFGx.CSIHnDIRx.
      container SpiDemEventParameterRefs  # Container for the references to DemEventParameter elements which shall be invoked using the API Dem_ReportErrorStatus API in case the corresponding error occurs. The EventId is taken from the referenced DemEventParameter's DemEventId value. The standardized errors are provided in the container and can be extended by vendor specific error references.
        symbolic name reference SPI_E_HARDWARE_ERROR: set at pre-compile, destination=DemEventParameter  # Reference to the DemEventParameter which shall be issued when a hardware error was detected.
        symbolic name reference SPI_E_DATA_TX_TIMEOUT_FAILURE: set at pre-compile, origin=Renesas_v1.0.0, destination=DemEventParameter  # Reference to the DemEventParameter which shall be issued when a time out error was detected.
        symbolic name reference SPI_E_LOOPBACK_SELFTEST_FAILURE [0..1]: set at pre-compile, origin=Renesas_v1.0.6, destination=DemEventParameter  # Reference to the DemEventParameter which shall be issued when loop back self test error was detected.
        symbolic name reference SPI_E_ECC_SELFTEST_FAILURE [0..1]: set at pre-compile, origin=Renesas_v1.0.6, destination=DemEventParameter  # Reference to the DemEventParameter which shall be issued when Ecc self test error was detected.
        symbolic name reference SPI_E_INT_INCONSISTENT [0..1]: set at pre-compile, origin=Renesas_v1.0.6, destination=DemEventParameter  # Reference to the DemEventParameter which shall be issued when Interrupt consistency error was detected.
        symbolic name reference SPI_E_REG_WRITE_VERIFY [0..1]: set at pre-compile, origin=Renesas_v1.0.6, destination=DemEventParameter  # Reference to the DemEventParameter which shall be issued when register write error was detected.
      container SpiExternalDevice [1..65536]  # The communication settings of an external device. Closely linked to SpiJob.
        float SpiBaudrate: 0..10000000, set at post-build, default-value=0  # This parameter is the communication baudrate. This parameter is not used for implementation since the value configured for this parameter cannot be mapped directly to the register value, set SpiBaudrateConfiguration instead. | This parameter allows using a range of values, from the point of view of configuration tools, from Hz up to MHz.
        integer SpiBaudrateConfiguration: 1..4095, set at post-build, origin=Renesas_v1.0.0, default-value=1  # This parameter contains Baud Rate Selection Bits. | Baud rate calculation: PCLK/(2^m * k * 2 ). Here k value is the value selected for this parameter and m is the value (0..6) set for SpiInputClockSelect parameter.
        string SpiCsIdentifier: set at pre-compile, symbolic-name-value=true, default-value=NULL  # This parameter is the symbolic name to identify the Chip Select (CS) allocated to this Job. This parameter is not used for implementation instead SpiPortPinSelect is used to select the CS associated to Job.
        enumeration SpiCsPolarity: {HIGH, LOW}, set at post-build, default-value=HIGH  # This parameter defines the active polarity of Chip Select. | HIGH: Chip selection polarity value is high. LOW: Chip selection polarity value is low.
        enumeration SpiCsSelection [0..1]: {CS_VIA_GPIO, CS_VIA_PERIPHERAL_ENGINE}, set at post-build, default-value=CS_VIA_GPIO  # When the Chip select handling is enabled (see SpiEnableCs), then this parameter specifies if the chip select is handled automatically by Peripheral HW engine or via general purpose IO by Spi driver.
        enumeration SpiDataShiftEdge: {LEADING, TRAILING}, set at post-build, default-value=TRAILING  # This parameter defines the SPI data shift edge. | TRAILING: Falling data shift edge. LEADING: Rising data shift edge.
        boolean SpiEnableCs: set at post-build, default-value=true  # This parameter enables or disables the Chip Select handling functions. | false: The SPI IP drives the chip select lines autonomously without explicit chip select control by the driver. true: The SPI driver shall drive the chip select lines explicitly as DIO.
        enumeration SpiHwUnit: {CSIG0, CSIH0, CSIH1, CSIH2, CSIH3}, set at pre-compile, default-value=CSIG0  # This parameter is the symbolic name to identify the HW SPI Hardware microcontroller peripheral allocated to this Job. | CSIG0: Clocked Serial Interface CSIG0 is selected. CSIH0: Clocked Serial Interface CSIH0 is selected. CSIH1: Clocked Serial Interface CSIH1 is selected. CSIH2: Clocked Serial Interface CSIH2 is selected. CSIH3: Clocked Serial Interface CSIH3 is selected. Note: If configured value is CSIH HW unit related then the same value should be configured for SpiHwUnitSelection parameter in the SpiMemoryMode container.
        enumeration SpiShiftClockIdleLevel: {HIGH, LOW}, set at post-build, default-value=LOW  # This parameter defines the SPI shift clock idle level. | HIGH: Shift clock idle level is high. LOW: Shift clock idle level is low.
        float SpiTimeClk2Cs: 0..0.0001, set at post-build, default-value=0  # Timing between clock and chip select - This parameter allows to use a range of values from 0 up to 100 microseconds. This parameter is not used for implementation, set SpiClk2CsCount instead. | The real configuration-value used in software BSW-SPI is calculated out of this by the generator-tools.
        integer SpiClk2CsCount: 0..100, set at post-build, origin=Renesas_v1.0.0, default-value=0  # Loop Count between clock and chip select - This parameter allows to use a range of values from 0 to 100 counts.
        boolean SpiCsInactiveAfterLastData [0..1]: set at post-build, origin=Renesas_v1.0.0, default-value=true  # This parameter enables or disables the Chip Select to Return to Inactive functions. | true: Chip Select holds inactive level after the data transfer of the final data. false: Chip Select holds active level after the data transfer of the final data. This parameter is valid only for CSIH hardware units. It is linked to a hardware bit CSIHnCTL1. CSIHnCSRI.
        boolean SpiCsIdleEnforcement [0..1]: set at post-build, origin=Renesas_v1.0.0, default-value=false  # This parameter enables or disables Chip Select Idle Enforcement configuration. | true: Regardless of the Chip select settings of two consecutive transmissions, an idle state is inserted between the two transmissions. false: If the Chip select settings of two consecutive transmissions are same, an idle state is not inserted between the two transmissions. This parameter is valid only for CSIH hardware units. It is linked to a hardware bit CSIHnCFGx. CSIHnIDLx.
        enumeration SpiCsIdleTiming [0..1]: {IDLE_TIME_0_POINT_5, IDLE_TIME_1, IDLE_TIME_1_POINT_5, IDLE_TIME_2_POINT_5, IDLE_TIME_3_POINT_5, IDLE_TIME_4_POINT_5, IDLE_TIME_6_POINT_5, IDLE_TIME_8_POINT_5}, set at post-build, origin=Renesas_v1.0.0, default-value=IDLE_TIME_0_POINT_5  # This parameter specifies Idle Timing. | IDLE_TIME_0_POINT_5: Idle Time is selected as 0.5(transition clocks). IDLE_TIME_1: Idle Time is selected as 1(transition clocks). IDLE_TIME_1_POINT_5: Idle Time is selected as 1.5(transition clocks). IDLE_TIME_2_POINT_5: Idle Time is selected as 2.5(transition clocks). IDLE_TIME_3_POINT_5: Idle Time is selected as 3.5(transition clocks). IDLE_TIME_4_POINT_5: Idle Time is selected as 4.5(transition clocks). IDLE_TIME_6_POINT_5: Idle Time is selected as 6.5(transition clocks). IDLE_TIME_8_POINT_5: Idle Time is selected as 8.5(transition clocks).
        enumeration SpiCsHoldTiming [0..1]: {HOLD_TIME_0_POINT_5, HOLD_TIME_1, HOLD_TIME_1_POINT_5, HOLD_TIME_2_POINT_5, HOLD_TIME_3_POINT_5, HOLD_TIME_4_POINT_5, HOLD_TIME_6_POINT_5, HOLD_TIME_8_POINT_5, HOLD_TIME_9_POINT_5, HOLD_TIME_10_POINT_5, HOLD_TIME_11_POINT_5, HOLD_TIME_12_POINT_5, HOLD_TIME_14_POINT_5, HOLD_TIME_16_POINT_5, HOLD_TIME_18_POINT_5, HOLD_TIME_20_POINT_5}, set at post-build, origin=Renesas_v1.0.0, default-value=HOLD_TIME_0_POINT_5  # This parameter specifies Hold Timing. | High CS holding time should not be used with Sync Transmit function but if it is used user should make sure that next consecutive SPI action happens after CS hold time expired. HOLD_TIME_0_POINT_5: Hold Time is selected as 0.5(transition clocks). HOLD_TIME_1: Hold Time is selected as 1(transition clocks). HOLD_TIME_1_POINT_5: Hold Time is selected as 1.5(transition clocks). HOLD_TIME_2_POINT_5: Hold Time is selected as 2.5(transition clocks). HOLD_TIME_3_POINT_5: Hold Time is selected as 3.5(transition clocks). HOLD_TIME_4_POINT_5: Hold Time is selected as 4.5(transition clocks). HOLD_TIME_6_POINT_5: Hold Time is selected as 6.5(transition clocks). HOLD_TIME_8_POINT_5: Hold Time is selected as 8.5(transition clocks). HOLD_TIME_9_POINT_5: Hold Time is selected as 9.5(transition clocks). HOLD_TIME_10_POINT_5: Hold Time is selected as 10.5(transition clocks). HOLD_TIME_11_POINT_5: Hold Time is selected as 11.5(transition clocks). HOLD_TIME_12_POINT_5: Hold Time is selected as 12.5(transition clocks). HOLD_TIME_14_POINT_5: Hold Time is selected as 14.5(transition clocks). HOLD_TIME_16_POINT_5: Hold Time is selected as 16.5(transition clocks). HOLD_TIME_18_POINT_5: Hold Time is selected as 18.5(transition clocks). HOLD_TIME_20_POINT_5: Hold Time is selected as 20.5(transition clocks).
        enumeration SpiCsInterDataDelay [0..1]: {INTER_DATA_TIME_0, INTER_DATA_TIME_0_POINT_5, INTER_DATA_TIME_1, INTER_DATA_TIME_2, INTER_DATA_TIME_3, INTER_DATA_TIME_4, INTER_DATA_TIME_6, INTER_DATA_TIME_8, INTER_DATA_TIME_9, INTER_DATA_TIME_10, INTER_DATA_TIME_11, INTER_DATA_TIME_12, INTER_DATA_TIME_14, INTER_DATA_TIME_16, INTER_DATA_TIME_18, INTER_DATA_TIME_20}, set at post-build, origin=Renesas_v1.0.0, default-value=INTER_DATA_TIME_0  # This parameter specifies Inter-data Delay Timing. | INTER_DATA_TIME_0: Inter Data Time is selected as 0(transition clocks). INTER_DATA_TIME_0_POINT_5: Inter Data Time is selected as 0.5(transition clocks). INTER_DATA_TIME_1: Inter Data Time is selected as 1(transition clocks). INTER_DATA_TIME_2: Inter Data Time is selected as 2(transition clocks). INTER_DATA_TIME_3: Inter Data Time is selected as 3(transition clocks). INTER_DATA_TIME_4: Inter Data Time is selected as 4(transition clocks). INTER_DATA_TIME_6: Inter Data Time is selected as 6(transition clocks). INTER_DATA_TIME_8: Inter Data Time is selected as 8(transition clocks). INTER_DATA_TIME_9: Inter Data Time is selected as 9(transition clocks). INTER_DATA_TIME_10: Inter Data Time is selected as 10(transition clocks). INTER_DATA_TIME_11: Inter Data Time is selected as 11(transition clocks). INTER_DATA_TIME_12: Inter Data Time is selected as 12(transition clocks). INTER_DATA_TIME_14: Inter Data Time is selected as 14(transition clocks). INTER_DATA_TIME_16: Inter Data Time is selected as 16(transition clocks). INTER_DATA_TIME_18: Inter Data Time is selected as 18(transition clocks). INTER_DATA_TIME_20: Inter Data Time is selected as 20(transition clocks).
        enumeration SpiCsSetupTime [0..1]: {SETUP_TIME_0_POINT_5, SETUP_TIME_1, SETUP_TIME_1_POINT_5, SETUP_TIME_2_POINT_5, SETUP_TIME_3_POINT_5, SETUP_TIME_4_POINT_5, SETUP_TIME_6_POINT_5, SETUP_TIME_8_POINT_5, SETUP_TIME_9_POINT_5, SETUP_TIME_10_POINT_5, SETUP_TIME_11_POINT_5, SETUP_TIME_12_POINT_5, SETUP_TIME_14_POINT_5, SETUP_TIME_16_POINT_5, SETUP_TIME_18_POINT_5, SETUP_TIME_20_POINT_5}, set at post-build, origin=Renesas_v1.0.0, default-value=SETUP_TIME_0_POINT_5  # This parameter specifies Setup Timing. | SETUP_TIME_0_POINT_5: Setup time for 0.5(transition clocks). SETUP_TIME_1: Setup time for 1(transition clocks). SETUP_TIME_1_POINT_5: Setup time for 1.5(transition clocks). SETUP_TIME_2_POINT_5: Setup time for 2.5(transition clocks). SETUP_TIME_3_POINT_5: Setup time for 3.5(transition clocks). SETUP_TIME_4_POINT_5: Setup time for 4.5(transition clocks). SETUP_TIME_6_POINT_5: Setup time for 6.5(transition clocks). SETUP_TIME_8_POINT_5: Setup time for 8.5(transition clocks). SETUP_TIME_9_POINT_5: Setup time for 9.5(transition clocks). SETUP_TIME_10_POINT_5: Setup time for 10.5(transition clocks). SETUP_TIME_11_POINT_5: Setup time for 11.5(transition clocks). SETUP_TIME_12_POINT_5: Setup time for 12.5(transition clocks). SETUP_TIME_14_POINT_5: Setup time for 14.5(transition clocks). SETUP_TIME_16_POINT_5: Setup time for 16.5(transition clocks). SETUP_TIME_18_POINT_5: Setup time for 18.5(transition clocks). SETUP_TIME_20_POINT_5: Setup time for 20.5(transition clocks).
        enumeration SpiInputClockSelect: set at post-build, origin=Renesas_v1.0.0, default-value=PCLK_DIVBY_4  # This parameter contains the Prescaler Section Bits. | PCLK: PCLK (Master mode) is selected. PCLK_DIVBY_2: PCLK/2 (Master mode) is selected. PCLK_DIVBY_4: PCLK/4 (Master mode) is selected. PCLK_DIVBY_8: PCLK/8 (Master mode) is selected. PCLK_DIVBY_16: PCLK/16 (Master mode) is selected. PCLK_DIVBY_32: PCLK/32 (Master mode) is selected. PCLK_DIVBY_64: PCLK/64 (Master mode) is selected. This parameter is considered for calculation of the baudrate as following: Baud rate calculation: PCLK/(2^m * k * 2 ). Here m value is the value selected for this parameter and k is the value set for SpiBaudrateConfiguration parameter.
          PCLK
          PCLK_DIVBY_2  # PCLK/2
          PCLK_DIVBY_4  # PCLK/4
          PCLK_DIVBY_8  # PCLK/8
          PCLK_DIVBY_16  # PCLK/16
          PCLK_DIVBY_32  # PCLK/32
          PCLK_DIVBY_64  # PCLK/64
        enumeration SpiBaudrateRegisterSelect [0..1]: {CSIH_BAUDRATE_REGISTER_0, CSIH_BAUDRATE_REGISTER_1, CSIH_BAUDRATE_REGISTER_2, CSIH_BAUDRATE_REGISTER_3}, set at post-build, origin=Renesas_v1.0.0, default-value=CSIH_BAUDRATE_REGISTER_0  # This parameter contains the Baudrate Register Selection. | For CSIH, CSIHnCFGx.CSIHnBRSSx[1:0] value will be selected here. CSIH_BAUDRATE_REGISTER_0: The baud rate is set according to the CSIHnBRS0 register setting. CSIH_BAUDRATE_REGISTER_1: The baud rate is set according to the CSIHnBRS1 register setting. CSIH_BAUDRATE_REGISTER_2: The baud rate is set according to the CSIHnBRS2 register setting. CSIH_BAUDRATE_REGISTER_3: The baud rate is set according to the CSIHnBRS3 register setting. This parameter is valid only for CSIH hardware units. It is linked to a hardware bit CSIHnCFGx. CSIHnBRSSx[1:0].
        boolean SpiInterruptDelayMode: set at post-build, origin=Renesas_v1.0.0, default-value=false  # This parameter enables delay for all interrupts. | true: Half clock delay for all interrupts. false: No delay for all interrupts.
        enumeration SpiParitySelection: {NO_PARITY, PARITY_AT_ZERO, ODD_PARITY, EVEN_PARITY}, set at post-build, origin=Renesas_v1.0.0, default-value=NO_PARITY  # This parameter defines the Parity selection. | NO_PARITY: At transmission No parity is transmitted and at reception parity is not expected. PARITY_AT_ZERO: At transmission parity bit at fixed 0 is added and at reception parity bit is expected but not judged. ODD_PARITY: At transmission odd parity is added and at reception odd parity bit is expected. EVEN_PARITY: At transmission even parity is added and at reception even parity bit is expected.
        enumeration SpiBroadcastingPriority: {DOMINANT, RECESSIVE}, set at post-build, origin=Renesas_v1.0.0, default-value=DOMINANT  # This parameter defines the Recessive Configuration for Broadcasting Selection. | DOMINANT: Priority of broadcasting selection is high. RECESSIVE: Priority of broadcasting selection is low. 0: Dominant (higher priority). 1: Recessive (lower priority). It is linked to a hardware bit CSIHnCFGx.CSIHnRCBx.
        reference SpiClockFrequencyRef: set at post-build, origin=Renesas_v1.0.0, destination=McuHighspeedPeriClk  # This parameter contains Assignment of the MCU frequency for a job.
      container SpiJob [1..65536]  # All data needed to configure one SPI-Job, amongst others the connection between the internal SPI unit and the special settings for an external device is done.
        enumeration SpiHwUnitSynchronous [0..1]: {ASYNCHRONOUS, SYNCHRONOUS}, set at pre-compile, default-value=ASYNCHRONOUS  # If SpiHwUnitSynchronous is set to "SYNCHRONOUS", the SpiJob uses its containing SpiDriver in a synchronous manner. If it is set to "ASYNCHRONOUS", it uses the driver in an asynchronous way. If the parameter is not set, the SpiChannel uses the driver also in an asynchronous way.
        enumeration SpiPortPinSelect [0..8]: {PORTGROUPJTAG_0_PORTPIN_0, PORTGROUPJTAG_0_PORTPIN_1, PORTGROUPJTAG_0_PORTPIN_2, PORTGROUPJTAG_0_PORTPIN_3, PORTGROUPJTAG_0_PORTPIN_4, PORTGROUPJTAG_0_PORTPIN_5, PORTGROUP_0_PORTPIN_0, PORTGROUP_0_PORTPIN_1, PORTGROUP_0_PORTPIN_2, PORTGROUP_0_PORTPIN_3, PORTGROUP_0_PORTPIN_4, PORTGROUP_0_PORTPIN_5, PORTGROUP_0_PORTPIN_6, PORTGROUP_0_PORTPIN_7, PORTGROUP_0_PORTPIN_8, PORTGROUP_0_PORTPIN_9, PORTGROUP_0_PORTPIN_10, PORTGROUP_0_PORTPIN_11, PORTGROUP_0_PORTPIN_12, PORTGROUP_0_PORTPIN_13, PORTGROUP_0_PORTPIN_14, PORTGROUP_1_PORTPIN_0, PORTGROUP_1_PORTPIN_1, PORTGROUP_1_PORTPIN_2, PORTGROUP_1_PORTPIN_3, PORTGROUP_1_PORTPIN_4, PORTGROUP_2_PORTPIN_0, PORTGROUP_2_PORTPIN_1, PORTGROUP_2_PORTPIN_2, PORTGROUP_2_PORTPIN_3, PORTGROUP_2_PORTPIN_4, PORTGROUP_2_PORTPIN_5, PORTGROUP_2_PORTPIN_6, PORTGROUP_2_PORTPIN_7, PORTGROUP_2_PORTPIN_8, PORTGROUP_2_PORTPIN_9, PORTGROUP_2_PORTPIN_10, PORTGROUP_2_PORTPIN_11, PORTGROUP_2_PORTPIN_12, PORTGROUP_2_PORTPIN_13, PORTGROUP_2_PORTPIN_14, PORTGROUP_2_PORTPIN_15, PORTGROUP_3_PORTPIN_0, PORTGROUP_3_PORTPIN_1, PORTGROUP_3_PORTPIN_2, PORTGROUP_3_PORTPIN_3, PORTGROUP_3_PORTPIN_4, PORTGROUP_3_PORTPIN_5, PORTGROUP_3_PORTPIN_6, PORTGROUP_3_PORTPIN_7, PORTGROUP_3_PORTPIN_8, PORTGROUP_3_PORTPIN_9, PORTGROUP_3_PORTPIN_10, PORTGROUP_3_PORTPIN_11, PORTGROUP_3_PORTPIN_12, PORTGROUP_3_PORTPIN_13, PORTGROUP_3_PORTPIN_14, PORTGROUP_4_PORTPIN_0, PORTGROUP_4_PORTPIN_1, PORTGROUP_4_PORTPIN_2, PORTGROUP_4_PORTPIN_3, PORTGROUP_4_PORTPIN_4, PORTGROUP_4_PORTPIN_5, PORTGROUP_4_PORTPIN_6, PORTGROUP_4_PORTPIN_7, PORTGROUP_4_PORTPIN_8, PORTGROUP_4_PORTPIN_9, PORTGROUP_4_PORTPIN_10, PORTGROUP_4_PORTPIN_11, PORTGROUP_4_PORTPIN_12, PORTGROUP_4_PORTPIN_13, PORTGROUP_4_PORTPIN_14, PORTGROUP_5_PORTPIN_0, PORTGROUP_5_PORTPIN_1, PORTGROUP_5_PORTPIN_2, PORTGROUP_5_PORTPIN_3, PORTGROUP_5_PORTPIN_4, PORTGROUP_5_PORTPIN_5, PORTGROUP_5_PORTPIN_6, PORTGROUP_5_PORTPIN_7, PORTGROUP_5_PORTPIN_8, PORTGROUP_5_PORTPIN_9, PORTGROUP_5_PORTPIN_10, PORTGROUP_5_PORTPIN_11, PORTGROUP_5_PORTPIN_12, PORTGROUP_5_PORTPIN_13, PORTGROUP_5_PORTPIN_14, PORTGROUP_5_PORTPIN_15, CSL0, CSL1, CSL2, CSL3, CSL4, CSL5, CSL6, CSL7}, set at post-build, origin=Renesas_v1.0.0, default-value=PORTGROUP_1_PORTPIN_0  # This parameter defines the Port Pin and internal chip selection. | If the value of parameter SpiHwUnit is CSIG Hardware unit, then only one port pin should be configured as chip select. The valid chip select is any of the port pins PORTGROUP_m_PORTPIN_n or PORTGROUPJTAG_m_PORTPIN_n. If the value of parameter SpiHwUnit is CSIH Hardware unit, then single or multiple internal chip selects of CSIH Hardware unit should be configured. The valid chip select is any of the internal chip selects CSLn. If the value of parameter SpiHwUnit is CSIH0 Hardware unit, then for the chip select CSLx, x should be configured in range 0 to 7. If the value of parameter SpiHwUnit is CSIH1 Hardware unit, then for the chip select CSLx, x should be configured in range 0 to 7. If the value of parameter SpiHwUnit is CSIH2 Hardware unit, then for the chip select CSLx, x should be configured in range 0 to 7. If the value of parameter SpiHwUnit is CSIH3 Hardware unit, then for the chip select CSLx, x should be configured in range 0 to 7.
        function name SpiJobEndNotification [0..1]: set at post-build, default-value=NULL, regular-expression=[a-zA-Z][a-zA-Z0-9_]*  # This parameter is a callback routine provided by the user to notify the caller that a job has been finished.
        integer SpiJobId: 0..65535, set at pre-compile, symbolic-name-value=true, default-value=0  # This parameter contains the Job ID of the SPI job. This value will be assigned to the symbolic name derived of the SpiJob container short name.
        integer SpiJobPriority: 0..3, set at post-build, default-value=3  # Priority set accordingly to SPI093. 0 is lowest priority and 3 is highest priority.
        reference SpiDeviceAssignment: set at post-build, destination=SpiExternalDevice  # Reference to the external device used by this job.
        container SpiChannelList [1..256]  # References to SPI channels and their order within the Job.
          integer SpiChannelIndex: 0..255, set at post-build, default-value=0  # This parameter specifies the order of Channels within the Job.
          reference SpiChannelAssignment: set at post-build, destination=SpiChannel  # A job reference to a SPI channel.
      container SpiSequence [1..256]  # All data needed to configure one SPI-sequence.
        boolean SpiInterruptibleSequence: set at post-build, default-value=true  # This parameter allows or denies this Sequence to be suspended by another one. | true: This sequence can be suspended by other sequence. false: This sequence cannot be suspended by other sequence.
        function name SpiSeqStartNotification: set at post-build, origin=Renesas_v1.0.0, default-value=NULL, regular-expression=[a-zA-Z][a-zA-Z0-9_]*  # This parameter is a reference to a start notification function.
        boolean SpiHighPriorityHwSequence: set at post-build, origin=Renesas_v1.0.0, default-value=false  # Enable/Disable the high priority H/W handling. | true: Spi High Priority H/W Handling Enable. false: Spi High Priority H/W Handling Disable.
        function name SpiSeqEndNotification [0..1]: set at post-build, default-value=NULL, regular-expression=[a-zA-Z][a-zA-Z0-9_]*  # This parameter is a reference to a notification function.
        integer SpiSequenceId: 0..255, set at pre-compile, symbolic-name-value=true, default-value=0  # This parameter specifies sequence ID of the SPI sequence. This value will be assigned to the symbolic name derived of the SpiSequence container short name.
        reference SpiJobAssignment [1..65536]: set at post-build, destination=SpiJob  # A sequence references several jobs, which are executed during a communication sequence.
      container SpiMemoryMode [0..4]  # This container contains memory mode selection for CSIH HW unit.
        enumeration SpiHwUnitSelection: {CSIH0, CSIH1, CSIH2, CSIH3}, set at post-build, origin=Renesas_v1.0.0, default-value=CSIH0  # This parameter is used to select CSIH HW unit. | CSIH0: Clocked Serial Interface CSIH0 is selected. CSIH1: Clocked Serial Interface CSIH1 is selected. CSIH2: Clocked Serial Interface CSIH2 is selected. CSIH3: Clocked Serial Interface CSIH3 is selected.
        enumeration SpiMemoryModeSelection: {DIRECT_ACCESS_MODE, DUAL_BUFFER_MODE, FIFO_MODE, TX_ONLY_MODE}, set at pre-compile, origin=Renesas_v1.0.0, default-value=DIRECT_ACCESS_MODE  # This parameter defines the Memory Mode Selection. | DIRECT_ACCESS_MODE: Direct access memory mode is selected. DUAL_BUFFER_MODE: Dual buffer memory mode is selected. FIFO_MODE: FIFO buffer memory mode is selected. TX_ONLY_MODE: Transmit only memory mode is selected. It is linked to a hardware bit CSIHnMCTL0.CSIHnMMS[1:0].
      container SpiDma [0..5]  # This container contains all data needed to configure one SPI-DMA Configuration.
        enumeration SpiTxDmaChannel: {DMA0, DMA1, DMA2, DMA3, DMA4, DMA5, DMA6, DMA7, DMA8, DMA9, DMA10, DMA11, DMA12, DMA13, DMA14, DMA15}, set at pre-compile, origin=Renesas_v1.0.0, default-value=DMA0  # This parameter is the symbolic name to identify the Tx DMA allocated to Job. | DMA0: DMA channel 0 is selected. DMA1: DMA channel 1 is selected. DMA2: DMA channel 2 is selected. DMA3: DMA channel 3 is selected. DMA4: DMA channel 4 is selected. DMA5: DMA channel 5 is selected. DMA6: DMA channel 6 is selected. DMA7: DMA channel 7 is selected. DMA8: DMA channel 8 is selected. DMA9: DMA channel 9 is selected. DMA10: DMA channel 10 is selected. DMA11: DMA channel 11 is selected. DMA12: DMA channel 12 is selected. DMA13: DMA channel 13 is selected. DMA14: DMA channel 14 is selected. DMA15: DMA channel 15 is selected.
        enumeration SpiRxDmaChannel: {DMA0, DMA1, DMA2, DMA3, DMA4, DMA5, DMA6, DMA7, DMA8, DMA9, DMA10, DMA11, DMA12, DMA13, DMA14, DMA15}, set at pre-compile, origin=Renesas_v1.0.0, default-value=DMA1  # This parameter is the symbolic name to identify the Rx DMA allocated to Job. | DMA0: DMA channel 0 is selected. DMA1: DMA channel 1 is selected. DMA2: DMA channel 2 is selected. DMA3: DMA channel 3 is selected. DMA4: DMA channel 4 is selected. DMA5: DMA channel 5 is selected. DMA6: DMA channel 6 is selected. DMA7: DMA channel 7 is selected. DMA8: DMA channel 8 is selected. DMA9: DMA channel 9 is selected. DMA10: DMA channel 10 is selected. DMA11: DMA channel 11 is selected. DMA12: DMA channel 12 is selected. DMA13: DMA channel 13 is selected. DMA14: DMA channel 14 is selected. DMA15: DMA channel 15 is selected.
        enumeration SpiDmaHwUnit: {CSIG0_TXID_86_RXID_85, CSIH0_CSL0_TXID_66_RXID_65, CSIH0_CSL1_TXID_68_RXID_67, CSIH0_CSL2_TXID_70_RXID_69, CSIH1_CSL0_TXID_73_RXID_72, CSIH1_CSL1_TXID_75_RXID_74, CSIH1_CSL2_TXID_77_RXID_76, CSIH2_TXID_80_RXID_79, CSIH3_TXID_83_RXID_82}, set at post-build, origin=Renesas_v1.0.0, default-value=CSIG0_TXID_86_RXID_85  # This parameter is the symbolic name to identify the hardware unit. | CSIG0_TXID_86_RXID_85: Clocked Serial Interface CSIG0 with Tx trigger factor 85 and Rx trigger factor 86 is selected. CSIH0_CSL0_TXID_66_RXID_65: Clocked Serial Interface CSIH0 with Tx trigger factor 66 and Rx trigger factor 65 is selected. CSIH0_CSL1_TXID_68_RXID_67: Clocked Serial Interface CSIH0 with Tx trigger factor 68 and Rx trigger factor 67 is selected. CSIH0_CSL2_TXID_70_RXID_69: Clocked Serial Interface CSIH0 with Tx trigger factor 70 and Rx trigger factor 69 is selected. CSIH1_CSL0_TXID_73_RXID_72: Clocked Serial Interface CSIH1 with Tx trigger factor 73 and Rx trigger factor 72 is selected. CSIH1_CSL1_TXID_75_RXID_74: Clocked Serial Interface CSIH1 with Tx trigger factor 75 and Rx trigger factor 74 is selected. CSIH1_CSL2_TXID_77_RXID_76: Clocked Serial Interface CSIH1 with Tx trigger factor 77 and Rx trigger factor 76 is selected. CSIH2_TXID_80_RXID_79: Clocked Serial Interface CSIH2 with Tx trigger factor 80 and Rx trigger factor 79 is selected. CSIH3_TXID_83_RXID_82: Clocked Serial Interface CSIH3 with Tx trigger factor 83 and Rx trigger factor 82 is selected.
        enumeration SpiDmaTrigCtrlOnCS [0..1]: {CSIH0_CSL0_IC0_IR0_00, CSIH0_CSL0_IC0_IR0_01, CSIH0_CSL0_IC0_IR0_10, CSIH0_CSL0_IC0_IR0_11, CSIH1_CSL0_IC0_IR0_00, CSIH1_CSL0_IC0_IR0_01, CSIH1_CSL0_IC0_IR0_10, CSIH1_CSL0_IC0_IR0_11}, set at post-build, origin=Renesas_v1.0.0, default-value=CSIH0_CSL0_IC0_IR0_00  # This parameter controls the generation condition for the DMA trigger based on chip select (CSL0) active condition only for CSIH0/CSIH1. This parameter has no effect on CSIH2 and CSIH3. | CSIH0_CSL0_IC0_IR0_00: DMA trigger can be generated regardless of the CSL0 setting by both the INTCSIH0IC0S and INTCSIH0IR0S interrupts. CSIH0_CSL0_IC0_IR0_01: DMA trigger can be generated only when CSL0 is active by the INTCSIH0IR0S interrupt. CSIH0_CSL0_IC0_IR0_10: DMA trigger can be generated only when CSL0 is active by the INTCSIH0IC0S interrupt. CSIH0_CSL0_IC0_IR0_11: DMA trigger can be generated only when CSL0 is active by both INTCSIH0IC0S and INTCSIH0IR0S interrupts. CSIH1_CSL0_IC0_IR0_00: DMA trigger can be generated regardless of the CSL0 setting by both the INTCSIH0IC0S and INTCSIH0IR0S interrupts. CSIH1_CSL0_IC0_IR0_01: DMA trigger can be generated only when CSL0 is active by the INTCSIH1IR0S interrupt. CSIH1_CSL0_IC0_IR0_10: DMA trigger can be generated only when CSL0 is active by the INTCSIH1IC0S interrupt. CSIH1_CSL0_IC0_IR0_11: DMA trigger can be generated only when CSL0 is active by both the INTCSIH1IC0S and INTCSIH1IR0S interrupts.
    container SpiPublishedInformation  # Container holding all SPI specific published information parameters. This container provides the information of hardware units. This container provides the information to the upper layer and is not used for implementation.
      integer SpiMaxHwUnit: 5..5, set at published-information, default-value=5  # Number of different SPI hardware microcontroller peripherals (units/busses) available and handled by this SPI Handler/Driver module.
      container SpiCsig0 [0..1]  # This container is for CSIG0 HW unit.
        enumeration SpiSynchHwUnit: {CSIG0}, set at published-information, origin=Renesas_v1.0.0, default-value=CSIG0  # This parameter specifies prearranged synchronous HW unit.
      container SpiCsih0 [0..1]  # This container is for CSIH0 HW unit.
        enumeration SpiSynchHwUnit: {CSIH0}, set at published-information, origin=Renesas_v1.0.0, default-value=CSIH0  # This parameter specifies prearranged synchronous HW unit.
      container SpiCsih1 [0..1]  # This container is for CSIH1 HW unit.
        enumeration SpiSynchHwUnit: {CSIH1}, set at published-information, origin=Renesas_v1.0.0, default-value=CSIH1  # This parameter specifies prearranged synchronous HW unit.
      container SpiCsih2 [0..1]  # This container is for CSIH2 HW unit.
        enumeration SpiSynchHwUnit: {CSIH2}, set at published-information, origin=Renesas_v1.0.0, default-value=CSIH2  # This parameter specifies prearranged synchronous HW unit.
      container SpiCsih3 [0..1]  # This container is for CSIH3 HW unit.
        enumeration SpiSynchHwUnit: {CSIH3}, set at published-information, origin=Renesas_v1.0.0, default-value=CSIH3  # This parameter specifies prearranged synchronous HW unit.
