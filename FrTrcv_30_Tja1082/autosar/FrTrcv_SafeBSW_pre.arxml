AUTOSAR XML (schema 4-0-3)
package /MICROSAR/FrTrcv_30_Tja1082
  module config FrTrcv_Rec: definition=FrTrcv
    FrTrcvGeneral: FrTrcvSafeBswChecks=1
