AUTOSAR XML (schema 4-0-3)
package /Nxtr
  module definition MotAg1Meas [0..1]: variants pre-compile  # Configuration of the MotAg1Meas.
    container MotAg1MeasGeneral  # This container contains the configuration (parameters) of the MotAg1Meas.
      boolean DIQEPIF: set at pre-compile, origin=NXTR, default-value=false  # Disables usage of QEP readings. Motor position readings switch to SPI interface
      enumeration MOTAG1PRTCLFLTNTCNR: {NTCNR_0X083, NTCNR_0X084, NTCNR_0X085, NTCNR_0X086, NTCNR_0X087, NTCNR_0X088, NTCNR_0X089, NTCNR_0X08A}, set at pre-compile, origin=Nxtr, default-value=NTCNR_0X085  # Motor Angle 0 Protocol Fault NTC Number
