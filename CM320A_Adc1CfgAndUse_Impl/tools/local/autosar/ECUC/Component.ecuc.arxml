AUTOSAR XML (schema 4-0-3)
package /ActiveEcuC
  ecuc value collection ActiveEcuC: ecu-extract=SYSTEM, ecuc-values=[Rte, Adc1CfgAndUse, Adc1CfgAndUse]
