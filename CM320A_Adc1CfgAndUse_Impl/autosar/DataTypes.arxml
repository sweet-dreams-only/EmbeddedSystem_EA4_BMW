AUTOSAR XML (schema 4-0-3)
standard types defined: uint8, uint8_DataConstr
