AUTOSAR XML (schema 4-0-3)
package /Nxtr/PortInterfaces
  client server interface AdcScanGroupCfg_PortIf1
    operation Oper
      arg StrtPtr_Arg: type=uint8, direction=IN
      arg EndPtr_Arg: type=uint8, direction=IN
