AUTOSAR XML (schema 4-0-3)
standard types defined: uint8_DataConstr, uint8
