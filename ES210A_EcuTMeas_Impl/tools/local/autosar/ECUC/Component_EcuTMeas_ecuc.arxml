AUTOSAR XML (schema 4-0-3)
package /ActiveEcuC
  module config EcuTMeas: implementation-config-variant=VARIANT-PRE-COMPILE
    EcuTMeasGeneral: DftTemp=60, FilTau=100
    EcuTMeasConversionTables: EcuTx=0, EcuTx=4.256, EcuTx=2.57, EcuTx=3, EcuTx=4, EcuTx=5, EcuTx=0, EcuTy=0, EcuTy=-2.5896, EcuTy=-50, EcuTy=150, EcuTy=0, EcuTy=0, EcuTy=0, EcuTy=0, EcuTx=0
    EcuTMeasDiagc: Ntc0x045FailStep=3000, Ntc0x045PassStep=3000, MaxTLim=145, MinTLim=-45
