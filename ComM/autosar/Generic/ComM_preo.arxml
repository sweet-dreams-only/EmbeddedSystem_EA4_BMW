AUTOSAR XML (schema 4-0-3)
package /MICROSAR
  module config ComM_Pre: definition=ComM
  module config ComM_Rec: definition=ComM, implementation-config-variant=VARIANT-PRE-COMPILE
    ComMGeneral: ComMDevErrorDetect=1, ComMVersionInfoApi=0
