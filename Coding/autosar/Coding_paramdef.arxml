AUTOSAR XML (schema 4-3-0)
# \copyright BMW AG 2016 - 2017
package /BMW_DEF
  module definition Coding: category=VENDOR_SPECIFIC_MODULE_DEFINITION, variants pre-compile  # This container holds the configuration of the Coding module.
    container CodingArea [1..255]  # This container contains the default value for unused bits and all user configurable functions of this Coding area.
      enumeration CodingAreaDefVal: {AllBitsZero, AllBitsOne}, origin=BMW, set at pre-compile, default-value=AllBitsZero  # General default value for Coding functions within the user configurable data.
      container CodingFunction [1..2016]  # This container contains one or more Coding functions.
        integer CodingFunctionStartByte: 0..255, origin=BMW, set at pre-compile  # Startbyte of the Coding function value within the user configurable data.
        integer CodingFunctionEndByte: 0..255, origin=BMW, set at pre-compile  # Endbyte of the Coding function value within the user configurable data.
        integer CodingFunctionMask: 0..255, origin=BMW, set at pre-compile, default-value=255  # Mask of the Coding function value within the user configurable data.
        enumeration CodingFunctionApplType: {Bool, Bytearray, Float32, Float64, Sint8, Sint16, Sint32, Sint64, Uint8, Uint16, Uint32, Uint64}, origin=BMW, set at pre-compile, default-value=bytearray  # Function type of the Coding function value toward application.
        boolean CodingFunctionDataCheck: origin=BMW, set at pre-compile, default-value=false  # Specified if a check for the Coding function is needed.
        string CodingFunctionTransformationRule [0..1]: origin=BMW, set at pre-compile  # Transformation rule for the Coding function value from non volatile memory to user interface. This rule shall be configured as a linear transformation f(x)=mx+t.
        float CodingFunctionLowerLimit [0..1]: -3.4028235e+38..3.4028235e+38, origin=BMW, set at pre-compile  # Lower limit for the Coding function value within the user configurable data.
        float CodingFunctionUpperLimit [0..1]: -3.4028235e+38..3.4028235e+38, origin=BMW, set at pre-compile  # Upper limit for the Coding function value within the user configurable data.
        choice container CodingFunctionNvramType  # Function type of the Coding function value in non volatile memory.
          container Bool [0..1]  # This standard type shall only be used together with the definitions TRUE and FALSE.
            boolean CodingFunctionDefaultValue [0..1]: origin=BMW, set at pre-compile  # Default value for the Coding function within the user configurable data.
          container Uint8 [0..1]  # This standard type shall be of 8 bit unsigned.
            integer CodingFunctionDefaultValue [0..1]: 0..255, origin=BMW, set at pre-compile  # Default value for the Coding function within the user configurable data.
          container Uint16 [0..1]  # This standard type shall be of 16 bit unsigned.
            integer CodingFunctionDefaultValue [0..1]: 0..65535, origin=BMW, set at pre-compile  # Default value for the Coding function within the user configurable data.
          container Uint32 [0..1]  # This standard type shall be of 32 bit unsigned.
            integer CodingFunctionDefaultValue [0..1]: 0..4294967295, origin=BMW, set at pre-compile  # Default value for the Coding function within the user configurable data.
          container Uint64 [0..1]  # This standard type shall be of 64 bit unsigned.
            integer CodingFunctionDefaultValue [0..1]: 0..18446744073709551615, origin=BMW, set at pre-compile  # Default value for the Coding function within the user configurable data.
          container Sint8 [0..1]  # This standard type shall be of 8 bit signed.
            integer CodingFunctionDefaultValue [0..1]: -128..+127, origin=BMW, set at pre-compile  # Default value for the Coding function within the user configurable data.
          container Sint16 [0..1]  # This standard type shall be of 16 bit signed.
            integer CodingFunctionDefaultValue [0..1]: -32768..32767, origin=BMW, set at pre-compile  # Default value for the Coding function within the user configurable data.
          container Sint32 [0..1]  # This standard type shall be of 32 bit signed.
            integer CodingFunctionDefaultValue [0..1]: -2147483648..2147483647, origin=BMW, set at pre-compile  # Default value for the Coding function within the user configurable data.
          container Sint64 [0..1]  # This standard type shall be of 64 bit signed.
            integer CodingFunctionDefaultValue [0..1]: -9223372036854775808..9223372036854775807, origin=BMW, set at pre-compile  # Default value for the Coding function within the user configurable data.
          container Float32 [0..1]  # This standard type shall follow the 32-bit binary interchange format according to IEEE 754-2008.
            float CodingFunctionDefaultValue [0..1]: -3.4028235e+38..3.4028235e+38, origin=BMW, set at pre-compile  # Default value for the Coding function within the user configurable data.
          container Float64 [0..1]  # This standard type shall follow the 64-bit binary interchange format according to IEEE 754-2008.
            float CodingFunctionDefaultValue [0..1]: -1.7976931348623157e+308..1.7976931348623157e+308, origin=BMW, set at pre-compile  # Default value for the Coding function within the user configurable data.
          container Bytearray [0..1]  # This type shall be an array of 8 bit unsigned types.
            string CodingFunctionDefaultValue [0..1]: origin=BMW, set at pre-compile  # Default value for the Coding function within the user configurable data.
    choice container CodingCrypto  # Choose which Crypto adapter to use.
      container CryptoLib [0..1]: multiplicity set at pre-compile  # Configure this container to use the BMW crypto library for crypto operations.
      container Csm [0..1]: multiplicity set at pre-compile  # Configure this container to use the AUTOSAR Csm for crypto operations.
        enumeration CodingHashSize: {HASH_SHA_256_32_BYTE, HASH_SHA_384_43_BYTE, HASH_SHA_512_64_BYTE}, origin=BMW, set at pre-compile, default-value=HASH_SHA_256_32_BYTE  # Size of the hash depending on the hash method.
    container CodingGeneral  # This container contains the configuration parameter whether to use detection of development errors of the Coding module or not.
      boolean CodingConditionCheck: origin=BMW, set at pre-compile, default-value=true  # Enable the check wheter the coding ability is allowed e.g. while the car is being driven or with the engine is running.
      boolean CodingCryptoEnable: origin=BMW, set at pre-compile, default-value=true  # Disable the Service to check net coding data signature.
      boolean CodingDevErrorDetect: origin=BMW, set at pre-compile, default-value=false  # Enable the Service to report development errors of the Coding module.
      boolean CodingProdErrorCEUDDetection: origin=BMW, set at pre-compile, default-value=false  # Enable the Service to report production error CEUD of the Coding module.
      integer CodingReceiveBufferSize: 0..65535, origin=BMW, set at pre-compile, default-value=1024  # Size of coding receive buffer of control unit in bytes.
      integer CodingSendBufferSize: 0..65535, origin=BMW, set at pre-compile, default-value=1024  # Size of coding send buffer of control unit in bytes.
      enumeration CodingSignatureSize: {SIGNATURE_ECC_64_BYTE_P_256_BIT, SIGNATURE_ECC_96_BYTE_P_384_BIT, SIGNATURE_ECC_132_BYTE_P_521_BIT, SIGNATURE_RSA_256_BYTE_2048_BIT, SIGNATURE_RSA_384_BYTE_3072_BIT, SIGNATURE_RSA_512_BYTE_4096_BIT}, origin=BMW, set at pre-compile, default-value=SIGNATURE_RSA_256_BYTE_2048_BIT  # Size of the net coding data signature depending on the signature method.
    container CommonPublishedInformation  # Common container, aggregated by all modules. It contains published information about vendor and versions.
      integer SwMajorVersion: origin=BMW, set at published-information, default-value=5  # Major version number of the vendor specific implementation of the module.
      integer SwMinorVersion: origin=BMW, set at published-information, default-value=2  # Minor version number of the vendor specific implementation of the module.
      integer SwPatchVersion: origin=BMW, set at published-information, default-value=1  # Patch version number of the vendor specific implementation of the module.
