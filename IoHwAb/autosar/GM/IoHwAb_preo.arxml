AUTOSAR XML (schema 4-0-3)
# COPYRIGHT
# Copyright (c) 2016 by Vctr Informatik GmbH. All rights reserved.
# This software is copyright protected and proprietary to Vctr Informatik GmbH.
# Vctr Informatik GmbH grants to you only those rights as set out in the license conditions.
package /MICROSAR  # IoHwAb Preconfiguration
  module config IoHwAb_Pre: definition=IoHwAb
  module config IoHwAb_Rec: definition=IoHwAb, implementation-config-variant=VARIANT-PRE-COMPILE
