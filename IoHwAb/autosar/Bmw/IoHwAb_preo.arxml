AUTOSAR XML (schema 4-0-3)
package /MICROSAR
  module config IoHwAb_Pre: definition=IoHwAb
  module config IoHwAb_Rec: definition=IoHwAb, implementation-config-variant=VARIANT-PRE-COMPILE
