AUTOSAR XML (schema 4-0-3)
package /Nxtr/Calibrations
  parameter interface uint8_CalPortIf1
    parameter data prototype Val: sw-calibration-access=READ-WRITE, type=uint8
