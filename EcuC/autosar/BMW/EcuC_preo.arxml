AUTOSAR XML (schema 4-0-3)
package /MICROSAR
  module config EcuC_Pre: definition=EcuC
  module config EcuC_Rec: definition=EcuC, implementation-config-variant=VARIANT-PRE-COMPILE
    EcucGeneral: EcuCUseStdReturnTypeForRte=1
