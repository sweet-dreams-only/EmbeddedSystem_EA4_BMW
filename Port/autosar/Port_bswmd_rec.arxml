AUTOSAR XML (schema 4-0-3)
package /Renesas/EcucDefs_Port
  module config Port_Rec: definition=Port
    PortGeneral: PortVersionCheckExternalModules=0
  bsw implementation Port_Impl: programming-language=C, behavior=PortBehavior, recommended-configuration=Port_Rec, vendor-specific-module-def=Port
