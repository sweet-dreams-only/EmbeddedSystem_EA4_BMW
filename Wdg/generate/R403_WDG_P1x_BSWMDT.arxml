AUTOSAR XML (schema 4-0-3)
# COPYRIGHT
# Copyright(c) 2013-2017 Renesas Electronics Corporation
package /Renesas/EcucDefs_Wdg0
  bsw implementation Wdg_Impl: programming-language=C, sw-version=1.0.12, vendor-id=59, ar-release-version=4.0.3, behavior=BswInternalBehavior_0, vendor-api-infix=DriverA, vendor-specific-module-def=Wdg
  bsw module description Wdg: module-id=102
    bsw module dependency BswModuleDependency_0
    bsw internal behavior BswInternalBehavior_0
      exclusive area TRIGG_PROTECTION
      exclusive area MODE_SWITCH_PROTECTION
      bsw interrupt entity BswInterruptEntity_0: can-enter-exclusive-area=TRIGG_PROTECTION, implemented-entry=WDG_59_DRIVERA_TRIGGERFUNCTION_ISR, interrupt-category=CAT-1, interrupt-source=INTWDTA0
      bsw interrupt entity BswInterruptEntity_1: can-enter-exclusive-area=TRIGG_PROTECTION, implemented-entry=WDG_59_DRIVERA_TRIGGERFUNCTION_CAT2_ISR, interrupt-category=CAT-2, interrupt-source=INTWDTA0
      4 x bsw called entity:
        BswCalledEntity_0: can-enter-exclusive-area=[TRIGG_PROTECTION, MODE_SWITCH_PROTECTION], implemented-entry=Wdg_59_DriverA_Init
        BswCalledEntity_1: can-enter-exclusive-area=[TRIGG_PROTECTION, MODE_SWITCH_PROTECTION], implemented-entry=Wdg_59_DriverA_SetMode
        BswCalledEntity_2: can-enter-exclusive-area=TRIGG_PROTECTION, implemented-entry=Wdg_59_DriverA_SetTriggerCondition
        BswCalledEntity_3: implemented-entry=Wdg_59_DriverA_GetVersionInfo
  6 x bsw module entry, all with is-synchronous=true, sw-service-impl-policy=STANDARD:
    WDG_59_DRIVERA_TRIGGERFUNCTION_ISR: is-reentrant=true, call-type=INTERRUPT, execution-context=INTERRUPT-CAT-1
    WDG_59_DRIVERA_TRIGGERFUNCTION_CAT2_ISR: is-reentrant=true, call-type=INTERRUPT, execution-context=INTERRUPT-CAT-2
    Wdg_59_DriverA_Init: service-id=0, is-reentrant=false, call-type=REGULAR, execution-context=TASK
    Wdg_59_DriverA_SetMode: service-id=1, is-reentrant=false, call-type=REGULAR, execution-context=TASK
    Wdg_59_DriverA_SetTriggerCondition: service-id=3, is-reentrant=false, call-type=REGULAR, execution-context=TASK
    Wdg_59_DriverA_GetVersionInfo: service-id=4, is-reentrant=true, call-type=REGULAR, execution-context=TASK
