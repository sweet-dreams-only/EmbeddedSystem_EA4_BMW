AUTOSAR XML (schema 4-0-3)
package /InitialEcuC
  ecuc value collection InitialEcuC
