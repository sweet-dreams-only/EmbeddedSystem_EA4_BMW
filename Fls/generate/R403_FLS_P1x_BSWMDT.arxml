AUTOSAR XML (schema 4-0-3)
# COPYRIGHT
# Copyright(c) 2013-2017 Renesas Electronics Corporation
package /Renesas/EcucDefs_Fls
  bsw implementation Fls_Impl: programming-language=C, sw-version=1.0.5, vendor-id=59, ar-release-version=4.0.3, behavior=BswInternalBehavior_0, vendor-api-infix=Renesas, vendor-specific-module-def=Fls
  bsw module description Fls: module-id=92
    bsw internal behavior BswInternalBehavior_0
      exclusive area FLS_DRIVERSTATE_DATA_PROTECTION
      exclusive area FLS_REGISTER_PROTECTION
      exclusive area FLS_CODE_FLASH_DISABLED
      bsw interrupt entity BswInterruptEntity_0: can-enter-exclusive-area=FLS_REGISTER_PROTECTION, implemented-entry=FLS_FLENDNM_ISR, interrupt-category=CAT-1, interrupt-source=INTFLENDNM
      bsw interrupt entity BswInterruptEntity_1: can-enter-exclusive-area=FLS_REGISTER_PROTECTION, implemented-entry=FLS_FLENDNM_CAT2_ISR, interrupt-category=CAT-2, interrupt-source=INTFLENDNM
      bsw schedulable entity Fls_MainFunction: can-enter-exclusive-area=[FLS_DRIVERSTATE_DATA_PROTECTION, FLS_REGISTER_PROTECTION], minimum-start-interval=0.00000085, implemented-entry=Fls_MainFunction
      14 x bsw called entity:
        BswCalledEntity_0: can-enter-exclusive-area=[FLS_REGISTER_PROTECTION, FLS_CODE_FLASH_DISABLED], implemented-entry=Fls_Init
        BswCalledEntity_1: can-enter-exclusive-area=[FLS_DRIVERSTATE_DATA_PROTECTION, FLS_REGISTER_PROTECTION], implemented-entry=Fls_Erase
        BswCalledEntity_2: can-enter-exclusive-area=[FLS_DRIVERSTATE_DATA_PROTECTION, FLS_REGISTER_PROTECTION], implemented-entry=Fls_Write
        BswCalledEntity_3: can-enter-exclusive-area=FLS_DRIVERSTATE_DATA_PROTECTION, implemented-entry=Fls_Cancel
        BswCalledEntity_4: implemented-entry=Fls_GetStatus
        BswCalledEntity_5: implemented-entry=Fls_GetJobResult
        BswCalledEntity_6: can-enter-exclusive-area=[FLS_DRIVERSTATE_DATA_PROTECTION, FLS_REGISTER_PROTECTION], implemented-entry=Fls_Read
        BswCalledEntity_7: can-enter-exclusive-area=FLS_DRIVERSTATE_DATA_PROTECTION, implemented-entry=Fls_Compare
        BswCalledEntity_8: implemented-entry=Fls_SetMode
        BswCalledEntity_9: can-enter-exclusive-area=FLS_DRIVERSTATE_DATA_PROTECTION, implemented-entry=Fls_ReadImmediate
        BswCalledEntity_10: can-enter-exclusive-area=FLS_DRIVERSTATE_DATA_PROTECTION, implemented-entry=Fls_BlankCheck
        BswCalledEntity_11: can-enter-exclusive-area=FLS_DRIVERSTATE_DATA_PROTECTION, implemented-entry=Fls_Suspend
        BswCalledEntity_12: can-enter-exclusive-area=FLS_DRIVERSTATE_DATA_PROTECTION, implemented-entry=Fls_Resume
        BswCalledEntity_13: implemented-entry=Fls_GetVersionInfo
      bsw timing event Evt_Fls_MainFunction: starts-on-event=Fls_MainFunction, period=0.01
  17 x bsw module entry, all with sw-service-impl-policy=STANDARD:
    FLS_FLENDNM_ISR: is-reentrant=false, is-synchronous=false, call-type=INTERRUPT, execution-context=INTERRUPT-CAT-1
    FLS_FLENDNM_CAT2_ISR: is-reentrant=false, is-synchronous=false, call-type=INTERRUPT, execution-context=INTERRUPT-CAT-2
    Fls_MainFunction: service-id=6, is-reentrant=false, is-synchronous=false, call-type=SCHEDULED, execution-context=TASK
    Fls_Init: service-id=0, is-reentrant=false, is-synchronous=true, call-type=REGULAR, execution-context=UNSPECIFIED
    Fls_Erase: service-id=1, is-reentrant=false, is-synchronous=false, call-type=REGULAR, execution-context=UNSPECIFIED
    Fls_Write: service-id=2, is-reentrant=false, is-synchronous=false, call-type=REGULAR, execution-context=UNSPECIFIED
    Fls_Cancel: service-id=3, is-reentrant=false, is-synchronous=true, call-type=REGULAR, execution-context=UNSPECIFIED
    Fls_GetStatus: service-id=4, is-reentrant=true, is-synchronous=true, call-type=REGULAR, execution-context=UNSPECIFIED
    Fls_GetJobResult: service-id=5, is-reentrant=true, is-synchronous=true, call-type=REGULAR, execution-context=UNSPECIFIED
    Fls_Read: service-id=7, is-reentrant=false, is-synchronous=false, call-type=REGULAR, execution-context=UNSPECIFIED
    Fls_Compare: service-id=8, is-reentrant=false, is-synchronous=false, call-type=REGULAR, execution-context=UNSPECIFIED
    Fls_SetMode: service-id=9, is-reentrant=false, is-synchronous=true, call-type=REGULAR, execution-context=UNSPECIFIED
    Fls_ReadImmediate: service-id=17, is-reentrant=false, is-synchronous=false, call-type=REGULAR, execution-context=UNSPECIFIED
    Fls_BlankCheck: service-id=18, is-reentrant=false, is-synchronous=false, call-type=REGULAR, execution-context=UNSPECIFIED
    Fls_Suspend: service-id=19, is-reentrant=false, is-synchronous=false, call-type=REGULAR, execution-context=UNSPECIFIED
    Fls_Resume: service-id=20, is-reentrant=false, is-synchronous=false, call-type=REGULAR, execution-context=UNSPECIFIED
    Fls_GetVersionInfo: service-id=16, is-reentrant=true, is-synchronous=true, call-type=REGULAR, execution-context=UNSPECIFIED
