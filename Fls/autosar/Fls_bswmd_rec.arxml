AUTOSAR XML (schema 4-0-3)
package /Renesas/EcucDefs_Fls
  module config Fls_Rec: definition=Fls
    FlsGeneral: FlsVersionCheckExternalModules=0
      FlsDataFlash
    FlsConfigSet
      FlsSectorList
        FlsSector: FlsNumberOfSectors=512, FlsPageSize=4, FlsSectorIndex=0, FlsSectorSize=64, FlsSectorStartaddress=0
  bsw implementation Fls_Impl: programming-language=C, behavior=FlsBehavior, recommended-configuration=Fls_Rec, vendor-specific-module-def=Fls
