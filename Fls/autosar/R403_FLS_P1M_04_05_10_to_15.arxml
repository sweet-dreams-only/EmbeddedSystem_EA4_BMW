AUTOSAR XML (schema 4-0-3)
# COPYRIGHT
# Copyright(c) 2013-2017 Renesas Electronics Corporation
package /Renesas/EcucDefs_Fls
  ecuc definition collection RenesasParameterDefinition_Fls: module=Fls
  module definition Fls: refined-module-def=Fls, variants post-build  # Configuration of the Fls (internal or external flash driver) module.
    container FlsGeneral  # Container for general parameters of the flash driver. These parameters are always pre-compile.
      boolean FlsDevErrorDetect: set at pre-compile, default-value=true  # This parameter is used to enable and disable development error detection. | true: Development error detection enabled. false: Development error detection disabled.
      boolean FlsAcLoadOnJobStart: set at pre-compile, default-value=false  # This parameter specifies the flash driver shall load the flash access code to RAM whenever an erase or write job is started and unload (overwrite) it after that job has been finished or cancelled. This parameter is not used for the implementation. | true: Flash access code loaded on job start / unloaded on job end or error. false: Flash access code not loaded to / unloaded from RAM at all.
      boolean FlsCancelApi: set at pre-compile, default-value=false  # This parameter is used to enable and disable the Fls_Cancel function. | true: API supported / function is provided. false: API supported / function not provided.
      boolean FlsCompareApi: set at pre-compile, default-value=false  # This parameter is used to enable and disable the Fls_Compare function. | true: API supported / function is provided. false: API supported / function not provided.
      integer FlsDriverIndex: 0..254, set at pre-compile, symbolic-name-value=true, default-value=0  # This parameter specifies index of the driver, used by FEE. This parameter is not used for implementation.
      boolean FlsGetJobResultApi: set at pre-compile, default-value=false  # This parameter is used to enable and disable the Fls_GetJobResult function. | true: API supported / function is provided. false: API supported / function not provided.
      boolean FlsGetStatusApi: set at pre-compile, default-value=false  # This parameter is used to enable and disable the Fls_GetStatus function. | true: API supported / function provided. false: API not supported / function not provided.
      boolean FlsSetModeApi: set at pre-compile, default-value=false  # This parameter is used to enable and disable the Fls_SetMode function. | true: API supported / function provided. false: API not supported / function not provided.
      boolean FlsUseInterrupts: set at pre-compile, default-value=false  # This parameter specifies job processing triggered by hardware interrupt. | true: Job processing triggered by interrupt (hardware controlled). false: Job processing not triggered by interrupt (software controlled).
      boolean FlsVersionInfoApi: set at pre-compile, default-value=false  # This parameter is used to enable / disable the API to read out the modules version information. | true: Version info API enabled. false: Version info API disabled.
      boolean FlsVersionCheckExternalModules: set at pre-compile, origin=Renesas_v1.0.0, default-value=true  # Enable / disable AUTOSAR Version check for inter-module dependencies. | true: AUTOSAR Version check for inter-module dependencies is enabled. false: AUTOSAR Version check for inter-module dependencies is disabled.
      boolean FlsCriticalSectionProtection: set at pre-compile, origin=Renesas_v1.0.0, default-value=true  # This parameter specifies if the FLS driver CPU load can be reduced by disabling the enter/exit critical section functionality by adding a precompiled configuration parameter to the FLS driver configuration. | true: Enables the critical section functionality for the restricted area. false: Disables the critical section functionality for the restricted area.
      boolean FlsFaciEccCheck: set at pre-compile, origin=Renesas_v1.1.2, default-value=true  # This parameter is used to enable or disable the check to ensure the ECC error interrupt enable FACI register settings during FLS module initialization.If the user configures this parameter as true, then user should configure "FLS_E_ECC_FAILED" parameter in "FlsConfigSet" container. | true: Enables the FACI ECC interrupt enable register check functionality during initialisation. false: Disables the FACI ECC interrupt enable register check functionality during initialisation.
      boolean FlsInterruptConsistencyCheck: set at pre-compile, origin=Renesas_v1.1.2, default-value=false  # This parameter shall enable/disable the Interrupt consistency check functionality. | TRUE - Interrupt Consistency checks are enabled. FALSE - Interrupt Consistency checks are disabled
      enumeration FlsWriteVerify: {WV_DISABLE, WV_INIT_ONLY, WV_INIT_RUNTIME}, set at pre-compile, origin=Renesas_v1.1.2, default-value=WV_DISABLE  # This parameter enables selection and support of INIT_ONLY or INIT_RUNTIME register read-back functionality of FACI and ECC registers. | WV_INIT_ONLY: Enables read-back functionality on static registers. WV_INIT_RUNTIME: Enables read-back functionality on static and dynamic registers. WV_DISABLE: Disables the register read back functionality for FACI and ECC registers.
      boolean FlsUseWVErrorInterface: set at pre-compile, origin=Renesas_v1.1.2, default-value=false  # This parameter specifies whether user can configure error notification interface instead of DEM error for Write-Verify functionality.This parameter is significant only when FlsWriteVerify parameter is configured as WV_INIT_ONLY or WV_INIT_RUNTIME. | true: user can configure error notification interface via FlsWriteVerifyErrorInterface parameter. false: Error notification for Write-Verify functionality shall be handled via DEM error.
      function name FlsWriteVerifyErrorInterface [0..1]: set at post-build, origin=Renesas_v1.1.2, default-value=NULL, regular-expression=[a-zA-Z][a-zA-Z0-9_]*  # This parameter is used to configure the name of the error notification which shall be called with the ApiID and ErrorId when there is a Write Verify error.
      integer FlsLoopCount: 32..255, set at pre-compile, origin=Renesas_v1.1.2, default-value=32  # This parameter is used to avoid the risk of endless loops in FLS driver. The loop count can be minimum 32 to maximum 255
      integer FlsVirtualBoundaryAddress: 32768..32768, set at pre-compile, origin=Renesas_v1.0.0, default-value=32768  # This parameter specifies the virtual boundary address for Data Flash. This parameter is used only for the validation purpose of virtual address range of Data Flash. | Virtual Address range for Data Flash: 0 - 32767(32K - 1).
      enumeration FlsDeviceName: {R7F701304, R7F701305, R7F701310, R7F701311, R7F701312, R7F701313, R7F701314, R7F701315}, set at pre-compile, origin=Renesas_v1.0.0, default-value=R7F701312  # This parameter contains the supported device name to identify the device specific C header file through Translation XML File. | R7F701304, R7F701305, R7F701310, R7F701311, R7F701312, R7F701313, R7F701314 or R7F701315 : This value should be child tag of TRANSLATION-FILE-PATH and DEVICE-FILE-PATH tag in Translation XML File.
      integer FlsBaseAddress: 0..4294967295, set at pre-compile, default-value=0  # This parameter specifies the flash memory start address. This parameter is not used for implementation. | Configure FlsDFBaseAddress instead of this parameter.
      integer FlsTotalSize: 64..32768, set at pre-compile, default-value=32768  # This parameter specifies the total amount of flash memory in bytes that is accessible by FLS driver. The value of parameter should be configured as 64 to 32768 (32K). It is calculated as (FlsNumberOfSectors * FlsSectorSize). This parameter is not used for implementation but it may be referenced by upper layers. | Configure FlsDataFlashSize instead of this parameter.
      boolean FlsTimeoutMonitoring: set at pre-compile, origin=Renesas_v1.0.0, default-value=false  # This Parameter compiles switch to enable or disable the FlsTimeout Supervision. true: This Parameter compiles switch to enable the FlsTimeout Supervision. false: This Parameter compiles switch to disable the FlsTimeout Supervision.
      container FlsDataFlash  # This container contains the configuration parameters for the Data Flash.
        integer FlsDFBaseAddress: 4280287232..4280287232, set at pre-compile, origin=Renesas_v1.0.0, default-value=4280287232  # This parameter specifies the data flash memory start address.
        integer FlsDFBlockSize: 64..64, set at pre-compile, origin=Renesas_v1.0.0, default-value=64  # This parameter specifies the block size of data flash memory in bytes.
        integer FlsDFTotalBlocks: 512..512, set at pre-compile, origin=Renesas_v1.0.0, default-value=512  # This parameter specifies the total number of data flash blocks. There are 512 64-Byte physical blocks in Data Flash.
        function name FlsEccSedNotification [0..1]: set at post-build, origin=Renesas_v1.0.0, default-value=NULL, regular-expression=[a-zA-Z][a-zA-Z0-9_]*  # This parameter mapped to Single-bit error (SED) notification routine provided by some upper layer module.
        function name FlsEccDedNotification [0..1]: set at post-build, origin=Renesas_v1.0.0, default-value=NULL, regular-expression=[a-zA-Z][a-zA-Z0-9_]*  # This parameter mapped to Double-bit error (DED) notification routine provided by some upper layer module.
        integer FlsDataFlashSize: 32768..32768, set at pre-compile, origin=Renesas_v1.0.0, default-value=32768  # This parameter indicates the physical total size of Data Flash memory.
        boolean FlsBlankCheckApi: set at pre-compile, origin=Renesas_v1.1.0, default-value=false  # This parameter compiles switch to enable and disable the FlsBlankCheckApi function. | true: API supported / function is provided. false: API supported / function not provided.
        boolean FlsReadImmediateApi: set at pre-compile, origin=Renesas_v1.1.0, default-value=false  # This parameter compiles switch to enable and disable the FlsReadImmediateApi function. | true: API supported / function is provided. false: API supported / function not provided.
        boolean FlsSuspendApi: set at pre-compile, origin=Renesas_v1.1.0, default-value=false  # This parameter compiles switch to enable and disable the Fls_Suspend function. | true: API supported / function is provided. false: API supported / function not provided.
        boolean FlsResumeApi: set at pre-compile, origin=Renesas_v1.1.0, default-value=false  # This parameter compiles switch to enable and disable the Fls_Resume function. | true: API supported / function is provided. false: API supported / function not provided.
        reference FlsFdlCpuFrequency: set at pre-compile, origin=Renesas_v1.0.0, destination=McuClockSettingConfig  # Reference to the CPU subsystem frequency configuration, which is set in the MCU driver configuration. This reference from MCU informs the programming HW frequency to the programming Firmware. The clock value in MCU must be according to the clock supply setting of the CPU Subsystem. Please make sure to set the correct clock value in MCU configuration to avoid damage to the flash hardware.
    container FlsPublishedInformation  # This container holding all Fls specific published information parameters. | Note that these parameters do not have any configuration class setting, since they are published information.
      integer FlsAcLocationErase: 0..4294967295, set at published-information, default-value=0  # Position in RAM, to which the erase flash access code has to be loaded. This parameter is not used for implementation, since flash access code is executed from ROM (Code Flash). | Only relevant if the erase flash access code is not position independent. If this information is not provided it is assumed that the erase flash access code is position independent and that therefore the RAM position can be freely configured.
      integer FlsAcLocationWrite: 0..4294967295, set at published-information, default-value=0  # Position in RAM, to which the write flash access code has to be loaded. This parameter is not used for implementation, since flash access code is executed from ROM (Code Flash). | Only relevant if the write flash access code is not position independent. If this information is not provided it is assumed that the write flash access code is position independent and that therefore the RAM position can be freely configured.
      integer FlsAcSizeErase: 0..4294967295, set at published-information, default-value=0  # Number of bytes in RAM needed for the erase flash access code. This parameter is not used for implementation, since flash access code is executed from ROM (Code Flash).
      integer FlsAcSizeWrite: 0..4294967295, set at published-information, default-value=0  # Number of bytes in RAM needed for the write flash access code. This parameter is not used for implementation, since flash access code is executed from ROM (Code Flash).
      float FlsEraseTime: 0.01..0.01, set at published-information, default-value=0.01  # Maximum time (in seconds) to erase one complete data flash block when fPCLK >= 20MHz.
      integer FlsErasedValue: 0..4294967295, set at published-information, default-value=4294967295  # The contents of an erased flash memory cell.
      string FlsExpectedHwId: set at published-information, default-value=NULL  # Unique identifier of the hardware device that is expected by this driver (the device for which this driver has been implemented). This parameter is not used for the implementation. | Only relevant for external flash drivers.
      integer FlsSpecifiedEraseCycles: 125000..125000, set at published-information, default-value=125000  # Number of erase cycles specified for the flash device. This parameter is not used for implementation but it may be referenced by upper layers. | FLS198: If the number of specified erase cycles depends on the operating environment (temperature, voltage, ...) during reprogramming of the flash device, the minimum number for which a data retention of at least 20 years under average temperature of 85 degree Celsius can be guaranteed shall be given. Note: If there are different numbers of specified erase cycles for different flash sectors of the device this parameter has to be extended to a parameter list (similar to the sector list above). This parameter value is applicable for Data flash only.
      float FlsWriteTime: 0.0017..0.0017, set at published-information, default-value=0.0017  # Maximum time (in seconds) to program one complete word when fPCLK >= 20MHz.
      float FlsBlankCheckTime: 0.000213..0.000213, set at published-information, origin=Renesas_v1.0.0, default-value=0.000213  # Maximum time (in seconds) to do blank check before read for one data flash word.
      float FlsSuspendTime: 0.0003..0.0003, set at published-information, origin=Renesas_v1.1.0, default-value=0.0003  # Maximum time (in seconds) to perform suspend operation.This parameter is not used for implementation.
      float FlsCancelTime: 0.000050..0.000050, set at published-information, origin=Renesas_v1.1.1, default-value=0.000050  # Maximum time (in seconds) to do cancel of on going job for data flash.This parameter is not used for implementation.
    container FlsConfigSet: multiple-configuration-container=true  # Container for runtime configuration parameters of the flash driver. | Implementation Type: Fls_ConfigType.
      integer FlsAcErase: 0..4294967295, set at post-build, default-value=0  # This parameter specifies address offset in RAM to which the erase flash access code shall be loaded. Used as function pointer to access the erase flash access code. This parameter is not used for implementation, since flash access code is executed from ROM (Code Flash).
      integer FlsAcWrite: 0..4294967295, set at post-build, default-value=0  # This parameter specifies address offset in RAM to which the write flash access code shall be loaded. Used as function pointer to access the write flash access code. This parameter is not used for implementation, since flash access code is executed from ROM (Code Flash).
      float FlsCallCycle: 0..1, set at post-build, default-value=0.000001  # This parameter specifies the cycle time of calls of the flash driver's main function (in seconds). The value is calculated for 160MHz frequency.
      integer FlsTimeOutCountValue [0..1]: 1..1000000, set at pre-compile, origin=Renesas_v1.1.2, default-value=10000  # This parameter specifies the time out count required for erase, write and blank check operations during interrupt mode.Incorrect configuration of this parameter shall lead to erroneous operations of FLS Driver
      enumeration FlsDefaultMode: {MEMIF_MODE_FAST, MEMIF_MODE_SLOW}, set at post-build, default-value=MEMIF_MODE_SLOW  # This parameter is the default FLS device mode after initialization.
      function name FlsJobEndNotification [0..1]: set at post-build, default-value=NULL, regular-expression=[a-zA-Z][a-zA-Z0-9_]*  # This parameter mapped to the job end notification routine provided by some upper layer module, typically the Fee module.
      function name FlsJobErrorNotification [0..1]: set at post-build, default-value=NULL, regular-expression=[a-zA-Z][a-zA-Z0-9_]*  # This parameter mapped to the job error notification routine provided by some upper layer module, typically the Fee module.
      integer FlsMaxReadFastMode: 4..8192, set at post-build, default-value=512  # This parameter specifies the maximum number of bytes to read or compare in one cycle of the flash driver's job processing function in fast mode.
      integer FlsMaxReadNormalMode: 4..8192, set at post-build, default-value=256  # This parameter specifies the maximum number of bytes to read or compare in one cycle of the flash driver's job processing function in normal mode.
      integer FlsMaxWriteFastMode: 0..4294967295, set at post-build, default-value=0  # This parameter specifies the maximum number of bytes to write in one cycle of the flash driver's job processing function in fast mode. This parameter is not used for implementation, since fast mode is not supported by hardware for write operation.
      integer FlsMaxWriteNormalMode: 4..4, set at post-build, default-value=4  # This parameter specifies the maximum number of bytes to write in one cycle of the flash driver's job processing function in normal mode. This parameter is not used for implementation.
      integer FlsMaxEraseNormalMode: 64..64, set at post-build, origin=Renesas_v1.0.0, default-value=64  # This parameter specifies the maximum number of bytes to erase in one cycle of the flash driver's job processing function in normal mode. This value should be multiple of 64 bytes. This parameter is not used for implementation.
      integer FlsProtection: 0..4294967295, set at post-build, default-value=0  # Erase/write protection settings. Only relevant if supported by hardware. This parameter is not used for implementation.
      container FlsDemEventParameterRefs  # Container for the references to DemEventParameter elements which shall be invoked using the Dem_ReportErrorStatus API in case the corresponding error occurs. The EventId is taken from the referenced DemEventParameter's DemEventId value. The standardized errors are provided in the container and can be extended by vendor specific error references.
        symbolic name reference FLS_E_COMPARE_FAILED: set at post-build, destination=DemEventParameter  # Reference to the DemEventParameter which shall be issued when the error "Flash compare failed (HW)" has occurred.
        symbolic name reference FLS_E_ERASE_FAILED: set at post-build, destination=DemEventParameter  # Reference to the DemEventParameter which shall be issued when the error "Flash erase failed (HW)" has occurred.
        symbolic name reference FLS_E_READ_FAILED: set at post-build, destination=DemEventParameter  # Reference to the DemEventParameter which shall be issued when the error "Flash read failed (HW)" has occurred.
        symbolic name reference FLS_E_UNEXPECTED_FLASH_ID [0..1]: set at post-build, destination=DemEventParameter  # Reference to the DemEventParameter which shall be issued when the error "Expected hardware ID not matched" has occurred. This parameter is not used for implementation.
        symbolic name reference FLS_E_WRITE_FAILED: set at post-build, destination=DemEventParameter  # Reference to the DemEventParameter which shall be issued when the error "Flash write failed (HW)" has occurred.
        symbolic name reference FLS_E_READ_FAILED_DED: set at post-build, origin=Renesas_v1.0.0, destination=DemEventParameter  # Reference to the DemEventParameter which shall be issued when the error "Flash read failed (HW) due to double bit ECC error" has occurred.
        symbolic name reference FLS_E_INT_INCONSISTENT [0..1]: set at pre-compile, origin=Renesas_v1.1.2, destination=DemEventParameter  # Reference to the DemEventParameter which shall be issued when Interrupt consistency error was detected.
        symbolic name reference FLS_E_REG_WRITE_VERIFY [0..1]: set at pre-compile, origin=Renesas_v1.1.2, destination=DemEventParameter  # Reference to the DemEventParameter which shall be issued when the error "Flash register write verification failed (HW)" has occurred.
        symbolic name reference FLS_E_HW_FAILURE: set at post-build, origin=Renesas_v1.1.2, destination=DemEventParameter  # Reference to the DemEventParameter which shall be issued when the error "Flash Hardware Failure (HW)" has occurred.
        symbolic name reference FLS_E_ECC_FAILED [0..1]: set at pre-compile, origin=Renesas_v1.1.2, destination=DemEventParameter  # Reference to the DemEventParameter which shall be issued when the error "Incorrect FACI ECC register settings during initialisation (HW)" has occurred.
      container FlsExternalDriver [0..1]  # This container is present for external Flash drivers only. Internal Flash drivers do not use the parameter listed in this container, hence its multiplicity is 0 for internal drivers. This container is not used for implementation.
        symbolic name reference FlsSpiReference: set at pre-compile, destination=SpiSequence  # Reference to SPI sequence (required for external Flash drivers). This parameter is not used for implementation.
      container FlsSectorList  # This container specifies the list of flashable sectors and pages.
        container FlsSector [1..512]  # This container specifies the configuration description of a flashable sector.
          integer FlsSectorIndex: 0..0, set at pre-compile, origin=Renesas_v1.0.0, default-value=0  # This parameter specifies unique index value for data flash sector.
          integer FlsNumberOfSectors: 1..512, set at pre-compile, default-value=1  # This parameter specifies number of continuous sectors with identical values for FlsSectorSize and FlsPageSize. This parameter setting shall be in line with FlsSectorStartaddress. | FlsNumberOfSectors should be configured as 1 to 512.
          integer FlsPageSize: 4..4, set at pre-compile, default-value=4  # This parameter specifies size of one page of this sector. | Implementation Type: Fls_LengthType.
          integer FlsSectorSize: 64..64, set at pre-compile, default-value=64  # This parameter specifies size of this sector in bytes. | FlsSectorSize should be configured as 64.
          integer FlsSectorStartaddress: 0..32767, set at pre-compile, default-value=0  # This parameter specifies the start address of this sector. This parameter specifies the virtual start address. Implementation Type: Fls_AddressType. | Virtual Address range for Data Flash: 0 - 32767(32K - 1).
