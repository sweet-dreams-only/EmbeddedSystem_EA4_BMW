AUTOSAR XML (schema 4-3-0)
package /BMW_DEF
  module definition CryptoClassic: category=VENDOR_SPECIFIC_MODULE_DEFINITION, variants pre-compile
    container CommonPublishedInformation
      integer SwMajorVersion: origin=BMW, set at published-information, default-value=5  # Major version number of the vendor specific implementation of the module.
      integer SwMinorVersion: origin=BMW, set at published-information, default-value=2  # Minor version number of the vendor specific implementation of the module.
      integer SwPatchVersion: origin=BMW, set at published-information, default-value=0  # Patch version number of the vendor specific implementation of the module.
    container Crypto_Certificate
      boolean Enable_Certificate_Code: origin=BMW, set at pre-compile, default-value=true
      boolean Enable_Certificate_JumpTable: origin=BMW, set at pre-compile, default-value=true
    container Crypto_ECDSA
      boolean Enable_ECDSA_Code: origin=BMW, set at pre-compile, default-value=true
      boolean Enable_ECDSA_JumpTable: origin=BMW, set at pre-compile, default-value=true
    container Crypto_RSA
      boolean Enable_RSA_JumpTable: origin=BMW, set at pre-compile, default-value=true
    container Crypto_SHA256
      boolean Enable_SHA256_Code: origin=BMW, set at pre-compile, default-value=true  # This parameter determines whether the BMW platform software implementation of SHA256 should be used.
      boolean Enable_SHA256_JumpTable: origin=BMW, set at pre-compile, default-value=true
    container Crypto_SHA384
      boolean Enable_SHA384_Code: origin=BMW, set at pre-compile, default-value=true  # This parameter determines whether the BMW platform software implementation of SHA384 should be used.
      boolean Enable_SHA384_JumpTable: origin=BMW, set at pre-compile, default-value=true
    container Crypto_SHA512
      boolean Enable_SHA512_Code: origin=BMW, set at pre-compile, default-value=true  # This parameter determines whether the BMW platform software implementation of SHA512 should be used.
      boolean Enable_SHA512_JumpTable: origin=BMW, set at pre-compile, default-value=true
