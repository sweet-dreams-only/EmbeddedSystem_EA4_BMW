AUTOSAR XML (schema 4-0-3)
package /ActiveEcuC
  module config SerlComTrcvIf: implementation-config-variant=VARIANT-PRE-COMPILE
    SerlComTrcvIfGeneral: PASSSTEP=16384
