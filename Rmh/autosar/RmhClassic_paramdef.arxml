AUTOSAR XML (schema 4-3-0)
# \copyright BMW AG 2015 - 2017
package /BMW_DEF
  module definition RmhClassic: variants pre-compile  # Configuration of the Rmh Request Message Handler.
    container CommonPublishedInformation  # Common container, aggregated by all modules. It contains published information about vendor and versions.
      integer SwMajorVersion: origin=BMW AG, set at published-information, default-value=5  # Major version number of the vendor specific implementation of the module.
      integer SwMinorVersion: origin=BMW AG, set at published-information, default-value=0  # Minor version number of the vendor specific implementation of the module. The numbering is vendor specific.
      integer SwPatchVersion: origin=BMW AG, set at published-information, default-value=0  # Patch level version number of the vendor specific implementation of the module. The numbering is vendor specific.
    container RmhGeneral  # This container contains the configuration (parameters) of the RMH.
      boolean RmhDevErrorDetect: origin=BMW AG, set at pre-compile, default-value=false  # Activate/Deactivate the Development Error Detection and Notification. True : Development Error Detection and Notification activated False : Development Error Detection and Notification deactivated
      choice container RmhPduTriggerMode  # This enum controls how the RMH triggers requested messages Either with the support of a generated CDD component or by using dedicated trigger Com signals via RTE_Write
        container RMH_MODE_TRIGGER_IPDU_SEND [0..1]  # Use separate CDD, which wraps the call to the BSW API Com_TriggerIPDUSend
          container RmhRequestPduMapping [0..*]  # This container contains the mappings between message identifiers as transmitted in the requesting message to the corresponding Com Tx I-PDU
            integer RmhRequestedMsgId: 0..65534, origin=BMW AG
            reference RmhRequestedComTxPdu: origin=BMW AG, set at pre-compile, destination=ComIPdu  # Reference to the corresponding Com-I-PDU.
        container RMH_MODE_ZERO_LENGTH_TRIGGER_SIGNAL [0..1]  # Use S/R Ports that write a dedicated trigger signal to trigger I-PDU transmission.
          container RmhRequestPduMapping [0..*]  # This container contains the mappings between message identifiers as transmitted in the requesting message to S/R P-Port names. This allows the integrator to assign names to the ports which support the connection to the correct Com signals.
            integer RmhRequestedMsgId: 0..65534, origin=BMW AG
            string RmhTriggerSignalPPortIdentifier: origin=BMW AG
