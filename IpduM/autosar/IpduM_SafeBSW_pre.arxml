AUTOSAR XML (schema 4-0-3)
package /MICROSAR
  module config IpduM_Rec: definition=IpduM
    IpduMGeneral: IpduMSafeBswChecks=1
