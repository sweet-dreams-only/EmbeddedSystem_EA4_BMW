AUTOSAR XML (schema 4-0-3)
package /ComponentTypes
  complex device driver sw component type CDD_XcpIfXcpEveCh2MilliSec
    behavior CDD_XcpIfXcpEveCh2MilliSec_InternalBehavior
      timing event TMT_CDD_XcpIfXcpEveCh2MilliSecPer1: start-on-event=CDD_XcpIfXcpEveCh2MilliSecPer1, period=0.002
      runnable CDD_XcpIfXcpEveCh2MilliSecPer1
  swc implementation CDD_XcpIfXcpEveCh2MilliSec_Implementation: behavior=CDD_XcpIfXcpEveCh2MilliSec_InternalBehavior
    code-descriptors:
      code Default: artifact-descriptors=autosar-engineering-object={short-label=Default, category=SWSRC}
