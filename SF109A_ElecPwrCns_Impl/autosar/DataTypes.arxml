AUTOSAR XML (schema 4-0-3)
standard types defined: float32, uint8, float32_DataConstr, uint8_DataConstr
