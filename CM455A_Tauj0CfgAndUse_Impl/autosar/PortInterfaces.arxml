AUTOSAR XML (schema 4-0-3)
package /Nxtr/PortInterfaces
  sender receiver interface uint32_PortIf1: invalidation-policy{data-element=Val, handle-invalid=DONT-INVALIDATE}
    data Val: type=uint32
